VERSION ""

NS_ :

BS_:

BU_: AGSM BCM BSM CADM DMSM DTCM ECM EVCU2 GNMM HCP IPC RFHM SGW TCM
BO_ 1459 CHARGE_SCHEDULE_NEXT: 32 EVCU2
 SG_ Next_Charge_End_Time_Hr : 12|5@0+ (1,0) [0|30] "Hours" IPC,SGW
 SG_ Next_Charge_End_Time_Min : 39|4@0+ (5,0) [0|55] "min" IPC,SGW
 SG_ Next_Charge_EndDay : 31|4@0+ (1,0) [0|15] "-" IPC,SGW
 SG_ Next_Charge_Start_Time_Hr : 20|5@0+ (1,0) [0|23] "Hours" IPC,SGW
 SG_ Next_Charge_Start_Time_Min : 35|4@0+ (5,0) [0|55] "min" IPC,SGW
 SG_ Next_Charge_StartDay : 27|4@0+ (1,0) [0|15] "-" IPC,SGW
 SG_ Next_Climate_Day : 183|4@0+ (1,0) [0|15] "" SGW
 SG_ Next_Climate_Time_Hr : 172|5@0+ (1,0) [0|23] "Hours" SGW
 SG_ Next_Climate_Time_Min : 163|4@0+ (5,0) [0|55] "min" SGW
 SG_ Next_SchCabin_Temp : 4|5@0+ (0.5,16) [16|31] "°C" SGW
 SG_ Nxt_Charge_Schedule_Type : 58|2@0+ (1,0) [0|3] "" SGW
 SG_ Nxt_Ext_Charge_End_Time_Hr : 63|5@0+ (1,0) [0|31] "hours" SGW
 SG_ Nxt_Ext_Charge_End_Time_Min : 51|4@0+ (5,0) [0|75] "minutes" SGW
 SG_ Nxt_External_Charge_EndDay : 55|4@0+ (1,0) [0|15] "" SGW
 SG_ Nxt_External_Charge_ExternalTgt : 43|4@0+ (5,50) [50|125] "%" SGW
 SG_ Nxt_External_Charge_ImmediateTgt : 47|4@0+ (5,0) [0|75] "%" SGW

BO_ 1468 CLIMATE_SCHEDULE_HCP1: 32 EVCU2
 SG_ AllowClimateSchd1_Sts : 3|2@0+ (1,0) [0|2] "-" SGW
 SG_ AllowClimateSchd2_Sts : 1|2@0+ (1,0) [0|2] "-" SGW
 SG_ Climate_Cabin_Temp1_Sts : 39|5@0+ (0.5,16) [16|31] "°C" SGW
 SG_ Climate_Cabin_Temp2_Sts : 63|5@0+ (0.5,16) [16|31] "°C" SGW
 SG_ ClimateSchd1_Day_Sts : 47|8@0+ (1,0) [0|254] "-" SGW
 SG_ ClimateSchd1_Departure_Hr_Sts : 23|5@0+ (1,0) [0|30] "Hours" SGW
 SG_ ClimateSchd1_Departure_Min_Sts : 15|4@0+ (5,0) [0|70] "min" SGW
 SG_ ClimateSchd2_Day_Sts : 55|8@0+ (1,0) [0|254] "-" SGW
 SG_ ClimateSchd2_Departure_Hr_Sts : 31|5@0+ (1,0) [0|30] "Hours" SGW
 SG_ ClimateSchd2_Departure_Min_Sts : 11|4@0+ (5,0) [0|70] "min" SGW
 SG_ Enable_ClimateSchd1_Sts : 7|1@0+ (1,0) [0|1] "-" SGW
 SG_ Enable_ClimateSchd2_Sts : 6|1@0+ (1,0) [0|1] "-" SGW

BO_ 1471 CLIMATE_SCHEDULE_HU1: 32 SGW
 SG_ AllowClimateSchd1 : 3|2@0+ (1,0) [0|2] "-" EVCU2
 SG_ AllowClimateSchd2 : 1|2@0+ (1,0) [0|2] "-" EVCU2
 SG_ Climate_Cabin_Temp1 : 39|5@0+ (0.5,16) [16|31] "°C" EVCU2
 SG_ Climate_Cabin_Temp2 : 63|5@0+ (0.5,16) [16|31] "°C" EVCU2
 SG_ ClimateSchd1_Day : 47|8@0+ (1,0) [0|254] "-" EVCU2
 SG_ ClimateSchd1_Departure_Hr : 23|5@0+ (1,0) [0|30] "Hours" EVCU2
 SG_ ClimateSchd1_Departure_Min : 15|4@0+ (5,0) [0|70] "min" EVCU2
 SG_ ClimateSchd2_Day : 55|8@0+ (1,0) [0|254] "-" EVCU2
 SG_ ClimateSchd2_Departure_Hr : 31|5@0+ (1,0) [0|30] "Hours" EVCU2
 SG_ ClimateSchd2_Departure_Min : 11|4@0+ (5,0) [0|70] "min" EVCU2
 SG_ Enable_ClimateSchd1 : 7|1@0+ (1,0) [0|1] "-" EVCU2
 SG_ Enable_ClimateSchd2 : 6|1@0+ (1,0) [0|1] "-" EVCU2
 SG_ Submit_ClimateSchd1 : 5|1@0+ (1,0) [0|1] "-" EVCU2
 SG_ Submit_ClimateSchd2 : 4|1@0+ (1,0) [0|1] "-" EVCU2

BO_ 1462 CLIMATE_SCHEDULE_TBM: 32 SGW
 SG_ Climate_TBM_Cabin_Temp1 : 39|5@0+ (0.5,16) [16|31] "°C" EVCU2
 SG_ Climate_TBM_Cabin_Temp2 : 71|5@0+ (0.5,16) [16|31] "°C" EVCU2
 SG_ TBM_AllowClimateSchd1 : 3|2@0+ (1,0) [0|2] "-" EVCU2
 SG_ TBM_AllowClimateSchd2 : 1|2@0+ (1,0) [0|2] "-" EVCU2
 SG_ TBM_ClimateSchd1_Day : 47|8@0+ (1,0) [0|254] "-" EVCU2
 SG_ TBM_ClimateSchd1_Departure_Hr : 23|5@0+ (1,0) [0|30] "Hours" EVCU2
 SG_ TBM_ClimateSchd1_Departure_Min : 15|4@0+ (5,0) [0|70] "min" EVCU2
 SG_ TBM_ClimateSchd2_Day : 55|8@0+ (1,0) [0|254] "-" EVCU2
 SG_ TBM_ClimateSchd2_Departure_Hr : 31|5@0+ (1,0) [0|30] "Hours" EVCU2
 SG_ TBM_ClimateSchd2_Departure_Min : 11|4@0+ (5,0) [0|70] "min" EVCU2
 SG_ TBM_Enable_ClimateSchd1 : 7|1@0+ (1,0) [0|0] "-" EVCU2
 SG_ TBM_Enable_ClimateSchd2 : 6|1@0+ (1,0) [0|0] "-" EVCU2
 SG_ TBM_Submit_ClimateSchd1 : 5|1@0+ (1,0) [0|1] "-" EVCU2
 SG_ TBM_Submit_ClimateSchd2 : 4|1@0+ (1,0) [0|1] "-" EVCU2

BO_ 275 CVPAM_FD_Control: 32 BCM
 SG_ CRC_CVPAM_FD_Control : 191|8@0+ (1,0) [0|255] "-" BSM
 SG_ MessageCounter_CVPAM_FD_Control : 179|4@0+ (1,0) [0|15] "-" BSM
 SG_ RR_PAM_Brk_RqSts : 150|1@0+ (1,0) [0|1] "-" BSM
 SG_ RR_PAM_Dist : 161|10@0+ (1,0) [0|1022] "cm" BSM
 SG_ RR_PAM_StopControlSts : 151|1@0+ (1,0) [0|1] "-" IPC

BO_ 950 CVPAM_FD_Info: 32 BCM
 SG_ Alert_CHF : 103|3@0+ (1,0) [0|7] "-" IPC
 SG_ Alert_CHR : 114|3@0+ (1,0) [0|7] "-" IPC
 SG_ Alert_LHF : 100|3@0+ (1,0) [0|7] "-" IPC
 SG_ Alert_LHR : 111|3@0+ (1,0) [0|7] "-" IPC
 SG_ Alert_RHF : 95|3@0+ (1,0) [0|7] "-" IPC
 SG_ Alert_RHR : 108|3@0+ (1,0) [0|7] "-" IPC
 SG_ CRC_CVPAM_FD_Info : 191|8@0+ (1,0) [0|255] "-" AGSM
 SG_ FrontSensorSts : 145|2@0+ (1,0) [0|3] "-" IPC
 SG_ FT_PAM_LedControlSts : 3|2@0+ (1,0) [0|2] "-" IPC
 SG_ Graphic_CHF : 133|2@0+ (1,0) [0|3] "-" IPC
 SG_ Graphic_CHR : 139|2@0+ (1,0) [0|3] "-" IPC
 SG_ Graphic_LHF : 131|2@0+ (1,0) [0|3] "-" IPC
 SG_ Graphic_LHR : 137|2@0+ (1,0) [0|3] "-" IPC
 SG_ Graphic_RHF : 129|2@0+ (1,0) [0|3] "-" IPC
 SG_ Graphic_RHR : 135|2@0+ (1,0) [0|3] "-" IPC
 SG_ HMICode : 175|8@0+ (1,0) [0|255] "-" IPC
 SG_ MessageCounter_CVPAM_FD_Info : 179|4@0+ (1,0) [0|15] "-" AGSM
 SG_ PAM_LedControlSts : 143|2@0+ (1,0) [0|3] "-" IPC
 SG_ PAM_Off_Status_2BT : 1|2@0+ (1,0) [0|3] "-" IPC
 SG_ PAM_PopUpRqst : 167|8@0+ (1,0) [0|255] "-" IPC
 SG_ PAMSystemFault : 181|2@0+ (1,0) [0|3] "-" IPC
 SG_ ParkingManeuverActive : 66|3@0+ (1,0) [0|6] "-" AGSM,TCM
 SG_ RearSensorSts : 147|2@0+ (1,0) [0|3] "-" IPC
 SG_ SPMControlSts : 183|2@0+ (1,0) [0|1] "-" ECM,IPC

BO_ 161 DBSM2_A1: 32 BCM
 SG_ BATTERY_voltage : 15|8@0+ (0.05,6) [6|18.7] "" Vector__XXX
 SG_ BATTERY2_voltage : 23|8@0+ (0.05,6) [6|18.7] "" Vector__XXX
 SG_ CRC_DBSM2_1 : 63|8@0+ (1,0) [0|0] "" Vector__XXX
 SG_ DBSM2_internal_error : 3|1@0+ (1,0) [0|1] "" Vector__XXX
 SG_ ESS_input_active : 1|1@0+ (1,0) [0|1] "" Vector__XXX
 SG_ L2plus_ack : 6|1@0+ (1,0) [0|1] "" Vector__XXX
 SG_ MC_DBSM2_1 : 55|4@0+ (1,0) [0|15] "" Vector__XXX
 SG_ overcurrent_detected : 4|1@0+ (1,0) [0|1] "" Vector__XXX
 SG_ overtemp_detected : 2|1@0+ (1,0) [0|1] "" Vector__XXX
 SG_ RsErr_DBSM2 : 7|1@0+ (1,0) [0|1] "" Vector__XXX
 SG_ switch_status_OpenClose : 0|1@0+ (1,0) [0|1] "" Vector__XXX
 SG_ undervoltage_detected : 5|1@0+ (1,0) [0|1] "" Vector__XXX

BO_ 2564440305 DIAGNOSTIC_REQUEST_BCM: 8 SGW
 SG_ N_PDU : 7|64@0+ (1,0) [0|0] "" BCM

BO_ 2564434161 DIAGNOSTIC_REQUEST_BSM: 8 SGW
 SG_ N_PDU : 7|64@0+ (1,0) [0|0] "" BSM

BO_ 2564435697 DIAGNOSTIC_REQUEST_CADM: 8 SGW
 SG_ N_PDU : 7|64@0+ (1,0) [0|0] "" CADM

BO_ 2564462577 DIAGNOSTIC_REQUEST_DMSM: 8 SGW
 SG_ N_PDU : 7|64@0+ (1,0) [0|0] "" DMSM

BO_ 2564430577 DIAGNOSTIC_REQUEST_DTCM: 8 SGW
 SG_ N_PDU : 7|64@0+ (1,0) [0|0] "" DTCM

BO_ 2564428017 DIAGNOSTIC_REQUEST_ECM: 8 SGW
 SG_ N_PDU : 7|64@0+ (1,0) [0|0] "" ECM

BO_ 2564440817 DIAGNOSTIC_REQUEST_EVCU2: 8 SGW
 SG_ N_PDU : 7|64@0+ (1,0) [0|0] "" EVCU2

BO_ 2564440306 DIAGNOSTIC_REQUEST_FD_BCM: 64 SGW
 SG_ N_PDU : 7|64@0+ (1,0) [0|0] "" BCM

BO_ 2564434162 DIAGNOSTIC_REQUEST_FD_BSM: 64 SGW
 SG_ N_PDU : 7|64@0+ (1,0) [0|0] "" BSM

BO_ 2564435698 DIAGNOSTIC_REQUEST_FD_CADM: 64 SGW
 SG_ N_PDU : 7|64@0+ (1,0) [0|0] "" CADM

BO_ 2564462578 DIAGNOSTIC_REQUEST_FD_DMSM: 64 SGW
 SG_ N_PDU : 7|64@0+ (1,0) [0|0] "" DMSM

BO_ 2564430578 DIAGNOSTIC_REQUEST_FD_DTCM: 64 SGW
 SG_ N_PDU : 7|64@0+ (1,0) [0|0] "" DTCM

BO_ 2564428018 DIAGNOSTIC_REQUEST_FD_ECM: 64 SGW
 SG_ N_PDU : 7|64@0+ (1,0) [0|0] "" ECM

BO_ 2564427762 DIAGNOSTIC_REQUEST_FD_FLDHM: 64 SGW
 SG_ N_PDU : 7|64@0+ (1,0) [0|0] "" RFHM

BO_ 2564427506 DIAGNOSTIC_REQUEST_FD_FRDHM: 64 SGW
 SG_ N_PDU : 7|64@0+ (1,0) [0|0] "" RFHM

BO_ 2564554482 DIAGNOSTIC_REQUEST_FD_FUNCTIONAL: 64 SGW
 SG_ N_PDU : 7|64@0+ (1,0) [0|0] "" AGSM,BCM,BSM,CADM,DMSM,DTCM,ECM,GNMM,IPC,RFHM,TCM

BO_ 2564437234 DIAGNOSTIC_REQUEST_FD_GNMM: 64 SGW
 SG_ N_PDU : 7|64@0+ (1,0) [0|0] "" GNMM

BO_ 2564448498 DIAGNOSTIC_REQUEST_FD_IPC: 64 SGW
 SG_ N_PDU : 7|64@0+ (1,0) [0|0] "" IPC

BO_ 2564429042 DIAGNOSTIC_REQUEST_FD_MCPA: 64 SGW
 SG_ N_PDU : 7|64@0+ (1,0) [0|0] "" EVCU2

BO_ 2564429298 DIAGNOSTIC_REQUEST_FD_MCPB: 64 SGW
 SG_ N_PDU : 7|64@0+ (1,0) [0|0] "" EVCU2

BO_ 2564474866 DIAGNOSTIC_REQUEST_FD_RFHM: 64 SGW
 SG_ N_PDU : 7|64@0+ (1,0) [0|0] "" RFHM

BO_ 2564455666 DIAGNOSTIC_REQUEST_FD_SGCP: 64 SGW
 SG_ N_PDU : 7|64@0+ (1,0) [0|0] "" EVCU2

BO_ 2564431858 DIAGNOSTIC_REQUEST_FD_SHIFTER: 64 SGW
 SG_ N_PDU : 7|64@0+ (1,0) [0|0] "" AGSM

BO_ 2564430066 DIAGNOSTIC_REQUEST_FD_TRANSM: 64 SGW
 SG_ N_PDU : 7|64@0+ (1,0) [0|0] "" TCM

BO_ 2564453362 DIAGNOSTIC_REQUEST_FD_WCPM2: 64 SGW
 SG_ N_PDU : 7|64@0+ (1,0) [0|0] "" RFHM

BO_ 2564427761 DIAGNOSTIC_REQUEST_FLDHM: 8 SGW
 SG_ N_PDU : 7|64@0+ (1,0) [0|0] "" RFHM

BO_ 2564440309 DIAGNOSTIC_REQUEST_FOTA_BCM: 64 SGW
 SG_ N_PDU : 7|64@0+ (1,0) [0|0] "" BCM

BO_ 2564434165 DIAGNOSTIC_REQUEST_FOTA_BSM: 64 SGW
 SG_ N_PDU : 7|64@0+ (1,0) [0|0] "" BSM

BO_ 2564435701 DIAGNOSTIC_REQUEST_FOTA_CADM: 64 SGW
 SG_ N_PDU : 7|64@0+ (1,0) [0|0] "" CADM

BO_ 2564428021 DIAGNOSTIC_REQUEST_FOTA_ECM: 64 SGW
 SG_ N_PDU : 7|64@0+ (1,0) [0|0] "" ECM

BO_ 2564428025 DIAGNOSTIC_REQUEST_FOTA_ECM_KWP: 8 SGW
 SG_ N_PDU : 7|64@0+ (1,0) [0|0] "" ECM

BO_ 2564430069 DIAGNOSTIC_REQUEST_FOTA_TRANSM: 64 SGW
 SG_ N_PDU : 7|64@0+ (1,0) [0|0] "" TCM

BO_ 2564427505 DIAGNOSTIC_REQUEST_FRDHM: 8 SGW
 SG_ N_PDU : 7|64@0+ (1,0) [0|0] "" RFHM

BO_ 2564554485 DIAGNOSTIC_REQUEST_FUNC_FOTA: 64 SGW
 SG_ N_PDU : 7|64@0+ (1,0) [0|0] "" AGSM,BCM,BSM,CADM,DMSM,DTCM,ECM,GNMM,IPC,RFHM,TCM

BO_ 2564554489 DIAGNOSTIC_REQUEST_FUNC_FOTA_KWP: 8 SGW
 SG_ N_PDU : 7|64@0+ (1,0) [0|0] "" ECM

BO_ 2564502513 DIAGNOSTIC_REQUEST_FUNC_OBD: 8 SGW
 SG_ N_PDU : 7|64@0+ (1,0) [0|0] "" ECM

BO_ 2564554481 DIAGNOSTIC_REQUEST_FUNCTIONAL: 8 SGW
 SG_ N_PDU : 7|64@0+ (1,0) [0|0] "" AGSM,BCM,BSM,CADM,DMSM,DTCM,ECM,GNMM,IPC,RFHM,TCM

BO_ 2564437233 DIAGNOSTIC_REQUEST_GNMM: 8 SGW
 SG_ N_PDU : 7|64@0+ (1,0) [0|0] "" GNMM

BO_ 2564448497 DIAGNOSTIC_REQUEST_IPC: 8 SGW
 SG_ N_PDU : 7|64@0+ (1,0) [0|0] "" IPC

BO_ 2564480497 DIAGNOSTIC_REQUEST_ISCM: 8 SGW
 SG_ N_PDU : 7|64@0+ (1,0) [0|0] "" ECM

BO_ 2564429041 DIAGNOSTIC_REQUEST_MCPA: 8 SGW
 SG_ N_PDU : 7|64@0+ (1,0) [0|0] "" EVCU2

BO_ 2564429297 DIAGNOSTIC_REQUEST_MCPB: 8 SGW
 SG_ N_PDU : 7|64@0+ (1,0) [0|0] "" EVCU2

BO_ 2564474865 DIAGNOSTIC_REQUEST_RFHM: 8 SGW
 SG_ N_PDU : 7|64@0+ (1,0) [0|0] "" RFHM

BO_ 2564455665 DIAGNOSTIC_REQUEST_SGCP: 8 SGW
 SG_ N_PDU : 7|64@0+ (1,0) [0|0] "" EVCU2

BO_ 2564431857 DIAGNOSTIC_REQUEST_SHIFTER: 8 SGW
 SG_ N_PDU : 7|64@0+ (1,0) [0|0] "" AGSM

BO_ 2564430065 DIAGNOSTIC_REQUEST_TRANSMISSION: 8 SGW
 SG_ N_PDU : 7|64@0+ (1,0) [0|0] "" TCM

BO_ 2564453361 DIAGNOSTIC_REQUEST_WCPM2: 8 SGW
 SG_ N_PDU : 7|64@0+ (1,0) [0|0] "" RFHM

BO_ 2564485440 DIAGNOSTIC_RESPONSE_BCM: 8 BCM
 SG_ N_PDU : 7|64@0+ (1,0) [0|0] "" SGW

BO_ 2564485416 DIAGNOSTIC_RESPONSE_BSM: 8 BSM
 SG_ N_PDU : 7|64@0+ (1,0) [0|0] "" SGW

BO_ 2564485422 DIAGNOSTIC_RESPONSE_CADM: 8 CADM
 SG_ N_PDU : 7|64@0+ (1,0) [0|0] "" SGW

BO_ 2564485527 DIAGNOSTIC_RESPONSE_DMSM: 8 DMSM
 SG_ N_PDU : 7|64@0+ (1,0) [0|0] "" SGW

BO_ 2564485402 DIAGNOSTIC_RESPONSE_DTCM: 8 DTCM
 SG_ N_PDU : 7|64@0+ (1,0) [0|0] "" SGW

BO_ 2564485392 DIAGNOSTIC_RESPONSE_ECM: 8 ECM
 SG_ N_PDU : 7|64@0+ (1,0) [0|0] "" SGW

BO_ 2564485442 DIAGNOSTIC_RESPONSE_EVCU2: 8 EVCU2
 SG_ N_PDU : 7|64@0+ (1,0) [0|0] "" SGW

BO_ 2564485696 DIAGNOSTIC_RESPONSE_FD_BCM: 64 BCM
 SG_ N_PDU : 7|64@0+ (1,0) [0|0] "" SGW

BO_ 2564485672 DIAGNOSTIC_RESPONSE_FD_BSM: 64 BSM
 SG_ N_PDU : 7|64@0+ (1,0) [0|0] "" SGW

BO_ 2564485678 DIAGNOSTIC_RESPONSE_FD_CADM: 64 CADM
 SG_ N_PDU : 7|64@0+ (1,0) [0|0] "" SGW

BO_ 2564485783 DIAGNOSTIC_RESPONSE_FD_DMSM: 64 DMSM
 SG_ N_PDU : 7|64@0+ (1,0) [0|0] "" SGW

BO_ 2564485658 DIAGNOSTIC_RESPONSE_FD_DTCM: 64 DTCM
 SG_ N_PDU : 7|64@0+ (1,0) [0|0] "" SGW

BO_ 2564485648 DIAGNOSTIC_RESPONSE_FD_ECM: 64 ECM
 SG_ N_PDU : 7|64@0+ (1,0) [0|0] "" SGW

BO_ 2564485647 DIAGNOSTIC_RESPONSE_FD_FLDHM: 64 RFHM
 SG_ N_PDU : 7|64@0+ (1,0) [0|0] "" SGW

BO_ 2564485646 DIAGNOSTIC_RESPONSE_FD_FRDHM: 64 RFHM
 SG_ N_PDU : 7|64@0+ (1,0) [0|0] "" SGW

BO_ 2564485684 DIAGNOSTIC_RESPONSE_FD_GNMM: 64 GNMM
 SG_ N_PDU : 7|64@0+ (1,0) [0|0] "" SGW

BO_ 2564485728 DIAGNOSTIC_RESPONSE_FD_IPC: 64 IPC
 SG_ N_PDU : 7|64@0+ (1,0) [0|0] "" SGW

BO_ 2564485652 DIAGNOSTIC_RESPONSE_FD_MCPA: 64 EVCU2
 SG_ N_PDU : 7|64@0+ (1,0) [0|0] "" SGW

BO_ 2564485653 DIAGNOSTIC_RESPONSE_FD_MCPB: 64 EVCU2
 SG_ N_PDU : 7|64@0+ (1,0) [0|0] "" SGW

BO_ 2564485831 DIAGNOSTIC_RESPONSE_FD_RFHM: 64 RFHM
 SG_ N_PDU : 7|64@0+ (1,0) [0|0] "" SGW

CM_ SG_ 1459 Next_Charge_End_Time_Hr "End time of next charge schedule window (hours, in 24hr format).";
CM_ SG_ 1459 Next_Charge_End_Time_Min "End time of next charge schedule window (in minutes).";
CM_ SG_ 1459 Next_Charge_EndDay "Next schedule end day to stop charging.";
CM_ SG_ 1459 Next_Charge_Start_Time_Hr "Start time of next charge schedule window (hours, in 24hr format).";
CM_ SG_ 1459 Next_Charge_Start_Time_Min "Start time of next charge schedule window (in minutes).";
CM_ SG_ 1459 Next_Charge_StartDay "Next schedule start day for charging.";
CM_ SG_ 1459 Next_Climate_Day "Next climate scheduled departure day";
CM_ SG_ 1459 Next_Climate_Time_Hr "Next climate scheduled departure time (hours, in 24hr format).";
CM_ SG_ 1459 Next_Climate_Time_Min "Next climate scheduled departure time (minutes).";
CM_ SG_ 1459 Next_SchCabin_Temp "Next Schedule cabin temperature";
CM_ SG_ 1459 Nxt_Charge_Schedule_Type "Standard, External or Both Charging of the Next Schedule";
CM_ SG_ 1459 Nxt_Ext_Charge_End_Time_Hr "End Hour for Next available External Charge";
CM_ SG_ 1459 Nxt_Ext_Charge_End_Time_Min "End Min for Next available External Charge";
CM_ SG_ 1459 Nxt_External_Charge_EndDay "End Day for Next available External Charge";
CM_ SG_ 1459 Nxt_External_Charge_ExternalTgt "Next Charge Display for Customer set External Target Display 50 to 100% with 5% Increment";
CM_ SG_ 1459 Nxt_External_Charge_ImmediateTgt "Next Charge Display for Customer set Immediate Target Display";
CM_ SG_ 1468 AllowClimateSchd1_Sts "Climate Scheduling1 Options";
CM_ SG_ 1468 AllowClimateSchd2_Sts "Climate Scheduling2 Options";
CM_ SG_ 1468 Climate_Cabin_Temp1_Sts "Schedule1 cabin temperature";
CM_ SG_ 1468 Climate_Cabin_Temp2_Sts "Schedule1 cabin temperature";
CM_ SG_ 1468 ClimateSchd1_Day_Sts "Scheduled#1 Day for cabin conditioning confirmation";
CM_ SG_ 1468 ClimateSchd1_Departure_Hr_Sts "Departure time of schedule 1 (hours in 24 hrs. format)";
CM_ SG_ 1468 ClimateSchd1_Departure_Min_Sts "Departure time of schedule 1(Minutes)";
CM_ SG_ 1468 ClimateSchd2_Day_Sts "Scheduled#2 Day for cabin conditioning confirmation";
CM_ SG_ 1468 ClimateSchd2_Departure_Hr_Sts "Departure time of schedule 2 (hours in 24 hrs. format)";
CM_ SG_ 1468 ClimateSchd2_Departure_Min_Sts "Departure time of schedule 2(Minutes)";
CM_ SG_ 1468 Enable_ClimateSchd1_Sts "Climate Schedule 1 checkbox enable status";
CM_ SG_ 1468 Enable_ClimateSchd2_Sts "Climate Schedule 2 checkbox enable status";
CM_ SG_ 1471 AllowClimateSchd1 "Climate Scheduling1 Options";
CM_ SG_ 1471 AllowClimateSchd2 "Climate Scheduling2 Options";
CM_ SG_ 1471 Climate_Cabin_Temp1 "Schedule1 cabin temperature";
CM_ SG_ 1471 Climate_Cabin_Temp2 "Schedule2 cabin temperature";
CM_ SG_ 1471 ClimateSchd1_Day "Schedule#1 Day for cabin conditioning";
CM_ SG_ 1471 ClimateSchd1_Departure_Hr "Departure time of schedule 1 (hours in 24 hrs. format)";
CM_ SG_ 1471 ClimateSchd1_Departure_Min "Departure time of schedule 1(Minutes)";
CM_ SG_ 1471 ClimateSchd2_Day "Scheduled#2 Day for cabin conditioning";
CM_ SG_ 1471 ClimateSchd2_Departure_Hr "Departure time of schedule 2 (hours in 24 hrs. format)";
CM_ SG_ 1471 ClimateSchd2_Departure_Min "Departure time of schedule 2(Minutes)";
CM_ SG_ 1471 Enable_ClimateSchd1 "Climate Schedule 1 checkbox enabled";
CM_ SG_ 1471 Enable_ClimateSchd2 "Climate Schedule 2 checkbox enabled";
CM_ SG_ 1471 Submit_ClimateSchd1 "Climate Schedule 1 submitted";
CM_ SG_ 1471 Submit_ClimateSchd2 "Climate Schedule 2 submitted";
CM_ SG_ 1462 Climate_TBM_Cabin_Temp1 "Schedule1 cabin temperature";
CM_ SG_ 1462 Climate_TBM_Cabin_Temp2 "Schedule1 cabin temperature";
CM_ SG_ 1462 TBM_AllowClimateSchd1 "Climate Scheduling1 Options";
CM_ SG_ 1462 TBM_AllowClimateSchd2 "Climate Scheduling2 Options";
CM_ SG_ 1462 TBM_ClimateSchd1_Day "Schedule#1 Day for Cabin conditioning";
CM_ SG_ 1462 TBM_ClimateSchd1_Departure_Hr "Departure time of schedule 1 (hours in 24 hrs. format)";
CM_ SG_ 1462 TBM_ClimateSchd1_Departure_Min "Departure time of schedule 1(Minutes)";
CM_ SG_ 1462 TBM_ClimateSchd2_Day "Schedule#2 Day for Cabin conditioning";
CM_ SG_ 1462 TBM_ClimateSchd2_Departure_Hr "Departure time of schedule 2 (hours in 24 hrs. format)";
CM_ SG_ 1462 TBM_ClimateSchd2_Departure_Min "Departure time of schedule 2(Minutes)";
CM_ SG_ 1462 TBM_Enable_ClimateSchd1 "Climate Schedule1 checkbox enabled";
CM_ SG_ 1462 TBM_Enable_ClimateSchd2 "Climate Schedule2 checkbox enabled";
CM_ SG_ 1462 TBM_Submit_ClimateSchd1 "Climate Schedule 1 submitted";
CM_ SG_ 1462 TBM_Submit_ClimateSchd2 "Climate Schedule 2 submitted";
CM_ SG_ 275 CRC_CVPAM_FD_Control "CRC according to SAE J1850 standard at each frame transmission.";
CM_ SG_ 275 MessageCounter_CVPAM_FD_Control "This signal is a counter used for safety checks strategies. This counter is incremented of 1 (one) unit at each frame transmission.";
CM_ SG_ 275 RR_PAM_Brk_RqSts "PAM rear brake request";
CM_ SG_ 275 RR_PAM_Dist "Rear Distance to Nearest Obstacle";
CM_ SG_ 275 RR_PAM_StopControlSts "PAM rear stop control status";
CM_ SG_ 950 Alert_CHF "This signal indicates which arc shall be displayed in the central hand, front position of the car graphics.";
CM_ SG_ 950 Alert_CHR "This signal indicates which arc shall be displayed in the central hand, rear position of the car graphics.";
CM_ SG_ 950 Alert_LHF "This signal indicates which arc shall be displayed in the left hand, front position of the car graphics.";
CM_ SG_ 950 Alert_LHR "This signal indicates which arc shall be displayed in the left hand, rear position of the car graphics.";
CM_ SG_ 950 Alert_RHF "This signal indicates which arc shall be displayed in the right hand, front position of the car graphics.";
CM_ SG_ 950 Alert_RHR "This signal indicates which arc shall be displayed in the right hand, rear position of the car graphics.";
CM_ SG_ 950 CRC_CVPAM_FD_Info "CRC according to SAE J1850 standard at each frame transmission.";
CM_ SG_ 950 FrontSensorSts "This signal indicates the activation state of the front sensors.";
CM_ SG_ 950 FT_PAM_LedControlSts "Front Park Sense Button LED Status";
CM_ SG_ 950 Graphic_CHF "This signal indicates the flash rate of the arc displayed in the central hand, front position of the car graphics.";
CM_ SG_ 950 Graphic_CHR "This signal indicates the flash rate of the arc displayed in the central hand, rear position of the car graphics.";
CM_ SG_ 950 Graphic_LHF "This signal indicates the flash rate of the arc displayed in the left hand, front position of the car graphics.";
CM_ SG_ 950 Graphic_LHR "This signal indicates the flash rate of the arc displayed in the left hand, rear position of the car graphics.";
CM_ SG_ 950 Graphic_RHF "This signal indicates the flash rate of the arc displayed in the right hand, front position of the car graphics.";
CM_ SG_ 950 Graphic_RHR "This signal indicates the flash rate of the arc displayed in the right hand, rear position of the car graphics.";
CM_ SG_ 950 HMICode "This signal indicates the request to display HMI content on the screen";
CM_ SG_ 950 MessageCounter_CVPAM_FD_Info "This signal is a counter used for safety checks strategies. This counter is incremented of 1 (one) unit at each frame transmission.";
CM_ SG_ 950 PAM_LedControlSts "This signal indicates the request to illuminate the PAM LED status indicator";
CM_ SG_ 950 PAM_Off_Status_2BT "Front/Rear Park Sense ON/OFF Status";
CM_ SG_ 950 PAM_PopUpRqst "ParkSense HMI pop-up message request";
CM_ SG_ 950 PAMSystemFault "This signal indicates if the PAM is in a faulted condition";
CM_ SG_ 950 ParkingManeuverActive "Parking information active";
CM_ SG_ 950 RearSensorSts "This signal indicates the activation state of the rear sensors";
CM_ SG_ 950 SPMControlSts "This signal indicates the activation state of the SPM module.";
CM_ SG_ 161 BATTERY_voltage "input voltage 1 measured by DBSM2";
CM_ SG_ 161 BATTERY2_voltage "input voltage 2 measured by DBSM2";
CM_ SG_ 161 CRC_DBSM2_1 "CRC-checksum byte 1 to 7 according to SAE J1850";
CM_ SG_ 161 DBSM2_internal_error "memory/CPU/sensors (fault flag)";
CM_ SG_ 161 ESS_input_active "ESS input was active (low) during the last 10 seconds";
CM_ SG_ 161 L2plus_ack "DBSM2 confirms L2plus mode";
CM_ SG_ 161 MC_DBSM2_1 "Message counter";
CM_ SG_ 161 overcurrent_detected "over current detected (fault flag)";
CM_ SG_ 161 overtemp_detected "over temperature detected (fault flag)";
CM_ SG_ 161 RsErr_DBSM2 "Response error DBSM2; Error=[1]";
CM_ SG_ 161 switch_status_OpenClose "The switch was activated (open) at least one time during the last 10 seconds";
CM_ SG_ 161 undervoltage_detected "under voltage detected (fault flag)";
CM_ SG_ 2564440305 N_PDU "This signal is used for diagnostic purposes";
CM_ SG_ 2564434161 N_PDU "This signal is used for diagnostic purposes";
CM_ SG_ 2564435697 N_PDU "This signal is used for diagnostic purposes";
CM_ SG_ 2564462577 N_PDU "This signal is used for diagnostic purposes";
CM_ SG_ 2564430577 N_PDU "This signal is used for diagnostic purposes";
CM_ SG_ 2564428017 N_PDU "This signal is used for diagnostic purposes";
CM_ SG_ 2564440817 N_PDU "This signal is used for diagnostic purposes";
CM_ SG_ 2564440306 N_PDU "This signal is used for diagnostic purposes";
CM_ SG_ 2564434162 N_PDU "This signal is used for diagnostic purposes";
CM_ SG_ 2564435698 N_PDU "This signal is used for diagnostic purposes";
CM_ SG_ 2564462578 N_PDU "This signal is used for diagnostic purposes";
CM_ SG_ 2564430578 N_PDU "This signal is used for diagnostic purposes";
CM_ SG_ 2564428018 N_PDU "This signal is used for diagnostic purposes";
CM_ SG_ 2564427762 N_PDU "This signal is used for diagnostic purposes";
CM_ SG_ 2564427506 N_PDU "This signal is used for diagnostic purposes";
CM_ SG_ 2564554482 N_PDU "This signal is used for diagnostic purposes";
CM_ SG_ 2564437234 N_PDU "This signal is used for diagnostic purposes";
CM_ SG_ 2564448498 N_PDU "This signal is used for diagnostic purposes";
CM_ SG_ 2564429042 N_PDU "This signal is used for diagnostic purposes";
CM_ SG_ 2564429298 N_PDU "This signal is used for diagnostic purposes";
CM_ SG_ 2564474866 N_PDU "This signal is used for diagnostic purposes";
CM_ SG_ 2564455666 N_PDU "This signal is used for diagnostic purposes";
CM_ SG_ 2564431858 N_PDU "This signal is used for diagnostic purposes";
CM_ SG_ 2564430066 N_PDU "This signal is used for diagnostic purposes";
CM_ SG_ 2564453362 N_PDU "This signal is used for diagnostic purposes";
CM_ SG_ 2564427761 N_PDU "This signal is used for diagnostic purposes";
CM_ SG_ 2564440309 N_PDU "This signal is used for diagnostic purposes";
CM_ SG_ 2564434165 N_PDU "This signal is used for diagnostic purposes";
CM_ SG_ 2564435701 N_PDU "This signal is used for diagnostic purposes";
CM_ SG_ 2564428021 N_PDU "This signal is used for diagnostic purposes";
CM_ SG_ 2564428025 N_PDU "This signal is used for diagnostic purposes";
CM_ SG_ 2564430069 N_PDU "This signal is used for diagnostic purposes";
CM_ SG_ 2564427505 N_PDU "This signal is used for diagnostic purposes";
CM_ SG_ 2564554485 N_PDU "This signal is used for diagnostic purposes";
CM_ SG_ 2564554489 N_PDU "This signal is used for diagnostic purposes";
CM_ SG_ 2564502513 N_PDU "This signal is used for diagnostic purposes";
CM_ SG_ 2564554481 N_PDU "This signal is used for diagnostic purposes";
CM_ SG_ 2564437233 N_PDU "This signal is used for diagnostic purposes";
CM_ SG_ 2564448497 N_PDU "This signal is used for diagnostic purposes";
CM_ SG_ 2564480497 N_PDU "This signal is used for diagnostic purposes";
CM_ SG_ 2564429041 N_PDU "This signal is used for diagnostic purposes";
CM_ SG_ 2564429297 N_PDU "This signal is used for diagnostic purposes";
CM_ SG_ 2564474865 N_PDU "This signal is used for diagnostic purposes";
CM_ SG_ 2564455665 N_PDU "This signal is used for diagnostic purposes";
CM_ SG_ 2564431857 N_PDU "This signal is used for diagnostic purposes";
CM_ SG_ 2564430065 N_PDU "This signal is used for diagnostic purposes";
CM_ SG_ 2564453361 N_PDU "This signal is used for diagnostic purposes";
CM_ SG_ 2564485440 N_PDU "This signal is used for diagnostic purposes";
CM_ SG_ 2564485416 N_PDU "This signal is used for diagnostic purposes";
CM_ SG_ 2564485422 N_PDU "This signal is used for diagnostic purposes";
CM_ SG_ 2564485527 N_PDU "This signal is used for diagnostic purposes";
CM_ SG_ 2564485402 N_PDU "This signal is used for diagnostic purposes";
CM_ SG_ 2564485392 N_PDU "This signal is used for diagnostic purposes";
CM_ SG_ 2564485442 N_PDU "This signal is used for diagnostic purposes";
CM_ SG_ 2564485696 N_PDU "This signal is used for diagnostic purposes";
CM_ SG_ 2564485672 N_PDU "This signal is used for diagnostic purposes";
CM_ SG_ 2564485678 N_PDU "This signal is used for diagnostic purposes";
CM_ SG_ 2564485783 N_PDU "This signal is used for diagnostic purposes";
CM_ SG_ 2564485658 N_PDU "This signal is used for diagnostic purposes";
CM_ SG_ 2564485648 N_PDU "This signal is used for diagnostic purposes";
CM_ SG_ 2564485647 N_PDU "This signal is used for diagnostic purposes";
CM_ SG_ 2564485646 N_PDU "This signal is used for diagnostic purposes";
CM_ SG_ 2564485684 N_PDU "This signal is used for diagnostic purposes";
CM_ SG_ 2564485728 N_PDU "This signal is used for diagnostic purposes";
CM_ SG_ 2564485652 N_PDU "This signal is used for diagnostic purposes";
CM_ SG_ 2564485653 N_PDU "This signal is used for diagnostic purposes";
CM_ SG_ 2564485831 N_PDU "This signal is used for diagnostic purposes";

BA_DEF_ SG_ "GenSigStartValue" INT 0 2147483647;
BA_DEF_ SG_ "GenSigInactiveValue" INT 0 2147483647;
BA_DEF_ SG_ "GenSigSendType" ENUM "NotUsed","OnWrite","OnWriteWithRepetition","OnChange","OnChangeWithRepetition","IfActive","IfActiveWithRepetition","NoSigSendType";
BA_DEF_ SG_ "SystemSignalLongSymbol" STRING ;
BA_DEF_ SG_ "GenSigTimeoutTime_AGSM" INT 0 65535;
BA_DEF_ SG_ "GenSigTimeoutTime_BCM" INT 0 65535;
BA_DEF_ SG_ "GenSigTimeoutTime_BSM" INT 0 65535;
BA_DEF_ SG_ "GenSigTimeoutTime_CADM" INT 0 65535;
BA_DEF_ SG_ "GenSigTimeoutTime_DMSM" INT 0 65535;
BA_DEF_ SG_ "GenSigTimeoutTime_DTCM" INT 0 65535;
BA_DEF_ SG_ "GenSigTimeoutTime_ECM" INT 0 65535;
BA_DEF_ SG_ "GenSigTimeoutTime_EVCU2" INT 0 65535;
BA_DEF_ SG_ "GenSigTimeoutTime_GNMM" INT 0 65535;
BA_DEF_ SG_ "GenSigTimeoutTime_HCP" INT 0 65535;
BA_DEF_ SG_ "GenSigTimeoutTime_IPC" INT 0 65535;
BA_DEF_ SG_ "GenSigTimeoutTime_RFHM" INT 0 65535;
BA_DEF_ SG_ "GenSigTimeoutTime_SGW" INT 0 65535;
BA_DEF_ SG_ "GenSigTimeoutTime_TCM" INT 0 65535;
BA_DEF_ BO_ "DiagRequest" ENUM "No","Yes";
BA_DEF_ BO_ "Type" ENUM "P","C","PE","COC","PE_Cntrl","E","E_Cntrl","OC","S","BAF","DC","EM","MM","ISO-TP","-";
BA_DEF_ BO_ "DiagResponse" ENUM "No","Yes";
BA_DEF_ BO_ "NmMessage" ENUM "No","Yes";
BA_DEF_ BO_ "GenMsgSendType" ENUM "Cyclic","NotUsed","NotUsed","NotUsed","NotUsed","NotUsed","NotUsed","NotUsed","NoMsgSendType";
BA_DEF_ BO_ "GenMsgNrOfRepetition" INT 0 255;
BA_DEF_ BO_ "GenMsgILSupport" ENUM "No","Yes";
BA_DEF_ BO_ "GenMsgStartDelayTime" INT 0 65535;
BA_DEF_ BO_ "GenMsgCycleTimeFast" INT 0 65535;
BA_DEF_ BO_ "GenMsgCycleTime" INT 0 65535;
BA_DEF_ BO_ "GenMsgDelayTime" INT 0 65535;
BA_DEF_ BO_ "NmAsrMessage" ENUM "No","Yes";
BA_DEF_ BO_ "DiagState" ENUM "No","Yes";
BA_DEF_ BO_ "DiagConnection" HEX 0 65535;
BA_DEF_ BO_ "VFrameFormat" ENUM "StandardCAN","ExtendedCAN","reserved","reserved","reserved","reserved","reserved","reserved","reserved","reserved","reserved","reserved","reserved","reserved","StandardCAN_FD","ExtendedCAN_FD";
BA_DEF_ BO_ "CANFD_BRS" ENUM "0","1";
BA_DEF_DEF_ "DiagRequest" "No";
BA_DEF_DEF_ "Type" "-";
BA_DEF_DEF_ "DiagResponse" "No";
BA_DEF_DEF_ "NmMessage" "No";
BA_DEF_DEF_ "GenMsgSendType" "NoMsgSendType";
BA_DEF_DEF_ "GenMsgNrOfRepetition" 0;
BA_DEF_DEF_ "GenMsgILSupport" "No";
BA_DEF_DEF_ "GenMsgStartDelayTime" 0;
BA_DEF_DEF_ "GenMsgCycleTimeFast" 0;
BA_DEF_DEF_ "GenMsgCycleTime" 0;
BA_DEF_DEF_ "GenMsgDelayTime" 0;
BA_DEF_DEF_ "NmAsrMessage" "No";
BA_DEF_DEF_ "DiagState" "No";
BA_DEF_DEF_ "DiagConnection" 0;
BA_DEF_DEF_ "VFrameFormat" "StandardCAN_FD";
BA_DEF_DEF_ "CANFD_BRS" "0";
BA_DEF_DEF_ "GenSigStartValue" 0;
BA_DEF_DEF_ "GenSigInactiveValue" 0;
BA_DEF_DEF_ "GenSigSendType" "NoSigSendType";
BA_DEF_DEF_ "SystemSignalLongSymbol" "";
BA_DEF_DEF_ "GenSigTimeoutTime_AGSM" 2500;
BA_DEF_DEF_ "GenSigTimeoutTime_BCM" 2500;
BA_DEF_DEF_ "GenSigTimeoutTime_BSM" 2500;
BA_DEF_DEF_ "GenSigTimeoutTime_CADM" 2500;
BA_DEF_DEF_ "GenSigTimeoutTime_DMSM" 2500;
BA_DEF_DEF_ "GenSigTimeoutTime_DTCM" 2500;
BA_DEF_DEF_ "GenSigTimeoutTime_ECM" 2500;
BA_DEF_DEF_ "GenSigTimeoutTime_EVCU2" 2500;
BA_DEF_DEF_ "GenSigTimeoutTime_GNMM" 2500;
BA_DEF_DEF_ "GenSigTimeoutTime_HCP" 2500;
BA_DEF_DEF_ "GenSigTimeoutTime_IPC" 2500;
BA_DEF_DEF_ "GenSigTimeoutTime_RFHM" 2500;
BA_DEF_DEF_ "GenSigTimeoutTime_SGW" 2500;
BA_DEF_DEF_ "GenSigTimeoutTime_TCM" 2500;
BA_ "Type" BO_ 1459 3;
BA_ "GenMsgSendType" BO_ 1459 0;
BA_ "GenMsgILSupport" BO_ 1459 1;
BA_ "GenMsgCycleTime" BO_ 1459 1000;
BA_ "GenMsgDelayTime" BO_ 1459 20;
BA_ "CANFD_BRS" BO_ 1459 1;
BA_ "Type" BO_ 1468 3;
BA_ "GenMsgSendType" BO_ 1468 0;
BA_ "GenMsgILSupport" BO_ 1468 1;
BA_ "GenMsgCycleTime" BO_ 1468 1000;
BA_ "CANFD_BRS" BO_ 1468 1;
BA_ "Type" BO_ 1471 3;
BA_ "GenMsgSendType" BO_ 1471 0;
BA_ "GenMsgILSupport" BO_ 1471 1;
BA_ "GenMsgCycleTime" BO_ 1471 1000;
BA_ "CANFD_BRS" BO_ 1471 1;
BA_ "Type" BO_ 1462 3;
BA_ "GenMsgSendType" BO_ 1462 0;
BA_ "GenMsgILSupport" BO_ 1462 1;
BA_ "GenMsgCycleTime" BO_ 1462 1000;
BA_ "CANFD_BRS" BO_ 1462 1;
BA_ "Type" BO_ 275 1;
BA_ "GenMsgSendType" BO_ 275 0;
BA_ "GenMsgILSupport" BO_ 275 1;
BA_ "GenMsgStartDelayTime" BO_ 275 5;
BA_ "GenMsgCycleTime" BO_ 275 10;
BA_ "CANFD_BRS" BO_ 275 1;
BA_ "Type" BO_ 950 3;
BA_ "GenMsgSendType" BO_ 950 0;
BA_ "GenMsgILSupport" BO_ 950 1;
BA_ "GenMsgStartDelayTime" BO_ 950 45;
BA_ "GenMsgCycleTime" BO_ 950 250;
BA_ "CANFD_BRS" BO_ 950 1;
BA_ "Type" BO_ 161 8;
BA_ "GenMsgILSupport" BO_ 161 1;
BA_ "CANFD_BRS" BO_ 161 1;
BA_ "DiagRequest" BO_ 2564440305 1;
BA_ "Type" BO_ 2564440305 8;
BA_ "DiagConnection" BO_ 2564440305 61760;
BA_ "VFrameFormat" BO_ 2564440305 1;
BA_ "DiagRequest" BO_ 2564434161 1;
BA_ "Type" BO_ 2564434161 8;
BA_ "DiagConnection" BO_ 2564434161 61736;
BA_ "VFrameFormat" BO_ 2564434161 1;
BA_ "DiagRequest" BO_ 2564435697 1;
BA_ "Type" BO_ 2564435697 8;
BA_ "DiagConnection" BO_ 2564435697 61742;
BA_ "VFrameFormat" BO_ 2564435697 1;
BA_ "DiagRequest" BO_ 2564462577 1;
BA_ "Type" BO_ 2564462577 8;
BA_ "DiagConnection" BO_ 2564462577 61847;
BA_ "VFrameFormat" BO_ 2564462577 1;
BA_ "DiagRequest" BO_ 2564430577 1;
BA_ "Type" BO_ 2564430577 8;
BA_ "DiagConnection" BO_ 2564430577 61722;
BA_ "VFrameFormat" BO_ 2564430577 1;
BA_ "DiagRequest" BO_ 2564428017 1;
BA_ "Type" BO_ 2564428017 8;
BA_ "DiagConnection" BO_ 2564428017 61712;
BA_ "VFrameFormat" BO_ 2564428017 1;
BA_ "DiagRequest" BO_ 2564440817 1;
BA_ "Type" BO_ 2564440817 8;
BA_ "DiagConnection" BO_ 2564440817 61762;
BA_ "VFrameFormat" BO_ 2564440817 1;
BA_ "DiagRequest" BO_ 2564440306 1;
BA_ "Type" BO_ 2564440306 8;
BA_ "DiagConnection" BO_ 2564440306 62016;
BA_ "VFrameFormat" BO_ 2564440306 15;
BA_ "CANFD_BRS" BO_ 2564440306 1;
BA_ "DiagRequest" BO_ 2564434162 1;
BA_ "Type" BO_ 2564434162 8;
BA_ "DiagConnection" BO_ 2564434162 61992;
BA_ "VFrameFormat" BO_ 2564434162 15;
BA_ "CANFD_BRS" BO_ 2564434162 1;
BA_ "DiagRequest" BO_ 2564435698 1;
BA_ "Type" BO_ 2564435698 8;
BA_ "DiagConnection" BO_ 2564435698 61998;
BA_ "VFrameFormat" BO_ 2564435698 15;
BA_ "CANFD_BRS" BO_ 2564435698 1;
BA_ "DiagRequest" BO_ 2564462578 1;
BA_ "Type" BO_ 2564462578 8;
BA_ "DiagConnection" BO_ 2564462578 62103;
BA_ "VFrameFormat" BO_ 2564462578 15;
BA_ "CANFD_BRS" BO_ 2564462578 1;
BA_ "DiagRequest" BO_ 2564430578 1;
BA_ "Type" BO_ 2564430578 8;
BA_ "DiagConnection" BO_ 2564430578 61978;
BA_ "VFrameFormat" BO_ 2564430578 15;
BA_ "CANFD_BRS" BO_ 2564430578 1;
BA_ "DiagRequest" BO_ 2564428018 1;
BA_ "Type" BO_ 2564428018 8;
BA_ "DiagConnection" BO_ 2564428018 61968;
BA_ "VFrameFormat" BO_ 2564428018 15;
BA_ "CANFD_BRS" BO_ 2564428018 1;
BA_ "DiagRequest" BO_ 2564427762 1;
BA_ "Type" BO_ 2564427762 8;
BA_ "DiagConnection" BO_ 2564427762 61967;
BA_ "VFrameFormat" BO_ 2564427762 15;
BA_ "CANFD_BRS" BO_ 2564427762 1;
BA_ "DiagRequest" BO_ 2564427506 1;
BA_ "Type" BO_ 2564427506 8;
BA_ "DiagConnection" BO_ 2564427506 61966;
BA_ "VFrameFormat" BO_ 2564427506 15;
BA_ "CANFD_BRS" BO_ 2564427506 1;
BA_ "Type" BO_ 2564554482 8;
BA_ "DiagState" BO_ 2564554482 1;
BA_ "DiagConnection" BO_ 2564554482 62206;
BA_ "VFrameFormat" BO_ 2564554482 15;
BA_ "CANFD_BRS" BO_ 2564554482 1;
BA_ "DiagRequest" BO_ 2564437234 1;
BA_ "Type" BO_ 2564437234 8;
BA_ "DiagConnection" BO_ 2564437234 62004;
BA_ "VFrameFormat" BO_ 2564437234 15;
BA_ "CANFD_BRS" BO_ 2564437234 1;
BA_ "DiagRequest" BO_ 2564448498 1;
BA_ "Type" BO_ 2564448498 8;
BA_ "DiagConnection" BO_ 2564448498 62048;
BA_ "VFrameFormat" BO_ 2564448498 15;
BA_ "CANFD_BRS" BO_ 2564448498 1;
BA_ "DiagRequest" BO_ 2564429042 1;
BA_ "Type" BO_ 2564429042 8;
BA_ "DiagConnection" BO_ 2564429042 61972;
BA_ "VFrameFormat" BO_ 2564429042 15;
BA_ "CANFD_BRS" BO_ 2564429042 1;
BA_ "DiagRequest" BO_ 2564429298 1;
BA_ "Type" BO_ 2564429298 8;
BA_ "DiagConnection" BO_ 2564429298 61973;
BA_ "VFrameFormat" BO_ 2564429298 15;
BA_ "CANFD_BRS" BO_ 2564429298 1;
BA_ "DiagRequest" BO_ 2564474866 1;
BA_ "Type" BO_ 2564474866 8;
BA_ "DiagConnection" BO_ 2564474866 62151;
BA_ "VFrameFormat" BO_ 2564474866 15;
BA_ "CANFD_BRS" BO_ 2564474866 1;
BA_ "DiagRequest" BO_ 2564455666 1;
BA_ "Type" BO_ 2564455666 8;
BA_ "DiagConnection" BO_ 2564455666 62076;
BA_ "VFrameFormat" BO_ 2564455666 15;
BA_ "CANFD_BRS" BO_ 2564455666 1;
BA_ "DiagRequest" BO_ 2564431858 1;
BA_ "Type" BO_ 2564431858 8;
BA_ "DiagConnection" BO_ 2564431858 61983;
BA_ "VFrameFormat" BO_ 2564431858 15;
BA_ "CANFD_BRS" BO_ 2564431858 1;
BA_ "DiagRequest" BO_ 2564430066 1;
BA_ "Type" BO_ 2564430066 8;
BA_ "DiagConnection" BO_ 2564430066 61976;
BA_ "VFrameFormat" BO_ 2564430066 15;
BA_ "CANFD_BRS" BO_ 2564430066 1;
BA_ "DiagRequest" BO_ 2564453362 1;
BA_ "Type" BO_ 2564453362 8;
BA_ "DiagConnection" BO_ 2564453362 62067;
BA_ "VFrameFormat" BO_ 2564453362 15;
BA_ "CANFD_BRS" BO_ 2564453362 1;
BA_ "DiagRequest" BO_ 2564427761 1;
BA_ "Type" BO_ 2564427761 8;
BA_ "DiagConnection" BO_ 2564427761 61711;
BA_ "VFrameFormat" BO_ 2564427761 1;
BA_ "DiagRequest" BO_ 2564440309 1;
BA_ "Type" BO_ 2564440309 8;
BA_ "DiagConnection" BO_ 2564440309 62784;
BA_ "VFrameFormat" BO_ 2564440309 15;
BA_ "CANFD_BRS" BO_ 2564440309 1;
BA_ "DiagRequest" BO_ 2564434165 1;
BA_ "Type" BO_ 2564434165 8;
BA_ "DiagConnection" BO_ 2564434165 62760;
BA_ "VFrameFormat" BO_ 2564434165 15;
BA_ "CANFD_BRS" BO_ 2564434165 1;
BA_ "DiagRequest" BO_ 2564435701 1;
BA_ "Type" BO_ 2564435701 8;
BA_ "DiagConnection" BO_ 2564435701 62766;
BA_ "VFrameFormat" BO_ 2564435701 15;
BA_ "CANFD_BRS" BO_ 2564435701 1;
BA_ "DiagRequest" BO_ 2564428021 1;
BA_ "Type" BO_ 2564428021 8;
BA_ "DiagConnection" BO_ 2564428021 62736;
BA_ "VFrameFormat" BO_ 2564428021 15;
BA_ "CANFD_BRS" BO_ 2564428021 1;
BA_ "DiagRequest" BO_ 2564428025 1;
BA_ "Type" BO_ 2564428025 8;
BA_ "DiagConnection" BO_ 2564428025 63760;
BA_ "VFrameFormat" BO_ 2564428025 1;
BA_ "DiagRequest" BO_ 2564430069 1;
BA_ "Type" BO_ 2564430069 8;
BA_ "DiagConnection" BO_ 2564430069 62744;
BA_ "VFrameFormat" BO_ 2564430069 15;
BA_ "CANFD_BRS" BO_ 2564430069 1;
BA_ "DiagRequest" BO_ 2564427505 1;
BA_ "Type" BO_ 2564427505 8;
BA_ "DiagConnection" BO_ 2564427505 61710;
BA_ "VFrameFormat" BO_ 2564427505 1;
BA_ "Type" BO_ 2564554485 8;
BA_ "DiagState" BO_ 2564554485 1;
BA_ "DiagConnection" BO_ 2564554485 62974;
BA_ "VFrameFormat" BO_ 2564554485 15;
BA_ "CANFD_BRS" BO_ 2564554485 1;
BA_ "Type" BO_ 2564554489 8;
BA_ "DiagState" BO_ 2564554489 1;
BA_ "DiagConnection" BO_ 2564554489 63998;
BA_ "VFrameFormat" BO_ 2564554489 1;
BA_ "Type" BO_ 2564502513 8;
BA_ "DiagState" BO_ 2564502513 1;
BA_ "DiagConnection" BO_ 2564502513 61747;
BA_ "VFrameFormat" BO_ 2564502513 1;
BA_ "Type" BO_ 2564554481 8;
BA_ "DiagState" BO_ 2564554481 1;
BA_ "DiagConnection" BO_ 2564554481 61950;
BA_ "VFrameFormat" BO_ 2564554481 1;
BA_ "DiagRequest" BO_ 2564437233 1;
BA_ "Type" BO_ 2564437233 8;
BA_ "DiagConnection" BO_ 2564437233 61748;
BA_ "VFrameFormat" BO_ 2564437233 1;
BA_ "DiagRequest" BO_ 2564448497 1;
BA_ "Type" BO_ 2564448497 8;
BA_ "DiagConnection" BO_ 2564448497 61792;
BA_ "VFrameFormat" BO_ 2564448497 1;
BA_ "DiagRequest" BO_ 2564480497 1;
BA_ "Type" BO_ 2564480497 8;
BA_ "DiagConnection" BO_ 2564480497 61917;
BA_ "VFrameFormat" BO_ 2564480497 1;
BA_ "DiagRequest" BO_ 2564429041 1;
BA_ "Type" BO_ 2564429041 8;
BA_ "DiagConnection" BO_ 2564429041 61716;
BA_ "VFrameFormat" BO_ 2564429041 1;
BA_ "DiagRequest" BO_ 2564429297 1;
BA_ "Type" BO_ 2564429297 8;
BA_ "DiagConnection" BO_ 2564429297 61717;
BA_ "VFrameFormat" BO_ 2564429297 1;
BA_ "DiagRequest" BO_ 2564474865 1;
BA_ "Type" BO_ 2564474865 8;
BA_ "DiagConnection" BO_ 2564474865 61895;
BA_ "VFrameFormat" BO_ 2564474865 1;
BA_ "DiagRequest" BO_ 2564455665 1;
BA_ "Type" BO_ 2564455665 8;
BA_ "DiagConnection" BO_ 2564455665 61820;
BA_ "VFrameFormat" BO_ 2564455665 1;
BA_ "DiagRequest" BO_ 2564431857 1;
BA_ "Type" BO_ 2564431857 8;
BA_ "DiagConnection" BO_ 2564431857 61727;
BA_ "VFrameFormat" BO_ 2564431857 1;
BA_ "DiagRequest" BO_ 2564430065 1;
BA_ "Type" BO_ 2564430065 8;
BA_ "DiagConnection" BO_ 2564430065 61720;
BA_ "VFrameFormat" BO_ 2564430065 1;
BA_ "DiagRequest" BO_ 2564453361 1;
BA_ "Type" BO_ 2564453361 8;
BA_ "DiagConnection" BO_ 2564453361 61811;
BA_ "VFrameFormat" BO_ 2564453361 1;
BA_ "Type" BO_ 2564485440 8;
BA_ "DiagResponse" BO_ 2564485440 1;
BA_ "DiagConnection" BO_ 2564485440 61760;
BA_ "VFrameFormat" BO_ 2564485440 1;
BA_ "Type" BO_ 2564485416 8;
BA_ "DiagResponse" BO_ 2564485416 1;
BA_ "DiagConnection" BO_ 2564485416 61736;
BA_ "VFrameFormat" BO_ 2564485416 1;
BA_ "Type" BO_ 2564485422 8;
BA_ "DiagResponse" BO_ 2564485422 1;
BA_ "DiagConnection" BO_ 2564485422 61742;
BA_ "VFrameFormat" BO_ 2564485422 1;
BA_ "Type" BO_ 2564485527 8;
BA_ "DiagResponse" BO_ 2564485527 1;
BA_ "DiagConnection" BO_ 2564485527 61847;
BA_ "VFrameFormat" BO_ 2564485527 1;
BA_ "Type" BO_ 2564485402 8;
BA_ "DiagResponse" BO_ 2564485402 1;
BA_ "DiagConnection" BO_ 2564485402 61722;
BA_ "VFrameFormat" BO_ 2564485402 1;
BA_ "Type" BO_ 2564485392 8;
BA_ "DiagResponse" BO_ 2564485392 1;
BA_ "DiagConnection" BO_ 2564485392 61712;
BA_ "VFrameFormat" BO_ 2564485392 1;
BA_ "Type" BO_ 2564485442 8;
BA_ "DiagResponse" BO_ 2564485442 1;
BA_ "DiagConnection" BO_ 2564485442 61762;
BA_ "VFrameFormat" BO_ 2564485442 1;
BA_ "Type" BO_ 2564485696 8;
BA_ "DiagResponse" BO_ 2564485696 1;
BA_ "DiagConnection" BO_ 2564485696 62016;
BA_ "VFrameFormat" BO_ 2564485696 15;
BA_ "CANFD_BRS" BO_ 2564485696 1;
BA_ "Type" BO_ 2564485672 8;
BA_ "DiagResponse" BO_ 2564485672 1;
BA_ "DiagConnection" BO_ 2564485672 61992;
BA_ "VFrameFormat" BO_ 2564485672 15;
BA_ "CANFD_BRS" BO_ 2564485672 1;
BA_ "Type" BO_ 2564485678 8;
BA_ "DiagResponse" BO_ 2564485678 1;
BA_ "DiagConnection" BO_ 2564485678 61998;
BA_ "VFrameFormat" BO_ 2564485678 15;
BA_ "CANFD_BRS" BO_ 2564485678 1;
BA_ "Type" BO_ 2564485783 8;
BA_ "DiagResponse" BO_ 2564485783 1;
BA_ "DiagConnection" BO_ 2564485783 62103;
BA_ "VFrameFormat" BO_ 2564485783 15;
BA_ "CANFD_BRS" BO_ 2564485783 1;
BA_ "Type" BO_ 2564485658 8;
BA_ "DiagResponse" BO_ 2564485658 1;
BA_ "DiagConnection" BO_ 2564485658 61978;
BA_ "VFrameFormat" BO_ 2564485658 15;
BA_ "CANFD_BRS" BO_ 2564485658 1;
BA_ "Type" BO_ 2564485648 8;
BA_ "DiagResponse" BO_ 2564485648 1;
BA_ "DiagConnection" BO_ 2564485648 61968;
BA_ "VFrameFormat" BO_ 2564485648 15;
BA_ "CANFD_BRS" BO_ 2564485648 1;
BA_ "Type" BO_ 2564485647 8;
BA_ "DiagResponse" BO_ 2564485647 1;
BA_ "DiagConnection" BO_ 2564485647 61967;
BA_ "VFrameFormat" BO_ 2564485647 15;
BA_ "CANFD_BRS" BO_ 2564485647 1;
BA_ "Type" BO_ 2564485646 8;
BA_ "DiagResponse" BO_ 2564485646 1;
BA_ "DiagConnection" BO_ 2564485646 61966;
BA_ "VFrameFormat" BO_ 2564485646 15;
BA_ "CANFD_BRS" BO_ 2564485646 1;
BA_ "Type" BO_ 2564485684 8;
BA_ "DiagResponse" BO_ 2564485684 1;
BA_ "DiagConnection" BO_ 2564485684 62004;
BA_ "VFrameFormat" BO_ 2564485684 15;
BA_ "CANFD_BRS" BO_ 2564485684 1;
BA_ "Type" BO_ 2564485728 8;
BA_ "DiagResponse" BO_ 2564485728 1;
BA_ "DiagConnection" BO_ 2564485728 62048;
BA_ "VFrameFormat" BO_ 2564485728 15;
BA_ "CANFD_BRS" BO_ 2564485728 1;
BA_ "Type" BO_ 2564485652 8;
BA_ "DiagResponse" BO_ 2564485652 1;
BA_ "DiagConnection" BO_ 2564485652 61972;
BA_ "VFrameFormat" BO_ 2564485652 15;
BA_ "CANFD_BRS" BO_ 2564485652 1;
BA_ "Type" BO_ 2564485653 8;
BA_ "DiagResponse" BO_ 2564485653 1;
BA_ "DiagConnection" BO_ 2564485653 61973;
BA_ "VFrameFormat" BO_ 2564485653 15;
BA_ "CANFD_BRS" BO_ 2564485653 1;
BA_ "Type" BO_ 2564485831 8;
BA_ "DiagResponse" BO_ 2564485831 1;
BA_ "DiagConnection" BO_ 2564485831 62151;
BA_ "VFrameFormat" BO_ 2564485831 15;
BA_ "CANFD_BRS" BO_ 2564485831 1;
BA_ "GenSigSendType" SG_ 1459 Next_Charge_End_Time_Hr 3;
BA_ "GenSigTimeoutTime_AGSM" SG_ 1459 Next_Charge_End_Time_Hr 0;
BA_ "GenSigTimeoutTime_BCM" SG_ 1459 Next_Charge_End_Time_Hr 0;
BA_ "GenSigTimeoutTime_BSM" SG_ 1459 Next_Charge_End_Time_Hr 0;
BA_ "GenSigTimeoutTime_CADM" SG_ 1459 Next_Charge_End_Time_Hr 0;
BA_ "GenSigTimeoutTime_DMSM" SG_ 1459 Next_Charge_End_Time_Hr 0;
BA_ "GenSigTimeoutTime_DTCM" SG_ 1459 Next_Charge_End_Time_Hr 0;
BA_ "GenSigTimeoutTime_ECM" SG_ 1459 Next_Charge_End_Time_Hr 0;
BA_ "GenSigTimeoutTime_EVCU2" SG_ 1459 Next_Charge_End_Time_Hr 0;
BA_ "GenSigTimeoutTime_GNMM" SG_ 1459 Next_Charge_End_Time_Hr 0;
BA_ "GenSigTimeoutTime_HCP" SG_ 1459 Next_Charge_End_Time_Hr 0;
BA_ "GenSigTimeoutTime_RFHM" SG_ 1459 Next_Charge_End_Time_Hr 0;
BA_ "GenSigTimeoutTime_TCM" SG_ 1459 Next_Charge_End_Time_Hr 0;
BA_ "GenSigTimeoutTime_AGSM" SG_ 1459 Next_Charge_End_Time_Min 0;
BA_ "GenSigTimeoutTime_BCM" SG_ 1459 Next_Charge_End_Time_Min 0;
BA_ "GenSigTimeoutTime_BSM" SG_ 1459 Next_Charge_End_Time_Min 0;
BA_ "GenSigTimeoutTime_CADM" SG_ 1459 Next_Charge_End_Time_Min 0;
BA_ "GenSigTimeoutTime_DMSM" SG_ 1459 Next_Charge_End_Time_Min 0;
BA_ "GenSigTimeoutTime_DTCM" SG_ 1459 Next_Charge_End_Time_Min 0;
BA_ "GenSigTimeoutTime_ECM" SG_ 1459 Next_Charge_End_Time_Min 0;
BA_ "GenSigTimeoutTime_EVCU2" SG_ 1459 Next_Charge_End_Time_Min 0;
BA_ "GenSigTimeoutTime_GNMM" SG_ 1459 Next_Charge_End_Time_Min 0;
BA_ "GenSigTimeoutTime_HCP" SG_ 1459 Next_Charge_End_Time_Min 0;
BA_ "GenSigTimeoutTime_RFHM" SG_ 1459 Next_Charge_End_Time_Min 0;
BA_ "GenSigTimeoutTime_TCM" SG_ 1459 Next_Charge_End_Time_Min 0;
BA_ "GenSigTimeoutTime_AGSM" SG_ 1459 Next_Charge_EndDay 0;
BA_ "GenSigTimeoutTime_BCM" SG_ 1459 Next_Charge_EndDay 0;
BA_ "GenSigTimeoutTime_BSM" SG_ 1459 Next_Charge_EndDay 0;
BA_ "GenSigTimeoutTime_CADM" SG_ 1459 Next_Charge_EndDay 0;
BA_ "GenSigTimeoutTime_DMSM" SG_ 1459 Next_Charge_EndDay 0;
BA_ "GenSigTimeoutTime_DTCM" SG_ 1459 Next_Charge_EndDay 0;
BA_ "GenSigTimeoutTime_ECM" SG_ 1459 Next_Charge_EndDay 0;
BA_ "GenSigTimeoutTime_EVCU2" SG_ 1459 Next_Charge_EndDay 0;
BA_ "GenSigTimeoutTime_GNMM" SG_ 1459 Next_Charge_EndDay 0;
BA_ "GenSigTimeoutTime_HCP" SG_ 1459 Next_Charge_EndDay 0;
BA_ "GenSigTimeoutTime_RFHM" SG_ 1459 Next_Charge_EndDay 0;
BA_ "GenSigTimeoutTime_TCM" SG_ 1459 Next_Charge_EndDay 0;
BA_ "GenSigTimeoutTime_AGSM" SG_ 1459 Next_Charge_Start_Time_Hr 0;
BA_ "GenSigTimeoutTime_BCM" SG_ 1459 Next_Charge_Start_Time_Hr 0;
BA_ "GenSigTimeoutTime_BSM" SG_ 1459 Next_Charge_Start_Time_Hr 0;
BA_ "GenSigTimeoutTime_CADM" SG_ 1459 Next_Charge_Start_Time_Hr 0;
BA_ "GenSigTimeoutTime_DMSM" SG_ 1459 Next_Charge_Start_Time_Hr 0;
BA_ "GenSigTimeoutTime_DTCM" SG_ 1459 Next_Charge_Start_Time_Hr 0;
BA_ "GenSigTimeoutTime_ECM" SG_ 1459 Next_Charge_Start_Time_Hr 0;
BA_ "GenSigTimeoutTime_EVCU2" SG_ 1459 Next_Charge_Start_Time_Hr 0;
BA_ "GenSigTimeoutTime_GNMM" SG_ 1459 Next_Charge_Start_Time_Hr 0;
BA_ "GenSigTimeoutTime_HCP" SG_ 1459 Next_Charge_Start_Time_Hr 0;
BA_ "GenSigTimeoutTime_RFHM" SG_ 1459 Next_Charge_Start_Time_Hr 0;
BA_ "GenSigTimeoutTime_TCM" SG_ 1459 Next_Charge_Start_Time_Hr 0;
BA_ "GenSigTimeoutTime_AGSM" SG_ 1459 Next_Charge_Start_Time_Min 0;
BA_ "GenSigTimeoutTime_BCM" SG_ 1459 Next_Charge_Start_Time_Min 0;
BA_ "GenSigTimeoutTime_BSM" SG_ 1459 Next_Charge_Start_Time_Min 0;
BA_ "GenSigTimeoutTime_CADM" SG_ 1459 Next_Charge_Start_Time_Min 0;
BA_ "GenSigTimeoutTime_DMSM" SG_ 1459 Next_Charge_Start_Time_Min 0;
BA_ "GenSigTimeoutTime_DTCM" SG_ 1459 Next_Charge_Start_Time_Min 0;
BA_ "GenSigTimeoutTime_ECM" SG_ 1459 Next_Charge_Start_Time_Min 0;
BA_ "GenSigTimeoutTime_EVCU2" SG_ 1459 Next_Charge_Start_Time_Min 0;
BA_ "GenSigTimeoutTime_GNMM" SG_ 1459 Next_Charge_Start_Time_Min 0;
BA_ "GenSigTimeoutTime_HCP" SG_ 1459 Next_Charge_Start_Time_Min 0;
BA_ "GenSigTimeoutTime_RFHM" SG_ 1459 Next_Charge_Start_Time_Min 0;
BA_ "GenSigTimeoutTime_TCM" SG_ 1459 Next_Charge_Start_Time_Min 0;
BA_ "GenSigTimeoutTime_AGSM" SG_ 1459 Next_Charge_StartDay 0;
BA_ "GenSigTimeoutTime_BCM" SG_ 1459 Next_Charge_StartDay 0;
BA_ "GenSigTimeoutTime_BSM" SG_ 1459 Next_Charge_StartDay 0;
BA_ "GenSigTimeoutTime_CADM" SG_ 1459 Next_Charge_StartDay 0;
BA_ "GenSigTimeoutTime_DMSM" SG_ 1459 Next_Charge_StartDay 0;
BA_ "GenSigTimeoutTime_DTCM" SG_ 1459 Next_Charge_StartDay 0;
BA_ "GenSigTimeoutTime_ECM" SG_ 1459 Next_Charge_StartDay 0;
BA_ "GenSigTimeoutTime_EVCU2" SG_ 1459 Next_Charge_StartDay 0;
BA_ "GenSigTimeoutTime_GNMM" SG_ 1459 Next_Charge_StartDay 0;
BA_ "GenSigTimeoutTime_HCP" SG_ 1459 Next_Charge_StartDay 0;
BA_ "GenSigTimeoutTime_RFHM" SG_ 1459 Next_Charge_StartDay 0;
BA_ "GenSigTimeoutTime_TCM" SG_ 1459 Next_Charge_StartDay 0;
BA_ "GenSigTimeoutTime_AGSM" SG_ 1459 Next_Climate_Day 0;
BA_ "GenSigTimeoutTime_BCM" SG_ 1459 Next_Climate_Day 0;
BA_ "GenSigTimeoutTime_BSM" SG_ 1459 Next_Climate_Day 0;
BA_ "GenSigTimeoutTime_CADM" SG_ 1459 Next_Climate_Day 0;
BA_ "GenSigTimeoutTime_DMSM" SG_ 1459 Next_Climate_Day 0;
BA_ "GenSigTimeoutTime_DTCM" SG_ 1459 Next_Climate_Day 0;
BA_ "GenSigTimeoutTime_ECM" SG_ 1459 Next_Climate_Day 0;
BA_ "GenSigTimeoutTime_EVCU2" SG_ 1459 Next_Climate_Day 0;
BA_ "GenSigTimeoutTime_GNMM" SG_ 1459 Next_Climate_Day 0;
BA_ "GenSigTimeoutTime_HCP" SG_ 1459 Next_Climate_Day 0;
BA_ "GenSigTimeoutTime_IPC" SG_ 1459 Next_Climate_Day 0;
BA_ "GenSigTimeoutTime_RFHM" SG_ 1459 Next_Climate_Day 0;
BA_ "GenSigTimeoutTime_TCM" SG_ 1459 Next_Climate_Day 0;
BA_ "GenSigTimeoutTime_AGSM" SG_ 1459 Next_Climate_Time_Hr 0;
BA_ "GenSigTimeoutTime_BCM" SG_ 1459 Next_Climate_Time_Hr 0;
BA_ "GenSigTimeoutTime_BSM" SG_ 1459 Next_Climate_Time_Hr 0;
BA_ "GenSigTimeoutTime_CADM" SG_ 1459 Next_Climate_Time_Hr 0;
BA_ "GenSigTimeoutTime_DMSM" SG_ 1459 Next_Climate_Time_Hr 0;
BA_ "GenSigTimeoutTime_DTCM" SG_ 1459 Next_Climate_Time_Hr 0;
BA_ "GenSigTimeoutTime_ECM" SG_ 1459 Next_Climate_Time_Hr 0;
BA_ "GenSigTimeoutTime_EVCU2" SG_ 1459 Next_Climate_Time_Hr 0;
BA_ "GenSigTimeoutTime_GNMM" SG_ 1459 Next_Climate_Time_Hr 0;
BA_ "GenSigTimeoutTime_HCP" SG_ 1459 Next_Climate_Time_Hr 0;
BA_ "GenSigTimeoutTime_IPC" SG_ 1459 Next_Climate_Time_Hr 0;
BA_ "GenSigTimeoutTime_RFHM" SG_ 1459 Next_Climate_Time_Hr 0;
BA_ "GenSigTimeoutTime_TCM" SG_ 1459 Next_Climate_Time_Hr 0;
BA_ "GenSigTimeoutTime_AGSM" SG_ 1459 Next_Climate_Time_Min 0;
BA_ "GenSigTimeoutTime_BCM" SG_ 1459 Next_Climate_Time_Min 0;
BA_ "GenSigTimeoutTime_BSM" SG_ 1459 Next_Climate_Time_Min 0;
BA_ "GenSigTimeoutTime_CADM" SG_ 1459 Next_Climate_Time_Min 0;
BA_ "GenSigTimeoutTime_DMSM" SG_ 1459 Next_Climate_Time_Min 0;
BA_ "GenSigTimeoutTime_DTCM" SG_ 1459 Next_Climate_Time_Min 0;
BA_ "GenSigTimeoutTime_ECM" SG_ 1459 Next_Climate_Time_Min 0;
BA_ "GenSigTimeoutTime_EVCU2" SG_ 1459 Next_Climate_Time_Min 0;
BA_ "GenSigTimeoutTime_GNMM" SG_ 1459 Next_Climate_Time_Min 0;
BA_ "GenSigTimeoutTime_HCP" SG_ 1459 Next_Climate_Time_Min 0;
BA_ "GenSigTimeoutTime_IPC" SG_ 1459 Next_Climate_Time_Min 0;
BA_ "GenSigTimeoutTime_RFHM" SG_ 1459 Next_Climate_Time_Min 0;
BA_ "GenSigTimeoutTime_TCM" SG_ 1459 Next_Climate_Time_Min 0;
BA_ "GenSigStartValue" SG_ 1459 Next_SchCabin_Temp 12;
BA_ "GenSigTimeoutTime_AGSM" SG_ 1459 Next_SchCabin_Temp 0;
BA_ "GenSigTimeoutTime_BCM" SG_ 1459 Next_SchCabin_Temp 0;
BA_ "GenSigTimeoutTime_BSM" SG_ 1459 Next_SchCabin_Temp 0;
BA_ "GenSigTimeoutTime_CADM" SG_ 1459 Next_SchCabin_Temp 0;
BA_ "GenSigTimeoutTime_DMSM" SG_ 1459 Next_SchCabin_Temp 0;
BA_ "GenSigTimeoutTime_DTCM" SG_ 1459 Next_SchCabin_Temp 0;
BA_ "GenSigTimeoutTime_ECM" SG_ 1459 Next_SchCabin_Temp 0;
BA_ "GenSigTimeoutTime_EVCU2" SG_ 1459 Next_SchCabin_Temp 0;
BA_ "GenSigTimeoutTime_GNMM" SG_ 1459 Next_SchCabin_Temp 0;
BA_ "GenSigTimeoutTime_HCP" SG_ 1459 Next_SchCabin_Temp 0;
BA_ "GenSigTimeoutTime_IPC" SG_ 1459 Next_SchCabin_Temp 0;
BA_ "GenSigTimeoutTime_RFHM" SG_ 1459 Next_SchCabin_Temp 0;
BA_ "GenSigTimeoutTime_TCM" SG_ 1459 Next_SchCabin_Temp 0;
BA_ "GenSigSendType" SG_ 1459 Nxt_Charge_Schedule_Type 3;
BA_ "GenSigTimeoutTime_AGSM" SG_ 1459 Nxt_Charge_Schedule_Type 0;
BA_ "GenSigTimeoutTime_BCM" SG_ 1459 Nxt_Charge_Schedule_Type 0;
BA_ "GenSigTimeoutTime_BSM" SG_ 1459 Nxt_Charge_Schedule_Type 0;
BA_ "GenSigTimeoutTime_CADM" SG_ 1459 Nxt_Charge_Schedule_Type 0;
BA_ "GenSigTimeoutTime_DMSM" SG_ 1459 Nxt_Charge_Schedule_Type 0;
BA_ "GenSigTimeoutTime_DTCM" SG_ 1459 Nxt_Charge_Schedule_Type 0;
BA_ "GenSigTimeoutTime_ECM" SG_ 1459 Nxt_Charge_Schedule_Type 0;
BA_ "GenSigTimeoutTime_EVCU2" SG_ 1459 Nxt_Charge_Schedule_Type 0;
BA_ "GenSigTimeoutTime_GNMM" SG_ 1459 Nxt_Charge_Schedule_Type 0;
BA_ "GenSigTimeoutTime_HCP" SG_ 1459 Nxt_Charge_Schedule_Type 0;
BA_ "GenSigTimeoutTime_IPC" SG_ 1459 Nxt_Charge_Schedule_Type 0;
BA_ "GenSigTimeoutTime_RFHM" SG_ 1459 Nxt_Charge_Schedule_Type 0;
BA_ "GenSigTimeoutTime_TCM" SG_ 1459 Nxt_Charge_Schedule_Type 0;
BA_ "GenSigSendType" SG_ 1459 Nxt_Ext_Charge_End_Time_Hr 3;
BA_ "GenSigTimeoutTime_AGSM" SG_ 1459 Nxt_Ext_Charge_End_Time_Hr 0;
BA_ "GenSigTimeoutTime_BCM" SG_ 1459 Nxt_Ext_Charge_End_Time_Hr 0;
BA_ "GenSigTimeoutTime_BSM" SG_ 1459 Nxt_Ext_Charge_End_Time_Hr 0;
BA_ "GenSigTimeoutTime_CADM" SG_ 1459 Nxt_Ext_Charge_End_Time_Hr 0;
BA_ "GenSigTimeoutTime_DMSM" SG_ 1459 Nxt_Ext_Charge_End_Time_Hr 0;
BA_ "GenSigTimeoutTime_DTCM" SG_ 1459 Nxt_Ext_Charge_End_Time_Hr 0;
BA_ "GenSigTimeoutTime_ECM" SG_ 1459 Nxt_Ext_Charge_End_Time_Hr 0;
BA_ "GenSigTimeoutTime_EVCU2" SG_ 1459 Nxt_Ext_Charge_End_Time_Hr 0;
BA_ "GenSigTimeoutTime_GNMM" SG_ 1459 Nxt_Ext_Charge_End_Time_Hr 0;
BA_ "GenSigTimeoutTime_HCP" SG_ 1459 Nxt_Ext_Charge_End_Time_Hr 0;
BA_ "GenSigTimeoutTime_IPC" SG_ 1459 Nxt_Ext_Charge_End_Time_Hr 0;
BA_ "GenSigTimeoutTime_RFHM" SG_ 1459 Nxt_Ext_Charge_End_Time_Hr 0;
BA_ "GenSigTimeoutTime_TCM" SG_ 1459 Nxt_Ext_Charge_End_Time_Hr 0;
BA_ "GenSigStartValue" SG_ 1459 Nxt_Ext_Charge_End_Time_Min 15;
BA_ "GenSigSendType" SG_ 1459 Nxt_Ext_Charge_End_Time_Min 3;
BA_ "GenSigTimeoutTime_AGSM" SG_ 1459 Nxt_Ext_Charge_End_Time_Min 0;
BA_ "GenSigTimeoutTime_BCM" SG_ 1459 Nxt_Ext_Charge_End_Time_Min 0;
BA_ "GenSigTimeoutTime_BSM" SG_ 1459 Nxt_Ext_Charge_End_Time_Min 0;
BA_ "GenSigTimeoutTime_CADM" SG_ 1459 Nxt_Ext_Charge_End_Time_Min 0;
BA_ "GenSigTimeoutTime_DMSM" SG_ 1459 Nxt_Ext_Charge_End_Time_Min 0;
BA_ "GenSigTimeoutTime_DTCM" SG_ 1459 Nxt_Ext_Charge_End_Time_Min 0;
BA_ "GenSigTimeoutTime_ECM" SG_ 1459 Nxt_Ext_Charge_End_Time_Min 0;
BA_ "GenSigTimeoutTime_EVCU2" SG_ 1459 Nxt_Ext_Charge_End_Time_Min 0;
BA_ "GenSigTimeoutTime_GNMM" SG_ 1459 Nxt_Ext_Charge_End_Time_Min 0;
BA_ "GenSigTimeoutTime_HCP" SG_ 1459 Nxt_Ext_Charge_End_Time_Min 0;
BA_ "GenSigTimeoutTime_IPC" SG_ 1459 Nxt_Ext_Charge_End_Time_Min 0;
BA_ "GenSigTimeoutTime_RFHM" SG_ 1459 Nxt_Ext_Charge_End_Time_Min 0;
BA_ "GenSigTimeoutTime_TCM" SG_ 1459 Nxt_Ext_Charge_End_Time_Min 0;
BA_ "GenSigStartValue" SG_ 1459 Nxt_External_Charge_EndDay 15;
BA_ "GenSigSendType" SG_ 1459 Nxt_External_Charge_EndDay 3;
BA_ "GenSigTimeoutTime_AGSM" SG_ 1459 Nxt_External_Charge_EndDay 0;
BA_ "GenSigTimeoutTime_BCM" SG_ 1459 Nxt_External_Charge_EndDay 0;
BA_ "GenSigTimeoutTime_BSM" SG_ 1459 Nxt_External_Charge_EndDay 0;
BA_ "GenSigTimeoutTime_CADM" SG_ 1459 Nxt_External_Charge_EndDay 0;
BA_ "GenSigTimeoutTime_DMSM" SG_ 1459 Nxt_External_Charge_EndDay 0;
BA_ "GenSigTimeoutTime_DTCM" SG_ 1459 Nxt_External_Charge_EndDay 0;
BA_ "GenSigTimeoutTime_ECM" SG_ 1459 Nxt_External_Charge_EndDay 0;
BA_ "GenSigTimeoutTime_EVCU2" SG_ 1459 Nxt_External_Charge_EndDay 0;
BA_ "GenSigTimeoutTime_GNMM" SG_ 1459 Nxt_External_Charge_EndDay 0;
BA_ "GenSigTimeoutTime_HCP" SG_ 1459 Nxt_External_Charge_EndDay 0;
BA_ "GenSigTimeoutTime_IPC" SG_ 1459 Nxt_External_Charge_EndDay 0;
BA_ "GenSigTimeoutTime_RFHM" SG_ 1459 Nxt_External_Charge_EndDay 0;
BA_ "GenSigTimeoutTime_TCM" SG_ 1459 Nxt_External_Charge_EndDay 0;
BA_ "GenSigStartValue" SG_ 1459 Nxt_External_Charge_ExternalTgt 15;
BA_ "GenSigSendType" SG_ 1459 Nxt_External_Charge_ExternalTgt 3;
BA_ "GenSigTimeoutTime_AGSM" SG_ 1459 Nxt_External_Charge_ExternalTgt 0;
BA_ "GenSigTimeoutTime_BCM" SG_ 1459 Nxt_External_Charge_ExternalTgt 0;
BA_ "GenSigTimeoutTime_BSM" SG_ 1459 Nxt_External_Charge_ExternalTgt 0;
BA_ "GenSigTimeoutTime_CADM" SG_ 1459 Nxt_External_Charge_ExternalTgt 0;
BA_ "GenSigTimeoutTime_DMSM" SG_ 1459 Nxt_External_Charge_ExternalTgt 0;
BA_ "GenSigTimeoutTime_DTCM" SG_ 1459 Nxt_External_Charge_ExternalTgt 0;
BA_ "GenSigTimeoutTime_ECM" SG_ 1459 Nxt_External_Charge_ExternalTgt 0;
BA_ "GenSigTimeoutTime_EVCU2" SG_ 1459 Nxt_External_Charge_ExternalTgt 0;
BA_ "GenSigTimeoutTime_GNMM" SG_ 1459 Nxt_External_Charge_ExternalTgt 0;
BA_ "GenSigTimeoutTime_HCP" SG_ 1459 Nxt_External_Charge_ExternalTgt 0;
BA_ "GenSigTimeoutTime_IPC" SG_ 1459 Nxt_External_Charge_ExternalTgt 0;
BA_ "GenSigTimeoutTime_RFHM" SG_ 1459 Nxt_External_Charge_ExternalTgt 0;
BA_ "GenSigTimeoutTime_TCM" SG_ 1459 Nxt_External_Charge_ExternalTgt 0;
BA_ "GenSigStartValue" SG_ 1459 Nxt_External_Charge_ImmediateTgt 15;
BA_ "GenSigSendType" SG_ 1459 Nxt_External_Charge_ImmediateTgt 3;
BA_ "GenSigTimeoutTime_AGSM" SG_ 1459 Nxt_External_Charge_ImmediateTgt 0;
BA_ "GenSigTimeoutTime_BCM" SG_ 1459 Nxt_External_Charge_ImmediateTgt 0;
BA_ "GenSigTimeoutTime_BSM" SG_ 1459 Nxt_External_Charge_ImmediateTgt 0;
BA_ "GenSigTimeoutTime_CADM" SG_ 1459 Nxt_External_Charge_ImmediateTgt 0;
BA_ "GenSigTimeoutTime_DMSM" SG_ 1459 Nxt_External_Charge_ImmediateTgt 0;
BA_ "GenSigTimeoutTime_DTCM" SG_ 1459 Nxt_External_Charge_ImmediateTgt 0;
BA_ "GenSigTimeoutTime_ECM" SG_ 1459 Nxt_External_Charge_ImmediateTgt 0;
BA_ "GenSigTimeoutTime_EVCU2" SG_ 1459 Nxt_External_Charge_ImmediateTgt 0;
BA_ "GenSigTimeoutTime_GNMM" SG_ 1459 Nxt_External_Charge_ImmediateTgt 0;
BA_ "GenSigTimeoutTime_HCP" SG_ 1459 Nxt_External_Charge_ImmediateTgt 0;
BA_ "GenSigTimeoutTime_IPC" SG_ 1459 Nxt_External_Charge_ImmediateTgt 0;
BA_ "GenSigTimeoutTime_RFHM" SG_ 1459 Nxt_External_Charge_ImmediateTgt 0;
BA_ "GenSigTimeoutTime_TCM" SG_ 1459 Nxt_External_Charge_ImmediateTgt 0;
BA_ "GenSigSendType" SG_ 1468 AllowClimateSchd1_Sts 3;
BA_ "GenSigTimeoutTime_AGSM" SG_ 1468 AllowClimateSchd1_Sts 0;
BA_ "GenSigTimeoutTime_BCM" SG_ 1468 AllowClimateSchd1_Sts 0;
BA_ "GenSigTimeoutTime_BSM" SG_ 1468 AllowClimateSchd1_Sts 0;
BA_ "GenSigTimeoutTime_CADM" SG_ 1468 AllowClimateSchd1_Sts 0;
BA_ "GenSigTimeoutTime_DMSM" SG_ 1468 AllowClimateSchd1_Sts 0;
BA_ "GenSigTimeoutTime_DTCM" SG_ 1468 AllowClimateSchd1_Sts 0;
BA_ "GenSigTimeoutTime_ECM" SG_ 1468 AllowClimateSchd1_Sts 0;
BA_ "GenSigTimeoutTime_EVCU2" SG_ 1468 AllowClimateSchd1_Sts 0;
BA_ "GenSigTimeoutTime_GNMM" SG_ 1468 AllowClimateSchd1_Sts 0;
BA_ "GenSigTimeoutTime_HCP" SG_ 1468 AllowClimateSchd1_Sts 0;
BA_ "GenSigTimeoutTime_IPC" SG_ 1468 AllowClimateSchd1_Sts 0;
BA_ "GenSigTimeoutTime_RFHM" SG_ 1468 AllowClimateSchd1_Sts 0;
BA_ "GenSigTimeoutTime_TCM" SG_ 1468 AllowClimateSchd1_Sts 0;
BA_ "GenSigSendType" SG_ 1468 AllowClimateSchd2_Sts 3;
BA_ "GenSigTimeoutTime_AGSM" SG_ 1468 AllowClimateSchd2_Sts 0;
BA_ "GenSigTimeoutTime_BCM" SG_ 1468 AllowClimateSchd2_Sts 0;
BA_ "GenSigTimeoutTime_BSM" SG_ 1468 AllowClimateSchd2_Sts 0;
BA_ "GenSigTimeoutTime_CADM" SG_ 1468 AllowClimateSchd2_Sts 0;
BA_ "GenSigTimeoutTime_DMSM" SG_ 1468 AllowClimateSchd2_Sts 0;
BA_ "GenSigTimeoutTime_DTCM" SG_ 1468 AllowClimateSchd2_Sts 0;
BA_ "GenSigTimeoutTime_ECM" SG_ 1468 AllowClimateSchd2_Sts 0;
BA_ "GenSigTimeoutTime_EVCU2" SG_ 1468 AllowClimateSchd2_Sts 0;
BA_ "GenSigTimeoutTime_GNMM" SG_ 1468 AllowClimateSchd2_Sts 0;
BA_ "GenSigTimeoutTime_HCP" SG_ 1468 AllowClimateSchd2_Sts 0;
BA_ "GenSigTimeoutTime_IPC" SG_ 1468 AllowClimateSchd2_Sts 0;
BA_ "GenSigTimeoutTime_RFHM" SG_ 1468 AllowClimateSchd2_Sts 0;
BA_ "GenSigTimeoutTime_TCM" SG_ 1468 AllowClimateSchd2_Sts 0;
BA_ "GenSigStartValue" SG_ 1468 Climate_Cabin_Temp1_Sts 12;
BA_ "GenSigSendType" SG_ 1468 Climate_Cabin_Temp1_Sts 3;
BA_ "GenSigTimeoutTime_AGSM" SG_ 1468 Climate_Cabin_Temp1_Sts 0;
BA_ "GenSigTimeoutTime_BCM" SG_ 1468 Climate_Cabin_Temp1_Sts 0;
BA_ "GenSigTimeoutTime_BSM" SG_ 1468 Climate_Cabin_Temp1_Sts 0;
BA_ "GenSigTimeoutTime_CADM" SG_ 1468 Climate_Cabin_Temp1_Sts 0;
BA_ "GenSigTimeoutTime_DMSM" SG_ 1468 Climate_Cabin_Temp1_Sts 0;
BA_ "GenSigTimeoutTime_DTCM" SG_ 1468 Climate_Cabin_Temp1_Sts 0;
BA_ "GenSigTimeoutTime_ECM" SG_ 1468 Climate_Cabin_Temp1_Sts 0;
BA_ "GenSigTimeoutTime_EVCU2" SG_ 1468 Climate_Cabin_Temp1_Sts 0;
BA_ "GenSigTimeoutTime_GNMM" SG_ 1468 Climate_Cabin_Temp1_Sts 0;
BA_ "GenSigTimeoutTime_HCP" SG_ 1468 Climate_Cabin_Temp1_Sts 0;
BA_ "GenSigTimeoutTime_IPC" SG_ 1468 Climate_Cabin_Temp1_Sts 0;
BA_ "GenSigTimeoutTime_RFHM" SG_ 1468 Climate_Cabin_Temp1_Sts 0;
BA_ "GenSigTimeoutTime_TCM" SG_ 1468 Climate_Cabin_Temp1_Sts 0;
BA_ "GenSigStartValue" SG_ 1468 Climate_Cabin_Temp2_Sts 12;
BA_ "GenSigSendType" SG_ 1468 Climate_Cabin_Temp2_Sts 3;
BA_ "GenSigTimeoutTime_AGSM" SG_ 1468 Climate_Cabin_Temp2_Sts 0;
BA_ "GenSigTimeoutTime_BCM" SG_ 1468 Climate_Cabin_Temp2_Sts 0;
BA_ "GenSigTimeoutTime_BSM" SG_ 1468 Climate_Cabin_Temp2_Sts 0;
BA_ "GenSigTimeoutTime_CADM" SG_ 1468 Climate_Cabin_Temp2_Sts 0;
BA_ "GenSigTimeoutTime_DMSM" SG_ 1468 Climate_Cabin_Temp2_Sts 0;
BA_ "GenSigTimeoutTime_DTCM" SG_ 1468 Climate_Cabin_Temp2_Sts 0;
BA_ "GenSigTimeoutTime_ECM" SG_ 1468 Climate_Cabin_Temp2_Sts 0;
BA_ "GenSigTimeoutTime_EVCU2" SG_ 1468 Climate_Cabin_Temp2_Sts 0;
BA_ "GenSigTimeoutTime_GNMM" SG_ 1468 Climate_Cabin_Temp2_Sts 0;
BA_ "GenSigTimeoutTime_HCP" SG_ 1468 Climate_Cabin_Temp2_Sts 0;
BA_ "GenSigTimeoutTime_IPC" SG_ 1468 Climate_Cabin_Temp2_Sts 0;
BA_ "GenSigTimeoutTime_RFHM" SG_ 1468 Climate_Cabin_Temp2_Sts 0;
BA_ "GenSigTimeoutTime_TCM" SG_ 1468 Climate_Cabin_Temp2_Sts 0;
BA_ "GenSigSendType" SG_ 1468 ClimateSchd1_Day_Sts 3;
BA_ "GenSigTimeoutTime_AGSM" SG_ 1468 ClimateSchd1_Day_Sts 0;
BA_ "GenSigTimeoutTime_BCM" SG_ 1468 ClimateSchd1_Day_Sts 0;
BA_ "GenSigTimeoutTime_BSM" SG_ 1468 ClimateSchd1_Day_Sts 0;
BA_ "GenSigTimeoutTime_CADM" SG_ 1468 ClimateSchd1_Day_Sts 0;
BA_ "GenSigTimeoutTime_DMSM" SG_ 1468 ClimateSchd1_Day_Sts 0;
BA_ "GenSigTimeoutTime_DTCM" SG_ 1468 ClimateSchd1_Day_Sts 0;
BA_ "GenSigTimeoutTime_ECM" SG_ 1468 ClimateSchd1_Day_Sts 0;
BA_ "GenSigTimeoutTime_EVCU2" SG_ 1468 ClimateSchd1_Day_Sts 0;
BA_ "GenSigTimeoutTime_GNMM" SG_ 1468 ClimateSchd1_Day_Sts 0;
BA_ "GenSigTimeoutTime_HCP" SG_ 1468 ClimateSchd1_Day_Sts 0;
BA_ "GenSigTimeoutTime_IPC" SG_ 1468 ClimateSchd1_Day_Sts 0;
BA_ "GenSigTimeoutTime_RFHM" SG_ 1468 ClimateSchd1_Day_Sts 0;
BA_ "GenSigTimeoutTime_TCM" SG_ 1468 ClimateSchd1_Day_Sts 0;
BA_ "GenSigSendType" SG_ 1468 ClimateSchd1_Departure_Hr_Sts 3;
BA_ "GenSigTimeoutTime_AGSM" SG_ 1468 ClimateSchd1_Departure_Hr_Sts 0;
BA_ "GenSigTimeoutTime_BCM" SG_ 1468 ClimateSchd1_Departure_Hr_Sts 0;
BA_ "GenSigTimeoutTime_BSM" SG_ 1468 ClimateSchd1_Departure_Hr_Sts 0;
BA_ "GenSigTimeoutTime_CADM" SG_ 1468 ClimateSchd1_Departure_Hr_Sts 0;
BA_ "GenSigTimeoutTime_DMSM" SG_ 1468 ClimateSchd1_Departure_Hr_Sts 0;
BA_ "GenSigTimeoutTime_DTCM" SG_ 1468 ClimateSchd1_Departure_Hr_Sts 0;
BA_ "GenSigTimeoutTime_ECM" SG_ 1468 ClimateSchd1_Departure_Hr_Sts 0;
BA_ "GenSigTimeoutTime_EVCU2" SG_ 1468 ClimateSchd1_Departure_Hr_Sts 0;
BA_ "GenSigTimeoutTime_GNMM" SG_ 1468 ClimateSchd1_Departure_Hr_Sts 0;
BA_ "GenSigTimeoutTime_HCP" SG_ 1468 ClimateSchd1_Departure_Hr_Sts 0;
BA_ "GenSigTimeoutTime_IPC" SG_ 1468 ClimateSchd1_Departure_Hr_Sts 0;
BA_ "GenSigTimeoutTime_RFHM" SG_ 1468 ClimateSchd1_Departure_Hr_Sts 0;
BA_ "GenSigTimeoutTime_TCM" SG_ 1468 ClimateSchd1_Departure_Hr_Sts 0;
BA_ "GenSigSendType" SG_ 1468 ClimateSchd1_Departure_Min_Sts 3;
BA_ "GenSigTimeoutTime_AGSM" SG_ 1468 ClimateSchd1_Departure_Min_Sts 0;
BA_ "GenSigTimeoutTime_BCM" SG_ 1468 ClimateSchd1_Departure_Min_Sts 0;
BA_ "GenSigTimeoutTime_BSM" SG_ 1468 ClimateSchd1_Departure_Min_Sts 0;
BA_ "GenSigTimeoutTime_CADM" SG_ 1468 ClimateSchd1_Departure_Min_Sts 0;
BA_ "GenSigTimeoutTime_DMSM" SG_ 1468 ClimateSchd1_Departure_Min_Sts 0;
BA_ "GenSigTimeoutTime_DTCM" SG_ 1468 ClimateSchd1_Departure_Min_Sts 0;
BA_ "GenSigTimeoutTime_ECM" SG_ 1468 ClimateSchd1_Departure_Min_Sts 0;
BA_ "GenSigTimeoutTime_EVCU2" SG_ 1468 ClimateSchd1_Departure_Min_Sts 0;
BA_ "GenSigTimeoutTime_GNMM" SG_ 1468 ClimateSchd1_Departure_Min_Sts 0;
BA_ "GenSigTimeoutTime_HCP" SG_ 1468 ClimateSchd1_Departure_Min_Sts 0;
BA_ "GenSigTimeoutTime_IPC" SG_ 1468 ClimateSchd1_Departure_Min_Sts 0;
BA_ "GenSigTimeoutTime_RFHM" SG_ 1468 ClimateSchd1_Departure_Min_Sts 0;
BA_ "GenSigTimeoutTime_TCM" SG_ 1468 ClimateSchd1_Departure_Min_Sts 0;
BA_ "GenSigSendType" SG_ 1468 ClimateSchd2_Day_Sts 3;
BA_ "GenSigTimeoutTime_AGSM" SG_ 1468 ClimateSchd2_Day_Sts 0;
BA_ "GenSigTimeoutTime_BCM" SG_ 1468 ClimateSchd2_Day_Sts 0;
BA_ "GenSigTimeoutTime_BSM" SG_ 1468 ClimateSchd2_Day_Sts 0;
BA_ "GenSigTimeoutTime_CADM" SG_ 1468 ClimateSchd2_Day_Sts 0;
BA_ "GenSigTimeoutTime_DMSM" SG_ 1468 ClimateSchd2_Day_Sts 0;
BA_ "GenSigTimeoutTime_DTCM" SG_ 1468 ClimateSchd2_Day_Sts 0;
BA_ "GenSigTimeoutTime_ECM" SG_ 1468 ClimateSchd2_Day_Sts 0;
BA_ "GenSigTimeoutTime_EVCU2" SG_ 1468 ClimateSchd2_Day_Sts 0;
BA_ "GenSigTimeoutTime_GNMM" SG_ 1468 ClimateSchd2_Day_Sts 0;
BA_ "GenSigTimeoutTime_HCP" SG_ 1468 ClimateSchd2_Day_Sts 0;
BA_ "GenSigTimeoutTime_IPC" SG_ 1468 ClimateSchd2_Day_Sts 0;
BA_ "GenSigTimeoutTime_RFHM" SG_ 1468 ClimateSchd2_Day_Sts 0;
BA_ "GenSigTimeoutTime_TCM" SG_ 1468 ClimateSchd2_Day_Sts 0;
BA_ "GenSigSendType" SG_ 1468 ClimateSchd2_Departure_Hr_Sts 3;
BA_ "GenSigTimeoutTime_AGSM" SG_ 1468 ClimateSchd2_Departure_Hr_Sts 0;
BA_ "GenSigTimeoutTime_BCM" SG_ 1468 ClimateSchd2_Departure_Hr_Sts 0;
BA_ "GenSigTimeoutTime_BSM" SG_ 1468 ClimateSchd2_Departure_Hr_Sts 0;
BA_ "GenSigTimeoutTime_CADM" SG_ 1468 ClimateSchd2_Departure_Hr_Sts 0;
BA_ "GenSigTimeoutTime_DMSM" SG_ 1468 ClimateSchd2_Departure_Hr_Sts 0;
BA_ "GenSigTimeoutTime_DTCM" SG_ 1468 ClimateSchd2_Departure_Hr_Sts 0;
BA_ "GenSigTimeoutTime_ECM" SG_ 1468 ClimateSchd2_Departure_Hr_Sts 0;
BA_ "GenSigTimeoutTime_EVCU2" SG_ 1468 ClimateSchd2_Departure_Hr_Sts 0;
BA_ "GenSigTimeoutTime_GNMM" SG_ 1468 ClimateSchd2_Departure_Hr_Sts 0;
BA_ "GenSigTimeoutTime_HCP" SG_ 1468 ClimateSchd2_Departure_Hr_Sts 0;
BA_ "GenSigTimeoutTime_IPC" SG_ 1468 ClimateSchd2_Departure_Hr_Sts 0;
BA_ "GenSigTimeoutTime_RFHM" SG_ 1468 ClimateSchd2_Departure_Hr_Sts 0;
BA_ "GenSigTimeoutTime_TCM" SG_ 1468 ClimateSchd2_Departure_Hr_Sts 0;
BA_ "GenSigSendType" SG_ 1468 ClimateSchd2_Departure_Min_Sts 3;
BA_ "GenSigTimeoutTime_AGSM" SG_ 1468 ClimateSchd2_Departure_Min_Sts 0;
BA_ "GenSigTimeoutTime_BCM" SG_ 1468 ClimateSchd2_Departure_Min_Sts 0;
BA_ "GenSigTimeoutTime_BSM" SG_ 1468 ClimateSchd2_Departure_Min_Sts 0;
BA_ "GenSigTimeoutTime_CADM" SG_ 1468 ClimateSchd2_Departure_Min_Sts 0;
BA_ "GenSigTimeoutTime_DMSM" SG_ 1468 ClimateSchd2_Departure_Min_Sts 0;
BA_ "GenSigTimeoutTime_DTCM" SG_ 1468 ClimateSchd2_Departure_Min_Sts 0;
BA_ "GenSigTimeoutTime_ECM" SG_ 1468 ClimateSchd2_Departure_Min_Sts 0;
BA_ "GenSigTimeoutTime_EVCU2" SG_ 1468 ClimateSchd2_Departure_Min_Sts 0;
BA_ "GenSigTimeoutTime_GNMM" SG_ 1468 ClimateSchd2_Departure_Min_Sts 0;
BA_ "GenSigTimeoutTime_HCP" SG_ 1468 ClimateSchd2_Departure_Min_Sts 0;
BA_ "GenSigTimeoutTime_IPC" SG_ 1468 ClimateSchd2_Departure_Min_Sts 0;
BA_ "GenSigTimeoutTime_RFHM" SG_ 1468 ClimateSchd2_Departure_Min_Sts 0;
BA_ "GenSigTimeoutTime_TCM" SG_ 1468 ClimateSchd2_Departure_Min_Sts 0;
BA_ "GenSigSendType" SG_ 1468 Enable_ClimateSchd1_Sts 3;
BA_ "GenSigTimeoutTime_AGSM" SG_ 1468 Enable_ClimateSchd1_Sts 0;
BA_ "GenSigTimeoutTime_BCM" SG_ 1468 Enable_ClimateSchd1_Sts 0;
BA_ "GenSigTimeoutTime_BSM" SG_ 1468 Enable_ClimateSchd1_Sts 0;
BA_ "GenSigTimeoutTime_CADM" SG_ 1468 Enable_ClimateSchd1_Sts 0;
BA_ "GenSigTimeoutTime_DMSM" SG_ 1468 Enable_ClimateSchd1_Sts 0;
BA_ "GenSigTimeoutTime_DTCM" SG_ 1468 Enable_ClimateSchd1_Sts 0;
BA_ "GenSigTimeoutTime_ECM" SG_ 1468 Enable_ClimateSchd1_Sts 0;
BA_ "GenSigTimeoutTime_EVCU2" SG_ 1468 Enable_ClimateSchd1_Sts 0;
BA_ "GenSigTimeoutTime_GNMM" SG_ 1468 Enable_ClimateSchd1_Sts 0;
BA_ "GenSigTimeoutTime_HCP" SG_ 1468 Enable_ClimateSchd1_Sts 0;
BA_ "GenSigTimeoutTime_IPC" SG_ 1468 Enable_ClimateSchd1_Sts 0;
BA_ "GenSigTimeoutTime_RFHM" SG_ 1468 Enable_ClimateSchd1_Sts 0;
BA_ "GenSigTimeoutTime_TCM" SG_ 1468 Enable_ClimateSchd1_Sts 0;
BA_ "GenSigSendType" SG_ 1468 Enable_ClimateSchd2_Sts 3;
BA_ "GenSigTimeoutTime_AGSM" SG_ 1468 Enable_ClimateSchd2_Sts 0;
BA_ "GenSigTimeoutTime_BCM" SG_ 1468 Enable_ClimateSchd2_Sts 0;
BA_ "GenSigTimeoutTime_BSM" SG_ 1468 Enable_ClimateSchd2_Sts 0;
BA_ "GenSigTimeoutTime_CADM" SG_ 1468 Enable_ClimateSchd2_Sts 0;
BA_ "GenSigTimeoutTime_DMSM" SG_ 1468 Enable_ClimateSchd2_Sts 0;
BA_ "GenSigTimeoutTime_DTCM" SG_ 1468 Enable_ClimateSchd2_Sts 0;
BA_ "GenSigTimeoutTime_ECM" SG_ 1468 Enable_ClimateSchd2_Sts 0;
BA_ "GenSigTimeoutTime_EVCU2" SG_ 1468 Enable_ClimateSchd2_Sts 0;
BA_ "GenSigTimeoutTime_GNMM" SG_ 1468 Enable_ClimateSchd2_Sts 0;
BA_ "GenSigTimeoutTime_HCP" SG_ 1468 Enable_ClimateSchd2_Sts 0;
BA_ "GenSigTimeoutTime_IPC" SG_ 1468 Enable_ClimateSchd2_Sts 0;
BA_ "GenSigTimeoutTime_RFHM" SG_ 1468 Enable_ClimateSchd2_Sts 0;
BA_ "GenSigTimeoutTime_TCM" SG_ 1468 Enable_ClimateSchd2_Sts 0;
BA_ "GenSigSendType" SG_ 1471 AllowClimateSchd1 3;
BA_ "GenSigTimeoutTime_AGSM" SG_ 1471 AllowClimateSchd1 0;
BA_ "GenSigTimeoutTime_BCM" SG_ 1471 AllowClimateSchd1 0;
BA_ "GenSigTimeoutTime_BSM" SG_ 1471 AllowClimateSchd1 0;
BA_ "GenSigTimeoutTime_CADM" SG_ 1471 AllowClimateSchd1 0;
BA_ "GenSigTimeoutTime_DMSM" SG_ 1471 AllowClimateSchd1 0;
BA_ "GenSigTimeoutTime_DTCM" SG_ 1471 AllowClimateSchd1 0;
BA_ "GenSigTimeoutTime_ECM" SG_ 1471 AllowClimateSchd1 0;
BA_ "GenSigTimeoutTime_GNMM" SG_ 1471 AllowClimateSchd1 0;
BA_ "GenSigTimeoutTime_HCP" SG_ 1471 AllowClimateSchd1 0;
BA_ "GenSigTimeoutTime_IPC" SG_ 1471 AllowClimateSchd1 0;
BA_ "GenSigTimeoutTime_RFHM" SG_ 1471 AllowClimateSchd1 0;
BA_ "GenSigTimeoutTime_SGW" SG_ 1471 AllowClimateSchd1 0;
BA_ "GenSigTimeoutTime_TCM" SG_ 1471 AllowClimateSchd1 0;
BA_ "GenSigSendType" SG_ 1471 AllowClimateSchd2 3;
BA_ "GenSigTimeoutTime_AGSM" SG_ 1471 AllowClimateSchd2 0;
BA_ "GenSigTimeoutTime_BCM" SG_ 1471 AllowClimateSchd2 0;
BA_ "GenSigTimeoutTime_BSM" SG_ 1471 AllowClimateSchd2 0;
BA_ "GenSigTimeoutTime_CADM" SG_ 1471 AllowClimateSchd2 0;
BA_ "GenSigTimeoutTime_DMSM" SG_ 1471 AllowClimateSchd2 0;
BA_ "GenSigTimeoutTime_DTCM" SG_ 1471 AllowClimateSchd2 0;
BA_ "GenSigTimeoutTime_ECM" SG_ 1471 AllowClimateSchd2 0;
BA_ "GenSigTimeoutTime_GNMM" SG_ 1471 AllowClimateSchd2 0;
BA_ "GenSigTimeoutTime_HCP" SG_ 1471 AllowClimateSchd2 0;
BA_ "GenSigTimeoutTime_IPC" SG_ 1471 AllowClimateSchd2 0;
BA_ "GenSigTimeoutTime_RFHM" SG_ 1471 AllowClimateSchd2 0;
BA_ "GenSigTimeoutTime_SGW" SG_ 1471 AllowClimateSchd2 0;
BA_ "GenSigTimeoutTime_TCM" SG_ 1471 AllowClimateSchd2 0;
BA_ "GenSigStartValue" SG_ 1471 Climate_Cabin_Temp1 12;
BA_ "GenSigSendType" SG_ 1471 Climate_Cabin_Temp1 3;
BA_ "GenSigTimeoutTime_AGSM" SG_ 1471 Climate_Cabin_Temp1 0;
BA_ "GenSigTimeoutTime_BCM" SG_ 1471 Climate_Cabin_Temp1 0;
BA_ "GenSigTimeoutTime_BSM" SG_ 1471 Climate_Cabin_Temp1 0;
BA_ "GenSigTimeoutTime_CADM" SG_ 1471 Climate_Cabin_Temp1 0;
BA_ "GenSigTimeoutTime_DMSM" SG_ 1471 Climate_Cabin_Temp1 0;
BA_ "GenSigTimeoutTime_DTCM" SG_ 1471 Climate_Cabin_Temp1 0;
BA_ "GenSigTimeoutTime_ECM" SG_ 1471 Climate_Cabin_Temp1 0;
BA_ "GenSigTimeoutTime_GNMM" SG_ 1471 Climate_Cabin_Temp1 0;
BA_ "GenSigTimeoutTime_HCP" SG_ 1471 Climate_Cabin_Temp1 0;
BA_ "GenSigTimeoutTime_IPC" SG_ 1471 Climate_Cabin_Temp1 0;
BA_ "GenSigTimeoutTime_RFHM" SG_ 1471 Climate_Cabin_Temp1 0;
BA_ "GenSigTimeoutTime_SGW" SG_ 1471 Climate_Cabin_Temp1 0;
BA_ "GenSigTimeoutTime_TCM" SG_ 1471 Climate_Cabin_Temp1 0;
BA_ "GenSigStartValue" SG_ 1471 Climate_Cabin_Temp2 12;
BA_ "GenSigSendType" SG_ 1471 Climate_Cabin_Temp2 3;
BA_ "GenSigTimeoutTime_AGSM" SG_ 1471 Climate_Cabin_Temp2 0;
BA_ "GenSigTimeoutTime_BCM" SG_ 1471 Climate_Cabin_Temp2 0;
BA_ "GenSigTimeoutTime_BSM" SG_ 1471 Climate_Cabin_Temp2 0;
BA_ "GenSigTimeoutTime_CADM" SG_ 1471 Climate_Cabin_Temp2 0;
BA_ "GenSigTimeoutTime_DMSM" SG_ 1471 Climate_Cabin_Temp2 0;
BA_ "GenSigTimeoutTime_DTCM" SG_ 1471 Climate_Cabin_Temp2 0;
BA_ "GenSigTimeoutTime_ECM" SG_ 1471 Climate_Cabin_Temp2 0;
BA_ "GenSigTimeoutTime_GNMM" SG_ 1471 Climate_Cabin_Temp2 0;
BA_ "GenSigTimeoutTime_HCP" SG_ 1471 Climate_Cabin_Temp2 0;
BA_ "GenSigTimeoutTime_IPC" SG_ 1471 Climate_Cabin_Temp2 0;
BA_ "GenSigTimeoutTime_RFHM" SG_ 1471 Climate_Cabin_Temp2 0;
BA_ "GenSigTimeoutTime_SGW" SG_ 1471 Climate_Cabin_Temp2 0;
BA_ "GenSigTimeoutTime_TCM" SG_ 1471 Climate_Cabin_Temp2 0;
BA_ "GenSigSendType" SG_ 1471 ClimateSchd1_Day 3;
BA_ "GenSigTimeoutTime_AGSM" SG_ 1471 ClimateSchd1_Day 0;
BA_ "GenSigTimeoutTime_BCM" SG_ 1471 ClimateSchd1_Day 0;
BA_ "GenSigTimeoutTime_BSM" SG_ 1471 ClimateSchd1_Day 0;
BA_ "GenSigTimeoutTime_CADM" SG_ 1471 ClimateSchd1_Day 0;
BA_ "GenSigTimeoutTime_DMSM" SG_ 1471 ClimateSchd1_Day 0;
BA_ "GenSigTimeoutTime_DTCM" SG_ 1471 ClimateSchd1_Day 0;
BA_ "GenSigTimeoutTime_ECM" SG_ 1471 ClimateSchd1_Day 0;
BA_ "GenSigTimeoutTime_GNMM" SG_ 1471 ClimateSchd1_Day 0;
BA_ "GenSigTimeoutTime_HCP" SG_ 1471 ClimateSchd1_Day 0;
BA_ "GenSigTimeoutTime_IPC" SG_ 1471 ClimateSchd1_Day 0;
BA_ "GenSigTimeoutTime_RFHM" SG_ 1471 ClimateSchd1_Day 0;
BA_ "GenSigTimeoutTime_SGW" SG_ 1471 ClimateSchd1_Day 0;
BA_ "GenSigTimeoutTime_TCM" SG_ 1471 ClimateSchd1_Day 0;
BA_ "GenSigSendType" SG_ 1471 ClimateSchd1_Departure_Hr 3;
BA_ "GenSigTimeoutTime_AGSM" SG_ 1471 ClimateSchd1_Departure_Hr 0;
BA_ "GenSigTimeoutTime_BCM" SG_ 1471 ClimateSchd1_Departure_Hr 0;
BA_ "GenSigTimeoutTime_BSM" SG_ 1471 ClimateSchd1_Departure_Hr 0;
BA_ "GenSigTimeoutTime_CADM" SG_ 1471 ClimateSchd1_Departure_Hr 0;
BA_ "GenSigTimeoutTime_DMSM" SG_ 1471 ClimateSchd1_Departure_Hr 0;
BA_ "GenSigTimeoutTime_DTCM" SG_ 1471 ClimateSchd1_Departure_Hr 0;
BA_ "GenSigTimeoutTime_ECM" SG_ 1471 ClimateSchd1_Departure_Hr 0;
BA_ "GenSigTimeoutTime_GNMM" SG_ 1471 ClimateSchd1_Departure_Hr 0;
BA_ "GenSigTimeoutTime_HCP" SG_ 1471 ClimateSchd1_Departure_Hr 0;
BA_ "GenSigTimeoutTime_IPC" SG_ 1471 ClimateSchd1_Departure_Hr 0;
BA_ "GenSigTimeoutTime_RFHM" SG_ 1471 ClimateSchd1_Departure_Hr 0;
BA_ "GenSigTimeoutTime_SGW" SG_ 1471 ClimateSchd1_Departure_Hr 0;
BA_ "GenSigTimeoutTime_TCM" SG_ 1471 ClimateSchd1_Departure_Hr 0;
BA_ "GenSigSendType" SG_ 1471 ClimateSchd1_Departure_Min 3;
BA_ "GenSigTimeoutTime_AGSM" SG_ 1471 ClimateSchd1_Departure_Min 0;
BA_ "GenSigTimeoutTime_BCM" SG_ 1471 ClimateSchd1_Departure_Min 0;
BA_ "GenSigTimeoutTime_BSM" SG_ 1471 ClimateSchd1_Departure_Min 0;
BA_ "GenSigTimeoutTime_CADM" SG_ 1471 ClimateSchd1_Departure_Min 0;
BA_ "GenSigTimeoutTime_DMSM" SG_ 1471 ClimateSchd1_Departure_Min 0;
BA_ "GenSigTimeoutTime_DTCM" SG_ 1471 ClimateSchd1_Departure_Min 0;
BA_ "GenSigTimeoutTime_ECM" SG_ 1471 ClimateSchd1_Departure_Min 0;
BA_ "GenSigTimeoutTime_GNMM" SG_ 1471 ClimateSchd1_Departure_Min 0;
BA_ "GenSigTimeoutTime_HCP" SG_ 1471 ClimateSchd1_Departure_Min 0;
BA_ "GenSigTimeoutTime_IPC" SG_ 1471 ClimateSchd1_Departure_Min 0;
BA_ "GenSigTimeoutTime_RFHM" SG_ 1471 ClimateSchd1_Departure_Min 0;
BA_ "GenSigTimeoutTime_SGW" SG_ 1471 ClimateSchd1_Departure_Min 0;
BA_ "GenSigTimeoutTime_TCM" SG_ 1471 ClimateSchd1_Departure_Min 0;
BA_ "GenSigSendType" SG_ 1471 ClimateSchd2_Day 3;
BA_ "GenSigTimeoutTime_AGSM" SG_ 1471 ClimateSchd2_Day 0;
BA_ "GenSigTimeoutTime_BCM" SG_ 1471 ClimateSchd2_Day 0;
BA_ "GenSigTimeoutTime_BSM" SG_ 1471 ClimateSchd2_Day 0;
BA_ "GenSigTimeoutTime_CADM" SG_ 1471 ClimateSchd2_Day 0;
BA_ "GenSigTimeoutTime_DMSM" SG_ 1471 ClimateSchd2_Day 0;
BA_ "GenSigTimeoutTime_DTCM" SG_ 1471 ClimateSchd2_Day 0;
BA_ "GenSigTimeoutTime_ECM" SG_ 1471 ClimateSchd2_Day 0;
BA_ "GenSigTimeoutTime_GNMM" SG_ 1471 ClimateSchd2_Day 0;
BA_ "GenSigTimeoutTime_HCP" SG_ 1471 ClimateSchd2_Day 0;
BA_ "GenSigTimeoutTime_IPC" SG_ 1471 ClimateSchd2_Day 0;
BA_ "GenSigTimeoutTime_RFHM" SG_ 1471 ClimateSchd2_Day 0;
BA_ "GenSigTimeoutTime_SGW" SG_ 1471 ClimateSchd2_Day 0;
BA_ "GenSigTimeoutTime_TCM" SG_ 1471 ClimateSchd2_Day 0;
BA_ "GenSigSendType" SG_ 1471 ClimateSchd2_Departure_Hr 3;
BA_ "GenSigTimeoutTime_AGSM" SG_ 1471 ClimateSchd2_Departure_Hr 0;
BA_ "GenSigTimeoutTime_BCM" SG_ 1471 ClimateSchd2_Departure_Hr 0;
BA_ "GenSigTimeoutTime_BSM" SG_ 1471 ClimateSchd2_Departure_Hr 0;
BA_ "GenSigTimeoutTime_CADM" SG_ 1471 ClimateSchd2_Departure_Hr 0;
BA_ "GenSigTimeoutTime_DMSM" SG_ 1471 ClimateSchd2_Departure_Hr 0;
BA_ "GenSigTimeoutTime_DTCM" SG_ 1471 ClimateSchd2_Departure_Hr 0;
BA_ "GenSigTimeoutTime_ECM" SG_ 1471 ClimateSchd2_Departure_Hr 0;
BA_ "GenSigTimeoutTime_GNMM" SG_ 1471 ClimateSchd2_Departure_Hr 0;
BA_ "GenSigTimeoutTime_HCP" SG_ 1471 ClimateSchd2_Departure_Hr 0;
BA_ "GenSigTimeoutTime_IPC" SG_ 1471 ClimateSchd2_Departure_Hr 0;
BA_ "GenSigTimeoutTime_RFHM" SG_ 1471 ClimateSchd2_Departure_Hr 0;
BA_ "GenSigTimeoutTime_SGW" SG_ 1471 ClimateSchd2_Departure_Hr 0;
BA_ "GenSigTimeoutTime_TCM" SG_ 1471 ClimateSchd2_Departure_Hr 0;
BA_ "GenSigSendType" SG_ 1471 ClimateSchd2_Departure_Min 3;
BA_ "GenSigTimeoutTime_AGSM" SG_ 1471 ClimateSchd2_Departure_Min 0;
BA_ "GenSigTimeoutTime_BCM" SG_ 1471 ClimateSchd2_Departure_Min 0;
BA_ "GenSigTimeoutTime_BSM" SG_ 1471 ClimateSchd2_Departure_Min 0;
BA_ "GenSigTimeoutTime_CADM" SG_ 1471 ClimateSchd2_Departure_Min 0;
BA_ "GenSigTimeoutTime_DMSM" SG_ 1471 ClimateSchd2_Departure_Min 0;
BA_ "GenSigTimeoutTime_DTCM" SG_ 1471 ClimateSchd2_Departure_Min 0;
BA_ "GenSigTimeoutTime_ECM" SG_ 1471 ClimateSchd2_Departure_Min 0;
BA_ "GenSigTimeoutTime_GNMM" SG_ 1471 ClimateSchd2_Departure_Min 0;
BA_ "GenSigTimeoutTime_HCP" SG_ 1471 ClimateSchd2_Departure_Min 0;
BA_ "GenSigTimeoutTime_IPC" SG_ 1471 ClimateSchd2_Departure_Min 0;
BA_ "GenSigTimeoutTime_RFHM" SG_ 1471 ClimateSchd2_Departure_Min 0;
BA_ "GenSigTimeoutTime_SGW" SG_ 1471 ClimateSchd2_Departure_Min 0;
BA_ "GenSigTimeoutTime_TCM" SG_ 1471 ClimateSchd2_Departure_Min 0;
BA_ "GenSigSendType" SG_ 1471 Enable_ClimateSchd1 3;
BA_ "GenSigTimeoutTime_AGSM" SG_ 1471 Enable_ClimateSchd1 0;
BA_ "GenSigTimeoutTime_BCM" SG_ 1471 Enable_ClimateSchd1 0;
BA_ "GenSigTimeoutTime_BSM" SG_ 1471 Enable_ClimateSchd1 0;
BA_ "GenSigTimeoutTime_CADM" SG_ 1471 Enable_ClimateSchd1 0;
BA_ "GenSigTimeoutTime_DMSM" SG_ 1471 Enable_ClimateSchd1 0;
BA_ "GenSigTimeoutTime_DTCM" SG_ 1471 Enable_ClimateSchd1 0;
BA_ "GenSigTimeoutTime_ECM" SG_ 1471 Enable_ClimateSchd1 0;
BA_ "GenSigTimeoutTime_GNMM" SG_ 1471 Enable_ClimateSchd1 0;
BA_ "GenSigTimeoutTime_HCP" SG_ 1471 Enable_ClimateSchd1 0;
BA_ "GenSigTimeoutTime_IPC" SG_ 1471 Enable_ClimateSchd1 0;
BA_ "GenSigTimeoutTime_RFHM" SG_ 1471 Enable_ClimateSchd1 0;
BA_ "GenSigTimeoutTime_SGW" SG_ 1471 Enable_ClimateSchd1 0;
BA_ "GenSigTimeoutTime_TCM" SG_ 1471 Enable_ClimateSchd1 0;
BA_ "GenSigSendType" SG_ 1471 Enable_ClimateSchd2 3;
BA_ "GenSigTimeoutTime_AGSM" SG_ 1471 Enable_ClimateSchd2 0;
BA_ "GenSigTimeoutTime_BCM" SG_ 1471 Enable_ClimateSchd2 0;
BA_ "GenSigTimeoutTime_BSM" SG_ 1471 Enable_ClimateSchd2 0;
BA_ "GenSigTimeoutTime_CADM" SG_ 1471 Enable_ClimateSchd2 0;
BA_ "GenSigTimeoutTime_DMSM" SG_ 1471 Enable_ClimateSchd2 0;
BA_ "GenSigTimeoutTime_DTCM" SG_ 1471 Enable_ClimateSchd2 0;
BA_ "GenSigTimeoutTime_ECM" SG_ 1471 Enable_ClimateSchd2 0;
BA_ "GenSigTimeoutTime_GNMM" SG_ 1471 Enable_ClimateSchd2 0;
BA_ "GenSigTimeoutTime_HCP" SG_ 1471 Enable_ClimateSchd2 0;
BA_ "GenSigTimeoutTime_IPC" SG_ 1471 Enable_ClimateSchd2 0;
BA_ "GenSigTimeoutTime_RFHM" SG_ 1471 Enable_ClimateSchd2 0;
BA_ "GenSigTimeoutTime_SGW" SG_ 1471 Enable_ClimateSchd2 0;
BA_ "GenSigTimeoutTime_TCM" SG_ 1471 Enable_ClimateSchd2 0;
BA_ "GenSigSendType" SG_ 1471 Submit_ClimateSchd1 3;
BA_ "GenSigTimeoutTime_AGSM" SG_ 1471 Submit_ClimateSchd1 0;
BA_ "GenSigTimeoutTime_BCM" SG_ 1471 Submit_ClimateSchd1 0;
BA_ "GenSigTimeoutTime_BSM" SG_ 1471 Submit_ClimateSchd1 0;
BA_ "GenSigTimeoutTime_CADM" SG_ 1471 Submit_ClimateSchd1 0;
BA_ "GenSigTimeoutTime_DMSM" SG_ 1471 Submit_ClimateSchd1 0;
BA_ "GenSigTimeoutTime_DTCM" SG_ 1471 Submit_ClimateSchd1 0;
BA_ "GenSigTimeoutTime_ECM" SG_ 1471 Submit_ClimateSchd1 0;
BA_ "GenSigTimeoutTime_GNMM" SG_ 1471 Submit_ClimateSchd1 0;
BA_ "GenSigTimeoutTime_HCP" SG_ 1471 Submit_ClimateSchd1 0;
BA_ "GenSigTimeoutTime_IPC" SG_ 1471 Submit_ClimateSchd1 0;
BA_ "GenSigTimeoutTime_RFHM" SG_ 1471 Submit_ClimateSchd1 0;
BA_ "GenSigTimeoutTime_SGW" SG_ 1471 Submit_ClimateSchd1 0;
BA_ "GenSigTimeoutTime_TCM" SG_ 1471 Submit_ClimateSchd1 0;
BA_ "GenSigSendType" SG_ 1471 Submit_ClimateSchd2 3;
BA_ "GenSigTimeoutTime_AGSM" SG_ 1471 Submit_ClimateSchd2 0;
BA_ "GenSigTimeoutTime_BCM" SG_ 1471 Submit_ClimateSchd2 0;
BA_ "GenSigTimeoutTime_BSM" SG_ 1471 Submit_ClimateSchd2 0;
BA_ "GenSigTimeoutTime_CADM" SG_ 1471 Submit_ClimateSchd2 0;
BA_ "GenSigTimeoutTime_DMSM" SG_ 1471 Submit_ClimateSchd2 0;
BA_ "GenSigTimeoutTime_DTCM" SG_ 1471 Submit_ClimateSchd2 0;
BA_ "GenSigTimeoutTime_ECM" SG_ 1471 Submit_ClimateSchd2 0;
BA_ "GenSigTimeoutTime_GNMM" SG_ 1471 Submit_ClimateSchd2 0;
BA_ "GenSigTimeoutTime_HCP" SG_ 1471 Submit_ClimateSchd2 0;
BA_ "GenSigTimeoutTime_IPC" SG_ 1471 Submit_ClimateSchd2 0;
BA_ "GenSigTimeoutTime_RFHM" SG_ 1471 Submit_ClimateSchd2 0;
BA_ "GenSigTimeoutTime_SGW" SG_ 1471 Submit_ClimateSchd2 0;
BA_ "GenSigTimeoutTime_TCM" SG_ 1471 Submit_ClimateSchd2 0;
BA_ "GenSigStartValue" SG_ 1462 Climate_TBM_Cabin_Temp1 12;
BA_ "GenSigSendType" SG_ 1462 Climate_TBM_Cabin_Temp1 3;
BA_ "GenSigTimeoutTime_AGSM" SG_ 1462 Climate_TBM_Cabin_Temp1 0;
BA_ "GenSigTimeoutTime_BCM" SG_ 1462 Climate_TBM_Cabin_Temp1 0;
BA_ "GenSigTimeoutTime_BSM" SG_ 1462 Climate_TBM_Cabin_Temp1 0;
BA_ "GenSigTimeoutTime_CADM" SG_ 1462 Climate_TBM_Cabin_Temp1 0;
BA_ "GenSigTimeoutTime_DMSM" SG_ 1462 Climate_TBM_Cabin_Temp1 0;
BA_ "GenSigTimeoutTime_DTCM" SG_ 1462 Climate_TBM_Cabin_Temp1 0;
BA_ "GenSigTimeoutTime_ECM" SG_ 1462 Climate_TBM_Cabin_Temp1 0;
BA_ "GenSigTimeoutTime_GNMM" SG_ 1462 Climate_TBM_Cabin_Temp1 0;
BA_ "GenSigTimeoutTime_HCP" SG_ 1462 Climate_TBM_Cabin_Temp1 0;
BA_ "GenSigTimeoutTime_IPC" SG_ 1462 Climate_TBM_Cabin_Temp1 0;
BA_ "GenSigTimeoutTime_RFHM" SG_ 1462 Climate_TBM_Cabin_Temp1 0;
BA_ "GenSigTimeoutTime_SGW" SG_ 1462 Climate_TBM_Cabin_Temp1 0;
BA_ "GenSigTimeoutTime_TCM" SG_ 1462 Climate_TBM_Cabin_Temp1 0;
BA_ "GenSigStartValue" SG_ 1462 Climate_TBM_Cabin_Temp2 12;
BA_ "GenSigSendType" SG_ 1462 Climate_TBM_Cabin_Temp2 3;
BA_ "GenSigTimeoutTime_AGSM" SG_ 1462 Climate_TBM_Cabin_Temp2 0;
BA_ "GenSigTimeoutTime_BCM" SG_ 1462 Climate_TBM_Cabin_Temp2 0;
BA_ "GenSigTimeoutTime_BSM" SG_ 1462 Climate_TBM_Cabin_Temp2 0;
BA_ "GenSigTimeoutTime_CADM" SG_ 1462 Climate_TBM_Cabin_Temp2 0;
BA_ "GenSigTimeoutTime_DMSM" SG_ 1462 Climate_TBM_Cabin_Temp2 0;
BA_ "GenSigTimeoutTime_DTCM" SG_ 1462 Climate_TBM_Cabin_Temp2 0;
BA_ "GenSigTimeoutTime_ECM" SG_ 1462 Climate_TBM_Cabin_Temp2 0;
BA_ "GenSigTimeoutTime_GNMM" SG_ 1462 Climate_TBM_Cabin_Temp2 0;
BA_ "GenSigTimeoutTime_HCP" SG_ 1462 Climate_TBM_Cabin_Temp2 0;
BA_ "GenSigTimeoutTime_IPC" SG_ 1462 Climate_TBM_Cabin_Temp2 0;
BA_ "GenSigTimeoutTime_RFHM" SG_ 1462 Climate_TBM_Cabin_Temp2 0;
BA_ "GenSigTimeoutTime_SGW" SG_ 1462 Climate_TBM_Cabin_Temp2 0;
BA_ "GenSigTimeoutTime_TCM" SG_ 1462 Climate_TBM_Cabin_Temp2 0;
BA_ "GenSigSendType" SG_ 1462 TBM_AllowClimateSchd1 3;
BA_ "GenSigTimeoutTime_AGSM" SG_ 1462 TBM_AllowClimateSchd1 0;
BA_ "GenSigTimeoutTime_BCM" SG_ 1462 TBM_AllowClimateSchd1 0;
BA_ "GenSigTimeoutTime_BSM" SG_ 1462 TBM_AllowClimateSchd1 0;
BA_ "GenSigTimeoutTime_CADM" SG_ 1462 TBM_AllowClimateSchd1 0;
BA_ "GenSigTimeoutTime_DMSM" SG_ 1462 TBM_AllowClimateSchd1 0;
BA_ "GenSigTimeoutTime_DTCM" SG_ 1462 TBM_AllowClimateSchd1 0;
BA_ "GenSigTimeoutTime_ECM" SG_ 1462 TBM_AllowClimateSchd1 0;
BA_ "GenSigTimeoutTime_GNMM" SG_ 1462 TBM_AllowClimateSchd1 0;
BA_ "GenSigTimeoutTime_HCP" SG_ 1462 TBM_AllowClimateSchd1 0;
BA_ "GenSigTimeoutTime_IPC" SG_ 1462 TBM_AllowClimateSchd1 0;
BA_ "GenSigTimeoutTime_RFHM" SG_ 1462 TBM_AllowClimateSchd1 0;
BA_ "GenSigTimeoutTime_SGW" SG_ 1462 TBM_AllowClimateSchd1 0;
BA_ "GenSigTimeoutTime_TCM" SG_ 1462 TBM_AllowClimateSchd1 0;
BA_ "GenSigSendType" SG_ 1462 TBM_AllowClimateSchd2 3;
BA_ "GenSigTimeoutTime_AGSM" SG_ 1462 TBM_AllowClimateSchd2 0;
BA_ "GenSigTimeoutTime_BCM" SG_ 1462 TBM_AllowClimateSchd2 0;
BA_ "GenSigTimeoutTime_BSM" SG_ 1462 TBM_AllowClimateSchd2 0;
BA_ "GenSigTimeoutTime_CADM" SG_ 1462 TBM_AllowClimateSchd2 0;
BA_ "GenSigTimeoutTime_DMSM" SG_ 1462 TBM_AllowClimateSchd2 0;
BA_ "GenSigTimeoutTime_DTCM" SG_ 1462 TBM_AllowClimateSchd2 0;
BA_ "GenSigTimeoutTime_ECM" SG_ 1462 TBM_AllowClimateSchd2 0;
BA_ "GenSigTimeoutTime_GNMM" SG_ 1462 TBM_AllowClimateSchd2 0;
BA_ "GenSigTimeoutTime_HCP" SG_ 1462 TBM_AllowClimateSchd2 0;
BA_ "GenSigTimeoutTime_IPC" SG_ 1462 TBM_AllowClimateSchd2 0;
BA_ "GenSigTimeoutTime_RFHM" SG_ 1462 TBM_AllowClimateSchd2 0;
BA_ "GenSigTimeoutTime_SGW" SG_ 1462 TBM_AllowClimateSchd2 0;
BA_ "GenSigTimeoutTime_TCM" SG_ 1462 TBM_AllowClimateSchd2 0;
BA_ "GenSigSendType" SG_ 1462 TBM_ClimateSchd1_Day 3;
BA_ "GenSigTimeoutTime_AGSM" SG_ 1462 TBM_ClimateSchd1_Day 0;
BA_ "GenSigTimeoutTime_BCM" SG_ 1462 TBM_ClimateSchd1_Day 0;
BA_ "GenSigTimeoutTime_BSM" SG_ 1462 TBM_ClimateSchd1_Day 0;
BA_ "GenSigTimeoutTime_CADM" SG_ 1462 TBM_ClimateSchd1_Day 0;
BA_ "GenSigTimeoutTime_DMSM" SG_ 1462 TBM_ClimateSchd1_Day 0;
BA_ "GenSigTimeoutTime_DTCM" SG_ 1462 TBM_ClimateSchd1_Day 0;
BA_ "GenSigTimeoutTime_ECM" SG_ 1462 TBM_ClimateSchd1_Day 0;
BA_ "GenSigTimeoutTime_GNMM" SG_ 1462 TBM_ClimateSchd1_Day 0;
BA_ "GenSigTimeoutTime_HCP" SG_ 1462 TBM_ClimateSchd1_Day 0;
BA_ "GenSigTimeoutTime_IPC" SG_ 1462 TBM_ClimateSchd1_Day 0;
BA_ "GenSigTimeoutTime_RFHM" SG_ 1462 TBM_ClimateSchd1_Day 0;
BA_ "GenSigTimeoutTime_SGW" SG_ 1462 TBM_ClimateSchd1_Day 0;
BA_ "GenSigTimeoutTime_TCM" SG_ 1462 TBM_ClimateSchd1_Day 0;
BA_ "GenSigSendType" SG_ 1462 TBM_ClimateSchd1_Departure_Hr 3;
BA_ "GenSigTimeoutTime_AGSM" SG_ 1462 TBM_ClimateSchd1_Departure_Hr 0;
BA_ "GenSigTimeoutTime_BCM" SG_ 1462 TBM_ClimateSchd1_Departure_Hr 0;
BA_ "GenSigTimeoutTime_BSM" SG_ 1462 TBM_ClimateSchd1_Departure_Hr 0;
BA_ "GenSigTimeoutTime_CADM" SG_ 1462 TBM_ClimateSchd1_Departure_Hr 0;
BA_ "GenSigTimeoutTime_DMSM" SG_ 1462 TBM_ClimateSchd1_Departure_Hr 0;
BA_ "GenSigTimeoutTime_DTCM" SG_ 1462 TBM_ClimateSchd1_Departure_Hr 0;
BA_ "GenSigTimeoutTime_ECM" SG_ 1462 TBM_ClimateSchd1_Departure_Hr 0;
BA_ "GenSigTimeoutTime_GNMM" SG_ 1462 TBM_ClimateSchd1_Departure_Hr 0;
BA_ "GenSigTimeoutTime_HCP" SG_ 1462 TBM_ClimateSchd1_Departure_Hr 0;
BA_ "GenSigTimeoutTime_IPC" SG_ 1462 TBM_ClimateSchd1_Departure_Hr 0;
BA_ "GenSigTimeoutTime_RFHM" SG_ 1462 TBM_ClimateSchd1_Departure_Hr 0;
BA_ "GenSigTimeoutTime_SGW" SG_ 1462 TBM_ClimateSchd1_Departure_Hr 0;
BA_ "GenSigTimeoutTime_TCM" SG_ 1462 TBM_ClimateSchd1_Departure_Hr 0;
BA_ "GenSigSendType" SG_ 1462 TBM_ClimateSchd1_Departure_Min 3;
BA_ "GenSigTimeoutTime_AGSM" SG_ 1462 TBM_ClimateSchd1_Departure_Min 0;
BA_ "GenSigTimeoutTime_BCM" SG_ 1462 TBM_ClimateSchd1_Departure_Min 0;
BA_ "GenSigTimeoutTime_BSM" SG_ 1462 TBM_ClimateSchd1_Departure_Min 0;
BA_ "GenSigTimeoutTime_CADM" SG_ 1462 TBM_ClimateSchd1_Departure_Min 0;
BA_ "GenSigTimeoutTime_DMSM" SG_ 1462 TBM_ClimateSchd1_Departure_Min 0;
BA_ "GenSigTimeoutTime_DTCM" SG_ 1462 TBM_ClimateSchd1_Departure_Min 0;
BA_ "GenSigTimeoutTime_ECM" SG_ 1462 TBM_ClimateSchd1_Departure_Min 0;
BA_ "GenSigTimeoutTime_GNMM" SG_ 1462 TBM_ClimateSchd1_Departure_Min 0;
BA_ "GenSigTimeoutTime_HCP" SG_ 1462 TBM_ClimateSchd1_Departure_Min 0;
BA_ "GenSigTimeoutTime_IPC" SG_ 1462 TBM_ClimateSchd1_Departure_Min 0;
BA_ "GenSigTimeoutTime_RFHM" SG_ 1462 TBM_ClimateSchd1_Departure_Min 0;
BA_ "GenSigTimeoutTime_SGW" SG_ 1462 TBM_ClimateSchd1_Departure_Min 0;
BA_ "GenSigTimeoutTime_TCM" SG_ 1462 TBM_ClimateSchd1_Departure_Min 0;
BA_ "GenSigSendType" SG_ 1462 TBM_ClimateSchd2_Day 3;
BA_ "GenSigTimeoutTime_AGSM" SG_ 1462 TBM_ClimateSchd2_Day 0;
BA_ "GenSigTimeoutTime_BCM" SG_ 1462 TBM_ClimateSchd2_Day 0;
BA_ "GenSigTimeoutTime_BSM" SG_ 1462 TBM_ClimateSchd2_Day 0;
BA_ "GenSigTimeoutTime_CADM" SG_ 1462 TBM_ClimateSchd2_Day 0;
BA_ "GenSigTimeoutTime_DMSM" SG_ 1462 TBM_ClimateSchd2_Day 0;
BA_ "GenSigTimeoutTime_DTCM" SG_ 1462 TBM_ClimateSchd2_Day 0;
BA_ "GenSigTimeoutTime_ECM" SG_ 1462 TBM_ClimateSchd2_Day 0;
BA_ "GenSigTimeoutTime_GNMM" SG_ 1462 TBM_ClimateSchd2_Day 0;
BA_ "GenSigTimeoutTime_HCP" SG_ 1462 TBM_ClimateSchd2_Day 0;
BA_ "GenSigTimeoutTime_IPC" SG_ 1462 TBM_ClimateSchd2_Day 0;
BA_ "GenSigTimeoutTime_RFHM" SG_ 1462 TBM_ClimateSchd2_Day 0;
BA_ "GenSigTimeoutTime_SGW" SG_ 1462 TBM_ClimateSchd2_Day 0;
BA_ "GenSigTimeoutTime_TCM" SG_ 1462 TBM_ClimateSchd2_Day 0;
BA_ "GenSigSendType" SG_ 1462 TBM_ClimateSchd2_Departure_Hr 3;
BA_ "GenSigTimeoutTime_AGSM" SG_ 1462 TBM_ClimateSchd2_Departure_Hr 0;
BA_ "GenSigTimeoutTime_BCM" SG_ 1462 TBM_ClimateSchd2_Departure_Hr 0;
BA_ "GenSigTimeoutTime_BSM" SG_ 1462 TBM_ClimateSchd2_Departure_Hr 0;
BA_ "GenSigTimeoutTime_CADM" SG_ 1462 TBM_ClimateSchd2_Departure_Hr 0;
BA_ "GenSigTimeoutTime_DMSM" SG_ 1462 TBM_ClimateSchd2_Departure_Hr 0;
BA_ "GenSigTimeoutTime_DTCM" SG_ 1462 TBM_ClimateSchd2_Departure_Hr 0;
BA_ "GenSigTimeoutTime_ECM" SG_ 1462 TBM_ClimateSchd2_Departure_Hr 0;
BA_ "GenSigTimeoutTime_GNMM" SG_ 1462 TBM_ClimateSchd2_Departure_Hr 0;
BA_ "GenSigTimeoutTime_HCP" SG_ 1462 TBM_ClimateSchd2_Departure_Hr 0;
BA_ "GenSigTimeoutTime_IPC" SG_ 1462 TBM_ClimateSchd2_Departure_Hr 0;
BA_ "GenSigTimeoutTime_RFHM" SG_ 1462 TBM_ClimateSchd2_Departure_Hr 0;
BA_ "GenSigTimeoutTime_SGW" SG_ 1462 TBM_ClimateSchd2_Departure_Hr 0;
BA_ "GenSigTimeoutTime_TCM" SG_ 1462 TBM_ClimateSchd2_Departure_Hr 0;
BA_ "GenSigSendType" SG_ 1462 TBM_ClimateSchd2_Departure_Min 3;
BA_ "GenSigTimeoutTime_AGSM" SG_ 1462 TBM_ClimateSchd2_Departure_Min 0;
BA_ "GenSigTimeoutTime_BCM" SG_ 1462 TBM_ClimateSchd2_Departure_Min 0;
BA_ "GenSigTimeoutTime_BSM" SG_ 1462 TBM_ClimateSchd2_Departure_Min 0;
BA_ "GenSigTimeoutTime_CADM" SG_ 1462 TBM_ClimateSchd2_Departure_Min 0;
BA_ "GenSigTimeoutTime_DMSM" SG_ 1462 TBM_ClimateSchd2_Departure_Min 0;
BA_ "GenSigTimeoutTime_DTCM" SG_ 1462 TBM_ClimateSchd2_Departure_Min 0;
BA_ "GenSigTimeoutTime_ECM" SG_ 1462 TBM_ClimateSchd2_Departure_Min 0;
BA_ "GenSigTimeoutTime_GNMM" SG_ 1462 TBM_ClimateSchd2_Departure_Min 0;
BA_ "GenSigTimeoutTime_HCP" SG_ 1462 TBM_ClimateSchd2_Departure_Min 0;
BA_ "GenSigTimeoutTime_IPC" SG_ 1462 TBM_ClimateSchd2_Departure_Min 0;
BA_ "GenSigTimeoutTime_RFHM" SG_ 1462 TBM_ClimateSchd2_Departure_Min 0;
BA_ "GenSigTimeoutTime_SGW" SG_ 1462 TBM_ClimateSchd2_Departure_Min 0;
BA_ "GenSigTimeoutTime_TCM" SG_ 1462 TBM_ClimateSchd2_Departure_Min 0;
BA_ "GenSigSendType" SG_ 1462 TBM_Enable_ClimateSchd1 3;
BA_ "GenSigTimeoutTime_AGSM" SG_ 1462 TBM_Enable_ClimateSchd1 0;
BA_ "GenSigTimeoutTime_BCM" SG_ 1462 TBM_Enable_ClimateSchd1 0;
BA_ "GenSigTimeoutTime_BSM" SG_ 1462 TBM_Enable_ClimateSchd1 0;
BA_ "GenSigTimeoutTime_CADM" SG_ 1462 TBM_Enable_ClimateSchd1 0;
BA_ "GenSigTimeoutTime_DMSM" SG_ 1462 TBM_Enable_ClimateSchd1 0;
BA_ "GenSigTimeoutTime_DTCM" SG_ 1462 TBM_Enable_ClimateSchd1 0;
BA_ "GenSigTimeoutTime_ECM" SG_ 1462 TBM_Enable_ClimateSchd1 0;
BA_ "GenSigTimeoutTime_GNMM" SG_ 1462 TBM_Enable_ClimateSchd1 0;
BA_ "GenSigTimeoutTime_HCP" SG_ 1462 TBM_Enable_ClimateSchd1 0;
BA_ "GenSigTimeoutTime_IPC" SG_ 1462 TBM_Enable_ClimateSchd1 0;
BA_ "GenSigTimeoutTime_RFHM" SG_ 1462 TBM_Enable_ClimateSchd1 0;
BA_ "GenSigTimeoutTime_SGW" SG_ 1462 TBM_Enable_ClimateSchd1 0;
BA_ "GenSigTimeoutTime_TCM" SG_ 1462 TBM_Enable_ClimateSchd1 0;
BA_ "GenSigSendType" SG_ 1462 TBM_Enable_ClimateSchd2 3;
BA_ "GenSigTimeoutTime_AGSM" SG_ 1462 TBM_Enable_ClimateSchd2 0;
BA_ "GenSigTimeoutTime_BCM" SG_ 1462 TBM_Enable_ClimateSchd2 0;
BA_ "GenSigTimeoutTime_BSM" SG_ 1462 TBM_Enable_ClimateSchd2 0;
BA_ "GenSigTimeoutTime_CADM" SG_ 1462 TBM_Enable_ClimateSchd2 0;
BA_ "GenSigTimeoutTime_DMSM" SG_ 1462 TBM_Enable_ClimateSchd2 0;
BA_ "GenSigTimeoutTime_DTCM" SG_ 1462 TBM_Enable_ClimateSchd2 0;
BA_ "GenSigTimeoutTime_ECM" SG_ 1462 TBM_Enable_ClimateSchd2 0;
BA_ "GenSigTimeoutTime_GNMM" SG_ 1462 TBM_Enable_ClimateSchd2 0;
BA_ "GenSigTimeoutTime_HCP" SG_ 1462 TBM_Enable_ClimateSchd2 0;
BA_ "GenSigTimeoutTime_IPC" SG_ 1462 TBM_Enable_ClimateSchd2 0;
BA_ "GenSigTimeoutTime_RFHM" SG_ 1462 TBM_Enable_ClimateSchd2 0;
BA_ "GenSigTimeoutTime_SGW" SG_ 1462 TBM_Enable_ClimateSchd2 0;
BA_ "GenSigTimeoutTime_TCM" SG_ 1462 TBM_Enable_ClimateSchd2 0;
BA_ "GenSigSendType" SG_ 1462 TBM_Submit_ClimateSchd1 3;
BA_ "GenSigTimeoutTime_AGSM" SG_ 1462 TBM_Submit_ClimateSchd1 0;
BA_ "GenSigTimeoutTime_BCM" SG_ 1462 TBM_Submit_ClimateSchd1 0;
BA_ "GenSigTimeoutTime_BSM" SG_ 1462 TBM_Submit_ClimateSchd1 0;
BA_ "GenSigTimeoutTime_CADM" SG_ 1462 TBM_Submit_ClimateSchd1 0;
BA_ "GenSigTimeoutTime_DMSM" SG_ 1462 TBM_Submit_ClimateSchd1 0;
BA_ "GenSigTimeoutTime_DTCM" SG_ 1462 TBM_Submit_ClimateSchd1 0;
BA_ "GenSigTimeoutTime_ECM" SG_ 1462 TBM_Submit_ClimateSchd1 0;
BA_ "GenSigTimeoutTime_GNMM" SG_ 1462 TBM_Submit_ClimateSchd1 0;
BA_ "GenSigTimeoutTime_HCP" SG_ 1462 TBM_Submit_ClimateSchd1 0;
BA_ "GenSigTimeoutTime_IPC" SG_ 1462 TBM_Submit_ClimateSchd1 0;
BA_ "GenSigTimeoutTime_RFHM" SG_ 1462 TBM_Submit_ClimateSchd1 0;
BA_ "GenSigTimeoutTime_SGW" SG_ 1462 TBM_Submit_ClimateSchd1 0;
BA_ "GenSigTimeoutTime_TCM" SG_ 1462 TBM_Submit_ClimateSchd1 0;
BA_ "GenSigSendType" SG_ 1462 TBM_Submit_ClimateSchd2 3;
BA_ "GenSigTimeoutTime_AGSM" SG_ 1462 TBM_Submit_ClimateSchd2 0;
BA_ "GenSigTimeoutTime_BCM" SG_ 1462 TBM_Submit_ClimateSchd2 0;
BA_ "GenSigTimeoutTime_BSM" SG_ 1462 TBM_Submit_ClimateSchd2 0;
BA_ "GenSigTimeoutTime_CADM" SG_ 1462 TBM_Submit_ClimateSchd2 0;
BA_ "GenSigTimeoutTime_DMSM" SG_ 1462 TBM_Submit_ClimateSchd2 0;
BA_ "GenSigTimeoutTime_DTCM" SG_ 1462 TBM_Submit_ClimateSchd2 0;
BA_ "GenSigTimeoutTime_ECM" SG_ 1462 TBM_Submit_ClimateSchd2 0;
BA_ "GenSigTimeoutTime_GNMM" SG_ 1462 TBM_Submit_ClimateSchd2 0;
BA_ "GenSigTimeoutTime_HCP" SG_ 1462 TBM_Submit_ClimateSchd2 0;
BA_ "GenSigTimeoutTime_IPC" SG_ 1462 TBM_Submit_ClimateSchd2 0;
BA_ "GenSigTimeoutTime_RFHM" SG_ 1462 TBM_Submit_ClimateSchd2 0;
BA_ "GenSigTimeoutTime_SGW" SG_ 1462 TBM_Submit_ClimateSchd2 0;
BA_ "GenSigTimeoutTime_TCM" SG_ 1462 TBM_Submit_ClimateSchd2 0;
BA_ "GenSigTimeoutTime_AGSM" SG_ 275 CRC_CVPAM_FD_Control 0;
BA_ "GenSigTimeoutTime_BCM" SG_ 275 CRC_CVPAM_FD_Control 0;
BA_ "GenSigTimeoutTime_CADM" SG_ 275 CRC_CVPAM_FD_Control 0;
BA_ "GenSigTimeoutTime_DMSM" SG_ 275 CRC_CVPAM_FD_Control 0;
BA_ "GenSigTimeoutTime_DTCM" SG_ 275 CRC_CVPAM_FD_Control 0;
BA_ "GenSigTimeoutTime_ECM" SG_ 275 CRC_CVPAM_FD_Control 0;
BA_ "GenSigTimeoutTime_EVCU2" SG_ 275 CRC_CVPAM_FD_Control 0;
BA_ "GenSigTimeoutTime_GNMM" SG_ 275 CRC_CVPAM_FD_Control 0;
BA_ "GenSigTimeoutTime_HCP" SG_ 275 CRC_CVPAM_FD_Control 0;
BA_ "GenSigTimeoutTime_IPC" SG_ 275 CRC_CVPAM_FD_Control 0;
BA_ "GenSigTimeoutTime_RFHM" SG_ 275 CRC_CVPAM_FD_Control 0;
BA_ "GenSigTimeoutTime_SGW" SG_ 275 CRC_CVPAM_FD_Control 0;
BA_ "GenSigTimeoutTime_TCM" SG_ 275 CRC_CVPAM_FD_Control 0;
BA_ "GenSigTimeoutTime_AGSM" SG_ 275 MessageCounter_CVPAM_FD_Control 0;
BA_ "GenSigTimeoutTime_BCM" SG_ 275 MessageCounter_CVPAM_FD_Control 0;
BA_ "GenSigTimeoutTime_CADM" SG_ 275 MessageCounter_CVPAM_FD_Control 0;
BA_ "GenSigTimeoutTime_DMSM" SG_ 275 MessageCounter_CVPAM_FD_Control 0;
BA_ "GenSigTimeoutTime_DTCM" SG_ 275 MessageCounter_CVPAM_FD_Control 0;
BA_ "GenSigTimeoutTime_ECM" SG_ 275 MessageCounter_CVPAM_FD_Control 0;
BA_ "GenSigTimeoutTime_EVCU2" SG_ 275 MessageCounter_CVPAM_FD_Control 0;
BA_ "GenSigTimeoutTime_GNMM" SG_ 275 MessageCounter_CVPAM_FD_Control 0;
BA_ "GenSigTimeoutTime_HCP" SG_ 275 MessageCounter_CVPAM_FD_Control 0;
BA_ "GenSigTimeoutTime_IPC" SG_ 275 MessageCounter_CVPAM_FD_Control 0;
BA_ "GenSigTimeoutTime_RFHM" SG_ 275 MessageCounter_CVPAM_FD_Control 0;
BA_ "GenSigTimeoutTime_SGW" SG_ 275 MessageCounter_CVPAM_FD_Control 0;
BA_ "GenSigTimeoutTime_TCM" SG_ 275 MessageCounter_CVPAM_FD_Control 0;
BA_ "GenSigTimeoutTime_AGSM" SG_ 275 RR_PAM_Brk_RqSts 0;
BA_ "GenSigTimeoutTime_BCM" SG_ 275 RR_PAM_Brk_RqSts 0;
BA_ "GenSigTimeoutTime_CADM" SG_ 275 RR_PAM_Brk_RqSts 0;
BA_ "GenSigTimeoutTime_DMSM" SG_ 275 RR_PAM_Brk_RqSts 0;
BA_ "GenSigTimeoutTime_DTCM" SG_ 275 RR_PAM_Brk_RqSts 0;
BA_ "GenSigTimeoutTime_ECM" SG_ 275 RR_PAM_Brk_RqSts 0;
BA_ "GenSigTimeoutTime_EVCU2" SG_ 275 RR_PAM_Brk_RqSts 0;
BA_ "GenSigTimeoutTime_GNMM" SG_ 275 RR_PAM_Brk_RqSts 0;
BA_ "GenSigTimeoutTime_HCP" SG_ 275 RR_PAM_Brk_RqSts 0;
BA_ "GenSigTimeoutTime_IPC" SG_ 275 RR_PAM_Brk_RqSts 0;
BA_ "GenSigTimeoutTime_RFHM" SG_ 275 RR_PAM_Brk_RqSts 0;
BA_ "GenSigTimeoutTime_SGW" SG_ 275 RR_PAM_Brk_RqSts 0;
BA_ "GenSigTimeoutTime_TCM" SG_ 275 RR_PAM_Brk_RqSts 0;
BA_ "GenSigTimeoutTime_AGSM" SG_ 275 RR_PAM_Dist 0;
BA_ "GenSigTimeoutTime_BCM" SG_ 275 RR_PAM_Dist 0;
BA_ "GenSigTimeoutTime_CADM" SG_ 275 RR_PAM_Dist 0;
BA_ "GenSigTimeoutTime_DMSM" SG_ 275 RR_PAM_Dist 0;
BA_ "GenSigTimeoutTime_DTCM" SG_ 275 RR_PAM_Dist 0;
BA_ "GenSigTimeoutTime_ECM" SG_ 275 RR_PAM_Dist 0;
BA_ "GenSigTimeoutTime_EVCU2" SG_ 275 RR_PAM_Dist 0;
BA_ "GenSigTimeoutTime_GNMM" SG_ 275 RR_PAM_Dist 0;
BA_ "GenSigTimeoutTime_HCP" SG_ 275 RR_PAM_Dist 0;
BA_ "GenSigTimeoutTime_IPC" SG_ 275 RR_PAM_Dist 0;
BA_ "GenSigTimeoutTime_RFHM" SG_ 275 RR_PAM_Dist 0;
BA_ "GenSigTimeoutTime_SGW" SG_ 275 RR_PAM_Dist 0;
BA_ "GenSigTimeoutTime_TCM" SG_ 275 RR_PAM_Dist 0;
BA_ "GenSigTimeoutTime_AGSM" SG_ 275 RR_PAM_StopControlSts 0;
BA_ "GenSigTimeoutTime_BCM" SG_ 275 RR_PAM_StopControlSts 0;
BA_ "GenSigTimeoutTime_BSM" SG_ 275 RR_PAM_StopControlSts 0;
BA_ "GenSigTimeoutTime_CADM" SG_ 275 RR_PAM_StopControlSts 0;
BA_ "GenSigTimeoutTime_DMSM" SG_ 275 RR_PAM_StopControlSts 0;
BA_ "GenSigTimeoutTime_DTCM" SG_ 275 RR_PAM_StopControlSts 0;
BA_ "GenSigTimeoutTime_ECM" SG_ 275 RR_PAM_StopControlSts 0;
BA_ "GenSigTimeoutTime_EVCU2" SG_ 275 RR_PAM_StopControlSts 0;
BA_ "GenSigTimeoutTime_GNMM" SG_ 275 RR_PAM_StopControlSts 0;
BA_ "GenSigTimeoutTime_HCP" SG_ 275 RR_PAM_StopControlSts 0;
BA_ "GenSigTimeoutTime_RFHM" SG_ 275 RR_PAM_StopControlSts 0;
BA_ "GenSigTimeoutTime_SGW" SG_ 275 RR_PAM_StopControlSts 0;
BA_ "GenSigTimeoutTime_TCM" SG_ 275 RR_PAM_StopControlSts 0;
BA_ "GenSigSendType" SG_ 950 Alert_CHF 3;
BA_ "GenSigTimeoutTime_AGSM" SG_ 950 Alert_CHF 0;
BA_ "GenSigTimeoutTime_BCM" SG_ 950 Alert_CHF 0;
BA_ "GenSigTimeoutTime_BSM" SG_ 950 Alert_CHF 0;
BA_ "GenSigTimeoutTime_CADM" SG_ 950 Alert_CHF 0;
BA_ "GenSigTimeoutTime_DMSM" SG_ 950 Alert_CHF 0;
BA_ "GenSigTimeoutTime_DTCM" SG_ 950 Alert_CHF 0;
BA_ "GenSigTimeoutTime_ECM" SG_ 950 Alert_CHF 0;
BA_ "GenSigTimeoutTime_EVCU2" SG_ 950 Alert_CHF 0;
BA_ "GenSigTimeoutTime_GNMM" SG_ 950 Alert_CHF 0;
BA_ "GenSigTimeoutTime_HCP" SG_ 950 Alert_CHF 0;
BA_ "GenSigTimeoutTime_RFHM" SG_ 950 Alert_CHF 0;
BA_ "GenSigTimeoutTime_SGW" SG_ 950 Alert_CHF 0;
BA_ "GenSigTimeoutTime_TCM" SG_ 950 Alert_CHF 0;
BA_ "GenSigSendType" SG_ 950 Alert_CHR 3;
BA_ "GenSigTimeoutTime_AGSM" SG_ 950 Alert_CHR 0;
BA_ "GenSigTimeoutTime_BCM" SG_ 950 Alert_CHR 0;
BA_ "GenSigTimeoutTime_BSM" SG_ 950 Alert_CHR 0;
BA_ "GenSigTimeoutTime_CADM" SG_ 950 Alert_CHR 0;
BA_ "GenSigTimeoutTime_DMSM" SG_ 950 Alert_CHR 0;
BA_ "GenSigTimeoutTime_DTCM" SG_ 950 Alert_CHR 0;
BA_ "GenSigTimeoutTime_ECM" SG_ 950 Alert_CHR 0;
BA_ "GenSigTimeoutTime_EVCU2" SG_ 950 Alert_CHR 0;
BA_ "GenSigTimeoutTime_GNMM" SG_ 950 Alert_CHR 0;
BA_ "GenSigTimeoutTime_HCP" SG_ 950 Alert_CHR 0;
BA_ "GenSigTimeoutTime_RFHM" SG_ 950 Alert_CHR 0;
BA_ "GenSigTimeoutTime_SGW" SG_ 950 Alert_CHR 0;
BA_ "GenSigTimeoutTime_TCM" SG_ 950 Alert_CHR 0;
BA_ "GenSigSendType" SG_ 950 Alert_LHF 3;
BA_ "GenSigTimeoutTime_AGSM" SG_ 950 Alert_LHF 0;
BA_ "GenSigTimeoutTime_BCM" SG_ 950 Alert_LHF 0;
BA_ "GenSigTimeoutTime_BSM" SG_ 950 Alert_LHF 0;
BA_ "GenSigTimeoutTime_CADM" SG_ 950 Alert_LHF 0;
BA_ "GenSigTimeoutTime_DMSM" SG_ 950 Alert_LHF 0;
BA_ "GenSigTimeoutTime_DTCM" SG_ 950 Alert_LHF 0;
BA_ "GenSigTimeoutTime_ECM" SG_ 950 Alert_LHF 0;
BA_ "GenSigTimeoutTime_EVCU2" SG_ 950 Alert_LHF 0;
BA_ "GenSigTimeoutTime_GNMM" SG_ 950 Alert_LHF 0;
BA_ "GenSigTimeoutTime_HCP" SG_ 950 Alert_LHF 0;
BA_ "GenSigTimeoutTime_RFHM" SG_ 950 Alert_LHF 0;
BA_ "GenSigTimeoutTime_SGW" SG_ 950 Alert_LHF 0;
BA_ "GenSigTimeoutTime_TCM" SG_ 950 Alert_LHF 0;
BA_ "GenSigSendType" SG_ 950 Alert_LHR 3;
BA_ "GenSigTimeoutTime_AGSM" SG_ 950 Alert_LHR 0;
BA_ "GenSigTimeoutTime_BCM" SG_ 950 Alert_LHR 0;
BA_ "GenSigTimeoutTime_BSM" SG_ 950 Alert_LHR 0;
BA_ "GenSigTimeoutTime_CADM" SG_ 950 Alert_LHR 0;
BA_ "GenSigTimeoutTime_DMSM" SG_ 950 Alert_LHR 0;
BA_ "GenSigTimeoutTime_DTCM" SG_ 950 Alert_LHR 0;
BA_ "GenSigTimeoutTime_ECM" SG_ 950 Alert_LHR 0;
BA_ "GenSigTimeoutTime_EVCU2" SG_ 950 Alert_LHR 0;
BA_ "GenSigTimeoutTime_GNMM" SG_ 950 Alert_LHR 0;
BA_ "GenSigTimeoutTime_HCP" SG_ 950 Alert_LHR 0;
BA_ "GenSigTimeoutTime_RFHM" SG_ 950 Alert_LHR 0;
BA_ "GenSigTimeoutTime_SGW" SG_ 950 Alert_LHR 0;
BA_ "GenSigTimeoutTime_TCM" SG_ 950 Alert_LHR 0;
BA_ "GenSigSendType" SG_ 950 Alert_RHF 3;
BA_ "GenSigTimeoutTime_AGSM" SG_ 950 Alert_RHF 0;
BA_ "GenSigTimeoutTime_BCM" SG_ 950 Alert_RHF 0;
BA_ "GenSigTimeoutTime_BSM" SG_ 950 Alert_RHF 0;
BA_ "GenSigTimeoutTime_CADM" SG_ 950 Alert_RHF 0;
BA_ "GenSigTimeoutTime_DMSM" SG_ 950 Alert_RHF 0;
BA_ "GenSigTimeoutTime_DTCM" SG_ 950 Alert_RHF 0;
BA_ "GenSigTimeoutTime_ECM" SG_ 950 Alert_RHF 0;
BA_ "GenSigTimeoutTime_EVCU2" SG_ 950 Alert_RHF 0;
BA_ "GenSigTimeoutTime_GNMM" SG_ 950 Alert_RHF 0;
BA_ "GenSigTimeoutTime_HCP" SG_ 950 Alert_RHF 0;
BA_ "GenSigTimeoutTime_RFHM" SG_ 950 Alert_RHF 0;
BA_ "GenSigTimeoutTime_SGW" SG_ 950 Alert_RHF 0;
BA_ "GenSigTimeoutTime_TCM" SG_ 950 Alert_RHF 0;
BA_ "GenSigSendType" SG_ 950 Alert_RHR 3;
BA_ "GenSigTimeoutTime_AGSM" SG_ 950 Alert_RHR 0;
BA_ "GenSigTimeoutTime_BCM" SG_ 950 Alert_RHR 0;
BA_ "GenSigTimeoutTime_BSM" SG_ 950 Alert_RHR 0;
BA_ "GenSigTimeoutTime_CADM" SG_ 950 Alert_RHR 0;
BA_ "GenSigTimeoutTime_DMSM" SG_ 950 Alert_RHR 0;
BA_ "GenSigTimeoutTime_DTCM" SG_ 950 Alert_RHR 0;
BA_ "GenSigTimeoutTime_ECM" SG_ 950 Alert_RHR 0;
BA_ "GenSigTimeoutTime_EVCU2" SG_ 950 Alert_RHR 0;
BA_ "GenSigTimeoutTime_GNMM" SG_ 950 Alert_RHR 0;
BA_ "GenSigTimeoutTime_HCP" SG_ 950 Alert_RHR 0;
BA_ "GenSigTimeoutTime_RFHM" SG_ 950 Alert_RHR 0;
BA_ "GenSigTimeoutTime_SGW" SG_ 950 Alert_RHR 0;
BA_ "GenSigTimeoutTime_TCM" SG_ 950 Alert_RHR 0;
BA_ "GenSigTimeoutTime_BCM" SG_ 950 CRC_CVPAM_FD_Info 0;
BA_ "GenSigTimeoutTime_BSM" SG_ 950 CRC_CVPAM_FD_Info 0;
BA_ "GenSigTimeoutTime_CADM" SG_ 950 CRC_CVPAM_FD_Info 0;
BA_ "GenSigTimeoutTime_DMSM" SG_ 950 CRC_CVPAM_FD_Info 0;
BA_ "GenSigTimeoutTime_DTCM" SG_ 950 CRC_CVPAM_FD_Info 0;
BA_ "GenSigTimeoutTime_ECM" SG_ 950 CRC_CVPAM_FD_Info 0;
BA_ "GenSigTimeoutTime_EVCU2" SG_ 950 CRC_CVPAM_FD_Info 0;
BA_ "GenSigTimeoutTime_GNMM" SG_ 950 CRC_CVPAM_FD_Info 0;
BA_ "GenSigTimeoutTime_HCP" SG_ 950 CRC_CVPAM_FD_Info 0;
BA_ "GenSigTimeoutTime_IPC" SG_ 950 CRC_CVPAM_FD_Info 0;
BA_ "GenSigTimeoutTime_RFHM" SG_ 950 CRC_CVPAM_FD_Info 0;
BA_ "GenSigTimeoutTime_SGW" SG_ 950 CRC_CVPAM_FD_Info 0;
BA_ "GenSigTimeoutTime_TCM" SG_ 950 CRC_CVPAM_FD_Info 0;
BA_ "GenSigSendType" SG_ 950 FrontSensorSts 3;
BA_ "GenSigTimeoutTime_AGSM" SG_ 950 FrontSensorSts 0;
BA_ "GenSigTimeoutTime_BCM" SG_ 950 FrontSensorSts 0;
BA_ "GenSigTimeoutTime_BSM" SG_ 950 FrontSensorSts 0;
BA_ "GenSigTimeoutTime_CADM" SG_ 950 FrontSensorSts 0;
BA_ "GenSigTimeoutTime_DMSM" SG_ 950 FrontSensorSts 0;
BA_ "GenSigTimeoutTime_DTCM" SG_ 950 FrontSensorSts 0;
BA_ "GenSigTimeoutTime_ECM" SG_ 950 FrontSensorSts 0;
BA_ "GenSigTimeoutTime_EVCU2" SG_ 950 FrontSensorSts 0;
BA_ "GenSigTimeoutTime_GNMM" SG_ 950 FrontSensorSts 0;
BA_ "GenSigTimeoutTime_HCP" SG_ 950 FrontSensorSts 0;
BA_ "GenSigTimeoutTime_RFHM" SG_ 950 FrontSensorSts 0;
BA_ "GenSigTimeoutTime_SGW" SG_ 950 FrontSensorSts 0;
BA_ "GenSigTimeoutTime_TCM" SG_ 950 FrontSensorSts 0;
BA_ "GenSigSendType" SG_ 950 FT_PAM_LedControlSts 3;
BA_ "GenSigTimeoutTime_AGSM" SG_ 950 FT_PAM_LedControlSts 0;
BA_ "GenSigTimeoutTime_BCM" SG_ 950 FT_PAM_LedControlSts 0;
BA_ "GenSigTimeoutTime_BSM" SG_ 950 FT_PAM_LedControlSts 0;
BA_ "GenSigTimeoutTime_CADM" SG_ 950 FT_PAM_LedControlSts 0;
BA_ "GenSigTimeoutTime_DMSM" SG_ 950 FT_PAM_LedControlSts 0;
BA_ "GenSigTimeoutTime_DTCM" SG_ 950 FT_PAM_LedControlSts 0;
BA_ "GenSigTimeoutTime_ECM" SG_ 950 FT_PAM_LedControlSts 0;
BA_ "GenSigTimeoutTime_EVCU2" SG_ 950 FT_PAM_LedControlSts 0;
BA_ "GenSigTimeoutTime_GNMM" SG_ 950 FT_PAM_LedControlSts 0;
BA_ "GenSigTimeoutTime_HCP" SG_ 950 FT_PAM_LedControlSts 0;
BA_ "GenSigTimeoutTime_RFHM" SG_ 950 FT_PAM_LedControlSts 0;
BA_ "GenSigTimeoutTime_SGW" SG_ 950 FT_PAM_LedControlSts 0;
BA_ "GenSigTimeoutTime_TCM" SG_ 950 FT_PAM_LedControlSts 0;
BA_ "GenSigSendType" SG_ 950 Graphic_CHF 3;
BA_ "GenSigTimeoutTime_AGSM" SG_ 950 Graphic_CHF 0;
BA_ "GenSigTimeoutTime_BCM" SG_ 950 Graphic_CHF 0;
BA_ "GenSigTimeoutTime_BSM" SG_ 950 Graphic_CHF 0;
BA_ "GenSigTimeoutTime_CADM" SG_ 950 Graphic_CHF 0;
BA_ "GenSigTimeoutTime_DMSM" SG_ 950 Graphic_CHF 0;
BA_ "GenSigTimeoutTime_DTCM" SG_ 950 Graphic_CHF 0;
BA_ "GenSigTimeoutTime_ECM" SG_ 950 Graphic_CHF 0;
BA_ "GenSigTimeoutTime_EVCU2" SG_ 950 Graphic_CHF 0;
BA_ "GenSigTimeoutTime_GNMM" SG_ 950 Graphic_CHF 0;
BA_ "GenSigTimeoutTime_HCP" SG_ 950 Graphic_CHF 0;
BA_ "GenSigTimeoutTime_RFHM" SG_ 950 Graphic_CHF 0;
BA_ "GenSigTimeoutTime_SGW" SG_ 950 Graphic_CHF 0;
BA_ "GenSigTimeoutTime_TCM" SG_ 950 Graphic_CHF 0;
BA_ "GenSigSendType" SG_ 950 Graphic_CHR 3;
BA_ "GenSigTimeoutTime_AGSM" SG_ 950 Graphic_CHR 0;
BA_ "GenSigTimeoutTime_BCM" SG_ 950 Graphic_CHR 0;
BA_ "GenSigTimeoutTime_BSM" SG_ 950 Graphic_CHR 0;
BA_ "GenSigTimeoutTime_CADM" SG_ 950 Graphic_CHR 0;
BA_ "GenSigTimeoutTime_DMSM" SG_ 950 Graphic_CHR 0;
BA_ "GenSigTimeoutTime_DTCM" SG_ 950 Graphic_CHR 0;
BA_ "GenSigTimeoutTime_ECM" SG_ 950 Graphic_CHR 0;
BA_ "GenSigTimeoutTime_EVCU2" SG_ 950 Graphic_CHR 0;
BA_ "GenSigTimeoutTime_GNMM" SG_ 950 Graphic_CHR 0;
BA_ "GenSigTimeoutTime_HCP" SG_ 950 Graphic_CHR 0;
BA_ "GenSigTimeoutTime_RFHM" SG_ 950 Graphic_CHR 0;
BA_ "GenSigTimeoutTime_SGW" SG_ 950 Graphic_CHR 0;
BA_ "GenSigTimeoutTime_TCM" SG_ 950 Graphic_CHR 0;
BA_ "GenSigSendType" SG_ 950 Graphic_LHF 3;
BA_ "GenSigTimeoutTime_AGSM" SG_ 950 Graphic_LHF 0;
BA_ "GenSigTimeoutTime_BCM" SG_ 950 Graphic_LHF 0;
BA_ "GenSigTimeoutTime_BSM" SG_ 950 Graphic_LHF 0;
BA_ "GenSigTimeoutTime_CADM" SG_ 950 Graphic_LHF 0;
BA_ "GenSigTimeoutTime_DMSM" SG_ 950 Graphic_LHF 0;
BA_ "GenSigTimeoutTime_DTCM" SG_ 950 Graphic_LHF 0;
BA_ "GenSigTimeoutTime_ECM" SG_ 950 Graphic_LHF 0;
BA_ "GenSigTimeoutTime_EVCU2" SG_ 950 Graphic_LHF 0;
BA_ "GenSigTimeoutTime_GNMM" SG_ 950 Graphic_LHF 0;
BA_ "GenSigTimeoutTime_HCP" SG_ 950 Graphic_LHF 0;
BA_ "GenSigTimeoutTime_RFHM" SG_ 950 Graphic_LHF 0;
BA_ "GenSigTimeoutTime_SGW" SG_ 950 Graphic_LHF 0;
BA_ "GenSigTimeoutTime_TCM" SG_ 950 Graphic_LHF 0;
BA_ "GenSigSendType" SG_ 950 Graphic_LHR 3;
BA_ "GenSigTimeoutTime_AGSM" SG_ 950 Graphic_LHR 0;
BA_ "GenSigTimeoutTime_BCM" SG_ 950 Graphic_LHR 0;
BA_ "GenSigTimeoutTime_BSM" SG_ 950 Graphic_LHR 0;
BA_ "GenSigTimeoutTime_CADM" SG_ 950 Graphic_LHR 0;
BA_ "GenSigTimeoutTime_DMSM" SG_ 950 Graphic_LHR 0;
BA_ "GenSigTimeoutTime_DTCM" SG_ 950 Graphic_LHR 0;
BA_ "GenSigTimeoutTime_ECM" SG_ 950 Graphic_LHR 0;
BA_ "GenSigTimeoutTime_EVCU2" SG_ 950 Graphic_LHR 0;
BA_ "GenSigTimeoutTime_GNMM" SG_ 950 Graphic_LHR 0;
BA_ "GenSigTimeoutTime_HCP" SG_ 950 Graphic_LHR 0;
BA_ "GenSigTimeoutTime_RFHM" SG_ 950 Graphic_LHR 0;
BA_ "GenSigTimeoutTime_SGW" SG_ 950 Graphic_LHR 0;
BA_ "GenSigTimeoutTime_TCM" SG_ 950 Graphic_LHR 0;
BA_ "GenSigSendType" SG_ 950 Graphic_RHF 3;
BA_ "GenSigTimeoutTime_AGSM" SG_ 950 Graphic_RHF 0;
BA_ "GenSigTimeoutTime_BCM" SG_ 950 Graphic_RHF 0;
BA_ "GenSigTimeoutTime_BSM" SG_ 950 Graphic_RHF 0;
BA_ "GenSigTimeoutTime_CADM" SG_ 950 Graphic_RHF 0;
BA_ "GenSigTimeoutTime_DMSM" SG_ 950 Graphic_RHF 0;
BA_ "GenSigTimeoutTime_DTCM" SG_ 950 Graphic_RHF 0;
BA_ "GenSigTimeoutTime_ECM" SG_ 950 Graphic_RHF 0;
BA_ "GenSigTimeoutTime_EVCU2" SG_ 950 Graphic_RHF 0;
BA_ "GenSigTimeoutTime_GNMM" SG_ 950 Graphic_RHF 0;
BA_ "GenSigTimeoutTime_HCP" SG_ 950 Graphic_RHF 0;
BA_ "GenSigTimeoutTime_RFHM" SG_ 950 Graphic_RHF 0;
BA_ "GenSigTimeoutTime_SGW" SG_ 950 Graphic_RHF 0;
BA_ "GenSigTimeoutTime_TCM" SG_ 950 Graphic_RHF 0;
BA_ "GenSigSendType" SG_ 950 Graphic_RHR 3;
BA_ "GenSigTimeoutTime_AGSM" SG_ 950 Graphic_RHR 0;
BA_ "GenSigTimeoutTime_BCM" SG_ 950 Graphic_RHR 0;
BA_ "GenSigTimeoutTime_BSM" SG_ 950 Graphic_RHR 0;
BA_ "GenSigTimeoutTime_CADM" SG_ 950 Graphic_RHR 0;
BA_ "GenSigTimeoutTime_DMSM" SG_ 950 Graphic_RHR 0;
BA_ "GenSigTimeoutTime_DTCM" SG_ 950 Graphic_RHR 0;
BA_ "GenSigTimeoutTime_ECM" SG_ 950 Graphic_RHR 0;
BA_ "GenSigTimeoutTime_EVCU2" SG_ 950 Graphic_RHR 0;
BA_ "GenSigTimeoutTime_GNMM" SG_ 950 Graphic_RHR 0;
BA_ "GenSigTimeoutTime_HCP" SG_ 950 Graphic_RHR 0;
BA_ "GenSigTimeoutTime_RFHM" SG_ 950 Graphic_RHR 0;
BA_ "GenSigTimeoutTime_SGW" SG_ 950 Graphic_RHR 0;
BA_ "GenSigTimeoutTime_TCM" SG_ 950 Graphic_RHR 0;
BA_ "GenSigSendType" SG_ 950 HMICode 3;
BA_ "GenSigTimeoutTime_AGSM" SG_ 950 HMICode 0;
BA_ "GenSigTimeoutTime_BCM" SG_ 950 HMICode 0;
BA_ "GenSigTimeoutTime_BSM" SG_ 950 HMICode 0;
BA_ "GenSigTimeoutTime_CADM" SG_ 950 HMICode 0;
BA_ "GenSigTimeoutTime_DMSM" SG_ 950 HMICode 0;
BA_ "GenSigTimeoutTime_DTCM" SG_ 950 HMICode 0;
BA_ "GenSigTimeoutTime_ECM" SG_ 950 HMICode 0;
BA_ "GenSigTimeoutTime_EVCU2" SG_ 950 HMICode 0;
BA_ "GenSigTimeoutTime_GNMM" SG_ 950 HMICode 0;
BA_ "GenSigTimeoutTime_HCP" SG_ 950 HMICode 0;
BA_ "GenSigTimeoutTime_RFHM" SG_ 950 HMICode 0;
BA_ "GenSigTimeoutTime_SGW" SG_ 950 HMICode 0;
BA_ "GenSigTimeoutTime_TCM" SG_ 950 HMICode 0;
BA_ "GenSigTimeoutTime_BCM" SG_ 950 MessageCounter_CVPAM_FD_Info 0;
BA_ "GenSigTimeoutTime_BSM" SG_ 950 MessageCounter_CVPAM_FD_Info 0;
BA_ "GenSigTimeoutTime_CADM" SG_ 950 MessageCounter_CVPAM_FD_Info 0;
BA_ "GenSigTimeoutTime_DMSM" SG_ 950 MessageCounter_CVPAM_FD_Info 0;
BA_ "GenSigTimeoutTime_DTCM" SG_ 950 MessageCounter_CVPAM_FD_Info 0;
BA_ "GenSigTimeoutTime_ECM" SG_ 950 MessageCounter_CVPAM_FD_Info 0;
BA_ "GenSigTimeoutTime_EVCU2" SG_ 950 MessageCounter_CVPAM_FD_Info 0;
BA_ "GenSigTimeoutTime_GNMM" SG_ 950 MessageCounter_CVPAM_FD_Info 0;
BA_ "GenSigTimeoutTime_HCP" SG_ 950 MessageCounter_CVPAM_FD_Info 0;
BA_ "GenSigTimeoutTime_IPC" SG_ 950 MessageCounter_CVPAM_FD_Info 0;
BA_ "GenSigTimeoutTime_RFHM" SG_ 950 MessageCounter_CVPAM_FD_Info 0;
BA_ "GenSigTimeoutTime_SGW" SG_ 950 MessageCounter_CVPAM_FD_Info 0;
BA_ "GenSigTimeoutTime_TCM" SG_ 950 MessageCounter_CVPAM_FD_Info 0;
BA_ "GenSigSendType" SG_ 950 PAM_LedControlSts 3;
BA_ "GenSigTimeoutTime_AGSM" SG_ 950 PAM_LedControlSts 0;
BA_ "GenSigTimeoutTime_BCM" SG_ 950 PAM_LedControlSts 0;
BA_ "GenSigTimeoutTime_BSM" SG_ 950 PAM_LedControlSts 0;
BA_ "GenSigTimeoutTime_CADM" SG_ 950 PAM_LedControlSts 0;
BA_ "GenSigTimeoutTime_DMSM" SG_ 950 PAM_LedControlSts 0;
BA_ "GenSigTimeoutTime_DTCM" SG_ 950 PAM_LedControlSts 0;
BA_ "GenSigTimeoutTime_ECM" SG_ 950 PAM_LedControlSts 0;
BA_ "GenSigTimeoutTime_EVCU2" SG_ 950 PAM_LedControlSts 0;
BA_ "GenSigTimeoutTime_GNMM" SG_ 950 PAM_LedControlSts 0;
BA_ "GenSigTimeoutTime_HCP" SG_ 950 PAM_LedControlSts 0;
BA_ "GenSigTimeoutTime_RFHM" SG_ 950 PAM_LedControlSts 0;
BA_ "GenSigTimeoutTime_SGW" SG_ 950 PAM_LedControlSts 0;
BA_ "GenSigTimeoutTime_TCM" SG_ 950 PAM_LedControlSts 0;
BA_ "GenSigSendType" SG_ 950 PAM_Off_Status_2BT 3;
BA_ "GenSigTimeoutTime_AGSM" SG_ 950 PAM_Off_Status_2BT 0;
BA_ "GenSigTimeoutTime_BCM" SG_ 950 PAM_Off_Status_2BT 0;
BA_ "GenSigTimeoutTime_BSM" SG_ 950 PAM_Off_Status_2BT 0;
BA_ "GenSigTimeoutTime_CADM" SG_ 950 PAM_Off_Status_2BT 0;
BA_ "GenSigTimeoutTime_DMSM" SG_ 950 PAM_Off_Status_2BT 0;
BA_ "GenSigTimeoutTime_DTCM" SG_ 950 PAM_Off_Status_2BT 0;
BA_ "GenSigTimeoutTime_ECM" SG_ 950 PAM_Off_Status_2BT 0;
BA_ "GenSigTimeoutTime_EVCU2" SG_ 950 PAM_Off_Status_2BT 0;
BA_ "GenSigTimeoutTime_GNMM" SG_ 950 PAM_Off_Status_2BT 0;
BA_ "GenSigTimeoutTime_HCP" SG_ 950 PAM_Off_Status_2BT 0;
BA_ "GenSigTimeoutTime_RFHM" SG_ 950 PAM_Off_Status_2BT 0;
BA_ "GenSigTimeoutTime_SGW" SG_ 950 PAM_Off_Status_2BT 0;
BA_ "GenSigTimeoutTime_TCM" SG_ 950 PAM_Off_Status_2BT 0;
BA_ "GenSigSendType" SG_ 950 PAM_PopUpRqst 3;
BA_ "GenSigTimeoutTime_AGSM" SG_ 950 PAM_PopUpRqst 0;
BA_ "GenSigTimeoutTime_BCM" SG_ 950 PAM_PopUpRqst 0;
BA_ "GenSigTimeoutTime_BSM" SG_ 950 PAM_PopUpRqst 0;
BA_ "GenSigTimeoutTime_CADM" SG_ 950 PAM_PopUpRqst 0;
BA_ "GenSigTimeoutTime_DMSM" SG_ 950 PAM_PopUpRqst 0;
BA_ "GenSigTimeoutTime_DTCM" SG_ 950 PAM_PopUpRqst 0;
BA_ "GenSigTimeoutTime_ECM" SG_ 950 PAM_PopUpRqst 0;
BA_ "GenSigTimeoutTime_EVCU2" SG_ 950 PAM_PopUpRqst 0;
BA_ "GenSigTimeoutTime_GNMM" SG_ 950 PAM_PopUpRqst 0;
BA_ "GenSigTimeoutTime_HCP" SG_ 950 PAM_PopUpRqst 0;
BA_ "GenSigTimeoutTime_RFHM" SG_ 950 PAM_PopUpRqst 0;
BA_ "GenSigTimeoutTime_SGW" SG_ 950 PAM_PopUpRqst 0;
BA_ "GenSigTimeoutTime_TCM" SG_ 950 PAM_PopUpRqst 0;
BA_ "GenSigSendType" SG_ 950 PAMSystemFault 3;
BA_ "GenSigTimeoutTime_AGSM" SG_ 950 PAMSystemFault 0;
BA_ "GenSigTimeoutTime_BCM" SG_ 950 PAMSystemFault 0;
BA_ "GenSigTimeoutTime_BSM" SG_ 950 PAMSystemFault 0;
BA_ "GenSigTimeoutTime_CADM" SG_ 950 PAMSystemFault 0;
BA_ "GenSigTimeoutTime_DMSM" SG_ 950 PAMSystemFault 0;
BA_ "GenSigTimeoutTime_DTCM" SG_ 950 PAMSystemFault 0;
BA_ "GenSigTimeoutTime_ECM" SG_ 950 PAMSystemFault 0;
BA_ "GenSigTimeoutTime_EVCU2" SG_ 950 PAMSystemFault 0;
BA_ "GenSigTimeoutTime_GNMM" SG_ 950 PAMSystemFault 0;
BA_ "GenSigTimeoutTime_HCP" SG_ 950 PAMSystemFault 0;
BA_ "GenSigTimeoutTime_RFHM" SG_ 950 PAMSystemFault 0;
BA_ "GenSigTimeoutTime_SGW" SG_ 950 PAMSystemFault 0;
BA_ "GenSigTimeoutTime_TCM" SG_ 950 PAMSystemFault 0;
BA_ "GenSigSendType" SG_ 950 ParkingManeuverActive 3;
BA_ "GenSigTimeoutTime_BCM" SG_ 950 ParkingManeuverActive 0;
BA_ "GenSigTimeoutTime_BSM" SG_ 950 ParkingManeuverActive 0;
BA_ "GenSigTimeoutTime_CADM" SG_ 950 ParkingManeuverActive 0;
BA_ "GenSigTimeoutTime_DMSM" SG_ 950 ParkingManeuverActive 0;
BA_ "GenSigTimeoutTime_DTCM" SG_ 950 ParkingManeuverActive 0;
BA_ "GenSigTimeoutTime_ECM" SG_ 950 ParkingManeuverActive 0;
BA_ "GenSigTimeoutTime_EVCU2" SG_ 950 ParkingManeuverActive 0;
BA_ "GenSigTimeoutTime_GNMM" SG_ 950 ParkingManeuverActive 0;
BA_ "GenSigTimeoutTime_HCP" SG_ 950 ParkingManeuverActive 0;
BA_ "GenSigTimeoutTime_IPC" SG_ 950 ParkingManeuverActive 0;
BA_ "GenSigTimeoutTime_RFHM" SG_ 950 ParkingManeuverActive 0;
BA_ "GenSigTimeoutTime_SGW" SG_ 950 ParkingManeuverActive 0;
BA_ "GenSigSendType" SG_ 950 RearSensorSts 3;
BA_ "GenSigTimeoutTime_AGSM" SG_ 950 RearSensorSts 0;
BA_ "GenSigTimeoutTime_BCM" SG_ 950 RearSensorSts 0;
BA_ "GenSigTimeoutTime_BSM" SG_ 950 RearSensorSts 0;
BA_ "GenSigTimeoutTime_CADM" SG_ 950 RearSensorSts 0;
BA_ "GenSigTimeoutTime_DMSM" SG_ 950 RearSensorSts 0;
BA_ "GenSigTimeoutTime_DTCM" SG_ 950 RearSensorSts 0;
BA_ "GenSigTimeoutTime_ECM" SG_ 950 RearSensorSts 0;
BA_ "GenSigTimeoutTime_EVCU2" SG_ 950 RearSensorSts 0;
BA_ "GenSigTimeoutTime_GNMM" SG_ 950 RearSensorSts 0;
BA_ "GenSigTimeoutTime_HCP" SG_ 950 RearSensorSts 0;
BA_ "GenSigTimeoutTime_RFHM" SG_ 950 RearSensorSts 0;
BA_ "GenSigTimeoutTime_SGW" SG_ 950 RearSensorSts 0;
BA_ "GenSigTimeoutTime_TCM" SG_ 950 RearSensorSts 0;
BA_ "GenSigSendType" SG_ 950 SPMControlSts 3;
BA_ "GenSigTimeoutTime_AGSM" SG_ 950 SPMControlSts 0;
BA_ "GenSigTimeoutTime_BCM" SG_ 950 SPMControlSts 0;
BA_ "GenSigTimeoutTime_BSM" SG_ 950 SPMControlSts 0;
BA_ "GenSigTimeoutTime_CADM" SG_ 950 SPMControlSts 0;
BA_ "GenSigTimeoutTime_DMSM" SG_ 950 SPMControlSts 0;
BA_ "GenSigTimeoutTime_DTCM" SG_ 950 SPMControlSts 0;
BA_ "GenSigTimeoutTime_EVCU2" SG_ 950 SPMControlSts 0;
BA_ "GenSigTimeoutTime_GNMM" SG_ 950 SPMControlSts 0;
BA_ "GenSigTimeoutTime_HCP" SG_ 950 SPMControlSts 0;
BA_ "GenSigTimeoutTime_RFHM" SG_ 950 SPMControlSts 0;
BA_ "GenSigTimeoutTime_SGW" SG_ 950 SPMControlSts 0;
BA_ "GenSigTimeoutTime_TCM" SG_ 950 SPMControlSts 0;
BA_ "GenSigStartValue" SG_ 161 BATTERY_voltage 255;
BA_ "GenSigTimeoutTime_AGSM" SG_ 161 BATTERY_voltage 0;
BA_ "GenSigTimeoutTime_BCM" SG_ 161 BATTERY_voltage 0;
BA_ "GenSigTimeoutTime_BSM" SG_ 161 BATTERY_voltage 0;
BA_ "GenSigTimeoutTime_CADM" SG_ 161 BATTERY_voltage 0;
BA_ "GenSigTimeoutTime_DMSM" SG_ 161 BATTERY_voltage 0;
BA_ "GenSigTimeoutTime_DTCM" SG_ 161 BATTERY_voltage 0;
BA_ "GenSigTimeoutTime_ECM" SG_ 161 BATTERY_voltage 0;
BA_ "GenSigTimeoutTime_EVCU2" SG_ 161 BATTERY_voltage 0;
BA_ "GenSigTimeoutTime_GNMM" SG_ 161 BATTERY_voltage 0;
BA_ "GenSigTimeoutTime_HCP" SG_ 161 BATTERY_voltage 0;
BA_ "GenSigTimeoutTime_IPC" SG_ 161 BATTERY_voltage 0;
BA_ "GenSigTimeoutTime_RFHM" SG_ 161 BATTERY_voltage 0;
BA_ "GenSigTimeoutTime_SGW" SG_ 161 BATTERY_voltage 0;
BA_ "GenSigTimeoutTime_TCM" SG_ 161 BATTERY_voltage 0;
BA_ "GenSigStartValue" SG_ 161 BATTERY2_voltage 255;
BA_ "GenSigTimeoutTime_AGSM" SG_ 161 BATTERY2_voltage 0;
BA_ "GenSigTimeoutTime_BCM" SG_ 161 BATTERY2_voltage 0;
BA_ "GenSigTimeoutTime_BSM" SG_ 161 BATTERY2_voltage 0;
BA_ "GenSigTimeoutTime_CADM" SG_ 161 BATTERY2_voltage 0;
BA_ "GenSigTimeoutTime_DMSM" SG_ 161 BATTERY2_voltage 0;
BA_ "GenSigTimeoutTime_DTCM" SG_ 161 BATTERY2_voltage 0;
BA_ "GenSigTimeoutTime_ECM" SG_ 161 BATTERY2_voltage 0;
BA_ "GenSigTimeoutTime_EVCU2" SG_ 161 BATTERY2_voltage 0;
BA_ "GenSigTimeoutTime_GNMM" SG_ 161 BATTERY2_voltage 0;
BA_ "GenSigTimeoutTime_HCP" SG_ 161 BATTERY2_voltage 0;
BA_ "GenSigTimeoutTime_IPC" SG_ 161 BATTERY2_voltage 0;
BA_ "GenSigTimeoutTime_RFHM" SG_ 161 BATTERY2_voltage 0;
BA_ "GenSigTimeoutTime_SGW" SG_ 161 BATTERY2_voltage 0;
BA_ "GenSigTimeoutTime_TCM" SG_ 161 BATTERY2_voltage 0;
BA_ "GenSigStartValue" SG_ 161 CRC_DBSM2_1 255;
BA_ "GenSigSendType" SG_ 161 CRC_DBSM2_1 1;
BA_ "GenSigTimeoutTime_AGSM" SG_ 161 CRC_DBSM2_1 0;
BA_ "GenSigTimeoutTime_BCM" SG_ 161 CRC_DBSM2_1 0;
BA_ "GenSigTimeoutTime_BSM" SG_ 161 CRC_DBSM2_1 0;
BA_ "GenSigTimeoutTime_CADM" SG_ 161 CRC_DBSM2_1 0;
BA_ "GenSigTimeoutTime_DMSM" SG_ 161 CRC_DBSM2_1 0;
BA_ "GenSigTimeoutTime_DTCM" SG_ 161 CRC_DBSM2_1 0;
BA_ "GenSigTimeoutTime_ECM" SG_ 161 CRC_DBSM2_1 0;
BA_ "GenSigTimeoutTime_EVCU2" SG_ 161 CRC_DBSM2_1 0;
BA_ "GenSigTimeoutTime_GNMM" SG_ 161 CRC_DBSM2_1 0;
BA_ "GenSigTimeoutTime_HCP" SG_ 161 CRC_DBSM2_1 0;
BA_ "GenSigTimeoutTime_IPC" SG_ 161 CRC_DBSM2_1 0;
BA_ "GenSigTimeoutTime_RFHM" SG_ 161 CRC_DBSM2_1 0;
BA_ "GenSigTimeoutTime_SGW" SG_ 161 CRC_DBSM2_1 0;
BA_ "GenSigTimeoutTime_TCM" SG_ 161 CRC_DBSM2_1 0;
BA_ "GenSigTimeoutTime_AGSM" SG_ 161 DBSM2_internal_error 0;
BA_ "GenSigTimeoutTime_BCM" SG_ 161 DBSM2_internal_error 0;
BA_ "GenSigTimeoutTime_BSM" SG_ 161 DBSM2_internal_error 0;
BA_ "GenSigTimeoutTime_CADM" SG_ 161 DBSM2_internal_error 0;
BA_ "GenSigTimeoutTime_DMSM" SG_ 161 DBSM2_internal_error 0;
BA_ "GenSigTimeoutTime_DTCM" SG_ 161 DBSM2_internal_error 0;
BA_ "GenSigTimeoutTime_ECM" SG_ 161 DBSM2_internal_error 0;
BA_ "GenSigTimeoutTime_EVCU2" SG_ 161 DBSM2_internal_error 0;
BA_ "GenSigTimeoutTime_GNMM" SG_ 161 DBSM2_internal_error 0;
BA_ "GenSigTimeoutTime_HCP" SG_ 161 DBSM2_internal_error 0;
BA_ "GenSigTimeoutTime_IPC" SG_ 161 DBSM2_internal_error 0;
BA_ "GenSigTimeoutTime_RFHM" SG_ 161 DBSM2_internal_error 0;
BA_ "GenSigTimeoutTime_SGW" SG_ 161 DBSM2_internal_error 0;
BA_ "GenSigTimeoutTime_TCM" SG_ 161 DBSM2_internal_error 0;
BA_ "GenSigTimeoutTime_AGSM" SG_ 161 ESS_input_active 0;
BA_ "GenSigTimeoutTime_BCM" SG_ 161 ESS_input_active 0;
BA_ "GenSigTimeoutTime_BSM" SG_ 161 ESS_input_active 0;
BA_ "GenSigTimeoutTime_CADM" SG_ 161 ESS_input_active 0;
BA_ "GenSigTimeoutTime_DMSM" SG_ 161 ESS_input_active 0;
BA_ "GenSigTimeoutTime_DTCM" SG_ 161 ESS_input_active 0;
BA_ "GenSigTimeoutTime_ECM" SG_ 161 ESS_input_active 0;
BA_ "GenSigTimeoutTime_EVCU2" SG_ 161 ESS_input_active 0;
BA_ "GenSigTimeoutTime_GNMM" SG_ 161 ESS_input_active 0;
BA_ "GenSigTimeoutTime_HCP" SG_ 161 ESS_input_active 0;
BA_ "GenSigTimeoutTime_IPC" SG_ 161 ESS_input_active 0;
BA_ "GenSigTimeoutTime_RFHM" SG_ 161 ESS_input_active 0;
BA_ "GenSigTimeoutTime_SGW" SG_ 161 ESS_input_active 0;
BA_ "GenSigTimeoutTime_TCM" SG_ 161 ESS_input_active 0;
BA_ "GenSigTimeoutTime_AGSM" SG_ 161 L2plus_ack 0;
BA_ "GenSigTimeoutTime_BCM" SG_ 161 L2plus_ack 0;
BA_ "GenSigTimeoutTime_BSM" SG_ 161 L2plus_ack 0;
BA_ "GenSigTimeoutTime_CADM" SG_ 161 L2plus_ack 0;
BA_ "GenSigTimeoutTime_DMSM" SG_ 161 L2plus_ack 0;
BA_ "GenSigTimeoutTime_DTCM" SG_ 161 L2plus_ack 0;
BA_ "GenSigTimeoutTime_ECM" SG_ 161 L2plus_ack 0;
BA_ "GenSigTimeoutTime_EVCU2" SG_ 161 L2plus_ack 0;
BA_ "GenSigTimeoutTime_GNMM" SG_ 161 L2plus_ack 0;
BA_ "GenSigTimeoutTime_HCP" SG_ 161 L2plus_ack 0;
BA_ "GenSigTimeoutTime_IPC" SG_ 161 L2plus_ack 0;
BA_ "GenSigTimeoutTime_RFHM" SG_ 161 L2plus_ack 0;
BA_ "GenSigTimeoutTime_SGW" SG_ 161 L2plus_ack 0;
BA_ "GenSigTimeoutTime_TCM" SG_ 161 L2plus_ack 0;
BA_ "GenSigTimeoutTime_AGSM" SG_ 161 MC_DBSM2_1 0;
BA_ "GenSigTimeoutTime_BCM" SG_ 161 MC_DBSM2_1 0;
BA_ "GenSigTimeoutTime_BSM" SG_ 161 MC_DBSM2_1 0;
BA_ "GenSigTimeoutTime_CADM" SG_ 161 MC_DBSM2_1 0;
BA_ "GenSigTimeoutTime_DMSM" SG_ 161 MC_DBSM2_1 0;
BA_ "GenSigTimeoutTime_DTCM" SG_ 161 MC_DBSM2_1 0;
BA_ "GenSigTimeoutTime_ECM" SG_ 161 MC_DBSM2_1 0;
BA_ "GenSigTimeoutTime_EVCU2" SG_ 161 MC_DBSM2_1 0;
BA_ "GenSigTimeoutTime_GNMM" SG_ 161 MC_DBSM2_1 0;
BA_ "GenSigTimeoutTime_HCP" SG_ 161 MC_DBSM2_1 0;
BA_ "GenSigTimeoutTime_IPC" SG_ 161 MC_DBSM2_1 0;
BA_ "GenSigTimeoutTime_RFHM" SG_ 161 MC_DBSM2_1 0;
BA_ "GenSigTimeoutTime_SGW" SG_ 161 MC_DBSM2_1 0;
BA_ "GenSigTimeoutTime_TCM" SG_ 161 MC_DBSM2_1 0;
BA_ "GenSigTimeoutTime_AGSM" SG_ 161 overcurrent_detected 0;
BA_ "GenSigTimeoutTime_BCM" SG_ 161 overcurrent_detected 0;
BA_ "GenSigTimeoutTime_BSM" SG_ 161 overcurrent_detected 0;
BA_ "GenSigTimeoutTime_CADM" SG_ 161 overcurrent_detected 0;
BA_ "GenSigTimeoutTime_DMSM" SG_ 161 overcurrent_detected 0;
BA_ "GenSigTimeoutTime_DTCM" SG_ 161 overcurrent_detected 0;
BA_ "GenSigTimeoutTime_ECM" SG_ 161 overcurrent_detected 0;
BA_ "GenSigTimeoutTime_EVCU2" SG_ 161 overcurrent_detected 0;
BA_ "GenSigTimeoutTime_GNMM" SG_ 161 overcurrent_detected 0;
BA_ "GenSigTimeoutTime_HCP" SG_ 161 overcurrent_detected 0;
BA_ "GenSigTimeoutTime_IPC" SG_ 161 overcurrent_detected 0;
BA_ "GenSigTimeoutTime_RFHM" SG_ 161 overcurrent_detected 0;
BA_ "GenSigTimeoutTime_SGW" SG_ 161 overcurrent_detected 0;
BA_ "GenSigTimeoutTime_TCM" SG_ 161 overcurrent_detected 0;
BA_ "GenSigTimeoutTime_AGSM" SG_ 161 overtemp_detected 0;
BA_ "GenSigTimeoutTime_BCM" SG_ 161 overtemp_detected 0;
BA_ "GenSigTimeoutTime_BSM" SG_ 161 overtemp_detected 0;
BA_ "GenSigTimeoutTime_CADM" SG_ 161 overtemp_detected 0;
BA_ "GenSigTimeoutTime_DMSM" SG_ 161 overtemp_detected 0;
BA_ "GenSigTimeoutTime_DTCM" SG_ 161 overtemp_detected 0;
BA_ "GenSigTimeoutTime_ECM" SG_ 161 overtemp_detected 0;
BA_ "GenSigTimeoutTime_EVCU2" SG_ 161 overtemp_detected 0;
BA_ "GenSigTimeoutTime_GNMM" SG_ 161 overtemp_detected 0;
BA_ "GenSigTimeoutTime_HCP" SG_ 161 overtemp_detected 0;
BA_ "GenSigTimeoutTime_IPC" SG_ 161 overtemp_detected 0;
BA_ "GenSigTimeoutTime_RFHM" SG_ 161 overtemp_detected 0;
BA_ "GenSigTimeoutTime_SGW" SG_ 161 overtemp_detected 0;
BA_ "GenSigTimeoutTime_TCM" SG_ 161 overtemp_detected 0;
BA_ "GenSigTimeoutTime_AGSM" SG_ 161 RsErr_DBSM2 0;
BA_ "GenSigTimeoutTime_BCM" SG_ 161 RsErr_DBSM2 0;
BA_ "GenSigTimeoutTime_BSM" SG_ 161 RsErr_DBSM2 0;
BA_ "GenSigTimeoutTime_CADM" SG_ 161 RsErr_DBSM2 0;
BA_ "GenSigTimeoutTime_DMSM" SG_ 161 RsErr_DBSM2 0;
BA_ "GenSigTimeoutTime_DTCM" SG_ 161 RsErr_DBSM2 0;
BA_ "GenSigTimeoutTime_ECM" SG_ 161 RsErr_DBSM2 0;
BA_ "GenSigTimeoutTime_EVCU2" SG_ 161 RsErr_DBSM2 0;
BA_ "GenSigTimeoutTime_GNMM" SG_ 161 RsErr_DBSM2 0;
BA_ "GenSigTimeoutTime_HCP" SG_ 161 RsErr_DBSM2 0;
BA_ "GenSigTimeoutTime_IPC" SG_ 161 RsErr_DBSM2 0;
BA_ "GenSigTimeoutTime_RFHM" SG_ 161 RsErr_DBSM2 0;
BA_ "GenSigTimeoutTime_SGW" SG_ 161 RsErr_DBSM2 0;
BA_ "GenSigTimeoutTime_TCM" SG_ 161 RsErr_DBSM2 0;
BA_ "GenSigTimeoutTime_AGSM" SG_ 161 switch_status_OpenClose 0;
BA_ "GenSigTimeoutTime_BCM" SG_ 161 switch_status_OpenClose 0;
BA_ "GenSigTimeoutTime_BSM" SG_ 161 switch_status_OpenClose 0;
BA_ "GenSigTimeoutTime_CADM" SG_ 161 switch_status_OpenClose 0;
BA_ "GenSigTimeoutTime_DMSM" SG_ 161 switch_status_OpenClose 0;
BA_ "GenSigTimeoutTime_DTCM" SG_ 161 switch_status_OpenClose 0;
BA_ "GenSigTimeoutTime_ECM" SG_ 161 switch_status_OpenClose 0;
BA_ "GenSigTimeoutTime_EVCU2" SG_ 161 switch_status_OpenClose 0;
BA_ "GenSigTimeoutTime_GNMM" SG_ 161 switch_status_OpenClose 0;
BA_ "GenSigTimeoutTime_HCP" SG_ 161 switch_status_OpenClose 0;
BA_ "GenSigTimeoutTime_IPC" SG_ 161 switch_status_OpenClose 0;
BA_ "GenSigTimeoutTime_RFHM" SG_ 161 switch_status_OpenClose 0;
BA_ "GenSigTimeoutTime_SGW" SG_ 161 switch_status_OpenClose 0;
BA_ "GenSigTimeoutTime_TCM" SG_ 161 switch_status_OpenClose 0;
BA_ "GenSigTimeoutTime_AGSM" SG_ 161 undervoltage_detected 0;
BA_ "GenSigTimeoutTime_BCM" SG_ 161 undervoltage_detected 0;
BA_ "GenSigTimeoutTime_BSM" SG_ 161 undervoltage_detected 0;
BA_ "GenSigTimeoutTime_CADM" SG_ 161 undervoltage_detected 0;
BA_ "GenSigTimeoutTime_DMSM" SG_ 161 undervoltage_detected 0;
BA_ "GenSigTimeoutTime_DTCM" SG_ 161 undervoltage_detected 0;
BA_ "GenSigTimeoutTime_ECM" SG_ 161 undervoltage_detected 0;
BA_ "GenSigTimeoutTime_EVCU2" SG_ 161 undervoltage_detected 0;
BA_ "GenSigTimeoutTime_GNMM" SG_ 161 undervoltage_detected 0;
BA_ "GenSigTimeoutTime_HCP" SG_ 161 undervoltage_detected 0;
BA_ "GenSigTimeoutTime_IPC" SG_ 161 undervoltage_detected 0;
BA_ "GenSigTimeoutTime_RFHM" SG_ 161 undervoltage_detected 0;
BA_ "GenSigTimeoutTime_SGW" SG_ 161 undervoltage_detected 0;
BA_ "GenSigTimeoutTime_TCM" SG_ 161 undervoltage_detected 0;
BA_ "GenSigTimeoutTime_AGSM" SG_ 2564440305 N_PDU 0;
BA_ "GenSigTimeoutTime_BCM" SG_ 2564440305 N_PDU 0;
BA_ "GenSigTimeoutTime_BSM" SG_ 2564440305 N_PDU 0;
BA_ "GenSigTimeoutTime_CADM" SG_ 2564440305 N_PDU 0;
BA_ "GenSigTimeoutTime_DMSM" SG_ 2564440305 N_PDU 0;
BA_ "GenSigTimeoutTime_DTCM" SG_ 2564440305 N_PDU 0;
BA_ "GenSigTimeoutTime_ECM" SG_ 2564440305 N_PDU 0;
BA_ "GenSigTimeoutTime_EVCU2" SG_ 2564440305 N_PDU 0;
BA_ "GenSigTimeoutTime_GNMM" SG_ 2564440305 N_PDU 0;
BA_ "GenSigTimeoutTime_HCP" SG_ 2564440305 N_PDU 0;
BA_ "GenSigTimeoutTime_IPC" SG_ 2564440305 N_PDU 0;
BA_ "GenSigTimeoutTime_RFHM" SG_ 2564440305 N_PDU 0;
BA_ "GenSigTimeoutTime_SGW" SG_ 2564440305 N_PDU 0;
BA_ "GenSigTimeoutTime_TCM" SG_ 2564440305 N_PDU 0;
BA_ "GenSigTimeoutTime_AGSM" SG_ 2564434161 N_PDU 0;
BA_ "GenSigTimeoutTime_BCM" SG_ 2564434161 N_PDU 0;
BA_ "GenSigTimeoutTime_BSM" SG_ 2564434161 N_PDU 0;
BA_ "GenSigTimeoutTime_CADM" SG_ 2564434161 N_PDU 0;
BA_ "GenSigTimeoutTime_DMSM" SG_ 2564434161 N_PDU 0;
BA_ "GenSigTimeoutTime_DTCM" SG_ 2564434161 N_PDU 0;
BA_ "GenSigTimeoutTime_ECM" SG_ 2564434161 N_PDU 0;
BA_ "GenSigTimeoutTime_EVCU2" SG_ 2564434161 N_PDU 0;
BA_ "GenSigTimeoutTime_GNMM" SG_ 2564434161 N_PDU 0;
BA_ "GenSigTimeoutTime_HCP" SG_ 2564434161 N_PDU 0;
BA_ "GenSigTimeoutTime_IPC" SG_ 2564434161 N_PDU 0;
BA_ "GenSigTimeoutTime_RFHM" SG_ 2564434161 N_PDU 0;
BA_ "GenSigTimeoutTime_SGW" SG_ 2564434161 N_PDU 0;
BA_ "GenSigTimeoutTime_TCM" SG_ 2564434161 N_PDU 0;
BA_ "GenSigTimeoutTime_AGSM" SG_ 2564435697 N_PDU 0;
BA_ "GenSigTimeoutTime_BCM" SG_ 2564435697 N_PDU 0;
BA_ "GenSigTimeoutTime_BSM" SG_ 2564435697 N_PDU 0;
BA_ "GenSigTimeoutTime_CADM" SG_ 2564435697 N_PDU 0;
BA_ "GenSigTimeoutTime_DMSM" SG_ 2564435697 N_PDU 0;
BA_ "GenSigTimeoutTime_DTCM" SG_ 2564435697 N_PDU 0;
BA_ "GenSigTimeoutTime_ECM" SG_ 2564435697 N_PDU 0;
BA_ "GenSigTimeoutTime_EVCU2" SG_ 2564435697 N_PDU 0;
BA_ "GenSigTimeoutTime_GNMM" SG_ 2564435697 N_PDU 0;
BA_ "GenSigTimeoutTime_HCP" SG_ 2564435697 N_PDU 0;
BA_ "GenSigTimeoutTime_IPC" SG_ 2564435697 N_PDU 0;
BA_ "GenSigTimeoutTime_RFHM" SG_ 2564435697 N_PDU 0;
BA_ "GenSigTimeoutTime_SGW" SG_ 2564435697 N_PDU 0;
BA_ "GenSigTimeoutTime_TCM" SG_ 2564435697 N_PDU 0;
BA_ "GenSigTimeoutTime_AGSM" SG_ 2564462577 N_PDU 0;
BA_ "GenSigTimeoutTime_BCM" SG_ 2564462577 N_PDU 0;
BA_ "GenSigTimeoutTime_BSM" SG_ 2564462577 N_PDU 0;
BA_ "GenSigTimeoutTime_CADM" SG_ 2564462577 N_PDU 0;
BA_ "GenSigTimeoutTime_DMSM" SG_ 2564462577 N_PDU 0;
BA_ "GenSigTimeoutTime_DTCM" SG_ 2564462577 N_PDU 0;
BA_ "GenSigTimeoutTime_ECM" SG_ 2564462577 N_PDU 0;
BA_ "GenSigTimeoutTime_EVCU2" SG_ 2564462577 N_PDU 0;
BA_ "GenSigTimeoutTime_GNMM" SG_ 2564462577 N_PDU 0;
BA_ "GenSigTimeoutTime_HCP" SG_ 2564462577 N_PDU 0;
BA_ "GenSigTimeoutTime_IPC" SG_ 2564462577 N_PDU 0;
BA_ "GenSigTimeoutTime_RFHM" SG_ 2564462577 N_PDU 0;
BA_ "GenSigTimeoutTime_SGW" SG_ 2564462577 N_PDU 0;
BA_ "GenSigTimeoutTime_TCM" SG_ 2564462577 N_PDU 0;
BA_ "GenSigTimeoutTime_AGSM" SG_ 2564430577 N_PDU 0;
BA_ "GenSigTimeoutTime_BCM" SG_ 2564430577 N_PDU 0;
BA_ "GenSigTimeoutTime_BSM" SG_ 2564430577 N_PDU 0;
BA_ "GenSigTimeoutTime_CADM" SG_ 2564430577 N_PDU 0;
BA_ "GenSigTimeoutTime_DMSM" SG_ 2564430577 N_PDU 0;
BA_ "GenSigTimeoutTime_DTCM" SG_ 2564430577 N_PDU 0;
BA_ "GenSigTimeoutTime_ECM" SG_ 2564430577 N_PDU 0;
BA_ "GenSigTimeoutTime_EVCU2" SG_ 2564430577 N_PDU 0;
BA_ "GenSigTimeoutTime_GNMM" SG_ 2564430577 N_PDU 0;
BA_ "GenSigTimeoutTime_HCP" SG_ 2564430577 N_PDU 0;
BA_ "GenSigTimeoutTime_IPC" SG_ 2564430577 N_PDU 0;
BA_ "GenSigTimeoutTime_RFHM" SG_ 2564430577 N_PDU 0;
BA_ "GenSigTimeoutTime_SGW" SG_ 2564430577 N_PDU 0;
BA_ "GenSigTimeoutTime_TCM" SG_ 2564430577 N_PDU 0;
BA_ "GenSigTimeoutTime_AGSM" SG_ 2564428017 N_PDU 0;
BA_ "GenSigTimeoutTime_BCM" SG_ 2564428017 N_PDU 0;
BA_ "GenSigTimeoutTime_BSM" SG_ 2564428017 N_PDU 0;
BA_ "GenSigTimeoutTime_CADM" SG_ 2564428017 N_PDU 0;
BA_ "GenSigTimeoutTime_DMSM" SG_ 2564428017 N_PDU 0;
BA_ "GenSigTimeoutTime_DTCM" SG_ 2564428017 N_PDU 0;
BA_ "GenSigTimeoutTime_ECM" SG_ 2564428017 N_PDU 0;
BA_ "GenSigTimeoutTime_EVCU2" SG_ 2564428017 N_PDU 0;
BA_ "GenSigTimeoutTime_GNMM" SG_ 2564428017 N_PDU 0;
BA_ "GenSigTimeoutTime_HCP" SG_ 2564428017 N_PDU 0;
BA_ "GenSigTimeoutTime_IPC" SG_ 2564428017 N_PDU 0;
BA_ "GenSigTimeoutTime_RFHM" SG_ 2564428017 N_PDU 0;
BA_ "GenSigTimeoutTime_SGW" SG_ 2564428017 N_PDU 0;
BA_ "GenSigTimeoutTime_TCM" SG_ 2564428017 N_PDU 0;
BA_ "GenSigTimeoutTime_AGSM" SG_ 2564440817 N_PDU 0;
BA_ "GenSigTimeoutTime_BCM" SG_ 2564440817 N_PDU 0;
BA_ "GenSigTimeoutTime_BSM" SG_ 2564440817 N_PDU 0;
BA_ "GenSigTimeoutTime_CADM" SG_ 2564440817 N_PDU 0;
BA_ "GenSigTimeoutTime_DMSM" SG_ 2564440817 N_PDU 0;
BA_ "GenSigTimeoutTime_DTCM" SG_ 2564440817 N_PDU 0;
BA_ "GenSigTimeoutTime_ECM" SG_ 2564440817 N_PDU 0;
BA_ "GenSigTimeoutTime_EVCU2" SG_ 2564440817 N_PDU 0;
BA_ "GenSigTimeoutTime_GNMM" SG_ 2564440817 N_PDU 0;
BA_ "GenSigTimeoutTime_HCP" SG_ 2564440817 N_PDU 0;
BA_ "GenSigTimeoutTime_IPC" SG_ 2564440817 N_PDU 0;
BA_ "GenSigTimeoutTime_RFHM" SG_ 2564440817 N_PDU 0;
BA_ "GenSigTimeoutTime_SGW" SG_ 2564440817 N_PDU 0;
BA_ "GenSigTimeoutTime_TCM" SG_ 2564440817 N_PDU 0;
BA_ "GenSigTimeoutTime_AGSM" SG_ 2564440306 N_PDU 0;
BA_ "GenSigTimeoutTime_BCM" SG_ 2564440306 N_PDU 0;
BA_ "GenSigTimeoutTime_BSM" SG_ 2564440306 N_PDU 0;
BA_ "GenSigTimeoutTime_CADM" SG_ 2564440306 N_PDU 0;
BA_ "GenSigTimeoutTime_DMSM" SG_ 2564440306 N_PDU 0;
BA_ "GenSigTimeoutTime_DTCM" SG_ 2564440306 N_PDU 0;
BA_ "GenSigTimeoutTime_ECM" SG_ 2564440306 N_PDU 0;
BA_ "GenSigTimeoutTime_EVCU2" SG_ 2564440306 N_PDU 0;
BA_ "GenSigTimeoutTime_GNMM" SG_ 2564440306 N_PDU 0;
BA_ "GenSigTimeoutTime_HCP" SG_ 2564440306 N_PDU 0;
BA_ "GenSigTimeoutTime_IPC" SG_ 2564440306 N_PDU 0;
BA_ "GenSigTimeoutTime_RFHM" SG_ 2564440306 N_PDU 0;
BA_ "GenSigTimeoutTime_SGW" SG_ 2564440306 N_PDU 0;
BA_ "GenSigTimeoutTime_TCM" SG_ 2564440306 N_PDU 0;
BA_ "GenSigTimeoutTime_AGSM" SG_ 2564434162 N_PDU 0;
BA_ "GenSigTimeoutTime_BCM" SG_ 2564434162 N_PDU 0;
BA_ "GenSigTimeoutTime_BSM" SG_ 2564434162 N_PDU 0;
BA_ "GenSigTimeoutTime_CADM" SG_ 2564434162 N_PDU 0;
BA_ "GenSigTimeoutTime_DMSM" SG_ 2564434162 N_PDU 0;
BA_ "GenSigTimeoutTime_DTCM" SG_ 2564434162 N_PDU 0;
BA_ "GenSigTimeoutTime_ECM" SG_ 2564434162 N_PDU 0;
BA_ "GenSigTimeoutTime_EVCU2" SG_ 2564434162 N_PDU 0;
BA_ "GenSigTimeoutTime_GNMM" SG_ 2564434162 N_PDU 0;
BA_ "GenSigTimeoutTime_HCP" SG_ 2564434162 N_PDU 0;
BA_ "GenSigTimeoutTime_IPC" SG_ 2564434162 N_PDU 0;
BA_ "GenSigTimeoutTime_RFHM" SG_ 2564434162 N_PDU 0;
BA_ "GenSigTimeoutTime_SGW" SG_ 2564434162 N_PDU 0;
BA_ "GenSigTimeoutTime_TCM" SG_ 2564434162 N_PDU 0;
BA_ "GenSigTimeoutTime_AGSM" SG_ 2564435698 N_PDU 0;
BA_ "GenSigTimeoutTime_BCM" SG_ 2564435698 N_PDU 0;
BA_ "GenSigTimeoutTime_BSM" SG_ 2564435698 N_PDU 0;
BA_ "GenSigTimeoutTime_CADM" SG_ 2564435698 N_PDU 0;
BA_ "GenSigTimeoutTime_DMSM" SG_ 2564435698 N_PDU 0;
BA_ "GenSigTimeoutTime_DTCM" SG_ 2564435698 N_PDU 0;
BA_ "GenSigTimeoutTime_ECM" SG_ 2564435698 N_PDU 0;
BA_ "GenSigTimeoutTime_EVCU2" SG_ 2564435698 N_PDU 0;
BA_ "GenSigTimeoutTime_GNMM" SG_ 2564435698 N_PDU 0;
BA_ "GenSigTimeoutTime_HCP" SG_ 2564435698 N_PDU 0;
BA_ "GenSigTimeoutTime_IPC" SG_ 2564435698 N_PDU 0;
BA_ "GenSigTimeoutTime_RFHM" SG_ 2564435698 N_PDU 0;
BA_ "GenSigTimeoutTime_SGW" SG_ 2564435698 N_PDU 0;
BA_ "GenSigTimeoutTime_TCM" SG_ 2564435698 N_PDU 0;
BA_ "GenSigTimeoutTime_AGSM" SG_ 2564462578 N_PDU 0;
BA_ "GenSigTimeoutTime_BCM" SG_ 2564462578 N_PDU 0;
BA_ "GenSigTimeoutTime_BSM" SG_ 2564462578 N_PDU 0;
BA_ "GenSigTimeoutTime_CADM" SG_ 2564462578 N_PDU 0;
BA_ "GenSigTimeoutTime_DMSM" SG_ 2564462578 N_PDU 0;
BA_ "GenSigTimeoutTime_DTCM" SG_ 2564462578 N_PDU 0;
BA_ "GenSigTimeoutTime_ECM" SG_ 2564462578 N_PDU 0;
BA_ "GenSigTimeoutTime_EVCU2" SG_ 2564462578 N_PDU 0;
BA_ "GenSigTimeoutTime_GNMM" SG_ 2564462578 N_PDU 0;
BA_ "GenSigTimeoutTime_HCP" SG_ 2564462578 N_PDU 0;
BA_ "GenSigTimeoutTime_IPC" SG_ 2564462578 N_PDU 0;
BA_ "GenSigTimeoutTime_RFHM" SG_ 2564462578 N_PDU 0;
BA_ "GenSigTimeoutTime_SGW" SG_ 2564462578 N_PDU 0;
BA_ "GenSigTimeoutTime_TCM" SG_ 2564462578 N_PDU 0;
BA_ "GenSigTimeoutTime_AGSM" SG_ 2564430578 N_PDU 0;
BA_ "GenSigTimeoutTime_BCM" SG_ 2564430578 N_PDU 0;
BA_ "GenSigTimeoutTime_BSM" SG_ 2564430578 N_PDU 0;
BA_ "GenSigTimeoutTime_CADM" SG_ 2564430578 N_PDU 0;
BA_ "GenSigTimeoutTime_DMSM" SG_ 2564430578 N_PDU 0;
BA_ "GenSigTimeoutTime_DTCM" SG_ 2564430578 N_PDU 0;
BA_ "GenSigTimeoutTime_ECM" SG_ 2564430578 N_PDU 0;
BA_ "GenSigTimeoutTime_EVCU2" SG_ 2564430578 N_PDU 0;
BA_ "GenSigTimeoutTime_GNMM" SG_ 2564430578 N_PDU 0;
BA_ "GenSigTimeoutTime_HCP" SG_ 2564430578 N_PDU 0;
BA_ "GenSigTimeoutTime_IPC" SG_ 2564430578 N_PDU 0;
BA_ "GenSigTimeoutTime_RFHM" SG_ 2564430578 N_PDU 0;
BA_ "GenSigTimeoutTime_SGW" SG_ 2564430578 N_PDU 0;
BA_ "GenSigTimeoutTime_TCM" SG_ 2564430578 N_PDU 0;
BA_ "GenSigTimeoutTime_AGSM" SG_ 2564428018 N_PDU 0;
BA_ "GenSigTimeoutTime_BCM" SG_ 2564428018 N_PDU 0;
BA_ "GenSigTimeoutTime_BSM" SG_ 2564428018 N_PDU 0;
BA_ "GenSigTimeoutTime_CADM" SG_ 2564428018 N_PDU 0;
BA_ "GenSigTimeoutTime_DMSM" SG_ 2564428018 N_PDU 0;
BA_ "GenSigTimeoutTime_DTCM" SG_ 2564428018 N_PDU 0;
BA_ "GenSigTimeoutTime_ECM" SG_ 2564428018 N_PDU 0;
BA_ "GenSigTimeoutTime_EVCU2" SG_ 2564428018 N_PDU 0;
BA_ "GenSigTimeoutTime_GNMM" SG_ 2564428018 N_PDU 0;
BA_ "GenSigTimeoutTime_HCP" SG_ 2564428018 N_PDU 0;
BA_ "GenSigTimeoutTime_IPC" SG_ 2564428018 N_PDU 0;
BA_ "GenSigTimeoutTime_RFHM" SG_ 2564428018 N_PDU 0;
BA_ "GenSigTimeoutTime_SGW" SG_ 2564428018 N_PDU 0;
BA_ "GenSigTimeoutTime_TCM" SG_ 2564428018 N_PDU 0;
BA_ "GenSigTimeoutTime_AGSM" SG_ 2564427762 N_PDU 0;
BA_ "GenSigTimeoutTime_BCM" SG_ 2564427762 N_PDU 0;
BA_ "GenSigTimeoutTime_BSM" SG_ 2564427762 N_PDU 0;
BA_ "GenSigTimeoutTime_CADM" SG_ 2564427762 N_PDU 0;
BA_ "GenSigTimeoutTime_DMSM" SG_ 2564427762 N_PDU 0;
BA_ "GenSigTimeoutTime_DTCM" SG_ 2564427762 N_PDU 0;
BA_ "GenSigTimeoutTime_ECM" SG_ 2564427762 N_PDU 0;
BA_ "GenSigTimeoutTime_EVCU2" SG_ 2564427762 N_PDU 0;
BA_ "GenSigTimeoutTime_GNMM" SG_ 2564427762 N_PDU 0;
BA_ "GenSigTimeoutTime_HCP" SG_ 2564427762 N_PDU 0;
BA_ "GenSigTimeoutTime_IPC" SG_ 2564427762 N_PDU 0;
BA_ "GenSigTimeoutTime_RFHM" SG_ 2564427762 N_PDU 0;
BA_ "GenSigTimeoutTime_SGW" SG_ 2564427762 N_PDU 0;
BA_ "GenSigTimeoutTime_TCM" SG_ 2564427762 N_PDU 0;
BA_ "GenSigTimeoutTime_AGSM" SG_ 2564427506 N_PDU 0;
BA_ "GenSigTimeoutTime_BCM" SG_ 2564427506 N_PDU 0;
BA_ "GenSigTimeoutTime_BSM" SG_ 2564427506 N_PDU 0;
BA_ "GenSigTimeoutTime_CADM" SG_ 2564427506 N_PDU 0;
BA_ "GenSigTimeoutTime_DMSM" SG_ 2564427506 N_PDU 0;
BA_ "GenSigTimeoutTime_DTCM" SG_ 2564427506 N_PDU 0;
BA_ "GenSigTimeoutTime_ECM" SG_ 2564427506 N_PDU 0;
BA_ "GenSigTimeoutTime_EVCU2" SG_ 2564427506 N_PDU 0;
BA_ "GenSigTimeoutTime_GNMM" SG_ 2564427506 N_PDU 0;
BA_ "GenSigTimeoutTime_HCP" SG_ 2564427506 N_PDU 0;
BA_ "GenSigTimeoutTime_IPC" SG_ 2564427506 N_PDU 0;
BA_ "GenSigTimeoutTime_RFHM" SG_ 2564427506 N_PDU 0;
BA_ "GenSigTimeoutTime_SGW" SG_ 2564427506 N_PDU 0;
BA_ "GenSigTimeoutTime_TCM" SG_ 2564427506 N_PDU 0;
BA_ "GenSigTimeoutTime_AGSM" SG_ 2564554482 N_PDU 0;
BA_ "GenSigTimeoutTime_BCM" SG_ 2564554482 N_PDU 0;
BA_ "GenSigTimeoutTime_BSM" SG_ 2564554482 N_PDU 0;
BA_ "GenSigTimeoutTime_CADM" SG_ 2564554482 N_PDU 0;
BA_ "GenSigTimeoutTime_DMSM" SG_ 2564554482 N_PDU 0;
BA_ "GenSigTimeoutTime_DTCM" SG_ 2564554482 N_PDU 0;
BA_ "GenSigTimeoutTime_ECM" SG_ 2564554482 N_PDU 0;
BA_ "GenSigTimeoutTime_EVCU2" SG_ 2564554482 N_PDU 0;
BA_ "GenSigTimeoutTime_GNMM" SG_ 2564554482 N_PDU 0;
BA_ "GenSigTimeoutTime_HCP" SG_ 2564554482 N_PDU 0;
BA_ "GenSigTimeoutTime_IPC" SG_ 2564554482 N_PDU 0;
BA_ "GenSigTimeoutTime_RFHM" SG_ 2564554482 N_PDU 0;
BA_ "GenSigTimeoutTime_SGW" SG_ 2564554482 N_PDU 0;
BA_ "GenSigTimeoutTime_TCM" SG_ 2564554482 N_PDU 0;
BA_ "GenSigTimeoutTime_AGSM" SG_ 2564437234 N_PDU 0;
BA_ "GenSigTimeoutTime_BCM" SG_ 2564437234 N_PDU 0;
BA_ "GenSigTimeoutTime_BSM" SG_ 2564437234 N_PDU 0;
BA_ "GenSigTimeoutTime_CADM" SG_ 2564437234 N_PDU 0;
BA_ "GenSigTimeoutTime_DMSM" SG_ 2564437234 N_PDU 0;
BA_ "GenSigTimeoutTime_DTCM" SG_ 2564437234 N_PDU 0;
BA_ "GenSigTimeoutTime_ECM" SG_ 2564437234 N_PDU 0;
BA_ "GenSigTimeoutTime_EVCU2" SG_ 2564437234 N_PDU 0;
BA_ "GenSigTimeoutTime_GNMM" SG_ 2564437234 N_PDU 0;
BA_ "GenSigTimeoutTime_HCP" SG_ 2564437234 N_PDU 0;
BA_ "GenSigTimeoutTime_IPC" SG_ 2564437234 N_PDU 0;
BA_ "GenSigTimeoutTime_RFHM" SG_ 2564437234 N_PDU 0;
BA_ "GenSigTimeoutTime_SGW" SG_ 2564437234 N_PDU 0;
BA_ "GenSigTimeoutTime_TCM" SG_ 2564437234 N_PDU 0;
BA_ "GenSigTimeoutTime_AGSM" SG_ 2564448498 N_PDU 0;
BA_ "GenSigTimeoutTime_BCM" SG_ 2564448498 N_PDU 0;
BA_ "GenSigTimeoutTime_BSM" SG_ 2564448498 N_PDU 0;
BA_ "GenSigTimeoutTime_CADM" SG_ 2564448498 N_PDU 0;
BA_ "GenSigTimeoutTime_DMSM" SG_ 2564448498 N_PDU 0;
BA_ "GenSigTimeoutTime_DTCM" SG_ 2564448498 N_PDU 0;
BA_ "GenSigTimeoutTime_ECM" SG_ 2564448498 N_PDU 0;
BA_ "GenSigTimeoutTime_EVCU2" SG_ 2564448498 N_PDU 0;
BA_ "GenSigTimeoutTime_GNMM" SG_ 2564448498 N_PDU 0;
BA_ "GenSigTimeoutTime_HCP" SG_ 2564448498 N_PDU 0;
BA_ "GenSigTimeoutTime_IPC" SG_ 2564448498 N_PDU 0;
BA_ "GenSigTimeoutTime_RFHM" SG_ 2564448498 N_PDU 0;
BA_ "GenSigTimeoutTime_SGW" SG_ 2564448498 N_PDU 0;
BA_ "GenSigTimeoutTime_TCM" SG_ 2564448498 N_PDU 0;
BA_ "GenSigTimeoutTime_AGSM" SG_ 2564429042 N_PDU 0;
BA_ "GenSigTimeoutTime_BCM" SG_ 2564429042 N_PDU 0;
BA_ "GenSigTimeoutTime_BSM" SG_ 2564429042 N_PDU 0;
BA_ "GenSigTimeoutTime_CADM" SG_ 2564429042 N_PDU 0;
BA_ "GenSigTimeoutTime_DMSM" SG_ 2564429042 N_PDU 0;
BA_ "GenSigTimeoutTime_DTCM" SG_ 2564429042 N_PDU 0;
BA_ "GenSigTimeoutTime_ECM" SG_ 2564429042 N_PDU 0;
BA_ "GenSigTimeoutTime_EVCU2" SG_ 2564429042 N_PDU 0;
BA_ "GenSigTimeoutTime_GNMM" SG_ 2564429042 N_PDU 0;
BA_ "GenSigTimeoutTime_HCP" SG_ 2564429042 N_PDU 0;
BA_ "GenSigTimeoutTime_IPC" SG_ 2564429042 N_PDU 0;
BA_ "GenSigTimeoutTime_RFHM" SG_ 2564429042 N_PDU 0;
BA_ "GenSigTimeoutTime_SGW" SG_ 2564429042 N_PDU 0;
BA_ "GenSigTimeoutTime_TCM" SG_ 2564429042 N_PDU 0;
BA_ "GenSigTimeoutTime_AGSM" SG_ 2564429298 N_PDU 0;
BA_ "GenSigTimeoutTime_BCM" SG_ 2564429298 N_PDU 0;
BA_ "GenSigTimeoutTime_BSM" SG_ 2564429298 N_PDU 0;
BA_ "GenSigTimeoutTime_CADM" SG_ 2564429298 N_PDU 0;
BA_ "GenSigTimeoutTime_DMSM" SG_ 2564429298 N_PDU 0;
BA_ "GenSigTimeoutTime_DTCM" SG_ 2564429298 N_PDU 0;
BA_ "GenSigTimeoutTime_ECM" SG_ 2564429298 N_PDU 0;
BA_ "GenSigTimeoutTime_EVCU2" SG_ 2564429298 N_PDU 0;
BA_ "GenSigTimeoutTime_GNMM" SG_ 2564429298 N_PDU 0;
BA_ "GenSigTimeoutTime_HCP" SG_ 2564429298 N_PDU 0;
BA_ "GenSigTimeoutTime_IPC" SG_ 2564429298 N_PDU 0;
BA_ "GenSigTimeoutTime_RFHM" SG_ 2564429298 N_PDU 0;
BA_ "GenSigTimeoutTime_SGW" SG_ 2564429298 N_PDU 0;
BA_ "GenSigTimeoutTime_TCM" SG_ 2564429298 N_PDU 0;
BA_ "GenSigTimeoutTime_AGSM" SG_ 2564474866 N_PDU 0;
BA_ "GenSigTimeoutTime_BCM" SG_ 2564474866 N_PDU 0;
BA_ "GenSigTimeoutTime_BSM" SG_ 2564474866 N_PDU 0;
BA_ "GenSigTimeoutTime_CADM" SG_ 2564474866 N_PDU 0;
BA_ "GenSigTimeoutTime_DMSM" SG_ 2564474866 N_PDU 0;
BA_ "GenSigTimeoutTime_DTCM" SG_ 2564474866 N_PDU 0;
BA_ "GenSigTimeoutTime_ECM" SG_ 2564474866 N_PDU 0;
BA_ "GenSigTimeoutTime_EVCU2" SG_ 2564474866 N_PDU 0;
BA_ "GenSigTimeoutTime_GNMM" SG_ 2564474866 N_PDU 0;
BA_ "GenSigTimeoutTime_HCP" SG_ 2564474866 N_PDU 0;
BA_ "GenSigTimeoutTime_IPC" SG_ 2564474866 N_PDU 0;
BA_ "GenSigTimeoutTime_RFHM" SG_ 2564474866 N_PDU 0;
BA_ "GenSigTimeoutTime_SGW" SG_ 2564474866 N_PDU 0;
BA_ "GenSigTimeoutTime_TCM" SG_ 2564474866 N_PDU 0;
BA_ "GenSigTimeoutTime_AGSM" SG_ 2564455666 N_PDU 0;
BA_ "GenSigTimeoutTime_BCM" SG_ 2564455666 N_PDU 0;
BA_ "GenSigTimeoutTime_BSM" SG_ 2564455666 N_PDU 0;
BA_ "GenSigTimeoutTime_CADM" SG_ 2564455666 N_PDU 0;
BA_ "GenSigTimeoutTime_DMSM" SG_ 2564455666 N_PDU 0;
BA_ "GenSigTimeoutTime_DTCM" SG_ 2564455666 N_PDU 0;
BA_ "GenSigTimeoutTime_ECM" SG_ 2564455666 N_PDU 0;
BA_ "GenSigTimeoutTime_EVCU2" SG_ 2564455666 N_PDU 0;
BA_ "GenSigTimeoutTime_GNMM" SG_ 2564455666 N_PDU 0;
BA_ "GenSigTimeoutTime_HCP" SG_ 2564455666 N_PDU 0;
BA_ "GenSigTimeoutTime_IPC" SG_ 2564455666 N_PDU 0;
BA_ "GenSigTimeoutTime_RFHM" SG_ 2564455666 N_PDU 0;
BA_ "GenSigTimeoutTime_SGW" SG_ 2564455666 N_PDU 0;
BA_ "GenSigTimeoutTime_TCM" SG_ 2564455666 N_PDU 0;
BA_ "GenSigTimeoutTime_AGSM" SG_ 2564431858 N_PDU 0;
BA_ "GenSigTimeoutTime_BCM" SG_ 2564431858 N_PDU 0;
BA_ "GenSigTimeoutTime_BSM" SG_ 2564431858 N_PDU 0;
BA_ "GenSigTimeoutTime_CADM" SG_ 2564431858 N_PDU 0;
BA_ "GenSigTimeoutTime_DMSM" SG_ 2564431858 N_PDU 0;
BA_ "GenSigTimeoutTime_DTCM" SG_ 2564431858 N_PDU 0;
BA_ "GenSigTimeoutTime_ECM" SG_ 2564431858 N_PDU 0;
BA_ "GenSigTimeoutTime_EVCU2" SG_ 2564431858 N_PDU 0;
BA_ "GenSigTimeoutTime_GNMM" SG_ 2564431858 N_PDU 0;
BA_ "GenSigTimeoutTime_HCP" SG_ 2564431858 N_PDU 0;
BA_ "GenSigTimeoutTime_IPC" SG_ 2564431858 N_PDU 0;
BA_ "GenSigTimeoutTime_RFHM" SG_ 2564431858 N_PDU 0;
BA_ "GenSigTimeoutTime_SGW" SG_ 2564431858 N_PDU 0;
BA_ "GenSigTimeoutTime_TCM" SG_ 2564431858 N_PDU 0;
BA_ "GenSigTimeoutTime_AGSM" SG_ 2564430066 N_PDU 0;
BA_ "GenSigTimeoutTime_BCM" SG_ 2564430066 N_PDU 0;
BA_ "GenSigTimeoutTime_BSM" SG_ 2564430066 N_PDU 0;
BA_ "GenSigTimeoutTime_CADM" SG_ 2564430066 N_PDU 0;
BA_ "GenSigTimeoutTime_DMSM" SG_ 2564430066 N_PDU 0;
BA_ "GenSigTimeoutTime_DTCM" SG_ 2564430066 N_PDU 0;
BA_ "GenSigTimeoutTime_ECM" SG_ 2564430066 N_PDU 0;
BA_ "GenSigTimeoutTime_EVCU2" SG_ 2564430066 N_PDU 0;
BA_ "GenSigTimeoutTime_GNMM" SG_ 2564430066 N_PDU 0;
BA_ "GenSigTimeoutTime_HCP" SG_ 2564430066 N_PDU 0;
BA_ "GenSigTimeoutTime_IPC" SG_ 2564430066 N_PDU 0;
BA_ "GenSigTimeoutTime_RFHM" SG_ 2564430066 N_PDU 0;
BA_ "GenSigTimeoutTime_SGW" SG_ 2564430066 N_PDU 0;
BA_ "GenSigTimeoutTime_TCM" SG_ 2564430066 N_PDU 0;
BA_ "GenSigTimeoutTime_AGSM" SG_ 2564453362 N_PDU 0;
BA_ "GenSigTimeoutTime_BCM" SG_ 2564453362 N_PDU 0;
BA_ "GenSigTimeoutTime_BSM" SG_ 2564453362 N_PDU 0;
BA_ "GenSigTimeoutTime_CADM" SG_ 2564453362 N_PDU 0;
BA_ "GenSigTimeoutTime_DMSM" SG_ 2564453362 N_PDU 0;
BA_ "GenSigTimeoutTime_DTCM" SG_ 2564453362 N_PDU 0;
BA_ "GenSigTimeoutTime_ECM" SG_ 2564453362 N_PDU 0;
BA_ "GenSigTimeoutTime_EVCU2" SG_ 2564453362 N_PDU 0;
BA_ "GenSigTimeoutTime_GNMM" SG_ 2564453362 N_PDU 0;
BA_ "GenSigTimeoutTime_HCP" SG_ 2564453362 N_PDU 0;
BA_ "GenSigTimeoutTime_IPC" SG_ 2564453362 N_PDU 0;
BA_ "GenSigTimeoutTime_RFHM" SG_ 2564453362 N_PDU 0;
BA_ "GenSigTimeoutTime_SGW" SG_ 2564453362 N_PDU 0;
BA_ "GenSigTimeoutTime_TCM" SG_ 2564453362 N_PDU 0;
BA_ "GenSigTimeoutTime_AGSM" SG_ 2564427761 N_PDU 0;
BA_ "GenSigTimeoutTime_BCM" SG_ 2564427761 N_PDU 0;
BA_ "GenSigTimeoutTime_BSM" SG_ 2564427761 N_PDU 0;
BA_ "GenSigTimeoutTime_CADM" SG_ 2564427761 N_PDU 0;
BA_ "GenSigTimeoutTime_DMSM" SG_ 2564427761 N_PDU 0;
BA_ "GenSigTimeoutTime_DTCM" SG_ 2564427761 N_PDU 0;
BA_ "GenSigTimeoutTime_ECM" SG_ 2564427761 N_PDU 0;
BA_ "GenSigTimeoutTime_EVCU2" SG_ 2564427761 N_PDU 0;
BA_ "GenSigTimeoutTime_GNMM" SG_ 2564427761 N_PDU 0;
BA_ "GenSigTimeoutTime_HCP" SG_ 2564427761 N_PDU 0;
BA_ "GenSigTimeoutTime_IPC" SG_ 2564427761 N_PDU 0;
BA_ "GenSigTimeoutTime_RFHM" SG_ 2564427761 N_PDU 0;
BA_ "GenSigTimeoutTime_SGW" SG_ 2564427761 N_PDU 0;
BA_ "GenSigTimeoutTime_TCM" SG_ 2564427761 N_PDU 0;
BA_ "GenSigTimeoutTime_AGSM" SG_ 2564440309 N_PDU 0;
BA_ "GenSigTimeoutTime_BCM" SG_ 2564440309 N_PDU 0;
BA_ "GenSigTimeoutTime_BSM" SG_ 2564440309 N_PDU 0;
BA_ "GenSigTimeoutTime_CADM" SG_ 2564440309 N_PDU 0;
BA_ "GenSigTimeoutTime_DMSM" SG_ 2564440309 N_PDU 0;
BA_ "GenSigTimeoutTime_DTCM" SG_ 2564440309 N_PDU 0;
BA_ "GenSigTimeoutTime_ECM" SG_ 2564440309 N_PDU 0;
BA_ "GenSigTimeoutTime_EVCU2" SG_ 2564440309 N_PDU 0;
BA_ "GenSigTimeoutTime_GNMM" SG_ 2564440309 N_PDU 0;
BA_ "GenSigTimeoutTime_HCP" SG_ 2564440309 N_PDU 0;
BA_ "GenSigTimeoutTime_IPC" SG_ 2564440309 N_PDU 0;
BA_ "GenSigTimeoutTime_RFHM" SG_ 2564440309 N_PDU 0;
BA_ "GenSigTimeoutTime_SGW" SG_ 2564440309 N_PDU 0;
BA_ "GenSigTimeoutTime_TCM" SG_ 2564440309 N_PDU 0;
BA_ "GenSigTimeoutTime_AGSM" SG_ 2564434165 N_PDU 0;
BA_ "GenSigTimeoutTime_BCM" SG_ 2564434165 N_PDU 0;
BA_ "GenSigTimeoutTime_BSM" SG_ 2564434165 N_PDU 0;
BA_ "GenSigTimeoutTime_CADM" SG_ 2564434165 N_PDU 0;
BA_ "GenSigTimeoutTime_DMSM" SG_ 2564434165 N_PDU 0;
BA_ "GenSigTimeoutTime_DTCM" SG_ 2564434165 N_PDU 0;
BA_ "GenSigTimeoutTime_ECM" SG_ 2564434165 N_PDU 0;
BA_ "GenSigTimeoutTime_EVCU2" SG_ 2564434165 N_PDU 0;
BA_ "GenSigTimeoutTime_GNMM" SG_ 2564434165 N_PDU 0;
BA_ "GenSigTimeoutTime_HCP" SG_ 2564434165 N_PDU 0;
BA_ "GenSigTimeoutTime_IPC" SG_ 2564434165 N_PDU 0;
BA_ "GenSigTimeoutTime_RFHM" SG_ 2564434165 N_PDU 0;
BA_ "GenSigTimeoutTime_SGW" SG_ 2564434165 N_PDU 0;
BA_ "GenSigTimeoutTime_TCM" SG_ 2564434165 N_PDU 0;
BA_ "GenSigTimeoutTime_AGSM" SG_ 2564435701 N_PDU 0;
BA_ "GenSigTimeoutTime_BCM" SG_ 2564435701 N_PDU 0;
BA_ "GenSigTimeoutTime_BSM" SG_ 2564435701 N_PDU 0;
BA_ "GenSigTimeoutTime_CADM" SG_ 2564435701 N_PDU 0;
BA_ "GenSigTimeoutTime_DMSM" SG_ 2564435701 N_PDU 0;
BA_ "GenSigTimeoutTime_DTCM" SG_ 2564435701 N_PDU 0;
BA_ "GenSigTimeoutTime_ECM" SG_ 2564435701 N_PDU 0;
BA_ "GenSigTimeoutTime_EVCU2" SG_ 2564435701 N_PDU 0;
BA_ "GenSigTimeoutTime_GNMM" SG_ 2564435701 N_PDU 0;
BA_ "GenSigTimeoutTime_HCP" SG_ 2564435701 N_PDU 0;
BA_ "GenSigTimeoutTime_IPC" SG_ 2564435701 N_PDU 0;
BA_ "GenSigTimeoutTime_RFHM" SG_ 2564435701 N_PDU 0;
BA_ "GenSigTimeoutTime_SGW" SG_ 2564435701 N_PDU 0;
BA_ "GenSigTimeoutTime_TCM" SG_ 2564435701 N_PDU 0;
BA_ "GenSigTimeoutTime_AGSM" SG_ 2564428021 N_PDU 0;
BA_ "GenSigTimeoutTime_BCM" SG_ 2564428021 N_PDU 0;
BA_ "GenSigTimeoutTime_BSM" SG_ 2564428021 N_PDU 0;
BA_ "GenSigTimeoutTime_CADM" SG_ 2564428021 N_PDU 0;
BA_ "GenSigTimeoutTime_DMSM" SG_ 2564428021 N_PDU 0;
BA_ "GenSigTimeoutTime_DTCM" SG_ 2564428021 N_PDU 0;
BA_ "GenSigTimeoutTime_ECM" SG_ 2564428021 N_PDU 0;
BA_ "GenSigTimeoutTime_EVCU2" SG_ 2564428021 N_PDU 0;
BA_ "GenSigTimeoutTime_GNMM" SG_ 2564428021 N_PDU 0;
BA_ "GenSigTimeoutTime_HCP" SG_ 2564428021 N_PDU 0;
BA_ "GenSigTimeoutTime_IPC" SG_ 2564428021 N_PDU 0;
BA_ "GenSigTimeoutTime_RFHM" SG_ 2564428021 N_PDU 0;
BA_ "GenSigTimeoutTime_SGW" SG_ 2564428021 N_PDU 0;
BA_ "GenSigTimeoutTime_TCM" SG_ 2564428021 N_PDU 0;
BA_ "GenSigTimeoutTime_AGSM" SG_ 2564428025 N_PDU 0;
BA_ "GenSigTimeoutTime_BCM" SG_ 2564428025 N_PDU 0;
BA_ "GenSigTimeoutTime_BSM" SG_ 2564428025 N_PDU 0;
BA_ "GenSigTimeoutTime_CADM" SG_ 2564428025 N_PDU 0;
BA_ "GenSigTimeoutTime_DMSM" SG_ 2564428025 N_PDU 0;
BA_ "GenSigTimeoutTime_DTCM" SG_ 2564428025 N_PDU 0;
BA_ "GenSigTimeoutTime_ECM" SG_ 2564428025 N_PDU 0;
BA_ "GenSigTimeoutTime_EVCU2" SG_ 2564428025 N_PDU 0;
BA_ "GenSigTimeoutTime_GNMM" SG_ 2564428025 N_PDU 0;
BA_ "GenSigTimeoutTime_HCP" SG_ 2564428025 N_PDU 0;
BA_ "GenSigTimeoutTime_IPC" SG_ 2564428025 N_PDU 0;
BA_ "GenSigTimeoutTime_RFHM" SG_ 2564428025 N_PDU 0;
BA_ "GenSigTimeoutTime_SGW" SG_ 2564428025 N_PDU 0;
BA_ "GenSigTimeoutTime_TCM" SG_ 2564428025 N_PDU 0;
BA_ "GenSigTimeoutTime_AGSM" SG_ 2564430069 N_PDU 0;
BA_ "GenSigTimeoutTime_BCM" SG_ 2564430069 N_PDU 0;
BA_ "GenSigTimeoutTime_BSM" SG_ 2564430069 N_PDU 0;
BA_ "GenSigTimeoutTime_CADM" SG_ 2564430069 N_PDU 0;
BA_ "GenSigTimeoutTime_DMSM" SG_ 2564430069 N_PDU 0;
BA_ "GenSigTimeoutTime_DTCM" SG_ 2564430069 N_PDU 0;
BA_ "GenSigTimeoutTime_ECM" SG_ 2564430069 N_PDU 0;
BA_ "GenSigTimeoutTime_EVCU2" SG_ 2564430069 N_PDU 0;
BA_ "GenSigTimeoutTime_GNMM" SG_ 2564430069 N_PDU 0;
BA_ "GenSigTimeoutTime_HCP" SG_ 2564430069 N_PDU 0;
BA_ "GenSigTimeoutTime_IPC" SG_ 2564430069 N_PDU 0;
BA_ "GenSigTimeoutTime_RFHM" SG_ 2564430069 N_PDU 0;
BA_ "GenSigTimeoutTime_SGW" SG_ 2564430069 N_PDU 0;
BA_ "GenSigTimeoutTime_TCM" SG_ 2564430069 N_PDU 0;
BA_ "GenSigTimeoutTime_AGSM" SG_ 2564427505 N_PDU 0;
BA_ "GenSigTimeoutTime_BCM" SG_ 2564427505 N_PDU 0;
BA_ "GenSigTimeoutTime_BSM" SG_ 2564427505 N_PDU 0;
BA_ "GenSigTimeoutTime_CADM" SG_ 2564427505 N_PDU 0;
BA_ "GenSigTimeoutTime_DMSM" SG_ 2564427505 N_PDU 0;
BA_ "GenSigTimeoutTime_DTCM" SG_ 2564427505 N_PDU 0;
BA_ "GenSigTimeoutTime_ECM" SG_ 2564427505 N_PDU 0;
BA_ "GenSigTimeoutTime_EVCU2" SG_ 2564427505 N_PDU 0;
BA_ "GenSigTimeoutTime_GNMM" SG_ 2564427505 N_PDU 0;
BA_ "GenSigTimeoutTime_HCP" SG_ 2564427505 N_PDU 0;
BA_ "GenSigTimeoutTime_IPC" SG_ 2564427505 N_PDU 0;
BA_ "GenSigTimeoutTime_RFHM" SG_ 2564427505 N_PDU 0;
BA_ "GenSigTimeoutTime_SGW" SG_ 2564427505 N_PDU 0;
BA_ "GenSigTimeoutTime_TCM" SG_ 2564427505 N_PDU 0;
BA_ "GenSigTimeoutTime_AGSM" SG_ 2564554485 N_PDU 0;
BA_ "GenSigTimeoutTime_BCM" SG_ 2564554485 N_PDU 0;
BA_ "GenSigTimeoutTime_BSM" SG_ 2564554485 N_PDU 0;
BA_ "GenSigTimeoutTime_CADM" SG_ 2564554485 N_PDU 0;
BA_ "GenSigTimeoutTime_DMSM" SG_ 2564554485 N_PDU 0;
BA_ "GenSigTimeoutTime_DTCM" SG_ 2564554485 N_PDU 0;
BA_ "GenSigTimeoutTime_ECM" SG_ 2564554485 N_PDU 0;
BA_ "GenSigTimeoutTime_EVCU2" SG_ 2564554485 N_PDU 0;
BA_ "GenSigTimeoutTime_GNMM" SG_ 2564554485 N_PDU 0;
BA_ "GenSigTimeoutTime_HCP" SG_ 2564554485 N_PDU 0;
BA_ "GenSigTimeoutTime_IPC" SG_ 2564554485 N_PDU 0;
BA_ "GenSigTimeoutTime_RFHM" SG_ 2564554485 N_PDU 0;
BA_ "GenSigTimeoutTime_SGW" SG_ 2564554485 N_PDU 0;
BA_ "GenSigTimeoutTime_TCM" SG_ 2564554485 N_PDU 0;
BA_ "GenSigTimeoutTime_AGSM" SG_ 2564554489 N_PDU 0;
BA_ "GenSigTimeoutTime_BCM" SG_ 2564554489 N_PDU 0;
BA_ "GenSigTimeoutTime_BSM" SG_ 2564554489 N_PDU 0;
BA_ "GenSigTimeoutTime_CADM" SG_ 2564554489 N_PDU 0;
BA_ "GenSigTimeoutTime_DMSM" SG_ 2564554489 N_PDU 0;
BA_ "GenSigTimeoutTime_DTCM" SG_ 2564554489 N_PDU 0;
BA_ "GenSigTimeoutTime_ECM" SG_ 2564554489 N_PDU 0;
BA_ "GenSigTimeoutTime_EVCU2" SG_ 2564554489 N_PDU 0;
BA_ "GenSigTimeoutTime_GNMM" SG_ 2564554489 N_PDU 0;
BA_ "GenSigTimeoutTime_HCP" SG_ 2564554489 N_PDU 0;
BA_ "GenSigTimeoutTime_IPC" SG_ 2564554489 N_PDU 0;
BA_ "GenSigTimeoutTime_RFHM" SG_ 2564554489 N_PDU 0;
BA_ "GenSigTimeoutTime_SGW" SG_ 2564554489 N_PDU 0;
BA_ "GenSigTimeoutTime_TCM" SG_ 2564554489 N_PDU 0;
BA_ "GenSigTimeoutTime_AGSM" SG_ 2564502513 N_PDU 0;
BA_ "GenSigTimeoutTime_BCM" SG_ 2564502513 N_PDU 0;
BA_ "GenSigTimeoutTime_BSM" SG_ 2564502513 N_PDU 0;
BA_ "GenSigTimeoutTime_CADM" SG_ 2564502513 N_PDU 0;
BA_ "GenSigTimeoutTime_DMSM" SG_ 2564502513 N_PDU 0;
BA_ "GenSigTimeoutTime_DTCM" SG_ 2564502513 N_PDU 0;
BA_ "GenSigTimeoutTime_ECM" SG_ 2564502513 N_PDU 0;
BA_ "GenSigTimeoutTime_EVCU2" SG_ 2564502513 N_PDU 0;
BA_ "GenSigTimeoutTime_GNMM" SG_ 2564502513 N_PDU 0;
BA_ "GenSigTimeoutTime_HCP" SG_ 2564502513 N_PDU 0;
BA_ "GenSigTimeoutTime_IPC" SG_ 2564502513 N_PDU 0;
BA_ "GenSigTimeoutTime_RFHM" SG_ 2564502513 N_PDU 0;
BA_ "GenSigTimeoutTime_SGW" SG_ 2564502513 N_PDU 0;
BA_ "GenSigTimeoutTime_TCM" SG_ 2564502513 N_PDU 0;
BA_ "GenSigTimeoutTime_AGSM" SG_ 2564554481 N_PDU 0;
BA_ "GenSigTimeoutTime_BCM" SG_ 2564554481 N_PDU 0;
BA_ "GenSigTimeoutTime_BSM" SG_ 2564554481 N_PDU 0;
BA_ "GenSigTimeoutTime_CADM" SG_ 2564554481 N_PDU 0;
BA_ "GenSigTimeoutTime_DMSM" SG_ 2564554481 N_PDU 0;
BA_ "GenSigTimeoutTime_DTCM" SG_ 2564554481 N_PDU 0;
BA_ "GenSigTimeoutTime_ECM" SG_ 2564554481 N_PDU 0;
BA_ "GenSigTimeoutTime_EVCU2" SG_ 2564554481 N_PDU 0;
BA_ "GenSigTimeoutTime_GNMM" SG_ 2564554481 N_PDU 0;
BA_ "GenSigTimeoutTime_HCP" SG_ 2564554481 N_PDU 0;
BA_ "GenSigTimeoutTime_IPC" SG_ 2564554481 N_PDU 0;
BA_ "GenSigTimeoutTime_RFHM" SG_ 2564554481 N_PDU 0;
BA_ "GenSigTimeoutTime_SGW" SG_ 2564554481 N_PDU 0;
BA_ "GenSigTimeoutTime_TCM" SG_ 2564554481 N_PDU 0;
BA_ "GenSigTimeoutTime_AGSM" SG_ 2564437233 N_PDU 0;
BA_ "GenSigTimeoutTime_BCM" SG_ 2564437233 N_PDU 0;
BA_ "GenSigTimeoutTime_BSM" SG_ 2564437233 N_PDU 0;
BA_ "GenSigTimeoutTime_CADM" SG_ 2564437233 N_PDU 0;
BA_ "GenSigTimeoutTime_DMSM" SG_ 2564437233 N_PDU 0;
BA_ "GenSigTimeoutTime_DTCM" SG_ 2564437233 N_PDU 0;
BA_ "GenSigTimeoutTime_ECM" SG_ 2564437233 N_PDU 0;
BA_ "GenSigTimeoutTime_EVCU2" SG_ 2564437233 N_PDU 0;
BA_ "GenSigTimeoutTime_GNMM" SG_ 2564437233 N_PDU 0;
BA_ "GenSigTimeoutTime_HCP" SG_ 2564437233 N_PDU 0;
BA_ "GenSigTimeoutTime_IPC" SG_ 2564437233 N_PDU 0;
BA_ "GenSigTimeoutTime_RFHM" SG_ 2564437233 N_PDU 0;
BA_ "GenSigTimeoutTime_SGW" SG_ 2564437233 N_PDU 0;
BA_ "GenSigTimeoutTime_TCM" SG_ 2564437233 N_PDU 0;
BA_ "GenSigTimeoutTime_AGSM" SG_ 2564448497 N_PDU 0;
BA_ "GenSigTimeoutTime_BCM" SG_ 2564448497 N_PDU 0;
BA_ "GenSigTimeoutTime_BSM" SG_ 2564448497 N_PDU 0;
BA_ "GenSigTimeoutTime_CADM" SG_ 2564448497 N_PDU 0;
BA_ "GenSigTimeoutTime_DMSM" SG_ 2564448497 N_PDU 0;
BA_ "GenSigTimeoutTime_DTCM" SG_ 2564448497 N_PDU 0;
BA_ "GenSigTimeoutTime_ECM" SG_ 2564448497 N_PDU 0;
BA_ "GenSigTimeoutTime_EVCU2" SG_ 2564448497 N_PDU 0;
BA_ "GenSigTimeoutTime_GNMM" SG_ 2564448497 N_PDU 0;
BA_ "GenSigTimeoutTime_HCP" SG_ 2564448497 N_PDU 0;
BA_ "GenSigTimeoutTime_IPC" SG_ 2564448497 N_PDU 0;
BA_ "GenSigTimeoutTime_RFHM" SG_ 2564448497 N_PDU 0;
BA_ "GenSigTimeoutTime_SGW" SG_ 2564448497 N_PDU 0;
BA_ "GenSigTimeoutTime_TCM" SG_ 2564448497 N_PDU 0;
BA_ "GenSigTimeoutTime_AGSM" SG_ 2564480497 N_PDU 0;
BA_ "GenSigTimeoutTime_BCM" SG_ 2564480497 N_PDU 0;
BA_ "GenSigTimeoutTime_BSM" SG_ 2564480497 N_PDU 0;
BA_ "GenSigTimeoutTime_CADM" SG_ 2564480497 N_PDU 0;
BA_ "GenSigTimeoutTime_DMSM" SG_ 2564480497 N_PDU 0;
BA_ "GenSigTimeoutTime_DTCM" SG_ 2564480497 N_PDU 0;
BA_ "GenSigTimeoutTime_ECM" SG_ 2564480497 N_PDU 0;
BA_ "GenSigTimeoutTime_EVCU2" SG_ 2564480497 N_PDU 0;
BA_ "GenSigTimeoutTime_GNMM" SG_ 2564480497 N_PDU 0;
BA_ "GenSigTimeoutTime_HCP" SG_ 2564480497 N_PDU 0;
BA_ "GenSigTimeoutTime_IPC" SG_ 2564480497 N_PDU 0;
BA_ "GenSigTimeoutTime_RFHM" SG_ 2564480497 N_PDU 0;
BA_ "GenSigTimeoutTime_SGW" SG_ 2564480497 N_PDU 0;
BA_ "GenSigTimeoutTime_TCM" SG_ 2564480497 N_PDU 0;
BA_ "GenSigTimeoutTime_AGSM" SG_ 2564429041 N_PDU 0;
BA_ "GenSigTimeoutTime_BCM" SG_ 2564429041 N_PDU 0;
BA_ "GenSigTimeoutTime_BSM" SG_ 2564429041 N_PDU 0;
BA_ "GenSigTimeoutTime_CADM" SG_ 2564429041 N_PDU 0;
BA_ "GenSigTimeoutTime_DMSM" SG_ 2564429041 N_PDU 0;
BA_ "GenSigTimeoutTime_DTCM" SG_ 2564429041 N_PDU 0;
BA_ "GenSigTimeoutTime_ECM" SG_ 2564429041 N_PDU 0;
BA_ "GenSigTimeoutTime_EVCU2" SG_ 2564429041 N_PDU 0;
BA_ "GenSigTimeoutTime_GNMM" SG_ 2564429041 N_PDU 0;
BA_ "GenSigTimeoutTime_HCP" SG_ 2564429041 N_PDU 0;
BA_ "GenSigTimeoutTime_IPC" SG_ 2564429041 N_PDU 0;
BA_ "GenSigTimeoutTime_RFHM" SG_ 2564429041 N_PDU 0;
BA_ "GenSigTimeoutTime_SGW" SG_ 2564429041 N_PDU 0;
BA_ "GenSigTimeoutTime_TCM" SG_ 2564429041 N_PDU 0;
BA_ "GenSigTimeoutTime_AGSM" SG_ 2564429297 N_PDU 0;
BA_ "GenSigTimeoutTime_BCM" SG_ 2564429297 N_PDU 0;
BA_ "GenSigTimeoutTime_BSM" SG_ 2564429297 N_PDU 0;
BA_ "GenSigTimeoutTime_CADM" SG_ 2564429297 N_PDU 0;
BA_ "GenSigTimeoutTime_DMSM" SG_ 2564429297 N_PDU 0;
BA_ "GenSigTimeoutTime_DTCM" SG_ 2564429297 N_PDU 0;
BA_ "GenSigTimeoutTime_ECM" SG_ 2564429297 N_PDU 0;
BA_ "GenSigTimeoutTime_EVCU2" SG_ 2564429297 N_PDU 0;
BA_ "GenSigTimeoutTime_GNMM" SG_ 2564429297 N_PDU 0;
BA_ "GenSigTimeoutTime_HCP" SG_ 2564429297 N_PDU 0;
BA_ "GenSigTimeoutTime_IPC" SG_ 2564429297 N_PDU 0;
BA_ "GenSigTimeoutTime_RFHM" SG_ 2564429297 N_PDU 0;
BA_ "GenSigTimeoutTime_SGW" SG_ 2564429297 N_PDU 0;
BA_ "GenSigTimeoutTime_TCM" SG_ 2564429297 N_PDU 0;
BA_ "GenSigTimeoutTime_AGSM" SG_ 2564474865 N_PDU 0;
BA_ "GenSigTimeoutTime_BCM" SG_ 2564474865 N_PDU 0;
BA_ "GenSigTimeoutTime_BSM" SG_ 2564474865 N_PDU 0;
BA_ "GenSigTimeoutTime_CADM" SG_ 2564474865 N_PDU 0;
BA_ "GenSigTimeoutTime_DMSM" SG_ 2564474865 N_PDU 0;
BA_ "GenSigTimeoutTime_DTCM" SG_ 2564474865 N_PDU 0;
BA_ "GenSigTimeoutTime_ECM" SG_ 2564474865 N_PDU 0;
BA_ "GenSigTimeoutTime_EVCU2" SG_ 2564474865 N_PDU 0;
BA_ "GenSigTimeoutTime_GNMM" SG_ 2564474865 N_PDU 0;
BA_ "GenSigTimeoutTime_HCP" SG_ 2564474865 N_PDU 0;
BA_ "GenSigTimeoutTime_IPC" SG_ 2564474865 N_PDU 0;
BA_ "GenSigTimeoutTime_RFHM" SG_ 2564474865 N_PDU 0;
BA_ "GenSigTimeoutTime_SGW" SG_ 2564474865 N_PDU 0;
BA_ "GenSigTimeoutTime_TCM" SG_ 2564474865 N_PDU 0;
BA_ "GenSigTimeoutTime_AGSM" SG_ 2564455665 N_PDU 0;
BA_ "GenSigTimeoutTime_BCM" SG_ 2564455665 N_PDU 0;
BA_ "GenSigTimeoutTime_BSM" SG_ 2564455665 N_PDU 0;
BA_ "GenSigTimeoutTime_CADM" SG_ 2564455665 N_PDU 0;
BA_ "GenSigTimeoutTime_DMSM" SG_ 2564455665 N_PDU 0;
BA_ "GenSigTimeoutTime_DTCM" SG_ 2564455665 N_PDU 0;
BA_ "GenSigTimeoutTime_ECM" SG_ 2564455665 N_PDU 0;
BA_ "GenSigTimeoutTime_EVCU2" SG_ 2564455665 N_PDU 0;
BA_ "GenSigTimeoutTime_GNMM" SG_ 2564455665 N_PDU 0;
BA_ "GenSigTimeoutTime_HCP" SG_ 2564455665 N_PDU 0;
BA_ "GenSigTimeoutTime_IPC" SG_ 2564455665 N_PDU 0;
BA_ "GenSigTimeoutTime_RFHM" SG_ 2564455665 N_PDU 0;
BA_ "GenSigTimeoutTime_SGW" SG_ 2564455665 N_PDU 0;
BA_ "GenSigTimeoutTime_TCM" SG_ 2564455665 N_PDU 0;
BA_ "GenSigTimeoutTime_AGSM" SG_ 2564431857 N_PDU 0;
BA_ "GenSigTimeoutTime_BCM" SG_ 2564431857 N_PDU 0;
BA_ "GenSigTimeoutTime_BSM" SG_ 2564431857 N_PDU 0;
BA_ "GenSigTimeoutTime_CADM" SG_ 2564431857 N_PDU 0;
BA_ "GenSigTimeoutTime_DMSM" SG_ 2564431857 N_PDU 0;
BA_ "GenSigTimeoutTime_DTCM" SG_ 2564431857 N_PDU 0;
BA_ "GenSigTimeoutTime_ECM" SG_ 2564431857 N_PDU 0;
BA_ "GenSigTimeoutTime_EVCU2" SG_ 2564431857 N_PDU 0;
BA_ "GenSigTimeoutTime_GNMM" SG_ 2564431857 N_PDU 0;
BA_ "GenSigTimeoutTime_HCP" SG_ 2564431857 N_PDU 0;
BA_ "GenSigTimeoutTime_IPC" SG_ 2564431857 N_PDU 0;
BA_ "GenSigTimeoutTime_RFHM" SG_ 2564431857 N_PDU 0;
BA_ "GenSigTimeoutTime_SGW" SG_ 2564431857 N_PDU 0;
BA_ "GenSigTimeoutTime_TCM" SG_ 2564431857 N_PDU 0;
BA_ "GenSigTimeoutTime_AGSM" SG_ 2564430065 N_PDU 0;
BA_ "GenSigTimeoutTime_BCM" SG_ 2564430065 N_PDU 0;
BA_ "GenSigTimeoutTime_BSM" SG_ 2564430065 N_PDU 0;
BA_ "GenSigTimeoutTime_CADM" SG_ 2564430065 N_PDU 0;
BA_ "GenSigTimeoutTime_DMSM" SG_ 2564430065 N_PDU 0;
BA_ "GenSigTimeoutTime_DTCM" SG_ 2564430065 N_PDU 0;
BA_ "GenSigTimeoutTime_ECM" SG_ 2564430065 N_PDU 0;
BA_ "GenSigTimeoutTime_EVCU2" SG_ 2564430065 N_PDU 0;
BA_ "GenSigTimeoutTime_GNMM" SG_ 2564430065 N_PDU 0;
BA_ "GenSigTimeoutTime_HCP" SG_ 2564430065 N_PDU 0;
BA_ "GenSigTimeoutTime_IPC" SG_ 2564430065 N_PDU 0;
BA_ "GenSigTimeoutTime_RFHM" SG_ 2564430065 N_PDU 0;
BA_ "GenSigTimeoutTime_SGW" SG_ 2564430065 N_PDU 0;
BA_ "GenSigTimeoutTime_TCM" SG_ 2564430065 N_PDU 0;
BA_ "GenSigTimeoutTime_AGSM" SG_ 2564453361 N_PDU 0;
BA_ "GenSigTimeoutTime_BCM" SG_ 2564453361 N_PDU 0;
BA_ "GenSigTimeoutTime_BSM" SG_ 2564453361 N_PDU 0;
BA_ "GenSigTimeoutTime_CADM" SG_ 2564453361 N_PDU 0;
BA_ "GenSigTimeoutTime_DMSM" SG_ 2564453361 N_PDU 0;
BA_ "GenSigTimeoutTime_DTCM" SG_ 2564453361 N_PDU 0;
BA_ "GenSigTimeoutTime_ECM" SG_ 2564453361 N_PDU 0;
BA_ "GenSigTimeoutTime_EVCU2" SG_ 2564453361 N_PDU 0;
BA_ "GenSigTimeoutTime_GNMM" SG_ 2564453361 N_PDU 0;
BA_ "GenSigTimeoutTime_HCP" SG_ 2564453361 N_PDU 0;
BA_ "GenSigTimeoutTime_IPC" SG_ 2564453361 N_PDU 0;
BA_ "GenSigTimeoutTime_RFHM" SG_ 2564453361 N_PDU 0;
BA_ "GenSigTimeoutTime_SGW" SG_ 2564453361 N_PDU 0;
BA_ "GenSigTimeoutTime_TCM" SG_ 2564453361 N_PDU 0;
BA_ "GenSigTimeoutTime_AGSM" SG_ 2564485440 N_PDU 0;
BA_ "GenSigTimeoutTime_BCM" SG_ 2564485440 N_PDU 0;
BA_ "GenSigTimeoutTime_BSM" SG_ 2564485440 N_PDU 0;
BA_ "GenSigTimeoutTime_CADM" SG_ 2564485440 N_PDU 0;
BA_ "GenSigTimeoutTime_DMSM" SG_ 2564485440 N_PDU 0;
BA_ "GenSigTimeoutTime_DTCM" SG_ 2564485440 N_PDU 0;
BA_ "GenSigTimeoutTime_ECM" SG_ 2564485440 N_PDU 0;
BA_ "GenSigTimeoutTime_EVCU2" SG_ 2564485440 N_PDU 0;
BA_ "GenSigTimeoutTime_GNMM" SG_ 2564485440 N_PDU 0;
BA_ "GenSigTimeoutTime_HCP" SG_ 2564485440 N_PDU 0;
BA_ "GenSigTimeoutTime_IPC" SG_ 2564485440 N_PDU 0;
BA_ "GenSigTimeoutTime_RFHM" SG_ 2564485440 N_PDU 0;
BA_ "GenSigTimeoutTime_SGW" SG_ 2564485440 N_PDU 0;
BA_ "GenSigTimeoutTime_TCM" SG_ 2564485440 N_PDU 0;
BA_ "GenSigTimeoutTime_AGSM" SG_ 2564485416 N_PDU 0;
BA_ "GenSigTimeoutTime_BCM" SG_ 2564485416 N_PDU 0;
BA_ "GenSigTimeoutTime_BSM" SG_ 2564485416 N_PDU 0;
BA_ "GenSigTimeoutTime_CADM" SG_ 2564485416 N_PDU 0;
BA_ "GenSigTimeoutTime_DMSM" SG_ 2564485416 N_PDU 0;
BA_ "GenSigTimeoutTime_DTCM" SG_ 2564485416 N_PDU 0;
BA_ "GenSigTimeoutTime_ECM" SG_ 2564485416 N_PDU 0;
BA_ "GenSigTimeoutTime_EVCU2" SG_ 2564485416 N_PDU 0;
BA_ "GenSigTimeoutTime_GNMM" SG_ 2564485416 N_PDU 0;
BA_ "GenSigTimeoutTime_HCP" SG_ 2564485416 N_PDU 0;
BA_ "GenSigTimeoutTime_IPC" SG_ 2564485416 N_PDU 0;
BA_ "GenSigTimeoutTime_RFHM" SG_ 2564485416 N_PDU 0;
BA_ "GenSigTimeoutTime_SGW" SG_ 2564485416 N_PDU 0;
BA_ "GenSigTimeoutTime_TCM" SG_ 2564485416 N_PDU 0;
BA_ "GenSigTimeoutTime_AGSM" SG_ 2564485422 N_PDU 0;
BA_ "GenSigTimeoutTime_BCM" SG_ 2564485422 N_PDU 0;
BA_ "GenSigTimeoutTime_BSM" SG_ 2564485422 N_PDU 0;
BA_ "GenSigTimeoutTime_CADM" SG_ 2564485422 N_PDU 0;
BA_ "GenSigTimeoutTime_DMSM" SG_ 2564485422 N_PDU 0;
BA_ "GenSigTimeoutTime_DTCM" SG_ 2564485422 N_PDU 0;
BA_ "GenSigTimeoutTime_ECM" SG_ 2564485422 N_PDU 0;
BA_ "GenSigTimeoutTime_EVCU2" SG_ 2564485422 N_PDU 0;
BA_ "GenSigTimeoutTime_GNMM" SG_ 2564485422 N_PDU 0;
BA_ "GenSigTimeoutTime_HCP" SG_ 2564485422 N_PDU 0;
BA_ "GenSigTimeoutTime_IPC" SG_ 2564485422 N_PDU 0;
BA_ "GenSigTimeoutTime_RFHM" SG_ 2564485422 N_PDU 0;
BA_ "GenSigTimeoutTime_SGW" SG_ 2564485422 N_PDU 0;
BA_ "GenSigTimeoutTime_TCM" SG_ 2564485422 N_PDU 0;
BA_ "GenSigTimeoutTime_AGSM" SG_ 2564485527 N_PDU 0;
BA_ "GenSigTimeoutTime_BCM" SG_ 2564485527 N_PDU 0;
BA_ "GenSigTimeoutTime_BSM" SG_ 2564485527 N_PDU 0;
BA_ "GenSigTimeoutTime_CADM" SG_ 2564485527 N_PDU 0;
BA_ "GenSigTimeoutTime_DMSM" SG_ 2564485527 N_PDU 0;
BA_ "GenSigTimeoutTime_DTCM" SG_ 2564485527 N_PDU 0;
BA_ "GenSigTimeoutTime_ECM" SG_ 2564485527 N_PDU 0;
BA_ "GenSigTimeoutTime_EVCU2" SG_ 2564485527 N_PDU 0;
BA_ "GenSigTimeoutTime_GNMM" SG_ 2564485527 N_PDU 0;
BA_ "GenSigTimeoutTime_HCP" SG_ 2564485527 N_PDU 0;
BA_ "GenSigTimeoutTime_IPC" SG_ 2564485527 N_PDU 0;
BA_ "GenSigTimeoutTime_RFHM" SG_ 2564485527 N_PDU 0;
BA_ "GenSigTimeoutTime_SGW" SG_ 2564485527 N_PDU 0;
BA_ "GenSigTimeoutTime_TCM" SG_ 2564485527 N_PDU 0;
BA_ "GenSigTimeoutTime_AGSM" SG_ 2564485402 N_PDU 0;
BA_ "GenSigTimeoutTime_BCM" SG_ 2564485402 N_PDU 0;
BA_ "GenSigTimeoutTime_BSM" SG_ 2564485402 N_PDU 0;
BA_ "GenSigTimeoutTime_CADM" SG_ 2564485402 N_PDU 0;
BA_ "GenSigTimeoutTime_DMSM" SG_ 2564485402 N_PDU 0;
BA_ "GenSigTimeoutTime_DTCM" SG_ 2564485402 N_PDU 0;
BA_ "GenSigTimeoutTime_ECM" SG_ 2564485402 N_PDU 0;
BA_ "GenSigTimeoutTime_EVCU2" SG_ 2564485402 N_PDU 0;
BA_ "GenSigTimeoutTime_GNMM" SG_ 2564485402 N_PDU 0;
BA_ "GenSigTimeoutTime_HCP" SG_ 2564485402 N_PDU 0;
BA_ "GenSigTimeoutTime_IPC" SG_ 2564485402 N_PDU 0;
BA_ "GenSigTimeoutTime_RFHM" SG_ 2564485402 N_PDU 0;
BA_ "GenSigTimeoutTime_SGW" SG_ 2564485402 N_PDU 0;
BA_ "GenSigTimeoutTime_TCM" SG_ 2564485402 N_PDU 0;
BA_ "GenSigTimeoutTime_AGSM" SG_ 2564485392 N_PDU 0;
BA_ "GenSigTimeoutTime_BCM" SG_ 2564485392 N_PDU 0;
BA_ "GenSigTimeoutTime_BSM" SG_ 2564485392 N_PDU 0;
BA_ "GenSigTimeoutTime_CADM" SG_ 2564485392 N_PDU 0;
BA_ "GenSigTimeoutTime_DMSM" SG_ 2564485392 N_PDU 0;
BA_ "GenSigTimeoutTime_DTCM" SG_ 2564485392 N_PDU 0;
BA_ "GenSigTimeoutTime_ECM" SG_ 2564485392 N_PDU 0;
BA_ "GenSigTimeoutTime_EVCU2" SG_ 2564485392 N_PDU 0;
BA_ "GenSigTimeoutTime_GNMM" SG_ 2564485392 N_PDU 0;
BA_ "GenSigTimeoutTime_HCP" SG_ 2564485392 N_PDU 0;
BA_ "GenSigTimeoutTime_IPC" SG_ 2564485392 N_PDU 0;
BA_ "GenSigTimeoutTime_RFHM" SG_ 2564485392 N_PDU 0;
BA_ "GenSigTimeoutTime_SGW" SG_ 2564485392 N_PDU 0;
BA_ "GenSigTimeoutTime_TCM" SG_ 2564485392 N_PDU 0;
BA_ "GenSigTimeoutTime_AGSM" SG_ 2564485442 N_PDU 0;
BA_ "GenSigTimeoutTime_BCM" SG_ 2564485442 N_PDU 0;
BA_ "GenSigTimeoutTime_BSM" SG_ 2564485442 N_PDU 0;
BA_ "GenSigTimeoutTime_CADM" SG_ 2564485442 N_PDU 0;
BA_ "GenSigTimeoutTime_DMSM" SG_ 2564485442 N_PDU 0;
BA_ "GenSigTimeoutTime_DTCM" SG_ 2564485442 N_PDU 0;
BA_ "GenSigTimeoutTime_ECM" SG_ 2564485442 N_PDU 0;
BA_ "GenSigTimeoutTime_EVCU2" SG_ 2564485442 N_PDU 0;
BA_ "GenSigTimeoutTime_GNMM" SG_ 2564485442 N_PDU 0;
BA_ "GenSigTimeoutTime_HCP" SG_ 2564485442 N_PDU 0;
BA_ "GenSigTimeoutTime_IPC" SG_ 2564485442 N_PDU 0;
BA_ "GenSigTimeoutTime_RFHM" SG_ 2564485442 N_PDU 0;
BA_ "GenSigTimeoutTime_SGW" SG_ 2564485442 N_PDU 0;
BA_ "GenSigTimeoutTime_TCM" SG_ 2564485442 N_PDU 0;
BA_ "GenSigTimeoutTime_AGSM" SG_ 2564485696 N_PDU 0;
BA_ "GenSigTimeoutTime_BCM" SG_ 2564485696 N_PDU 0;
BA_ "GenSigTimeoutTime_BSM" SG_ 2564485696 N_PDU 0;
BA_ "GenSigTimeoutTime_CADM" SG_ 2564485696 N_PDU 0;
BA_ "GenSigTimeoutTime_DMSM" SG_ 2564485696 N_PDU 0;
BA_ "GenSigTimeoutTime_DTCM" SG_ 2564485696 N_PDU 0;
BA_ "GenSigTimeoutTime_ECM" SG_ 2564485696 N_PDU 0;
BA_ "GenSigTimeoutTime_EVCU2" SG_ 2564485696 N_PDU 0;
BA_ "GenSigTimeoutTime_GNMM" SG_ 2564485696 N_PDU 0;
BA_ "GenSigTimeoutTime_HCP" SG_ 2564485696 N_PDU 0;
BA_ "GenSigTimeoutTime_IPC" SG_ 2564485696 N_PDU 0;
BA_ "GenSigTimeoutTime_RFHM" SG_ 2564485696 N_PDU 0;
BA_ "GenSigTimeoutTime_SGW" SG_ 2564485696 N_PDU 0;
BA_ "GenSigTimeoutTime_TCM" SG_ 2564485696 N_PDU 0;
BA_ "GenSigTimeoutTime_AGSM" SG_ 2564485672 N_PDU 0;
BA_ "GenSigTimeoutTime_BCM" SG_ 2564485672 N_PDU 0;
BA_ "GenSigTimeoutTime_BSM" SG_ 2564485672 N_PDU 0;
BA_ "GenSigTimeoutTime_CADM" SG_ 2564485672 N_PDU 0;
BA_ "GenSigTimeoutTime_DMSM" SG_ 2564485672 N_PDU 0;
BA_ "GenSigTimeoutTime_DTCM" SG_ 2564485672 N_PDU 0;
BA_ "GenSigTimeoutTime_ECM" SG_ 2564485672 N_PDU 0;
BA_ "GenSigTimeoutTime_EVCU2" SG_ 2564485672 N_PDU 0;
BA_ "GenSigTimeoutTime_GNMM" SG_ 2564485672 N_PDU 0;
BA_ "GenSigTimeoutTime_HCP" SG_ 2564485672 N_PDU 0;
BA_ "GenSigTimeoutTime_IPC" SG_ 2564485672 N_PDU 0;
BA_ "GenSigTimeoutTime_RFHM" SG_ 2564485672 N_PDU 0;
BA_ "GenSigTimeoutTime_SGW" SG_ 2564485672 N_PDU 0;
BA_ "GenSigTimeoutTime_TCM" SG_ 2564485672 N_PDU 0;
BA_ "GenSigTimeoutTime_AGSM" SG_ 2564485678 N_PDU 0;
BA_ "GenSigTimeoutTime_BCM" SG_ 2564485678 N_PDU 0;
BA_ "GenSigTimeoutTime_BSM" SG_ 2564485678 N_PDU 0;
BA_ "GenSigTimeoutTime_CADM" SG_ 2564485678 N_PDU 0;
BA_ "GenSigTimeoutTime_DMSM" SG_ 2564485678 N_PDU 0;
BA_ "GenSigTimeoutTime_DTCM" SG_ 2564485678 N_PDU 0;
BA_ "GenSigTimeoutTime_ECM" SG_ 2564485678 N_PDU 0;
BA_ "GenSigTimeoutTime_EVCU2" SG_ 2564485678 N_PDU 0;
BA_ "GenSigTimeoutTime_GNMM" SG_ 2564485678 N_PDU 0;
BA_ "GenSigTimeoutTime_HCP" SG_ 2564485678 N_PDU 0;
BA_ "GenSigTimeoutTime_IPC" SG_ 2564485678 N_PDU 0;
BA_ "GenSigTimeoutTime_RFHM" SG_ 2564485678 N_PDU 0;
BA_ "GenSigTimeoutTime_SGW" SG_ 2564485678 N_PDU 0;
BA_ "GenSigTimeoutTime_TCM" SG_ 2564485678 N_PDU 0;
BA_ "GenSigTimeoutTime_AGSM" SG_ 2564485783 N_PDU 0;
BA_ "GenSigTimeoutTime_BCM" SG_ 2564485783 N_PDU 0;
BA_ "GenSigTimeoutTime_BSM" SG_ 2564485783 N_PDU 0;
BA_ "GenSigTimeoutTime_CADM" SG_ 2564485783 N_PDU 0;
BA_ "GenSigTimeoutTime_DMSM" SG_ 2564485783 N_PDU 0;
BA_ "GenSigTimeoutTime_DTCM" SG_ 2564485783 N_PDU 0;
BA_ "GenSigTimeoutTime_ECM" SG_ 2564485783 N_PDU 0;
BA_ "GenSigTimeoutTime_EVCU2" SG_ 2564485783 N_PDU 0;
BA_ "GenSigTimeoutTime_GNMM" SG_ 2564485783 N_PDU 0;
BA_ "GenSigTimeoutTime_HCP" SG_ 2564485783 N_PDU 0;
BA_ "GenSigTimeoutTime_IPC" SG_ 2564485783 N_PDU 0;
BA_ "GenSigTimeoutTime_RFHM" SG_ 2564485783 N_PDU 0;
BA_ "GenSigTimeoutTime_SGW" SG_ 2564485783 N_PDU 0;
BA_ "GenSigTimeoutTime_TCM" SG_ 2564485783 N_PDU 0;
BA_ "GenSigTimeoutTime_AGSM" SG_ 2564485658 N_PDU 0;
BA_ "GenSigTimeoutTime_BCM" SG_ 2564485658 N_PDU 0;
BA_ "GenSigTimeoutTime_BSM" SG_ 2564485658 N_PDU 0;
BA_ "GenSigTimeoutTime_CADM" SG_ 2564485658 N_PDU 0;
BA_ "GenSigTimeoutTime_DMSM" SG_ 2564485658 N_PDU 0;
BA_ "GenSigTimeoutTime_DTCM" SG_ 2564485658 N_PDU 0;
BA_ "GenSigTimeoutTime_ECM" SG_ 2564485658 N_PDU 0;
BA_ "GenSigTimeoutTime_EVCU2" SG_ 2564485658 N_PDU 0;
BA_ "GenSigTimeoutTime_GNMM" SG_ 2564485658 N_PDU 0;
BA_ "GenSigTimeoutTime_HCP" SG_ 2564485658 N_PDU 0;
BA_ "GenSigTimeoutTime_IPC" SG_ 2564485658 N_PDU 0;
BA_ "GenSigTimeoutTime_RFHM" SG_ 2564485658 N_PDU 0;
BA_ "GenSigTimeoutTime_SGW" SG_ 2564485658 N_PDU 0;
BA_ "GenSigTimeoutTime_TCM" SG_ 2564485658 N_PDU 0;
BA_ "GenSigTimeoutTime_AGSM" SG_ 2564485648 N_PDU 0;
BA_ "GenSigTimeoutTime_BCM" SG_ 2564485648 N_PDU 0;
BA_ "GenSigTimeoutTime_BSM" SG_ 2564485648 N_PDU 0;
BA_ "GenSigTimeoutTime_CADM" SG_ 2564485648 N_PDU 0;
BA_ "GenSigTimeoutTime_DMSM" SG_ 2564485648 N_PDU 0;
BA_ "GenSigTimeoutTime_DTCM" SG_ 2564485648 N_PDU 0;
BA_ "GenSigTimeoutTime_ECM" SG_ 2564485648 N_PDU 0;
BA_ "GenSigTimeoutTime_EVCU2" SG_ 2564485648 N_PDU 0;
BA_ "GenSigTimeoutTime_GNMM" SG_ 2564485648 N_PDU 0;
BA_ "GenSigTimeoutTime_HCP" SG_ 2564485648 N_PDU 0;
BA_ "GenSigTimeoutTime_IPC" SG_ 2564485648 N_PDU 0;
BA_ "GenSigTimeoutTime_RFHM" SG_ 2564485648 N_PDU 0;
BA_ "GenSigTimeoutTime_SGW" SG_ 2564485648 N_PDU 0;
BA_ "GenSigTimeoutTime_TCM" SG_ 2564485648 N_PDU 0;
BA_ "GenSigTimeoutTime_AGSM" SG_ 2564485647 N_PDU 0;
BA_ "GenSigTimeoutTime_BCM" SG_ 2564485647 N_PDU 0;
BA_ "GenSigTimeoutTime_BSM" SG_ 2564485647 N_PDU 0;
BA_ "GenSigTimeoutTime_CADM" SG_ 2564485647 N_PDU 0;
BA_ "GenSigTimeoutTime_DMSM" SG_ 2564485647 N_PDU 0;
BA_ "GenSigTimeoutTime_DTCM" SG_ 2564485647 N_PDU 0;
BA_ "GenSigTimeoutTime_ECM" SG_ 2564485647 N_PDU 0;
BA_ "GenSigTimeoutTime_EVCU2" SG_ 2564485647 N_PDU 0;
BA_ "GenSigTimeoutTime_GNMM" SG_ 2564485647 N_PDU 0;
BA_ "GenSigTimeoutTime_HCP" SG_ 2564485647 N_PDU 0;
BA_ "GenSigTimeoutTime_IPC" SG_ 2564485647 N_PDU 0;
BA_ "GenSigTimeoutTime_RFHM" SG_ 2564485647 N_PDU 0;
BA_ "GenSigTimeoutTime_SGW" SG_ 2564485647 N_PDU 0;
BA_ "GenSigTimeoutTime_TCM" SG_ 2564485647 N_PDU 0;
BA_ "GenSigTimeoutTime_AGSM" SG_ 2564485646 N_PDU 0;
BA_ "GenSigTimeoutTime_BCM" SG_ 2564485646 N_PDU 0;
BA_ "GenSigTimeoutTime_BSM" SG_ 2564485646 N_PDU 0;
BA_ "GenSigTimeoutTime_CADM" SG_ 2564485646 N_PDU 0;
BA_ "GenSigTimeoutTime_DMSM" SG_ 2564485646 N_PDU 0;
BA_ "GenSigTimeoutTime_DTCM" SG_ 2564485646 N_PDU 0;
BA_ "GenSigTimeoutTime_ECM" SG_ 2564485646 N_PDU 0;
BA_ "GenSigTimeoutTime_EVCU2" SG_ 2564485646 N_PDU 0;
BA_ "GenSigTimeoutTime_GNMM" SG_ 2564485646 N_PDU 0;
BA_ "GenSigTimeoutTime_HCP" SG_ 2564485646 N_PDU 0;
BA_ "GenSigTimeoutTime_IPC" SG_ 2564485646 N_PDU 0;
BA_ "GenSigTimeoutTime_RFHM" SG_ 2564485646 N_PDU 0;
BA_ "GenSigTimeoutTime_SGW" SG_ 2564485646 N_PDU 0;
BA_ "GenSigTimeoutTime_TCM" SG_ 2564485646 N_PDU 0;
BA_ "GenSigTimeoutTime_AGSM" SG_ 2564485684 N_PDU 0;
BA_ "GenSigTimeoutTime_BCM" SG_ 2564485684 N_PDU 0;
BA_ "GenSigTimeoutTime_BSM" SG_ 2564485684 N_PDU 0;
BA_ "GenSigTimeoutTime_CADM" SG_ 2564485684 N_PDU 0;
BA_ "GenSigTimeoutTime_DMSM" SG_ 2564485684 N_PDU 0;
BA_ "GenSigTimeoutTime_DTCM" SG_ 2564485684 N_PDU 0;
BA_ "GenSigTimeoutTime_ECM" SG_ 2564485684 N_PDU 0;
BA_ "GenSigTimeoutTime_EVCU2" SG_ 2564485684 N_PDU 0;
BA_ "GenSigTimeoutTime_GNMM" SG_ 2564485684 N_PDU 0;
BA_ "GenSigTimeoutTime_HCP" SG_ 2564485684 N_PDU 0;
BA_ "GenSigTimeoutTime_IPC" SG_ 2564485684 N_PDU 0;
BA_ "GenSigTimeoutTime_RFHM" SG_ 2564485684 N_PDU 0;
BA_ "GenSigTimeoutTime_SGW" SG_ 2564485684 N_PDU 0;
BA_ "GenSigTimeoutTime_TCM" SG_ 2564485684 N_PDU 0;
BA_ "GenSigTimeoutTime_AGSM" SG_ 2564485728 N_PDU 0;
BA_ "GenSigTimeoutTime_BCM" SG_ 2564485728 N_PDU 0;
BA_ "GenSigTimeoutTime_BSM" SG_ 2564485728 N_PDU 0;
BA_ "GenSigTimeoutTime_CADM" SG_ 2564485728 N_PDU 0;
BA_ "GenSigTimeoutTime_DMSM" SG_ 2564485728 N_PDU 0;
BA_ "GenSigTimeoutTime_DTCM" SG_ 2564485728 N_PDU 0;
BA_ "GenSigTimeoutTime_ECM" SG_ 2564485728 N_PDU 0;
BA_ "GenSigTimeoutTime_EVCU2" SG_ 2564485728 N_PDU 0;
BA_ "GenSigTimeoutTime_GNMM" SG_ 2564485728 N_PDU 0;
BA_ "GenSigTimeoutTime_HCP" SG_ 2564485728 N_PDU 0;
BA_ "GenSigTimeoutTime_IPC" SG_ 2564485728 N_PDU 0;
BA_ "GenSigTimeoutTime_RFHM" SG_ 2564485728 N_PDU 0;
BA_ "GenSigTimeoutTime_SGW" SG_ 2564485728 N_PDU 0;
BA_ "GenSigTimeoutTime_TCM" SG_ 2564485728 N_PDU 0;
BA_ "GenSigTimeoutTime_AGSM" SG_ 2564485652 N_PDU 0;
BA_ "GenSigTimeoutTime_BCM" SG_ 2564485652 N_PDU 0;
BA_ "GenSigTimeoutTime_BSM" SG_ 2564485652 N_PDU 0;
BA_ "GenSigTimeoutTime_CADM" SG_ 2564485652 N_PDU 0;
BA_ "GenSigTimeoutTime_DMSM" SG_ 2564485652 N_PDU 0;
BA_ "GenSigTimeoutTime_DTCM" SG_ 2564485652 N_PDU 0;
BA_ "GenSigTimeoutTime_ECM" SG_ 2564485652 N_PDU 0;
BA_ "GenSigTimeoutTime_EVCU2" SG_ 2564485652 N_PDU 0;
BA_ "GenSigTimeoutTime_GNMM" SG_ 2564485652 N_PDU 0;
BA_ "GenSigTimeoutTime_HCP" SG_ 2564485652 N_PDU 0;
BA_ "GenSigTimeoutTime_IPC" SG_ 2564485652 N_PDU 0;
BA_ "GenSigTimeoutTime_RFHM" SG_ 2564485652 N_PDU 0;
BA_ "GenSigTimeoutTime_SGW" SG_ 2564485652 N_PDU 0;
BA_ "GenSigTimeoutTime_TCM" SG_ 2564485652 N_PDU 0;
BA_ "GenSigTimeoutTime_AGSM" SG_ 2564485653 N_PDU 0;
BA_ "GenSigTimeoutTime_BCM" SG_ 2564485653 N_PDU 0;
BA_ "GenSigTimeoutTime_BSM" SG_ 2564485653 N_PDU 0;
BA_ "GenSigTimeoutTime_CADM" SG_ 2564485653 N_PDU 0;
BA_ "GenSigTimeoutTime_DMSM" SG_ 2564485653 N_PDU 0;
BA_ "GenSigTimeoutTime_DTCM" SG_ 2564485653 N_PDU 0;
BA_ "GenSigTimeoutTime_ECM" SG_ 2564485653 N_PDU 0;
BA_ "GenSigTimeoutTime_EVCU2" SG_ 2564485653 N_PDU 0;
BA_ "GenSigTimeoutTime_GNMM" SG_ 2564485653 N_PDU 0;
BA_ "GenSigTimeoutTime_HCP" SG_ 2564485653 N_PDU 0;
BA_ "GenSigTimeoutTime_IPC" SG_ 2564485653 N_PDU 0;
BA_ "GenSigTimeoutTime_RFHM" SG_ 2564485653 N_PDU 0;
BA_ "GenSigTimeoutTime_SGW" SG_ 2564485653 N_PDU 0;
BA_ "GenSigTimeoutTime_TCM" SG_ 2564485653 N_PDU 0;
BA_ "GenSigTimeoutTime_AGSM" SG_ 2564485831 N_PDU 0;
BA_ "GenSigTimeoutTime_BCM" SG_ 2564485831 N_PDU 0;
BA_ "GenSigTimeoutTime_BSM" SG_ 2564485831 N_PDU 0;
BA_ "GenSigTimeoutTime_CADM" SG_ 2564485831 N_PDU 0;
BA_ "GenSigTimeoutTime_DMSM" SG_ 2564485831 N_PDU 0;
BA_ "GenSigTimeoutTime_DTCM" SG_ 2564485831 N_PDU 0;
BA_ "GenSigTimeoutTime_ECM" SG_ 2564485831 N_PDU 0;
BA_ "GenSigTimeoutTime_EVCU2" SG_ 2564485831 N_PDU 0;
BA_ "GenSigTimeoutTime_GNMM" SG_ 2564485831 N_PDU 0;
BA_ "GenSigTimeoutTime_HCP" SG_ 2564485831 N_PDU 0;
BA_ "GenSigTimeoutTime_IPC" SG_ 2564485831 N_PDU 0;
BA_ "GenSigTimeoutTime_RFHM" SG_ 2564485831 N_PDU 0;
BA_ "GenSigTimeoutTime_SGW" SG_ 2564485831 N_PDU 0;
BA_ "GenSigTimeoutTime_TCM" SG_ 2564485831 N_PDU 0;
VAL_ 1459 Next_Charge_End_Time_Hr 0 "Hour_0" 1 "Hour_1" 2 "Hour_2" 3 "Hour_3" 4 "Hour_4" 5 "Hour_5" 6 "Hour_6" 7 "Hour_7" 8 "Hour_8" 9 "Hour_9" 10 "Hour_10" 11 "Hour_11" 12 "Hour_12" 13 "Hour_13" 14 "Hour_14" 15 "Hour_15" 16 "Hour_16" 17 "Hour_17" 18 "Hour_18" 19 "Hour_19" 20 "Hour_20" 21 "Hour_21" 22 "Hour_22" 23 "Hour_23" 25 "Charge_Until_Full" 31 "SNA";
VAL_ 1459 Next_Charge_End_Time_Min 15 "SNA";
VAL_ 1459 Next_Charge_EndDay 0 "No Selection" 1 "M" 2 "T" 3 "W" 4 "Th" 5 "F" 6 "Sa" 7 "S" 15 "SNA";
VAL_ 1459 Next_Charge_Start_Time_Hr 31 "SNA";
VAL_ 1459 Next_Charge_Start_Time_Min 15 "SNA";
VAL_ 1459 Next_Charge_StartDay 0 "No Selection" 1 "M" 2 "T" 3 "W" 4 "Th" 5 "F" 6 "Sa" 7 "S" 9 "No Schedule Set" 15 "SNA";
VAL_ 1459 Next_Climate_Day 0 "No Selection" 1 "M" 2 "T" 3 "W" 4 "Th" 5 "F" 6 "Sa" 7 "S" 9 "No Schedule Set" 15 "SNA";
VAL_ 1459 Next_Climate_Time_Hr 31 "SNA";
VAL_ 1459 Next_Climate_Time_Min 15 "SNA";
VAL_ 1459 Next_SchCabin_Temp 31 "SNA";
VAL_ 1459 Nxt_Charge_Schedule_Type 0 "No_Selection" 1 "Standard_Charge" 2 "External_Charge" 3 "Both";
VAL_ 1459 Nxt_Ext_Charge_End_Time_Hr 31 "SNA";
VAL_ 1459 Nxt_Ext_Charge_End_Time_Min 15 "SNA";
VAL_ 1459 Nxt_External_Charge_EndDay 0 "No_Selection" 1 "Monday" 2 "Tuesday" 3 "Wednesday" 4 "Thursday" 5 "Friday" 6 "Saturday" 7 "Sunday" 15 "SNA";
VAL_ 1459 Nxt_External_Charge_ExternalTgt 15 "No_Selection";
VAL_ 1459 Nxt_External_Charge_ImmediateTgt 15 "No_Selection";
VAL_ 1468 AllowClimateSchd1_Sts 0 "Any_Time " 1 "Plugged_In_Only" 2 "Plugged_In_and_In_Charge_Schd" 3 "SNA";
VAL_ 1468 AllowClimateSchd2_Sts 0 "Any_Time " 1 "Plugged_In_Only" 2 "Plugged_In_and_In_Charge_Schd" 3 "SNA";
VAL_ 1468 Climate_Cabin_Temp1_Sts 31 "SNA";
VAL_ 1468 Climate_Cabin_Temp2_Sts 31 "SNA";
VAL_ 1468 ClimateSchd1_Day_Sts 0 "No Selection" 1 "M" 2 "T" 3 "TM" 4 "W" 5 "WM" 6 "WT" 7 "WTM" 8 "Th" 9 "ThM" 10 "ThT" 11 "ThTM" 12 "ThW" 13 "ThWM" 14 "ThWT" 15 "ThWTM" 16 "F" 17 "FM" 18 "FT" 19 "FTM" 20 "FW" 21 "FWM" 22 "FWT" 23 "FWTM" 24 "FTh" 25 "FThM" 26 "FThT" 27 "FThTM" 28 "FThW" 29 "FThWM" 30 "FThWT" 31 "FThWTM" 32 "S" 33 "SM" 34 "ST" 35 "STM" 36 "SW" 37 "SWM" 38 "SWT" 39 "SWTM" 40 "STh" 41 "SThM" 42 "SThT" 43 "SThTM" 44 "SThW" 45 "SThWM" 46 "SThWT" 47 "SThWTM" 48 "SF" 49 "SFM" 50 "SFT" 51 "SFTM" 52 "SFW" 53 "SFWM" 54 "SFWT" 55 "SFWTM" 56 "SFTh" 57 "SFThM" 58 "SFThT" 59 "SFThTM" 60 "SFThW" 61 "SFThWM" 62 "SFThWT" 63 "SFThWTM" 64 "Su" 65 "SuM" 66 "SuT" 67 "SuTM" 68 "SuW" 69 "SuWM" 70 "SuWT" 71 "SuWTM" 72 "SuTh" 73 "SuThM" 74 "SuThT" 75 "SuThTM" 76 "SuThW" 77 "SuThWM" 78 "SuThWT" 79 "SuThWTM" 80 "SuF" 81 "SuFM" 82 "SuFT" 83 "SuFTM" 84 "SuFW" 85 "SuFWM" 86 "SuFWT" 87 "SuFWTM" 88 "SuFTh" 89 "SuFThM" 90 "SuFThT" 91 "SuFThTM" 92 "SuFThW" 93 "SuFThWM" 94 "SuFThWT" 95 "SuFThWTM" 96 "SuS" 97 "SuSM" 98 "SuST" 99 "SuSTM" 100 "SuSW" 101 "SuSWM" 102 "SuSWT" 103 "SuSWTM" 104 "SuSTh" 105 "SuSThM" 106 "SuSThT" 107 "SuSThTM" 108 "SuSThW" 109 "SuSThWM" 110 "SuSThWT" 111 "SuSThWTM" 112 "SuSF" 113 "SuSFM" 114 "SuSFT" 115 "SuSFTM" 116 "SuSFW" 117 "SuSFWM" 118 "SuSFWT" 119 "SuSFWTM" 120 "SuSFTh" 121 "SuSFThM" 122 "SuSFThT" 123 "SuSFThTM" 124 "SuSFThW" 125 "SuSFThWM" 126 "SuSFThWT" 127 "SuSFThWTM" 255 "SNA";
VAL_ 1468 ClimateSchd1_Departure_Hr_Sts 31 "SNA";
VAL_ 1468 ClimateSchd1_Departure_Min_Sts 15 "SNA";
VAL_ 1468 ClimateSchd2_Day_Sts 0 "No Selection" 1 "M" 2 "T" 3 "TM" 4 "W" 5 "WM" 6 "WT" 7 "WTM" 8 "Th" 9 "ThM" 10 "ThT" 11 "ThTM" 12 "ThW" 13 "ThWM" 14 "ThWT" 15 "ThWTM" 16 "F" 17 "FM" 18 "FT" 19 "FTM" 20 "FW" 21 "FWM" 22 "FWT" 23 "FWTM" 24 "FTh" 25 "FThM" 26 "FThT" 27 "FThTM" 28 "FThW" 29 "FThWM" 30 "FThWT" 31 "FThWTM" 32 "S" 33 "SM" 34 "ST" 35 "STM" 36 "SW" 37 "SWM" 38 "SWT" 39 "SWTM" 40 "STh" 41 "SThM" 42 "SThT" 43 "SThTM" 44 "SThW" 45 "SThWM" 46 "SThWT" 47 "SThWTM" 48 "SF" 49 "SFM" 50 "SFT" 51 "SFTM" 52 "SFW" 53 "SFWM" 54 "SFWT" 55 "SFWTM" 56 "SFTh" 57 "SFThM" 58 "SFThT" 59 "SFThTM" 60 "SFThW" 61 "SFThWM" 62 "SFThWT" 63 "SFThWTM" 64 "Su" 65 "SuM" 66 "SuT" 67 "SuTM" 68 "SuW" 69 "SuWM" 70 "SuWT" 71 "SuWTM" 72 "SuTh" 73 "SuThM" 74 "SuThT" 75 "SuThTM" 76 "SuThW" 77 "SuThWM" 78 "SuThWT" 79 "SuThWTM" 80 "SuF" 81 "SuFM" 82 "SuFT" 83 "SuFTM" 84 "SuFW" 85 "SuFWM" 86 "SuFWT" 87 "SuFWTM" 88 "SuFTh" 89 "SuFThM" 90 "SuFThT" 91 "SuFThTM" 92 "SuFThW" 93 "SuFThWM" 94 "SuFThWT" 95 "SuFThWTM" 96 "SuS" 97 "SuSM" 98 "SuST" 99 "SuSTM" 100 "SuSW" 101 "SuSWM" 102 "SuSWT" 103 "SuSWTM" 104 "SuSTh" 105 "SuSThM" 106 "SuSThT" 107 "SuSThTM" 108 "SuSThW" 109 "SuSThWM" 110 "SuSThWT" 111 "SuSThWTM" 112 "SuSF" 113 "SuSFM" 114 "SuSFT" 115 "SuSFTM" 116 "SuSFW" 117 "SuSFWM" 118 "SuSFWT" 119 "SuSFWTM" 120 "SuSFTh" 121 "SuSFThM" 122 "SuSFThT" 123 "SuSFThTM" 124 "SuSFThW" 125 "SuSFThWM" 126 "SuSFThWT" 127 "SuSFThWTM" 255 "SNA";
VAL_ 1468 ClimateSchd2_Departure_Hr_Sts 31 "SNA";
VAL_ 1468 ClimateSchd2_Departure_Min_Sts 15 "SNA";
VAL_ 1468 Enable_ClimateSchd1_Sts 0 "Disable" 1 "Enable";
VAL_ 1468 Enable_ClimateSchd2_Sts 0 "Disable" 1 "Enable";
VAL_ 1471 AllowClimateSchd1 0 "Any_Time " 1 "Plugged_In_Only" 2 "Plugged_In_and_In_Charge_Schd" 3 "SNA";
VAL_ 1471 AllowClimateSchd2 0 "Any_Time " 1 "Plugged_In_Only" 2 "Plugged_In_and_In_Charge_Schd" 3 "SNA";
VAL_ 1471 Climate_Cabin_Temp1 31 "SNA";
VAL_ 1471 Climate_Cabin_Temp2 31 "SNA";
VAL_ 1471 ClimateSchd1_Day 0 "No Selection" 1 "M" 2 "T" 3 "TM" 4 "W" 5 "WM" 6 "WT" 7 "WTM" 8 "Th" 9 "ThM" 10 "ThT" 11 "ThTM" 12 "ThW" 13 "ThWM" 14 "ThWT" 15 "ThWTM" 16 "F" 17 "FM" 18 "FT" 19 "FTM" 20 "FW" 21 "FWM" 22 "FWT" 23 "FWTM" 24 "FTh" 25 "FThM" 26 "FThT" 27 "FThTM" 28 "FThW" 29 "FThWM" 30 "FThWT" 31 "FThWTM" 32 "S" 33 "SM" 34 "ST" 35 "STM" 36 "SW" 37 "SWM" 38 "SWT" 39 "SWTM" 40 "STh" 41 "SThM" 42 "SThT" 43 "SThTM" 44 "SThW" 45 "SThWM" 46 "SThWT" 47 "SThWTM" 48 "SF" 49 "SFM" 50 "SFT" 51 "SFTM" 52 "SFW" 53 "SFWM" 54 "SFWT" 55 "SFWTM" 56 "SFTh" 57 "SFThM" 58 "SFThT" 59 "SFThTM" 60 "SFThW" 61 "SFThWM" 62 "SFThWT" 63 "SFThWTM" 64 "Su" 65 "SuM" 66 "SuT" 67 "SuTM" 68 "SuW" 69 "SuWM" 70 "SuWT" 71 "SuWTM" 72 "SuTh" 73 "SuThM" 74 "SuThT" 75 "SuThTM" 76 "SuThW" 77 "SuThWM" 78 "SuThWT" 79 "SuThWTM" 80 "SuF" 81 "SuFM" 82 "SuFT" 83 "SuFTM" 84 "SuFW" 85 "SuFWM" 86 "SuFWT" 87 "SuFWTM" 88 "SuFTh" 89 "SuFThM" 90 "SuFThT" 91 "SuFThTM" 92 "SuFThW" 93 "SuFThWM" 94 "SuFThWT" 95 "SuFThWTM" 96 "SuS" 97 "SuSM" 98 "SuST" 99 "SuSTM" 100 "SuSW" 101 "SuSWM" 102 "SuSWT" 103 "SuSWTM" 104 "SuSTh" 105 "SuSThM" 106 "SuSThT" 107 "SuSThTM" 108 "SuSThW" 109 "SuSThWM" 110 "SuSThWT" 111 "SuSThWTM" 112 "SuSF" 113 "SuSFM" 114 "SuSFT" 115 "SuSFTM" 116 "SuSFW" 117 "SuSFWM" 118 "SuSFWT" 119 "SuSFWTM" 120 "SuSFTh" 121 "SuSFThM" 122 "SuSFThT" 123 "SuSFThTM" 124 "SuSFThW" 125 "SuSFThWM" 126 "SuSFThWT" 127 "SuSFThWTM" 255 "SNA";
VAL_ 1471 ClimateSchd1_Departure_Hr 31 "SNA";
VAL_ 1471 ClimateSchd1_Departure_Min 15 "SNA";
VAL_ 1471 ClimateSchd2_Day 0 "No Selection" 1 "M" 2 "T" 3 "TM" 4 "W" 5 "WM" 6 "WT" 7 "WTM" 8 "Th" 9 "ThM" 10 "ThT" 11 "ThTM" 12 "ThW" 13 "ThWM" 14 "ThWT" 15 "ThWTM" 16 "F" 17 "FM" 18 "FT" 19 "FTM" 20 "FW" 21 "FWM" 22 "FWT" 23 "FWTM" 24 "FTh" 25 "FThM" 26 "FThT" 27 "FThTM" 28 "FThW" 29 "FThWM" 30 "FThWT" 31 "FThWTM" 32 "S" 33 "SM" 34 "ST" 35 "STM" 36 "SW" 37 "SWM" 38 "SWT" 39 "SWTM" 40 "STh" 41 "SThM" 42 "SThT" 43 "SThTM" 44 "SThW" 45 "SThWM" 46 "SThWT" 47 "SThWTM" 48 "SF" 49 "SFM" 50 "SFT" 51 "SFTM" 52 "SFW" 53 "SFWM" 54 "SFWT" 55 "SFWTM" 56 "SFTh" 57 "SFThM" 58 "SFThT" 59 "SFThTM" 60 "SFThW" 61 "SFThWM" 62 "SFThWT" 63 "SFThWTM" 64 "Su" 65 "SuM" 66 "SuT" 67 "SuTM" 68 "SuW" 69 "SuWM" 70 "SuWT" 71 "SuWTM" 72 "SuTh" 73 "SuThM" 74 "SuThT" 75 "SuThTM" 76 "SuThW" 77 "SuThWM" 78 "SuThWT" 79 "SuThWTM" 80 "SuF" 81 "SuFM" 82 "SuFT" 83 "SuFTM" 84 "SuFW" 85 "SuFWM" 86 "SuFWT" 87 "SuFWTM" 88 "SuFTh" 89 "SuFThM" 90 "SuFThT" 91 "SuFThTM" 92 "SuFThW" 93 "SuFThWM" 94 "SuFThWT" 95 "SuFThWTM" 96 "SuS" 97 "SuSM" 98 "SuST" 99 "SuSTM" 100 "SuSW" 101 "SuSWM" 102 "SuSWT" 103 "SuSWTM" 104 "SuSTh" 105 "SuSThM" 106 "SuSThT" 107 "SuSThTM" 108 "SuSThW" 109 "SuSThWM" 110 "SuSThWT" 111 "SuSThWTM" 112 "SuSF" 113 "SuSFM" 114 "SuSFT" 115 "SuSFTM" 116 "SuSFW" 117 "SuSFWM" 118 "SuSFWT" 119 "SuSFWTM" 120 "SuSFTh" 121 "SuSFThM" 122 "SuSFThT" 123 "SuSFThTM" 124 "SuSFThW" 125 "SuSFThWM" 126 "SuSFThWT" 127 "SuSFThWTM" 255 "SNA";
VAL_ 1471 ClimateSchd2_Departure_Hr 31 "SNA";
VAL_ 1471 ClimateSchd2_Departure_Min 15 "SNA";
VAL_ 1471 Enable_ClimateSchd1 0 "Disable_schedule1" 1 "Enable_schedule1";
VAL_ 1471 Enable_ClimateSchd2 0 "Disable_schedule2" 1 "Enable_schedule2";
VAL_ 1471 Submit_ClimateSchd1 0 "No_Change" 1 "Change_in_schedule1";
VAL_ 1471 Submit_ClimateSchd2 0 "No_Change" 1 "Change_in_schedule2";
VAL_ 1462 Climate_TBM_Cabin_Temp1 31 "SNA";
VAL_ 1462 Climate_TBM_Cabin_Temp2 31 "SNA";
VAL_ 1462 TBM_AllowClimateSchd1 0 "Any_Time " 1 "Plugged_In_Only" 2 "Plugged_In_and_In_Charge_Schd" 3 "SNA";
VAL_ 1462 TBM_AllowClimateSchd2 0 "Any_Time " 1 "Plugged_In_Only" 2 "Plugged_In_and_In_Charge_Schd" 3 "SNA";
VAL_ 1462 TBM_ClimateSchd1_Day 0 "No Selection" 1 "M" 2 "T" 3 "TM" 4 "W" 5 "WM" 6 "WT" 7 "WTM" 8 "Th" 9 "ThM" 10 "ThT" 11 "ThTM" 12 "ThW" 13 "ThWM" 14 "ThWT" 15 "ThWTM" 16 "F" 17 "FM" 18 "FT" 19 "FTM" 20 "FW" 21 "FWM" 22 "FWT" 23 "FWTM" 24 "FTh" 25 "FThM" 26 "FThT" 27 "FThTM" 28 "FThW" 29 "FThWM" 30 "FThWT" 31 "FThWTM" 32 "S" 33 "SM" 34 "ST" 35 "STM" 36 "SW" 37 "SWM" 38 "SWT" 39 "SWTM" 40 "STh" 41 "SThM" 42 "SThT" 43 "SThTM" 44 "SThW" 45 "SThWM" 46 "SThWT" 47 "SThWTM" 48 "SF" 49 "SFM" 50 "SFT" 51 "SFTM" 52 "SFW" 53 "SFWM" 54 "SFWT" 55 "SFWTM" 56 "SFTh" 57 "SFThM" 58 "SFThT" 59 "SFThTM" 60 "SFThW" 61 "SFThWM" 62 "SFThWT" 63 "SFThWTM" 64 "Su" 65 "SuM" 66 "SuT" 67 "SuTM" 68 "SuW" 69 "SuWM" 70 "SuWT" 71 "SuWTM" 72 "SuTh" 73 "SuThM" 74 "SuThT" 75 "SuThTM" 76 "SuThW" 77 "SuThWM" 78 "SuThWT" 79 "SuThWTM" 80 "SuF" 81 "SuFM" 82 "SuFT" 83 "SuFTM" 84 "SuFW" 85 "SuFWM" 86 "SuFWT" 87 "SuFWTM" 88 "SuFTh" 89 "SuFThM" 90 "SuFThT" 91 "SuFThTM" 92 "SuFThW" 93 "SuFThWM" 94 "SuFThWT" 95 "SuFThWTM" 96 "SuS" 97 "SuSM" 98 "SuST" 99 "SuSTM" 100 "SuSW" 101 "SuSWM" 102 "SuSWT" 103 "SuSWTM" 104 "SuSTh" 105 "SuSThM" 106 "SuSThT" 107 "SuSThTM" 108 "SuSThW" 109 "SuSThWM" 110 "SuSThWT" 111 "SuSThWTM" 112 "SuSF" 113 "SuSFM" 114 "SuSFT" 115 "SuSFTM" 116 "SuSFW" 117 "SuSFWM" 118 "SuSFWT" 119 "SuSFWTM" 120 "SuSFTh" 121 "SuSFThM" 122 "SuSFThT" 123 "SuSFThTM" 124 "SuSFThW" 125 "SuSFThWM" 126 "SuSFThWT" 127 "SuSFThWTM" 255 "SNA";
VAL_ 1462 TBM_ClimateSchd1_Departure_Hr 31 "SNA";
VAL_ 1462 TBM_ClimateSchd1_Departure_Min 15 "SNA";
VAL_ 1462 TBM_ClimateSchd2_Day 0 "No Selection" 1 "M" 2 "T" 3 "TM" 4 "W" 5 "WM" 6 "WT" 7 "WTM" 8 "Th" 9 "ThM" 10 "ThT" 11 "ThTM" 12 "ThW" 13 "ThWM" 14 "ThWT" 15 "ThWTM" 16 "F" 17 "FM" 18 "FT" 19 "FTM" 20 "FW" 21 "FWM" 22 "FWT" 23 "FWTM" 24 "FTh" 25 "FThM" 26 "FThT" 27 "FThTM" 28 "FThW" 29 "FThWM" 30 "FThWT" 31 "FThWTM" 32 "S" 33 "SM" 34 "ST" 35 "STM" 36 "SW" 37 "SWM" 38 "SWT" 39 "SWTM" 40 "STh" 41 "SThM" 42 "SThT" 43 "SThTM" 44 "SThW" 45 "SThWM" 46 "SThWT" 47 "SThWTM" 48 "SF" 49 "SFM" 50 "SFT" 51 "SFTM" 52 "SFW" 53 "SFWM" 54 "SFWT" 55 "SFWTM" 56 "SFTh" 57 "SFThM" 58 "SFThT" 59 "SFThTM" 60 "SFThW" 61 "SFThWM" 62 "SFThWT" 63 "SFThWTM" 64 "Su" 65 "SuM" 66 "SuT" 67 "SuTM" 68 "SuW" 69 "SuWM" 70 "SuWT" 71 "SuWTM" 72 "SuTh" 73 "SuThM" 74 "SuThT" 75 "SuThTM" 76 "SuThW" 77 "SuThWM" 78 "SuThWT" 79 "SuThWTM" 80 "SuF" 81 "SuFM" 82 "SuFT" 83 "SuFTM" 84 "SuFW" 85 "SuFWM" 86 "SuFWT" 87 "SuFWTM" 88 "SuFTh" 89 "SuFThM" 90 "SuFThT" 91 "SuFThTM" 92 "SuFThW" 93 "SuFThWM" 94 "SuFThWT" 95 "SuFThWTM" 96 "SuS" 97 "SuSM" 98 "SuST" 99 "SuSTM" 100 "SuSW" 101 "SuSWM" 102 "SuSWT" 103 "SuSWTM" 104 "SuSTh" 105 "SuSThM" 106 "SuSThT" 107 "SuSThTM" 108 "SuSThW" 109 "SuSThWM" 110 "SuSThWT" 111 "SuSThWTM" 112 "SuSF" 113 "SuSFM" 114 "SuSFT" 115 "SuSFTM" 116 "SuSFW" 117 "SuSFWM" 118 "SuSFWT" 119 "SuSFWTM" 120 "SuSFTh" 121 "SuSFThM" 122 "SuSFThT" 123 "SuSFThTM" 124 "SuSFThW" 125 "SuSFThWM" 126 "SuSFThWT" 127 "SuSFThWTM" 255 "SNA";
VAL_ 1462 TBM_ClimateSchd2_Departure_Hr 31 "SNA";
VAL_ 1462 TBM_ClimateSchd2_Departure_Min 15 "SNA";
VAL_ 1462 TBM_Enable_ClimateSchd1 0 "Disable_schedule1" 1 "Enable_schedule1";
VAL_ 1462 TBM_Enable_ClimateSchd2 0 "Disable_schedule2" 1 "Enable_schedule2";
VAL_ 1462 TBM_Submit_ClimateSchd1 0 "No_Change" 1 "Change_in_schedule1";
VAL_ 1462 TBM_Submit_ClimateSchd2 0 "No_Change" 1 "Change_in_schedule2";
VAL_ 275 RR_PAM_Brk_RqSts 0 "Off" 1 "On";
VAL_ 275 RR_PAM_Dist 1023 "SNA";
VAL_ 275 RR_PAM_StopControlSts 0 "Off" 1 "On";
VAL_ 950 Alert_CHF 0 "No_object_detected" 1 "1_Arc" 2 "2_Arc" 3 "3_Arc" 4 "4_Arc" 5 "5_Arc" 6 "6_Arc" 7 "SNA";
VAL_ 950 Alert_CHR 0 "No_object_detected" 1 "1_Arc" 2 "2_Arc" 3 "3_Arc" 4 "4_Arc" 5 "5_Arc" 6 "6_Arc" 7 "SNA";
VAL_ 950 Alert_LHF 0 "No_object_detected" 1 "1_Arc" 2 "2_Arc" 7 "SNA";
VAL_ 950 Alert_LHR 0 "No_object_detected" 1 "1_Arc" 2 "2_Arc" 7 "SNA";
VAL_ 950 Alert_RHF 0 "No_object_detected" 1 "1_Arc" 2 "2_Arc" 7 "SNA";
VAL_ 950 Alert_RHR 0 "No_object_detected" 1 "1_Arc" 2 "2_Arc" 7 "SNA";
VAL_ 950 FrontSensorSts 0 "Active" 1 "Not_Active_blocked" 2 "Not_Active_failure" 3 "SNA";
VAL_ 950 FT_PAM_LedControlSts 0 "Off" 1 "Continuous Light" 2 "2Blinking Light" 3 "SNA";
VAL_ 950 Graphic_CHF 0 "Slow_flash" 1 "Solid" 2 "None" 3 "SNA";
VAL_ 950 Graphic_CHR 0 "Slow_flash" 1 "Solid" 2 "None" 3 "SNA";
VAL_ 950 Graphic_LHF 0 "Slow_flash" 1 "Solid" 2 "None" 3 "SNA";
VAL_ 950 Graphic_LHR 0 "Slow_flash" 1 "Solid" 2 "None" 3 "SNA";
VAL_ 950 Graphic_RHF 0 "Slow_flash" 1 "Solid" 2 "None" 3 "SNA";
VAL_ 950 Graphic_RHR 0 "Slow_flash" 1 "Solid" 2 "None" 3 "SNA";
VAL_ 950 PAM_LedControlSts 0 "Off" 1 "Continuous light" 2 "Blinking light" 3 "SNA";
VAL_ 950 PAM_Off_Status_2BT 0 "FT_OFF_RR_OFF" 1 "FT_OFF_RR_ON" 2 "FT_ON_RR_OFF" 3 "FT_ON_RR_ON";
VAL_ 950 PAM_PopUpRqst 0 "TM0" 1 "TM1" 2 "TM2" 3 "TM3" 4 "TM4" 5 "TM5" 6 "TM6" 7 "TM7" 8 "TM8" 9 "TM9" 10 "TM10" 11 "TM11" 12 "TM12" 13 "TM13" 14 "TM14" 15 "TM15" 16 "TM16" 17 "TM17" 18 "TM18" 19 "TM19" 20 "TM20" 21 "TM21" 22 "TM22" 23 "TM23" 24 "TM24" 25 "TM25" 26 "TM26" 27 "TM27" 28 "TM28" 29 "TM29" 30 "TM30" 31 "TM31" 32 "TM32" 33 "TM33" 34 "TM34" 35 "TM35" 36 "TM36" 37 "TM37" 38 "TM38" 39 "TM39" 40 "TM40" 41 "TM41" 42 "TM42" 43 "TM43" 44 "TM44" 45 "TM45" 46 "TM46" 47 "TM47" 48 "TM48" 49 "TM49" 50 "TM50" 51 "TM51" 52 "TM52" 53 "TM53" 54 "TM54" 55 "TM55" 56 "TM56" 57 "TM57" 58 "TM58" 59 "TM59" 60 "TM60" 61 "TM61" 62 "TM62" 63 "TM63" 64 "TM64" 65 "TM65" 66 "TM66" 67 "TM67" 68 "TM68" 69 "TM69" 70 "TM70" 71 "TM71" 72 "TM72" 73 "TM73" 74 "TM74" 75 "TM75" 76 "TM76" 77 "TM77" 78 "TM78" 79 "TM79" 80 "TM80" 81 "TM81" 82 "TM82" 83 "TM83" 84 "TM84" 85 "TM85" 86 "TM86" 87 "TM87" 88 "TM88" 89 "TM89" 90 "TM90" 91 "TM91" 92 "TM92" 93 "TM93" 94 "TM94" 95 "TM95" 96 "TM96" 97 "TM97" 98 "TM98" 99 "TM99" 100 "TM100" 255 "SNA";
VAL_ 950 PAMSystemFault 0 "False" 1 "Temporary_Failure" 2 "External_Failure" 3 "System_Failure";
VAL_ 950 ParkingManeuverActive 0 "Idle" 1 "Enabled_Seeking" 2 "Engaged_Semi" 3 "Engaged_Full" 4 "Not_Used" 5 "Not_Used" 6 "Not_Used" 7 "SNA";
VAL_ 950 RearSensorSts 0 "Active" 1 "Not_Active_blocked" 2 "Not_Active_failure" 3 "SNA";
VAL_ 950 SPMControlSts 0 "Not_Active" 1 "Active_ParallelParking" 2 "Active_PerpendicularParking" 3 "Active_OutParking";
VAL_ 161 BATTERY_voltage 255 "SNA";
VAL_ 161 BATTERY2_voltage 255 "SNA";
VAL_ 161 DBSM2_internal_error 0 "No_Error" 1 "Internal_Error";
VAL_ 161 ESS_input_active 0 "ESS_NotActivated" 1 "ESS_Activated";
VAL_ 161 L2plus_ack 0 "Inactive" 1 "L2plus_mode_active";
VAL_ 161 overcurrent_detected 0 "No_Fault" 1 "Over_Current";
VAL_ 161 overtemp_detected 0 "No_Fault" 1 "Over_Temp";
VAL_ 161 RsErr_DBSM2 0 "No_Error" 1 "Error";
VAL_ 161 switch_status_OpenClose 0 "Open" 1 "Close";
VAL_ 161 undervoltage_detected 0 "No_Fault" 1 "Under_Voltage";
