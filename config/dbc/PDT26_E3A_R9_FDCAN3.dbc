VERSION ""

NS_ :

BS_:

BU_: AGSM BCM BSM CADM DMSM DTCM ECM EVCU2 GNMM HCP IPC RFHM SGW TCM
BO_ 1445 ASCM_FD_2: 32 BCM
 SG_ ADC_Stat_2 : 10|3@0+ (1,0) [0|6] "-" SGW
 SG_ ADS_SrvSys : 115|1@0+ (1,0) [0|1] "-" IPC
 SG_ ASCM_HMI_Stat : 7|5@0+ (1,0) [0|31] "-" IPC
 SG_ ASCM_RemStat : 101|2@0+ (1,0) [0|0] "-" RFHM
 SG_ ASCM_Srv : 111|1@0+ (1,0) [0|1] "-" IPC,SGW
 SG_ ASCM_Stat : 135|4@0+ (1,0) [0|14] "-" BSM,CADM,ECM,IPC
 SG_ ASCM_StatDisp : 99|4@0+ (1,0) [0|14] "-" IPC
 SG_ ASCM_SysFail : 110|1@0+ (1,0) [0|1] "-" IPC,SGW
 SG_ ASCM_SYSFAIL_HMI : 93|2@0+ (1,0) [0|3] "-" IPC
 SG_ CRC_ASCM2 : 191|8@0+ (1,0) [0|255] "-" BSM,CADM,IPC
 SG_ Loading_Lv : 109|3@0+ (1,0) [0|6] "-" BSM,CADM,IPC
 SG_ MessageCounter_ASCM2 : 179|4@0+ (1,0) [0|15] "-" BSM,CADM,IPC
 SG_ Tgt_Level : 106|3@0+ (1,0) [0|6] "-" CADM
 SG_ TJM_Enbl : 0|1@0+ (1,0) [0|1] "-" IPC

BO_ 204 AXLE_TORQUE_FD_1: 48 ECM
 SG_ Axle_Torque_DrvReqMod : 55|16@0+ (2,-65534) [-65534|65536] "Nm" BCM,BSM
 SG_ Axle_TorqueStatic_D_TTC : 39|16@0+ (2,-65534) [-65534|65536] "Nm" BCM,BSM
 SG_ CRC_AXLE_TORQUE_FD_1 : 319|8@0+ (1,0) [0|255] "-" BSM
 SG_ Front_Axle_Est_Regen_Torq : 149|14@0+ (2,0) [0|32764] "Nm" BSM
 SG_ Front_Axle_Regen_Capacity : 165|14@0+ (2,0) [0|32764] "Nm" BSM
 SG_ Front_AxleTorque_Max : 71|16@0+ (2,-65534) [-65534|65536] "Nm" BSM
 SG_ Front_AxleTorque_Min : 87|16@0+ (2,-65534) [-65534|65536] "Nm" BSM
 SG_ MaxRegen_Diff_Axle_Torq : 134|15@0+ (2,0) [0|65532] "Nm" BSM
 SG_ MaxRegen_Diff_Axle_Torq_Active : 135|1@0+ (1,0) [0|1] "" BCM,BSM
 SG_ MessageCounter_AXLE_TORQUE_FD_1 : 307|4@0+ (1,0) [0|15] "-" BSM
 SG_ Rear_Axle_Est_Regen_Torq : 181|14@0+ (2,0) [0|32764] "Nm" BSM
 SG_ Rear_Axle_Regen_Capacity : 197|14@0+ (2,0) [0|32764] "Nm" BSM
 SG_ Rear_AxleTorque_Max : 103|16@0+ (2,-65534) [-65534|65536] "Nm" BSM
 SG_ Rear_AxleTorque_Min : 119|16@0+ (2,-65534) [-65534|65536] "Nm" BSM
 SG_ Total_AxleTorque_Max : 7|16@0+ (2,-65534) [-65534|65536] "Nm" BSM
 SG_ Total_AxleTorque_Min : 23|16@0+ (2,-65534) [-65534|65536] "Nm" BSM

BO_ 247 BCM_CODE_TRM_REQUEST: 32 BCM
 SG_ ControlEncoding_TRM_Rq : 87|8@0+ (1,0) [0|255] "-" RFHM
 SG_ MiniCrypt_Rnd_TRM_Rq : 111|32@0+ (1,0) [0|4294967295] "-" RFHM
 SG_ MiniCryptFCode_TRM_Rq : 95|16@0+ (1,0) [0|65535] "-" RFHM

BO_ 1153 BCM_FD_10: 32 BCM
 SG_ CmdIgnSts : 138|3@0+ (1,0) [0|7] "" AGSM,BSM,CADM,DMSM,DTCM,ECM,EVCU2,GNMM,HCP,IPC,RFHM,SGW,TCM
 SG_ CompressorACReqSts : 175|1@0+ (1,0) [0|1] "-" ECM,EVCU2
 SG_ CRC_BCM10 : 191|8@0+ (1,0) [0|255] "-" AGSM,BSM,CADM,DMSM,ECM,EVCU2,GNMM,HCP,IPC,RFHM,TCM
 SG_ DAY_LGT_MD : 15|1@0+ (1,0) [0|1] "" AGSM,BSM,EVCU2,IPC,RFHM,SGW,TCM
 SG_ ExteriorRearReleaseSwitchSts : 161|1@0+ (1,0) [0|1] "" RFHM
 SG_ ExternalTemperatureC : 80|9@0+ (0.5,-85) [-85|170] "°C" AGSM,BSM,CADM,DMSM,DTCM,ECM,EVCU2,GNMM,HCP,IPC,RFHM,SGW,TCM
 SG_ ExternalTemperatureF : 96|9@0+ (1,-121) [-121|389] "°F" IPC,SGW
 SG_ FOA_Mobile_App_Alert : 41|1@0+ (1,0) [0|1] "" SGW
 SG_ FOA_Msg_Req : 146|3@0+ (1,0) [0|7] "-" IPC,SGW
 SG_ FOBSearchRequest : 159|2@0+ (1,0) [0|3] "" RFHM
 SG_ MessageCounter_BCM10 : 179|4@0+ (1,0) [0|15] "-" AGSM,BSM,CADM,DMSM,ECM,EVCU2,GNMM,HCP,IPC,RFHM,TCM
 SG_ PANEL_INTS : 7|8@0+ (0.5,0) [0|100] "%" AGSM,RFHM,SGW,TCM
 SG_ RemSt_InhibitSts : 133|6@0+ (1,0) [0|62] "" IPC,SGW
 SG_ SCC_InhibitSts : 14|6@0+ (1,0) [0|62] "" IPC
 SG_ SpSt_Pad1 : 149|3@0+ (1,0) [0|6] "" ECM,SGW
 SG_ StTypSts : 141|3@0+ (1,0) [0|7] "" RFHM,SGW
 SG_ TurnIndicationSts : 143|2@0+ (1,0) [0|3] "" CADM,SGW
 SG_ WPR_SYS_AUTO : 43|1@0+ (1,0) [0|1] "-" CADM

BO_ 1430 BCM_FD_11: 32 BCM
 SG_ A2D_DRV_TEMP_DR_POS : 57|10@0+ (0.0048828125,0) [0|4.9951171875] "Volt" ECM
 SG_ AcOutputCurrentSts : 55|8@0+ (0.008,0) [0|2.04] "A" ECM
 SG_ Batt_ST_Crit : 141|1@0+ (1,0) [0|1] "" CADM,IPC,SGW
 SG_ CMP_DIR : 79|4@0+ (1,0) [0|15] "" IPC,SGW
 SG_ CRC_BCM11 : 191|8@0+ (1,0) [0|255] "-" CADM
 SG_ DSM_PDL_LKOUT : 132|3@0+ (1,0) [0|6] "" IPC
 SG_ EngineOffTimer : 83|12@0+ (1,0) [0|4080] "min" Vector__XXX
 SG_ Gate_Req_PE : 45|2@0+ (1,0) [0|3] "" RFHM,SGW
 SG_ MessageCounter_BCM11 : 179|4@0+ (1,0) [0|15] "-" CADM
 SG_ MF_SWG_AJAR : 58|1@0+ (1,0) [0|1] "-" IPC
 SG_ PanicModeActive : 145|1@0+ (1,0) [0|1] "-" SGW
 SG_ Parallel_Prk_Ast_Pad1 : 172|3@0+ (1,0) [0|6] "-" ECM
 SG_ PFTM_Req_PE : 183|2@0+ (1,0) [0|3] "" RFHM
 SG_ PN14_LS_Actv : 112|1@0+ (1,0) [0|1] "" CADM,IPC,SGW
 SG_ PN14_LS_Lvl7 : 129|1@0+ (1,0) [0|1] "" CADM,SGW
 SG_ StopStartClimateInfo : 175|3@0+ (1,0) [0|5] "-" ECM,EVCU2,SGW

BO_ 1431 BCM_FD_12: 32 BCM
 SG_ AirTemp_Outsd : 47|8@0+ (0.5,-40) [-40|85] "°C" Vector__XXX
 SG_ APARequestSts : 124|1@0+ (1,0) [0|1] "" SGW
 SG_ AxleLckrSEL_SW : 39|2@0+ (1,0) [0|2] "" DTCM,EVCU2
 SG_ CRC_BCM12 : 191|8@0+ (1,0) [0|255] "-" BSM,CADM,EVCU2,TCM
 SG_ DALM_Status : 96|1@0+ (1,0) [0|1] "" CADM
 SG_ GlobDrvMdRq_BCM : 109|5@0+ (1,0) [0|30] "" ECM
 SG_ IGN_OFF_TIME_LNG : 147|12@0+ (1,0) [0|4080] "min" BSM,DTCM,SGW,TCM
 SG_ Left_Button_BCM : 58|3@0+ (1,0) [0|6] "" ECM,EVCU2
 SG_ MessageCounter_BCM12 : 179|4@0+ (1,0) [0|15] "-" BSM,CADM,EVCU2,TCM
 SG_ PaddlesModeReq : 17|2@0+ (1,0) [0|0] "" TCM
 SG_ PAMRequestSts : 125|1@0+ (1,0) [0|1] "" SGW
 SG_ PreCondCabinSts : 111|2@0+ (1,0) [0|2] "" EVCU2
 SG_ Right_Button_BCM : 77|3@0+ (1,0) [0|6] "" ECM,EVCU2
 SG_ SeatVib_Sts : 33|2@0+ (1,0) [0|3] "" CADM
 SG_ Switch_2WD_Rq : 123|2@0+ (1,0) [0|2] "" DTCM,EVCU2
 SG_ Switch_4AUTO_Rq : 130|2@0+ (1,0) [0|2] "" DTCM,EVCU2
 SG_ Switch_4LOCK_Rq : 121|2@0+ (1,0) [0|2] "" DTCM,EVCU2
 SG_ Switch1_Rq : 98|2@0+ (1,0) [0|2] "" DTCM
 SG_ Switch2_Rq : 100|2@0+ (1,0) [0|2] "" DTCM,EVCU2
 SG_ TerrainModeInterfaceButton_BCM : 74|3@0+ (1,0) [0|6] "" ECM
 SG_ Tow_Request : 36|3@0+ (1,0) [0|6] "" ECM
 SG_ TRAC_PSD : 14|1@0+ (1,0) [0|1] "" BSM
 SG_ Trns_DrvMdReq_BCM : 135|5@0+ (1,0) [0|30] "" ECM

BO_ 159 BCM_FD_13: 32 BCM
 SG_ ACC_DistSwDec : 87|1@0+ (1,0) [0|1] "" CADM,SGW
 SG_ ACC_DistSwInc : 86|1@0+ (1,0) [0|1] "" CADM,SGW
 SG_ ACC_On : 85|1@0+ (1,0) [0|1] "" BSM,CADM,SGW
 SG_ AcceleratorSts : 110|1@0+ (1,0) [0|1] "" BSM,CADM,ECM,SGW
 SG_ CRC_BCM13 : 191|8@0+ (1,0) [0|255] "-" BSM,CADM,ECM
 SG_ CRC_CSWC_1 : 103|8@0+ (1,0) [0|255] "" Vector__XXX
 SG_ CruiseControlFailSts : 107|1@0+ (1,0) [0|1] "" CADM
 SG_ CruiseControlOnOffSts : 111|1@0+ (1,0) [0|1] "" BSM,CADM,SGW
 SG_ CrusCnclSwitch : 84|1@0+ (1,0) [0|1] "" BSM,CADM,SGW
 SG_ DeceleratorSts : 109|1@0+ (1,0) [0|1] "" BSM,CADM,ECM,SGW
 SG_ MC_CSWC_1 : 95|4@0+ (1,0) [0|15] "" Vector__XXX
 SG_ MessageCounter_BCM13 : 179|4@0+ (1,0) [0|15] "-" BSM,CADM,ECM
 SG_ ResumeSwitch : 108|1@0+ (1,0) [0|1] "" BSM,CADM,ECM,SGW

BO_ 736 BCM_FD_14: 32 BCM
 SG_ Command_01Sts : 75|2@0+ (1,0) [0|2] "" CADM,SGW
 SG_ Command_02Sts : 73|2@0+ (1,0) [0|2] "" CADM,SGW
 SG_ Command_03Sts : 87|2@0+ (1,0) [0|2] "" CADM,SGW
 SG_ Command_04Sts : 85|2@0+ (1,0) [0|2] "" CADM,SGW
 SG_ Command_05Sts : 83|2@0+ (1,0) [0|2] "" CADM,SGW
 SG_ Command_06Sts : 81|2@0+ (1,0) [0|2] "" CADM,SGW
 SG_ Command_07Sts : 95|2@0+ (1,0) [0|2] "" CADM,SGW
 SG_ Command_08Sts : 93|2@0+ (1,0) [0|2] "" CADM,SGW
 SG_ Command_09Sts : 91|2@0+ (1,0) [0|2] "" CADM,SGW
 SG_ Command_10Sts : 89|2@0+ (1,0) [0|2] "" CADM,IPC,SGW
 SG_ Command_11Sts : 103|2@0+ (1,0) [0|2] "" CADM,IPC,SGW
 SG_ Command_12Sts : 101|2@0+ (1,0) [0|2] "" CADM,IPC,SGW
 SG_ Command_13Sts : 99|2@0+ (1,0) [0|2] "" CADM,IPC,SGW
 SG_ Command_14Sts : 97|2@0+ (1,0) [0|2] "" CADM,IPC,SGW
 SG_ Command_15Sts : 111|2@0+ (1,0) [0|2] "" CADM,ECM,IPC,SGW
 SG_ CRC_BCM14 : 191|8@0+ (1,0) [0|255] "-" CADM,IPC
 SG_ MessageCounter_BCM14 : 179|4@0+ (1,0) [0|15] "-" CADM,IPC

BO_ 512 BCM_FD_18: 32 BCM
 SG_ BonnetAjarRawValSts_8 : 15|8@0+ (0.019607843,0) [0|4.999999965] "Volt" ECM,EVCU2
 SG_ CRC_BCM18 : 191|8@0+ (1,0) [0|255] "-" BSM,ECM,EVCU2,HCP,TCM
 SG_ DriverDoor2AjarRawValSts_8 : 7|8@0+ (0.019607843,0) [0|4.999999965] "Volt" ECM,TCM
 SG_ DriverDoor2AjarXtionSts : 37|2@0+ (1,0) [0|3] "-" ECM
 SG_ DriverDoorAjarRawValSts_8 : 31|8@0+ (0.019607843,0) [0|4.999999965] "Volt" ECM,TCM
 SG_ DriverDoorAjarXtionSts : 39|2@0+ (1,0) [0|3] "-" ECM
 SG_ DRV_DR_UNLOCKING : 183|1@0+ (1,0) [0|1] "-" EVCU2
 SG_ LeakCheckTimerExpired : 73|2@0+ (1,0) [0|0] "" ECM
 SG_ MessageCounter_BCM18 : 179|4@0+ (1,0) [0|15] "-" BSM,ECM,EVCU2,HCP,TCM
 SG_ PsngrDoorAjarRawValSts : 23|8@0+ (0.019607843,0) [0|4.999999965] "Volt" Vector__XXX

BO_ 256 BCM_FD_2: 32 BCM
 SG_ BrkPdlStat_BCM : 6|2@0+ (1,0) [0|2] "" RFHM
 SG_ CRC_BCM2 : 191|8@0+ (1,0) [0|255] "-" AGSM,BSM,CADM,DMSM,ECM,EVCU2,HCP,IPC,TCM
 SG_ EngineOffRequest : 119|1@0+ (1,0) [0|1] "-" ECM
 SG_ KeyInIgnSts : 106|2@0+ (1,0) [0|2] "" EVCU2,HCP,SGW
 SG_ MessageCounter_BCM2 : 179|4@0+ (1,0) [0|15] "-" AGSM,BSM,CADM,DMSM,ECM,EVCU2,HCP,IPC,TCM
 SG_ OperationalModeSts : 75|4@0+ (1,0) [0|15] "" AGSM,BSM,CADM,DMSM,DTCM,ECM,GNMM,HCP,IPC,RFHM,SGW,TCM
 SG_ RefuelRequest : 19|2@0+ (1,0) [0|3] "" ECM
 SG_ RemStActvSts : 107|1@0+ (1,0) [0|1] "" CADM,EVCU2,IPC,RFHM,SGW
 SG_ RemStActvSts_R : 7|1@0+ (1,0) [0|1] "" DTCM,ECM,EVCU2,TCM
 SG_ SCCActvSts : 104|1@0+ (1,0) [0|1] "" AGSM,EVCU2,IPC,RFHM,SGW
 SG_ StartRelayBCMFault : 108|1@0+ (1,0) [0|1] "" ECM,SGW
 SG_ StartRelayBCMSts : 109|1@0+ (1,0) [0|1] "" ECM
 SG_ TurnIndicatorSts : 95|2@0+ (1,0) [0|3] "-" CADM,IPC,SGW

BO_ 164 BCM_FD_20: 32 BCM
 SG_ PFTM_Stat : 7|4@0+ (1,0) [0|15] "-" IPC
 SG_ PTG_Stat : 87|4@0+ (1,0) [0|14] "-" IPC

BO_ 1826 BCM_FD_21: 32 BCM
 SG_ Bed_Lighting_Stat : 4|1@0+ (1,0) [0|1] "" Vector__XXX
 SG_ CargoLamp_Stat : 7|1@0+ (1,0) [0|1] "" IPC
 SG_ Rr_Guide_Lgt_Stat : 3|1@0+ (1,0) [0|1] "" IPC
 SG_ UTL_CARGO_COMB : 6|1@0+ (1,0) [0|1] "" Vector__XXX

BO_ 602 BCM_FD_22: 32 BCM
 SG_ CRC_BCM22 : 191|8@0+ (1,0) [0|255] "-" CADM,EVCU2
 SG_ FL_HS_STATFailSts : 21|1@0+ (1,0) [0|1] "" EVCU2,SGW
 SG_ FL_HS_STATSts : 23|2@0+ (1,0) [0|3] "" EVCU2,SGW
 SG_ FR_HS_STATFailSts : 16|1@0+ (1,0) [0|1] "" EVCU2,SGW
 SG_ FR_HS_STATSts : 18|2@0+ (1,0) [0|3] "" EVCU2,SGW
 SG_ HiBmLvr_Stat : 10|2@0+ (1,0) [0|2] "" CADM,EVCU2,IPC
 SG_ MessageCounter_BCM22 : 179|4@0+ (1,0) [0|15] "-" CADM,EVCU2
 SG_ TurnLeverLatched : 8|1@0+ (1,0) [0|1] "" CADM
 SG_ WprSw6Posn : 5|4@0+ (1,0) [0|14] "" CADM

BO_ 1434 BCM_FD_23: 32 BCM
 SG_ BCM_AUX1_HLEnbl : 27|1@0+ (1,0) [0|1] "" Vector__XXX
 SG_ BCM_AUX1_PWRMD : 31|1@0+ (1,0) [0|1] "" Vector__XXX
 SG_ BCM_AUX1_Type : 0|1@0+ (1,0) [0|1] "" Vector__XXX
 SG_ BCM_AUX2_HLEnbl : 26|1@0+ (1,0) [0|1] "" Vector__XXX
 SG_ BCM_AUX2_PWRMD : 30|1@0+ (1,0) [0|1] "" Vector__XXX
 SG_ BCM_AUX2_Type : 10|1@0+ (1,0) [0|1] "" Vector__XXX
 SG_ BCM_AUX3_HLEnbl : 25|1@0+ (1,0) [0|1] "" Vector__XXX
 SG_ BCM_AUX3_PWRMD : 29|1@0+ (1,0) [0|1] "" Vector__XXX
 SG_ BCM_AUX3_Type : 9|1@0+ (1,0) [0|1] "" Vector__XXX
 SG_ BCM_AUX4_HLEnbl : 24|1@0+ (1,0) [0|1] "" Vector__XXX
 SG_ BCM_AUX4_PWRMD : 28|1@0+ (1,0) [0|1] "" Vector__XXX
 SG_ BCM_AUX4_Type : 8|1@0+ (1,0) [0|1] "" Vector__XXX
 SG_ BCM_AUX5_HLEnbl : 62|1@0+ (1,0) [0|1] "" Vector__XXX
 SG_ BCM_AUX5_PWRMD : 32|1@0+ (1,0) [0|1] "" Vector__XXX
 SG_ BCM_AUX5_Type : 34|1@0+ (1,0) [0|1] "" Vector__XXX
 SG_ BCM_AUX6_HLEnbl : 61|1@0+ (1,0) [0|1] "" Vector__XXX
 SG_ BCM_AUX6_PWRMD : 63|1@0+ (1,0) [0|1] "" Vector__XXX
 SG_ BCM_AUX6_Type : 33|1@0+ (1,0) [0|1] "" Vector__XXX
 SG_ Cfg_Aux_PTO : 39|3@0+ (1,0) [0|6] "" Vector__XXX
 SG_ GeneratorModeActive : 65|1@0+ (1,0) [0|1] "" IPC,SGW
 SG_ GeneratorModeSwitch : 105|1@0+ (1,0) [0|1] "" SGW
 SG_ HRLS_Ambient_Light_Level : 23|8@0+ (20,0) [0|5080] "LUX" IPC
 SG_ INV_CARGO_OnState : 12|2@0+ (1,0) [0|2] "" IPC
 SG_ PowerDraw : 103|5@0+ (100,0) [0|3100] "W" ECM,HCP,SGW
 SG_ PSS_Display : 183|4@0+ (1,0) [0|14] "" IPC
 SG_ Radio_Theme : 87|8@0+ (1,0) [0|254] "-" IPC
 SG_ VehAcc_Display : 95|4@0+ (1,0) [0|15] "" IPC
 SG_ Worksite_Inverter_Active : 64|1@0+ (1,0) [0|1] "" ECM,HCP,SGW
 SG_ Worksite_Inverter_RadioSwitch : 98|1@0+ (1,0) [0|1] "" SGW

BO_ 1069 BCM_FD_24: 32 BCM
 SG_ CRC_BCM24 : 191|8@0+ (1,0) [0|255] "-" BSM,IPC
 SG_ FronWasherSts : 147|1@0+ (1,0) [0|1] "" Vector__XXX
 SG_ HazardCluster : 148|1@0+ (1,0) [0|1] "" IPC
 SG_ MessageCounter_BCM24 : 179|4@0+ (1,0) [0|15] "-" BSM,IPC
 SG_ ReverseLamp : 137|1@0+ (1,0) [0|1] "" SGW

BO_ 603 BCM_FD_25: 32 BCM
 SG_ HVACDRVTemp : 79|6@0+ (1,0) [0|63] "°" SGW
 SG_ HVACPSNTemp : 87|6@0+ (1,0) [0|63] "°" SGW

BO_TX_BU_ 204 : ECM,EVCU2;
CM_ SG_ 1445 ADC_Stat_2 "Active damping control status";
CM_ SG_ 1445 ADS_SrvSys "ADS service system; True = [1]";
CM_ SG_ 1445 ASCM_HMI_Stat "ASCM HMI status";
CM_ SG_ 1445 ASCM_RemStat "ASCM remote lowering status";
CM_ SG_ 1445 ASCM_Srv "Service air suspension; 1 = True";
CM_ SG_ 1445 ASCM_Stat "Air suspension status";
CM_ SG_ 1445 ASCM_StatDisp "Air suspension status for display";
CM_ SG_ 1445 ASCM_SysFail "Loss of function - system fault; 1 = True";
CM_ SG_ 1445 ASCM_SYSFAIL_HMI "Sysfail Speed Indications";
CM_ SG_ 1445 CRC_ASCM2 "CRC according to SAE J1850 standard at each frame transmission.";
CM_ SG_ 1445 Loading_Lv "Loading level";
CM_ SG_ 1445 MessageCounter_ASCM2 "This signal is a counter used for safety checks strategies. This counter is incremented of 1 (one) unit at each frame transmission.";
CM_ SG_ 1445 Tgt_Level "Target Level";
CM_ SG_ 1445 TJM_Enbl "Tire jack mode; 1 = True";
CM_ SG_ 204 Axle_Torque_DrvReqMod "Driver requested Axle torque raw (no torque shaping)";
CM_ SG_ 204 Axle_TorqueStatic_D_TTC "Driver requested Axle torque (filtered/ torque shaped)";
CM_ SG_ 204 CRC_AXLE_TORQUE_FD_1 "CRC according to SAE J1850 standard at each frame transmission.";
CM_ SG_ 204 Front_Axle_Est_Regen_Torq "Estimated regen Braking Torque at the Front axle";
CM_ SG_ 204 Front_Axle_Regen_Capacity "Regenerative Braking front Axle Torque Capability";
CM_ SG_ 204 Front_AxleTorque_Max "Maximum front Axle torque";
CM_ SG_ 204 Front_AxleTorque_Min "Minimum front Axle torque";
CM_ SG_ 204 MaxRegen_Diff_Axle_Torq "Difference between Max Regen and normal coasting torques";
CM_ SG_ 204 MaxRegen_Diff_Axle_Torq_Active "Max Regen torque request; Active = [1]";
CM_ SG_ 204 MessageCounter_AXLE_TORQUE_FD_1 "This signal is a counter used for safety checks strategies. This counter is incremented of 1 (one) unit at each frame transmission.";
CM_ SG_ 204 Rear_Axle_Est_Regen_Torq "Estimated regen Braking Torque at the Rear axle";
CM_ SG_ 204 Rear_Axle_Regen_Capacity "Regenerative Braking rear Axle Torque Capability";
CM_ SG_ 204 Rear_AxleTorque_Max "Maximum rear Axle torque";
CM_ SG_ 204 Rear_AxleTorque_Min "Minimum rear Axle torque";
CM_ SG_ 204 Total_AxleTorque_Max "Maximum total Axle torque";
CM_ SG_ 204 Total_AxleTorque_Min "Minimum total Axle torque";
CM_ SG_ 1153 CmdIgnSts "Used to give information about the key selector position";
CM_ SG_ 1153 CompressorACReqSts "This signal is sent from BCM to ECM to inform of Compressor AC activation request";
CM_ SG_ 1153 CRC_BCM10 "CRC according to SAE J1850 standard at each frame transmission.";
CM_ SG_ 1153 DAY_LGT_MD "Day light brightness mode; Night=[0], Day=[1]";
CM_ SG_ 1153 ExteriorRearReleaseSwitchSts "Used to give rear access button press info to the body controller to allow releasing the rear access point";
CM_ SG_ 1153 ExternalTemperatureC "Used to indicate the external temperature value in °C";
CM_ SG_ 1153 ExternalTemperatureF "Used to indicate the external temperature value in °F";
CM_ SG_ 1153 FOA_Mobile_App_Alert "Forgotten Object Alert mobile alert";
CM_ SG_ 1153 FOA_Msg_Req "Represents Message request to display on HMI for Forgotten Object Alert";
CM_ SG_ 1153 FOBSearchRequest "Signal used to request the FOB searching.";
CM_ SG_ 1153 MessageCounter_BCM10 "This signal is a counter used for safety checks strategies. This counter is incremented of 1 (one) unit at each frame transmission.";
CM_ SG_ 1153 PANEL_INTS "Panel-/display intensity";
CM_ SG_ 1153 RemSt_InhibitSts "Remote start inhibit";
CM_ SG_ 1153 SCC_InhibitSts "SCC_InhibitSts";
CM_ SG_ 1153 SpSt_Pad1 "Stop Start Button Press 1";
CM_ SG_ 1153 WPR_SYS_AUTO "Wiper system auto; [1] = Auto wipers equipped";
CM_ SG_ 1430 A2D_DRV_TEMP_DR_POS "Transmit raw A/D driver temp door position to ECM, the information is used to make OBD model more robust";
CM_ SG_ 1430 AcOutputCurrentSts "It is the ECVD electrovalve current";
CM_ SG_ 1430 Batt_ST_Crit "Battery reached critical state";
CM_ SG_ 1430 CMP_DIR "Compass direction";
CM_ SG_ 1430 CRC_BCM11 "CRC according to SAE J1850 standard at each frame transmission.";
CM_ SG_ 1430 DSM_PDL_LKOUT "DSM_PDL_LKOUT";
CM_ SG_ 1430 EngineOffTimer "Engine off timer - engine off ignition NOT lock.";
CM_ SG_ 1430 Gate_Req_PE "Gate passive entry requested";
CM_ SG_ 1430 MessageCounter_BCM11 "This signal is a counter used for safety checks strategies. This counter is incremented of 1 (one) unit at each frame transmission.";
CM_ SG_ 1430 MF_SWG_AJAR "Multifunction Swing Gate ajar";
CM_ SG_ 1430 PanicModeActive "Panic Status";
CM_ SG_ 1430 Parallel_Prk_Ast_Pad1 "Parallel Park Assist Pad 1 switch state";
CM_ SG_ 1430 PFTM_Req_PE "Hood passive entry requested";
CM_ SG_ 1430 PN14_LS_Actv "14 V powernet Load Shed active";
CM_ SG_ 1430 PN14_LS_Lvl7 "Load Shedding level7";
CM_ SG_ 1430 StopStartClimateInfo "HVAC conditions effecting stop start enable";
CM_ SG_ 1431 AirTemp_Outsd "Outside air temperature";
CM_ SG_ 1431 APARequestSts "It indicates the pressure of Advanced Park Assist pushbutton";
CM_ SG_ 1431 AxleLckrSEL_SW "AxleLckrSEL_SW";
CM_ SG_ 1431 CRC_BCM12 "CRC according to SAE J1850 standard at each frame transmission.";
CM_ SG_ 1431 DALM_Status "DALM status";
CM_ SG_ 1431 GlobDrvMdRq_BCM "Global drive mode status";
CM_ SG_ 1431 IGN_OFF_TIME_LNG "Time since last ignition on (long)";
CM_ SG_ 1431 Left_Button_BCM "Signal indicates Customer pressed Left terrain switch";
CM_ SG_ 1431 MessageCounter_BCM12 "This signal is a counter used for safety checks strategies. This counter is incremented of 1 (one) unit at each frame transmission.";
CM_ SG_ 1431 PaddlesModeReq "Requested state of paddle lock-out function";
CM_ SG_ 1431 PAMRequestSts "It indicates the pressure of Park Assist pushbutton";
CM_ SG_ 1431 Right_Button_BCM "Signal indicates Customer pressed Right terrain switch";
CM_ SG_ 1431 SeatVib_Sts "Seat vibration status";
CM_ SG_ 1431 Switch_2WD_Rq "Transfer case 2WD request";
CM_ SG_ 1431 Switch_4AUTO_Rq "Transfer case 4WD AUTO request";
CM_ SG_ 1431 Switch_4LOCK_Rq "Transfer case 4WD LOCK request";
CM_ SG_ 1431 Switch1_Rq "Used to require the activation of the related feature";
CM_ SG_ 1431 Switch2_Rq "Used to require the activation of the related feature";
CM_ SG_ 1431 TerrainModeInterfaceButton_BCM "Signal Indicates G/T or TRX Button activated or Not Activated by driver";
CM_ SG_ 1431 Tow_Request "Tow Switch Request";
CM_ SG_ 1431 TRAC_PSD "Traction on/off button pressed; [0] = Not Pressed, [1] = Pressed";
CM_ SG_ 1431 Trns_DrvMdReq_BCM "The requested state of the drive mode feature";
CM_ SG_ 159 ACC_DistSwDec "ACC distance switch decrement";
CM_ SG_ 159 ACC_DistSwInc "ACC distance switch increment";
CM_ SG_ 159 ACC_On "ACC on/off";
CM_ SG_ 159 AcceleratorSts "This signal is used to give information about cruise control accelerator button activation.";
CM_ SG_ 159 CRC_BCM13 "CRC according to SAE J1850 standard at each frame transmission.";
CM_ SG_ 159 CRC_CSWC_1 "CRC according to SAE J1850 standard that has to be calculated from bit 63 to bit 48 at each frame transmission.";
CM_ SG_ 159 CruiseControlFailSts "This signal is used to give information about a fault on cruise control commands";
CM_ SG_ 159 CruiseControlOnOffSts "This signal is used to give information about cruise control on/off button activation .";
CM_ SG_ 159 CrusCnclSwitch "Cruise Switch:  Cancel Pressed.";
CM_ SG_ 159 DeceleratorSts "This signal is used to give information about cruise control decelerator button activation.";
CM_ SG_ 159 MC_CSWC_1 "This signal is a counter used for safety checks strategies. This counter is incremented of 1 (one) unit at each frame transmission.";
CM_ SG_ 159 MessageCounter_BCM13 "This signal is a counter used for safety checks strategies. This counter is incremented of 1 (one) unit at each frame transmission.";
CM_ SG_ 159 ResumeSwitch "This signal is used to give information about cruise control RESUME button activation.";
CM_ SG_ 736 Command_01Sts "Infotainment Switch 1";
CM_ SG_ 736 Command_02Sts "Infotainment Switch 2";
CM_ SG_ 736 Command_03Sts "Infotainment Switch 3";
CM_ SG_ 736 Command_04Sts "Infotainment Switch 4";
CM_ SG_ 736 Command_05Sts "Infotainment Switch 5";
CM_ SG_ 736 Command_06Sts "Infotainment Switch 6";
CM_ SG_ 736 Command_07Sts "Infotainment Switch 7";
CM_ SG_ 736 Command_08Sts "Infotainment Switch 8";
CM_ SG_ 736 Command_09Sts "Infotainment Switch 9";
CM_ SG_ 736 Command_10Sts "Infotainment Switch 10";
CM_ SG_ 736 Command_11Sts "Infotainment Switch 11";
CM_ SG_ 736 Command_12Sts "Infotainment Switch 12";
CM_ SG_ 736 Command_13Sts "Infotainment Switch 13";
CM_ SG_ 736 Command_14Sts "Infotainment Switch 14";
CM_ SG_ 736 Command_15Sts "Infotainment Switch 15";
CM_ SG_ 736 CRC_BCM14 "CRC according to SAE J1850 standard at each frame transmission.";
CM_ SG_ 736 MessageCounter_BCM14 "This signal is a counter used for safety checks strategies. This counter is incremented of 1 (one) unit at each frame transmission.";
CM_ SG_ 512 BonnetAjarRawValSts_8 "The signal gives info on Bonnet ajar input to engine controller to use for stop-start and do diagnosis in the engine controller.";
CM_ SG_ 512 CRC_BCM18 "CRC according to SAE J1850 standard at each frame transmission.";
CM_ SG_ 512 DriverDoor2AjarRawValSts_8 "Driver door status value";
CM_ SG_ 512 DriverDoor2AjarXtionSts "Driver door status change";
CM_ SG_ 512 DriverDoorAjarRawValSts_8 "The signal gives info on Driver Door ajar input to engine controller to use for stop-start and do diagnosis in the engine controller.";
CM_ SG_ 512 DriverDoorAjarXtionSts "Driver door status change";
CM_ SG_ 512 DRV_DR_UNLOCKING "This signal describe the actuation state of driver door unlock switch";
CM_ SG_ 512 LeakCheckTimerExpired "Status of leak test timer";
CM_ SG_ 512 MessageCounter_BCM18 "This signal is a counter used for safety checks strategies. This counter is incremented of 1 (one) unit at each frame transmission.";
CM_ SG_ 512 PsngrDoorAjarRawValSts "The signal gives info on psngr Door ajar input to engine controller to use for stop-start and do diagnosis in the engine controller.";
CM_ SG_ 256 BrkPdlStat_BCM "Brake pedal state reported by CBC";
CM_ SG_ 256 CRC_BCM2 "CRC according to SAE J1850 standard at each frame transmission.";
CM_ SG_ 256 EngineOffRequest "The signal is used to require an  engine shut off";
CM_ SG_ 256 KeyInIgnSts "Key in ignition status";
CM_ SG_ 256 MessageCounter_BCM2 "This signal is a counter used for safety checks strategies. This counter is incremented of 1 (one) unit at each frame transmission.";
CM_ SG_ 256 RefuelRequest "Driver has initiated a refueling event";
CM_ SG_ 256 RemStActvSts "Redundant Remote Start Active Status";
CM_ SG_ 256 RemStActvSts_R "Redundant Remote Start Active Status";
CM_ SG_ 256 SCCActvSts "SCCActvSts";
CM_ SG_ 256 StartRelayBCMFault "BCM starter relay fault detected";
CM_ SG_ 256 StartRelayBCMSts "BCM starter relay status; [1] = ON";
CM_ SG_ 256 TurnIndicatorSts "The signal is used to indicate the turn indicator position.";
CM_ SG_ 164 PFTM_Stat "This signal is used to indicate to the customer a reason for or a solution to the power front trunk not operating normally";
CM_ SG_ 164 PTG_Stat "Multifunction Swing Gate ajar";
CM_ SG_ 1826 Bed_Lighting_Stat "Bed Lighting Status";
CM_ SG_ 1826 CargoLamp_Stat "Cargo Light Status";
CM_ SG_ 1826 Rr_Guide_Lgt_Stat "Rear Guidance Light Status";
CM_ SG_ 1826 UTL_CARGO_COMB "Utility and Cargo Light Combined Status";
CM_ SG_ 602 CRC_BCM22 "CRC according to SAE J1850 standard at each frame transmission.";
CM_ SG_ 602 FL_HS_STATFailSts "It indicates a fail in Front Left heated seat";
CM_ SG_ 602 FL_HS_STATSts "Front left heated seat status";
CM_ SG_ 602 FR_HS_STATFailSts "It indicates a fail in Front Right heated seat";
CM_ SG_ 602 FR_HS_STATSts "Front right heated seat status";
CM_ SG_ 602 HiBmLvr_Stat "Indicate High Beam Lever Position";
CM_ SG_ 602 MessageCounter_BCM22 "This signal is a counter used for safety checks strategies. This counter is incremented of 1 (one) unit at each frame transmission.";
CM_ SG_ 602 TurnLeverLatched "Indicate if Turn Lever is in a Latched Position";
CM_ SG_ 602 WprSw6Posn "Wiper switch (6 stages) position";
CM_ SG_ 1434 BCM_AUX1_HLEnbl "Aux switch 1 enable holding last state";
CM_ SG_ 1434 BCM_AUX1_PWRMD "Aux switch 1 power mode";
CM_ SG_ 1434 BCM_AUX1_Type "Aux switch 1 behavior";
CM_ SG_ 1434 BCM_AUX2_HLEnbl "Aux switch 2 enable holding last state";
CM_ SG_ 1434 BCM_AUX2_PWRMD "Aux switch 2 power mode";
CM_ SG_ 1434 BCM_AUX2_Type "Aux switch 2 behavior";
CM_ SG_ 1434 BCM_AUX3_HLEnbl "Aux switch 3 enable holding last state";
CM_ SG_ 1434 BCM_AUX3_PWRMD "Aux switch 3 power mode";
CM_ SG_ 1434 BCM_AUX3_Type "Aux switch 3 behavior";
CM_ SG_ 1434 BCM_AUX4_HLEnbl "Aux switch 4 enable holding last state";
CM_ SG_ 1434 BCM_AUX4_PWRMD "Aux switch 4 power mode";
CM_ SG_ 1434 BCM_AUX4_Type "Aux switch 4 behavior";
CM_ SG_ 1434 BCM_AUX5_HLEnbl "1= Enabled";
CM_ SG_ 1434 BCM_AUX5_PWRMD "0 = Latching
1 = Momentary";
CM_ SG_ 1434 BCM_AUX5_Type "0 = Latching
1 = Momentary";
CM_ SG_ 1434 BCM_AUX6_HLEnbl "1= Enabled";
CM_ SG_ 1434 BCM_AUX6_PWRMD "0 = Latching
1 = Momentary";
CM_ SG_ 1434 BCM_AUX6_Type "0 = Latching
1 = Momentary";
CM_ SG_ 1434 Cfg_Aux_PTO "AUX Switches Configuration";
CM_ SG_ 1434 GeneratorModeActive "Generator Mode active status";
CM_ SG_ 1434 GeneratorModeSwitch "Generator Mode Switch; [1]= ON";
CM_ SG_ 1434 HRLS_Ambient_Light_Level "HRLS Ambient Light Level";
CM_ SG_ 1434 INV_CARGO_OnState "01 =cargo outlet is disabled, 10 = cargo outlet is enabled";
CM_ SG_ 1434 PowerDraw "Power draw from the inverter";
CM_ SG_ 1434 Radio_Theme "Radio Theme";
CM_ SG_ 1434 VehAcc_Display "VehAcc Display";
CM_ SG_ 1434 Worksite_Inverter_Active "Inverter active status";
CM_ SG_ 1434 Worksite_Inverter_RadioSwitch "Inverter Soft Button switch; [1] = ON";
CM_ SG_ 1069 CRC_BCM24 "CRC according to SAE J1850 standard at each frame transmission.";
CM_ SG_ 1069 FronWasherSts "Wiper System Wash.";
CM_ SG_ 1069 HazardCluster "Request Hazard Cluster Telltale";
CM_ SG_ 1069 MessageCounter_BCM24 "This signal is a counter used for safety checks strategies. This counter is incremented of 1 (one) unit at each frame transmission.";
CM_ SG_ 1069 ReverseLamp "Indicate if Reverse Lamps is active";
CM_ SG_ 603 HVACDRVTemp "Front driver temperature status";
CM_ SG_ 603 HVACPSNTemp "Front passenger temperature status";

BA_DEF_ SG_ "GenSigStartValue" INT 0 2147483647;
BA_DEF_ SG_ "GenSigInactiveValue" INT 0 2147483647;
BA_DEF_ SG_ "GenSigSendType" ENUM "NotUsed","OnWrite","OnWriteWithRepetition","OnChange","OnChangeWithRepetition","IfActive","IfActiveWithRepetition","NoSigSendType";
BA_DEF_ SG_ "SystemSignalLongSymbol" STRING ;
BA_DEF_ SG_ "GenSigTimeoutTime_AGSM" INT 0 65535;
BA_DEF_ SG_ "GenSigTimeoutTime_BCM" INT 0 65535;
BA_DEF_ SG_ "GenSigTimeoutTime_BSM" INT 0 65535;
BA_DEF_ SG_ "GenSigTimeoutTime_CADM" INT 0 65535;
BA_DEF_ SG_ "GenSigTimeoutTime_DMSM" INT 0 65535;
BA_DEF_ SG_ "GenSigTimeoutTime_DTCM" INT 0 65535;
BA_DEF_ SG_ "GenSigTimeoutTime_ECM" INT 0 65535;
BA_DEF_ SG_ "GenSigTimeoutTime_EVCU2" INT 0 65535;
BA_DEF_ SG_ "GenSigTimeoutTime_GNMM" INT 0 65535;
BA_DEF_ SG_ "GenSigTimeoutTime_HCP" INT 0 65535;
BA_DEF_ SG_ "GenSigTimeoutTime_IPC" INT 0 65535;
BA_DEF_ SG_ "GenSigTimeoutTime_RFHM" INT 0 65535;
BA_DEF_ SG_ "GenSigTimeoutTime_SGW" INT 0 65535;
BA_DEF_ SG_ "GenSigTimeoutTime_TCM" INT 0 65535;
BA_DEF_ BO_ "DiagRequest" ENUM "No","Yes";
BA_DEF_ BO_ "Type" ENUM "P","C","PE","COC","PE_Cntrl","E","E_Cntrl","OC","S","BAF","DC","EM","MM","ISO-TP","-";
BA_DEF_ BO_ "DiagResponse" ENUM "No","Yes";
BA_DEF_ BO_ "NmMessage" ENUM "No","Yes";
BA_DEF_ BO_ "GenMsgSendType" ENUM "Cyclic","NotUsed","NotUsed","NotUsed","NotUsed","NotUsed","NotUsed","NotUsed","NoMsgSendType";
BA_DEF_ BO_ "GenMsgNrOfRepetition" INT 0 255;
BA_DEF_ BO_ "GenMsgILSupport" ENUM "No","Yes";
BA_DEF_ BO_ "GenMsgStartDelayTime" INT 0 65535;
BA_DEF_ BO_ "GenMsgCycleTimeFast" INT 0 65535;
BA_DEF_ BO_ "GenMsgCycleTime" INT 0 65535;
BA_DEF_ BO_ "GenMsgDelayTime" INT 0 65535;
BA_DEF_ BO_ "NmAsrMessage" ENUM "No","Yes";
BA_DEF_ BO_ "DiagState" ENUM "No","Yes";
BA_DEF_ BO_ "DiagConnection" HEX 0 65535;
BA_DEF_ BO_ "VFrameFormat" ENUM "StandardCAN","ExtendedCAN","reserved","reserved","reserved","reserved","reserved","reserved","reserved","reserved","reserved","reserved","reserved","reserved","StandardCAN_FD","ExtendedCAN_FD";
BA_DEF_ BO_ "CANFD_BRS" ENUM "0","1";
BA_DEF_DEF_ "DiagRequest" "No";
BA_DEF_DEF_ "Type" "-";
BA_DEF_DEF_ "DiagResponse" "No";
BA_DEF_DEF_ "NmMessage" "No";
BA_DEF_DEF_ "GenMsgSendType" "NoMsgSendType";
BA_DEF_DEF_ "GenMsgNrOfRepetition" 0;
BA_DEF_DEF_ "GenMsgILSupport" "No";
BA_DEF_DEF_ "GenMsgStartDelayTime" 0;
BA_DEF_DEF_ "GenMsgCycleTimeFast" 0;
BA_DEF_DEF_ "GenMsgCycleTime" 0;
BA_DEF_DEF_ "GenMsgDelayTime" 0;
BA_DEF_DEF_ "NmAsrMessage" "No";
BA_DEF_DEF_ "DiagState" "No";
BA_DEF_DEF_ "DiagConnection" 0;
BA_DEF_DEF_ "VFrameFormat" "StandardCAN_FD";
BA_DEF_DEF_ "CANFD_BRS" "0";
BA_DEF_DEF_ "GenSigStartValue" 0;
BA_DEF_DEF_ "GenSigInactiveValue" 0;
BA_DEF_DEF_ "GenSigSendType" "NoSigSendType";
BA_DEF_DEF_ "SystemSignalLongSymbol" "";
BA_DEF_DEF_ "GenSigTimeoutTime_AGSM" 2500;
BA_DEF_DEF_ "GenSigTimeoutTime_BCM" 2500;
BA_DEF_DEF_ "GenSigTimeoutTime_BSM" 2500;
BA_DEF_DEF_ "GenSigTimeoutTime_CADM" 2500;
BA_DEF_DEF_ "GenSigTimeoutTime_DMSM" 2500;
BA_DEF_DEF_ "GenSigTimeoutTime_DTCM" 2500;
BA_DEF_DEF_ "GenSigTimeoutTime_ECM" 2500;
BA_DEF_DEF_ "GenSigTimeoutTime_EVCU2" 2500;
BA_DEF_DEF_ "GenSigTimeoutTime_GNMM" 2500;
BA_DEF_DEF_ "GenSigTimeoutTime_HCP" 2500;
BA_DEF_DEF_ "GenSigTimeoutTime_IPC" 2500;
BA_DEF_DEF_ "GenSigTimeoutTime_RFHM" 2500;
BA_DEF_DEF_ "GenSigTimeoutTime_SGW" 2500;
BA_DEF_DEF_ "GenSigTimeoutTime_TCM" 2500;
BA_ "Type" BO_ 1445 3;
BA_ "GenMsgSendType" BO_ 1445 0;
BA_ "GenMsgNrOfRepetition" BO_ 1445 2;
BA_ "GenMsgILSupport" BO_ 1445 1;
BA_ "GenMsgStartDelayTime" BO_ 1445 375;
BA_ "GenMsgCycleTimeFast" BO_ 1445 20;
BA_ "GenMsgCycleTime" BO_ 1445 1000;
BA_ "GenMsgDelayTime" BO_ 1445 20;
BA_ "CANFD_BRS" BO_ 1445 1;
BA_ "Type" BO_ 204 1;
BA_ "GenMsgSendType" BO_ 204 0;
BA_ "GenMsgILSupport" BO_ 204 1;
BA_ "GenMsgCycleTime" BO_ 204 10;
BA_ "CANFD_BRS" BO_ 204 1;
BA_ "Type" BO_ 247 8;
BA_ "GenMsgILSupport" BO_ 247 1;
BA_ "CANFD_BRS" BO_ 247 1;
BA_ "Type" BO_ 1153 3;
BA_ "GenMsgSendType" BO_ 1153 0;
BA_ "GenMsgNrOfRepetition" BO_ 1153 2;
BA_ "GenMsgILSupport" BO_ 1153 1;
BA_ "GenMsgStartDelayTime" BO_ 1153 65;
BA_ "GenMsgCycleTimeFast" BO_ 1153 20;
BA_ "GenMsgCycleTime" BO_ 1153 500;
BA_ "GenMsgDelayTime" BO_ 1153 20;
BA_ "CANFD_BRS" BO_ 1153 1;
BA_ "Type" BO_ 1430 3;
BA_ "GenMsgSendType" BO_ 1430 0;
BA_ "GenMsgNrOfRepetition" BO_ 1430 2;
BA_ "GenMsgILSupport" BO_ 1430 1;
BA_ "GenMsgStartDelayTime" BO_ 1430 380;
BA_ "GenMsgCycleTimeFast" BO_ 1430 20;
BA_ "GenMsgCycleTime" BO_ 1430 1000;
BA_ "GenMsgDelayTime" BO_ 1430 20;
BA_ "CANFD_BRS" BO_ 1430 1;
BA_ "Type" BO_ 1431 3;
BA_ "GenMsgSendType" BO_ 1431 0;
BA_ "GenMsgNrOfRepetition" BO_ 1431 2;
BA_ "GenMsgILSupport" BO_ 1431 1;
BA_ "GenMsgStartDelayTime" BO_ 1431 385;
BA_ "GenMsgCycleTimeFast" BO_ 1431 20;
BA_ "GenMsgCycleTime" BO_ 1431 100;
BA_ "GenMsgDelayTime" BO_ 1431 20;
BA_ "CANFD_BRS" BO_ 1431 1;
BA_ "Type" BO_ 159 11;
BA_ "GenMsgILSupport" BO_ 159 1;
BA_ "GenMsgDelayTime" BO_ 159 50;
BA_ "CANFD_BRS" BO_ 159 1;
BA_ "Type" BO_ 736 7;
BA_ "GenMsgILSupport" BO_ 736 1;
BA_ "GenMsgDelayTime" BO_ 736 20;
BA_ "CANFD_BRS" BO_ 736 1;
BA_ "Type" BO_ 512 1;
BA_ "GenMsgSendType" BO_ 512 0;
BA_ "GenMsgILSupport" BO_ 512 1;
BA_ "GenMsgStartDelayTime" BO_ 512 15;
BA_ "GenMsgCycleTime" BO_ 512 20;
BA_ "CANFD_BRS" BO_ 512 1;
BA_ "Type" BO_ 256 1;
BA_ "GenMsgSendType" BO_ 256 0;
BA_ "GenMsgILSupport" BO_ 256 1;
BA_ "GenMsgCycleTime" BO_ 256 10;
BA_ "CANFD_BRS" BO_ 256 1;
BA_ "Type" BO_ 164 7;
BA_ "GenMsgILSupport" BO_ 164 1;
BA_ "CANFD_BRS" BO_ 164 1;
BA_ "Type" BO_ 1826 1;
BA_ "GenMsgSendType" BO_ 1826 0;
BA_ "GenMsgILSupport" BO_ 1826 1;
BA_ "GenMsgCycleTime" BO_ 1826 1000;
BA_ "CANFD_BRS" BO_ 1826 1;
BA_ "Type" BO_ 602 3;
BA_ "GenMsgSendType" BO_ 602 0;
BA_ "GenMsgNrOfRepetition" BO_ 602 2;
BA_ "GenMsgILSupport" BO_ 602 1;
BA_ "GenMsgStartDelayTime" BO_ 602 50;
BA_ "GenMsgCycleTimeFast" BO_ 602 20;
BA_ "GenMsgCycleTime" BO_ 602 100;
BA_ "GenMsgDelayTime" BO_ 602 20;
BA_ "CANFD_BRS" BO_ 602 1;
BA_ "Type" BO_ 1434 3;
BA_ "GenMsgSendType" BO_ 1434 0;
BA_ "GenMsgNrOfRepetition" BO_ 1434 2;
BA_ "GenMsgILSupport" BO_ 1434 1;
BA_ "GenMsgStartDelayTime" BO_ 1434 390;
BA_ "GenMsgCycleTimeFast" BO_ 1434 20;
BA_ "GenMsgCycleTime" BO_ 1434 1000;
BA_ "GenMsgDelayTime" BO_ 1434 20;
BA_ "CANFD_BRS" BO_ 1434 1;
BA_ "Type" BO_ 1069 3;
BA_ "GenMsgSendType" BO_ 1069 0;
BA_ "GenMsgILSupport" BO_ 1069 1;
BA_ "GenMsgStartDelayTime" BO_ 1069 55;
BA_ "GenMsgCycleTime" BO_ 1069 100;
BA_ "CANFD_BRS" BO_ 1069 1;
BA_ "Type" BO_ 603 3;
BA_ "GenMsgSendType" BO_ 603 0;
BA_ "GenMsgNrOfRepetition" BO_ 603 2;
BA_ "GenMsgILSupport" BO_ 603 1;
BA_ "GenMsgStartDelayTime" BO_ 603 60;
BA_ "GenMsgCycleTimeFast" BO_ 603 20;
BA_ "GenMsgCycleTime" BO_ 603 100;
BA_ "GenMsgDelayTime" BO_ 603 20;
BA_ "CANFD_BRS" BO_ 603 1;
BA_ "GenSigSendType" SG_ 1445 ADC_Stat_2 3;
BA_ "GenSigTimeoutTime_AGSM" SG_ 1445 ADC_Stat_2 0;
BA_ "GenSigTimeoutTime_BCM" SG_ 1445 ADC_Stat_2 0;
BA_ "GenSigTimeoutTime_BSM" SG_ 1445 ADC_Stat_2 0;
BA_ "GenSigTimeoutTime_CADM" SG_ 1445 ADC_Stat_2 0;
BA_ "GenSigTimeoutTime_DMSM" SG_ 1445 ADC_Stat_2 0;
BA_ "GenSigTimeoutTime_DTCM" SG_ 1445 ADC_Stat_2 0;
BA_ "GenSigTimeoutTime_ECM" SG_ 1445 ADC_Stat_2 0;
BA_ "GenSigTimeoutTime_EVCU2" SG_ 1445 ADC_Stat_2 0;
BA_ "GenSigTimeoutTime_GNMM" SG_ 1445 ADC_Stat_2 0;
BA_ "GenSigTimeoutTime_HCP" SG_ 1445 ADC_Stat_2 0;
BA_ "GenSigTimeoutTime_IPC" SG_ 1445 ADC_Stat_2 0;
BA_ "GenSigTimeoutTime_RFHM" SG_ 1445 ADC_Stat_2 0;
BA_ "GenSigTimeoutTime_TCM" SG_ 1445 ADC_Stat_2 0;
BA_ "GenSigSendType" SG_ 1445 ADS_SrvSys 3;
BA_ "GenSigTimeoutTime_AGSM" SG_ 1445 ADS_SrvSys 0;
BA_ "GenSigTimeoutTime_BCM" SG_ 1445 ADS_SrvSys 0;
BA_ "GenSigTimeoutTime_BSM" SG_ 1445 ADS_SrvSys 0;
BA_ "GenSigTimeoutTime_CADM" SG_ 1445 ADS_SrvSys 0;
BA_ "GenSigTimeoutTime_DMSM" SG_ 1445 ADS_SrvSys 0;
BA_ "GenSigTimeoutTime_DTCM" SG_ 1445 ADS_SrvSys 0;
BA_ "GenSigTimeoutTime_ECM" SG_ 1445 ADS_SrvSys 0;
BA_ "GenSigTimeoutTime_EVCU2" SG_ 1445 ADS_SrvSys 0;
BA_ "GenSigTimeoutTime_GNMM" SG_ 1445 ADS_SrvSys 0;
BA_ "GenSigTimeoutTime_HCP" SG_ 1445 ADS_SrvSys 0;
BA_ "GenSigTimeoutTime_RFHM" SG_ 1445 ADS_SrvSys 0;
BA_ "GenSigTimeoutTime_SGW" SG_ 1445 ADS_SrvSys 0;
BA_ "GenSigTimeoutTime_TCM" SG_ 1445 ADS_SrvSys 0;
BA_ "GenSigSendType" SG_ 1445 ASCM_HMI_Stat 3;
BA_ "GenSigTimeoutTime_AGSM" SG_ 1445 ASCM_HMI_Stat 0;
BA_ "GenSigTimeoutTime_BCM" SG_ 1445 ASCM_HMI_Stat 0;
BA_ "GenSigTimeoutTime_BSM" SG_ 1445 ASCM_HMI_Stat 0;
BA_ "GenSigTimeoutTime_CADM" SG_ 1445 ASCM_HMI_Stat 0;
BA_ "GenSigTimeoutTime_DMSM" SG_ 1445 ASCM_HMI_Stat 0;
BA_ "GenSigTimeoutTime_DTCM" SG_ 1445 ASCM_HMI_Stat 0;
BA_ "GenSigTimeoutTime_ECM" SG_ 1445 ASCM_HMI_Stat 0;
BA_ "GenSigTimeoutTime_EVCU2" SG_ 1445 ASCM_HMI_Stat 0;
BA_ "GenSigTimeoutTime_GNMM" SG_ 1445 ASCM_HMI_Stat 0;
BA_ "GenSigTimeoutTime_HCP" SG_ 1445 ASCM_HMI_Stat 0;
BA_ "GenSigTimeoutTime_RFHM" SG_ 1445 ASCM_HMI_Stat 0;
BA_ "GenSigTimeoutTime_SGW" SG_ 1445 ASCM_HMI_Stat 0;
BA_ "GenSigTimeoutTime_TCM" SG_ 1445 ASCM_HMI_Stat 0;
BA_ "GenSigSendType" SG_ 1445 ASCM_RemStat 3;
BA_ "GenSigTimeoutTime_AGSM" SG_ 1445 ASCM_RemStat 0;
BA_ "GenSigTimeoutTime_BCM" SG_ 1445 ASCM_RemStat 0;
BA_ "GenSigTimeoutTime_BSM" SG_ 1445 ASCM_RemStat 0;
BA_ "GenSigTimeoutTime_CADM" SG_ 1445 ASCM_RemStat 0;
BA_ "GenSigTimeoutTime_DMSM" SG_ 1445 ASCM_RemStat 0;
BA_ "GenSigTimeoutTime_DTCM" SG_ 1445 ASCM_RemStat 0;
BA_ "GenSigTimeoutTime_ECM" SG_ 1445 ASCM_RemStat 0;
BA_ "GenSigTimeoutTime_EVCU2" SG_ 1445 ASCM_RemStat 0;
BA_ "GenSigTimeoutTime_GNMM" SG_ 1445 ASCM_RemStat 0;
BA_ "GenSigTimeoutTime_HCP" SG_ 1445 ASCM_RemStat 0;
BA_ "GenSigTimeoutTime_IPC" SG_ 1445 ASCM_RemStat 0;
BA_ "GenSigTimeoutTime_SGW" SG_ 1445 ASCM_RemStat 0;
BA_ "GenSigTimeoutTime_TCM" SG_ 1445 ASCM_RemStat 0;
BA_ "GenSigSendType" SG_ 1445 ASCM_Srv 3;
BA_ "GenSigTimeoutTime_AGSM" SG_ 1445 ASCM_Srv 0;
BA_ "GenSigTimeoutTime_BCM" SG_ 1445 ASCM_Srv 0;
BA_ "GenSigTimeoutTime_BSM" SG_ 1445 ASCM_Srv 0;
BA_ "GenSigTimeoutTime_CADM" SG_ 1445 ASCM_Srv 0;
BA_ "GenSigTimeoutTime_DMSM" SG_ 1445 ASCM_Srv 0;
BA_ "GenSigTimeoutTime_DTCM" SG_ 1445 ASCM_Srv 0;
BA_ "GenSigTimeoutTime_ECM" SG_ 1445 ASCM_Srv 0;
BA_ "GenSigTimeoutTime_EVCU2" SG_ 1445 ASCM_Srv 0;
BA_ "GenSigTimeoutTime_GNMM" SG_ 1445 ASCM_Srv 0;
BA_ "GenSigTimeoutTime_HCP" SG_ 1445 ASCM_Srv 0;
BA_ "GenSigTimeoutTime_RFHM" SG_ 1445 ASCM_Srv 0;
BA_ "GenSigTimeoutTime_TCM" SG_ 1445 ASCM_Srv 0;
BA_ "GenSigSendType" SG_ 1445 ASCM_Stat 3;
BA_ "GenSigTimeoutTime_AGSM" SG_ 1445 ASCM_Stat 0;
BA_ "GenSigTimeoutTime_BCM" SG_ 1445 ASCM_Stat 0;
BA_ "GenSigTimeoutTime_DMSM" SG_ 1445 ASCM_Stat 0;
BA_ "GenSigTimeoutTime_DTCM" SG_ 1445 ASCM_Stat 0;
BA_ "GenSigTimeoutTime_EVCU2" SG_ 1445 ASCM_Stat 0;
BA_ "GenSigTimeoutTime_GNMM" SG_ 1445 ASCM_Stat 0;
BA_ "GenSigTimeoutTime_HCP" SG_ 1445 ASCM_Stat 0;
BA_ "GenSigTimeoutTime_RFHM" SG_ 1445 ASCM_Stat 0;
BA_ "GenSigTimeoutTime_SGW" SG_ 1445 ASCM_Stat 0;
BA_ "GenSigTimeoutTime_TCM" SG_ 1445 ASCM_Stat 0;
BA_ "GenSigSendType" SG_ 1445 ASCM_StatDisp 3;
BA_ "GenSigTimeoutTime_AGSM" SG_ 1445 ASCM_StatDisp 0;
BA_ "GenSigTimeoutTime_BCM" SG_ 1445 ASCM_StatDisp 0;
BA_ "GenSigTimeoutTime_BSM" SG_ 1445 ASCM_StatDisp 0;
BA_ "GenSigTimeoutTime_CADM" SG_ 1445 ASCM_StatDisp 0;
BA_ "GenSigTimeoutTime_DMSM" SG_ 1445 ASCM_StatDisp 0;
BA_ "GenSigTimeoutTime_DTCM" SG_ 1445 ASCM_StatDisp 0;
BA_ "GenSigTimeoutTime_ECM" SG_ 1445 ASCM_StatDisp 0;
BA_ "GenSigTimeoutTime_EVCU2" SG_ 1445 ASCM_StatDisp 0;
BA_ "GenSigTimeoutTime_GNMM" SG_ 1445 ASCM_StatDisp 0;
BA_ "GenSigTimeoutTime_HCP" SG_ 1445 ASCM_StatDisp 0;
BA_ "GenSigTimeoutTime_RFHM" SG_ 1445 ASCM_StatDisp 0;
BA_ "GenSigTimeoutTime_SGW" SG_ 1445 ASCM_StatDisp 0;
BA_ "GenSigTimeoutTime_TCM" SG_ 1445 ASCM_StatDisp 0;
BA_ "GenSigSendType" SG_ 1445 ASCM_SysFail 3;
BA_ "GenSigTimeoutTime_AGSM" SG_ 1445 ASCM_SysFail 0;
BA_ "GenSigTimeoutTime_BCM" SG_ 1445 ASCM_SysFail 0;
BA_ "GenSigTimeoutTime_BSM" SG_ 1445 ASCM_SysFail 0;
BA_ "GenSigTimeoutTime_CADM" SG_ 1445 ASCM_SysFail 0;
BA_ "GenSigTimeoutTime_DMSM" SG_ 1445 ASCM_SysFail 0;
BA_ "GenSigTimeoutTime_DTCM" SG_ 1445 ASCM_SysFail 0;
BA_ "GenSigTimeoutTime_ECM" SG_ 1445 ASCM_SysFail 0;
BA_ "GenSigTimeoutTime_EVCU2" SG_ 1445 ASCM_SysFail 0;
BA_ "GenSigTimeoutTime_GNMM" SG_ 1445 ASCM_SysFail 0;
BA_ "GenSigTimeoutTime_HCP" SG_ 1445 ASCM_SysFail 0;
BA_ "GenSigTimeoutTime_RFHM" SG_ 1445 ASCM_SysFail 0;
BA_ "GenSigTimeoutTime_TCM" SG_ 1445 ASCM_SysFail 0;
BA_ "GenSigSendType" SG_ 1445 ASCM_SYSFAIL_HMI 3;
BA_ "GenSigTimeoutTime_AGSM" SG_ 1445 ASCM_SYSFAIL_HMI 0;
BA_ "GenSigTimeoutTime_BCM" SG_ 1445 ASCM_SYSFAIL_HMI 0;
BA_ "GenSigTimeoutTime_BSM" SG_ 1445 ASCM_SYSFAIL_HMI 0;
BA_ "GenSigTimeoutTime_CADM" SG_ 1445 ASCM_SYSFAIL_HMI 0;
BA_ "GenSigTimeoutTime_DMSM" SG_ 1445 ASCM_SYSFAIL_HMI 0;
BA_ "GenSigTimeoutTime_DTCM" SG_ 1445 ASCM_SYSFAIL_HMI 0;
BA_ "GenSigTimeoutTime_ECM" SG_ 1445 ASCM_SYSFAIL_HMI 0;
BA_ "GenSigTimeoutTime_EVCU2" SG_ 1445 ASCM_SYSFAIL_HMI 0;
BA_ "GenSigTimeoutTime_GNMM" SG_ 1445 ASCM_SYSFAIL_HMI 0;
BA_ "GenSigTimeoutTime_HCP" SG_ 1445 ASCM_SYSFAIL_HMI 0;
BA_ "GenSigTimeoutTime_RFHM" SG_ 1445 ASCM_SYSFAIL_HMI 0;
BA_ "GenSigTimeoutTime_SGW" SG_ 1445 ASCM_SYSFAIL_HMI 0;
BA_ "GenSigTimeoutTime_TCM" SG_ 1445 ASCM_SYSFAIL_HMI 0;
BA_ "GenSigTimeoutTime_AGSM" SG_ 1445 CRC_ASCM2 0;
BA_ "GenSigTimeoutTime_BCM" SG_ 1445 CRC_ASCM2 0;
BA_ "GenSigTimeoutTime_DMSM" SG_ 1445 CRC_ASCM2 0;
BA_ "GenSigTimeoutTime_DTCM" SG_ 1445 CRC_ASCM2 0;
BA_ "GenSigTimeoutTime_ECM" SG_ 1445 CRC_ASCM2 0;
BA_ "GenSigTimeoutTime_EVCU2" SG_ 1445 CRC_ASCM2 0;
BA_ "GenSigTimeoutTime_GNMM" SG_ 1445 CRC_ASCM2 0;
BA_ "GenSigTimeoutTime_HCP" SG_ 1445 CRC_ASCM2 0;
BA_ "GenSigTimeoutTime_RFHM" SG_ 1445 CRC_ASCM2 0;
BA_ "GenSigTimeoutTime_SGW" SG_ 1445 CRC_ASCM2 0;
BA_ "GenSigTimeoutTime_TCM" SG_ 1445 CRC_ASCM2 0;
BA_ "GenSigStartValue" SG_ 1445 Loading_Lv 7;
BA_ "GenSigSendType" SG_ 1445 Loading_Lv 3;
BA_ "GenSigTimeoutTime_AGSM" SG_ 1445 Loading_Lv 0;
BA_ "GenSigTimeoutTime_BCM" SG_ 1445 Loading_Lv 0;
BA_ "GenSigTimeoutTime_DMSM" SG_ 1445 Loading_Lv 0;
BA_ "GenSigTimeoutTime_DTCM" SG_ 1445 Loading_Lv 0;
BA_ "GenSigTimeoutTime_ECM" SG_ 1445 Loading_Lv 0;
BA_ "GenSigTimeoutTime_EVCU2" SG_ 1445 Loading_Lv 0;
BA_ "GenSigTimeoutTime_GNMM" SG_ 1445 Loading_Lv 0;
BA_ "GenSigTimeoutTime_HCP" SG_ 1445 Loading_Lv 0;
BA_ "GenSigTimeoutTime_RFHM" SG_ 1445 Loading_Lv 0;
BA_ "GenSigTimeoutTime_SGW" SG_ 1445 Loading_Lv 0;
BA_ "GenSigTimeoutTime_TCM" SG_ 1445 Loading_Lv 0;
BA_ "GenSigTimeoutTime_AGSM" SG_ 1445 MessageCounter_ASCM2 0;
BA_ "GenSigTimeoutTime_BCM" SG_ 1445 MessageCounter_ASCM2 0;
BA_ "GenSigTimeoutTime_DMSM" SG_ 1445 MessageCounter_ASCM2 0;
BA_ "GenSigTimeoutTime_DTCM" SG_ 1445 MessageCounter_ASCM2 0;
BA_ "GenSigTimeoutTime_ECM" SG_ 1445 MessageCounter_ASCM2 0;
BA_ "GenSigTimeoutTime_EVCU2" SG_ 1445 MessageCounter_ASCM2 0;
BA_ "GenSigTimeoutTime_GNMM" SG_ 1445 MessageCounter_ASCM2 0;
BA_ "GenSigTimeoutTime_HCP" SG_ 1445 MessageCounter_ASCM2 0;
BA_ "GenSigTimeoutTime_RFHM" SG_ 1445 MessageCounter_ASCM2 0;
BA_ "GenSigTimeoutTime_SGW" SG_ 1445 MessageCounter_ASCM2 0;
BA_ "GenSigTimeoutTime_TCM" SG_ 1445 MessageCounter_ASCM2 0;
BA_ "GenSigStartValue" SG_ 1445 Tgt_Level 7;
BA_ "GenSigSendType" SG_ 1445 Tgt_Level 3;
BA_ "GenSigTimeoutTime_AGSM" SG_ 1445 Tgt_Level 0;
BA_ "GenSigTimeoutTime_BCM" SG_ 1445 Tgt_Level 0;
BA_ "GenSigTimeoutTime_BSM" SG_ 1445 Tgt_Level 0;
BA_ "GenSigTimeoutTime_DMSM" SG_ 1445 Tgt_Level 0;
BA_ "GenSigTimeoutTime_DTCM" SG_ 1445 Tgt_Level 0;
BA_ "GenSigTimeoutTime_ECM" SG_ 1445 Tgt_Level 0;
BA_ "GenSigTimeoutTime_EVCU2" SG_ 1445 Tgt_Level 0;
BA_ "GenSigTimeoutTime_GNMM" SG_ 1445 Tgt_Level 0;
BA_ "GenSigTimeoutTime_HCP" SG_ 1445 Tgt_Level 0;
BA_ "GenSigTimeoutTime_IPC" SG_ 1445 Tgt_Level 0;
BA_ "GenSigTimeoutTime_RFHM" SG_ 1445 Tgt_Level 0;
BA_ "GenSigTimeoutTime_SGW" SG_ 1445 Tgt_Level 0;
BA_ "GenSigTimeoutTime_TCM" SG_ 1445 Tgt_Level 0;
BA_ "GenSigSendType" SG_ 1445 TJM_Enbl 3;
BA_ "GenSigTimeoutTime_AGSM" SG_ 1445 TJM_Enbl 0;
BA_ "GenSigTimeoutTime_BCM" SG_ 1445 TJM_Enbl 0;
BA_ "GenSigTimeoutTime_BSM" SG_ 1445 TJM_Enbl 0;
BA_ "GenSigTimeoutTime_CADM" SG_ 1445 TJM_Enbl 0;
BA_ "GenSigTimeoutTime_DMSM" SG_ 1445 TJM_Enbl 0;
BA_ "GenSigTimeoutTime_DTCM" SG_ 1445 TJM_Enbl 0;
BA_ "GenSigTimeoutTime_ECM" SG_ 1445 TJM_Enbl 0;
BA_ "GenSigTimeoutTime_EVCU2" SG_ 1445 TJM_Enbl 0;
BA_ "GenSigTimeoutTime_GNMM" SG_ 1445 TJM_Enbl 0;
BA_ "GenSigTimeoutTime_HCP" SG_ 1445 TJM_Enbl 0;
BA_ "GenSigTimeoutTime_RFHM" SG_ 1445 TJM_Enbl 0;
BA_ "GenSigTimeoutTime_SGW" SG_ 1445 TJM_Enbl 0;
BA_ "GenSigTimeoutTime_TCM" SG_ 1445 TJM_Enbl 0;
BA_ "GenSigStartValue" SG_ 204 Axle_Torque_DrvReqMod 32768;
BA_ "GenSigTimeoutTime_AGSM" SG_ 204 Axle_Torque_DrvReqMod 0;
BA_ "GenSigTimeoutTime_CADM" SG_ 204 Axle_Torque_DrvReqMod 0;
BA_ "GenSigTimeoutTime_DMSM" SG_ 204 Axle_Torque_DrvReqMod 0;
BA_ "GenSigTimeoutTime_DTCM" SG_ 204 Axle_Torque_DrvReqMod 0;
BA_ "GenSigTimeoutTime_ECM" SG_ 204 Axle_Torque_DrvReqMod 0;
BA_ "GenSigTimeoutTime_EVCU2" SG_ 204 Axle_Torque_DrvReqMod 0;
BA_ "GenSigTimeoutTime_GNMM" SG_ 204 Axle_Torque_DrvReqMod 0;
BA_ "GenSigTimeoutTime_HCP" SG_ 204 Axle_Torque_DrvReqMod 0;
BA_ "GenSigTimeoutTime_IPC" SG_ 204 Axle_Torque_DrvReqMod 0;
BA_ "GenSigTimeoutTime_RFHM" SG_ 204 Axle_Torque_DrvReqMod 0;
BA_ "GenSigTimeoutTime_SGW" SG_ 204 Axle_Torque_DrvReqMod 0;
BA_ "GenSigTimeoutTime_TCM" SG_ 204 Axle_Torque_DrvReqMod 0;
BA_ "GenSigStartValue" SG_ 204 Axle_TorqueStatic_D_TTC 32767;
BA_ "GenSigTimeoutTime_AGSM" SG_ 204 Axle_TorqueStatic_D_TTC 0;
BA_ "GenSigTimeoutTime_CADM" SG_ 204 Axle_TorqueStatic_D_TTC 0;
BA_ "GenSigTimeoutTime_DMSM" SG_ 204 Axle_TorqueStatic_D_TTC 0;
BA_ "GenSigTimeoutTime_DTCM" SG_ 204 Axle_TorqueStatic_D_TTC 0;
BA_ "GenSigTimeoutTime_ECM" SG_ 204 Axle_TorqueStatic_D_TTC 0;
BA_ "GenSigTimeoutTime_EVCU2" SG_ 204 Axle_TorqueStatic_D_TTC 0;
BA_ "GenSigTimeoutTime_GNMM" SG_ 204 Axle_TorqueStatic_D_TTC 0;
BA_ "GenSigTimeoutTime_HCP" SG_ 204 Axle_TorqueStatic_D_TTC 0;
BA_ "GenSigTimeoutTime_IPC" SG_ 204 Axle_TorqueStatic_D_TTC 0;
BA_ "GenSigTimeoutTime_RFHM" SG_ 204 Axle_TorqueStatic_D_TTC 0;
BA_ "GenSigTimeoutTime_SGW" SG_ 204 Axle_TorqueStatic_D_TTC 0;
BA_ "GenSigTimeoutTime_TCM" SG_ 204 Axle_TorqueStatic_D_TTC 0;
BA_ "GenSigTimeoutTime_AGSM" SG_ 204 CRC_AXLE_TORQUE_FD_1 0;
BA_ "GenSigTimeoutTime_BCM" SG_ 204 CRC_AXLE_TORQUE_FD_1 0;
BA_ "GenSigTimeoutTime_CADM" SG_ 204 CRC_AXLE_TORQUE_FD_1 0;
BA_ "GenSigTimeoutTime_DMSM" SG_ 204 CRC_AXLE_TORQUE_FD_1 0;
BA_ "GenSigTimeoutTime_DTCM" SG_ 204 CRC_AXLE_TORQUE_FD_1 0;
BA_ "GenSigTimeoutTime_ECM" SG_ 204 CRC_AXLE_TORQUE_FD_1 0;
BA_ "GenSigTimeoutTime_EVCU2" SG_ 204 CRC_AXLE_TORQUE_FD_1 0;
BA_ "GenSigTimeoutTime_GNMM" SG_ 204 CRC_AXLE_TORQUE_FD_1 0;
BA_ "GenSigTimeoutTime_HCP" SG_ 204 CRC_AXLE_TORQUE_FD_1 0;
BA_ "GenSigTimeoutTime_IPC" SG_ 204 CRC_AXLE_TORQUE_FD_1 0;
BA_ "GenSigTimeoutTime_RFHM" SG_ 204 CRC_AXLE_TORQUE_FD_1 0;
BA_ "GenSigTimeoutTime_SGW" SG_ 204 CRC_AXLE_TORQUE_FD_1 0;
BA_ "GenSigTimeoutTime_TCM" SG_ 204 CRC_AXLE_TORQUE_FD_1 0;
BA_ "GenSigTimeoutTime_AGSM" SG_ 204 Front_Axle_Est_Regen_Torq 0;
BA_ "GenSigTimeoutTime_BCM" SG_ 204 Front_Axle_Est_Regen_Torq 0;
BA_ "GenSigTimeoutTime_CADM" SG_ 204 Front_Axle_Est_Regen_Torq 0;
BA_ "GenSigTimeoutTime_DMSM" SG_ 204 Front_Axle_Est_Regen_Torq 0;
BA_ "GenSigTimeoutTime_DTCM" SG_ 204 Front_Axle_Est_Regen_Torq 0;
BA_ "GenSigTimeoutTime_ECM" SG_ 204 Front_Axle_Est_Regen_Torq 0;
BA_ "GenSigTimeoutTime_EVCU2" SG_ 204 Front_Axle_Est_Regen_Torq 0;
BA_ "GenSigTimeoutTime_GNMM" SG_ 204 Front_Axle_Est_Regen_Torq 0;
BA_ "GenSigTimeoutTime_HCP" SG_ 204 Front_Axle_Est_Regen_Torq 0;
BA_ "GenSigTimeoutTime_IPC" SG_ 204 Front_Axle_Est_Regen_Torq 0;
BA_ "GenSigTimeoutTime_RFHM" SG_ 204 Front_Axle_Est_Regen_Torq 0;
BA_ "GenSigTimeoutTime_SGW" SG_ 204 Front_Axle_Est_Regen_Torq 0;
BA_ "GenSigTimeoutTime_TCM" SG_ 204 Front_Axle_Est_Regen_Torq 0;
BA_ "GenSigTimeoutTime_AGSM" SG_ 204 Front_Axle_Regen_Capacity 0;
BA_ "GenSigTimeoutTime_BCM" SG_ 204 Front_Axle_Regen_Capacity 0;
BA_ "GenSigTimeoutTime_CADM" SG_ 204 Front_Axle_Regen_Capacity 0;
BA_ "GenSigTimeoutTime_DMSM" SG_ 204 Front_Axle_Regen_Capacity 0;
BA_ "GenSigTimeoutTime_DTCM" SG_ 204 Front_Axle_Regen_Capacity 0;
BA_ "GenSigTimeoutTime_ECM" SG_ 204 Front_Axle_Regen_Capacity 0;
BA_ "GenSigTimeoutTime_EVCU2" SG_ 204 Front_Axle_Regen_Capacity 0;
BA_ "GenSigTimeoutTime_GNMM" SG_ 204 Front_Axle_Regen_Capacity 0;
BA_ "GenSigTimeoutTime_HCP" SG_ 204 Front_Axle_Regen_Capacity 0;
BA_ "GenSigTimeoutTime_IPC" SG_ 204 Front_Axle_Regen_Capacity 0;
BA_ "GenSigTimeoutTime_RFHM" SG_ 204 Front_Axle_Regen_Capacity 0;
BA_ "GenSigTimeoutTime_SGW" SG_ 204 Front_Axle_Regen_Capacity 0;
BA_ "GenSigTimeoutTime_TCM" SG_ 204 Front_Axle_Regen_Capacity 0;
BA_ "GenSigStartValue" SG_ 204 Front_AxleTorque_Max 32767;
BA_ "GenSigTimeoutTime_AGSM" SG_ 204 Front_AxleTorque_Max 0;
BA_ "GenSigTimeoutTime_BCM" SG_ 204 Front_AxleTorque_Max 0;
BA_ "GenSigTimeoutTime_CADM" SG_ 204 Front_AxleTorque_Max 0;
BA_ "GenSigTimeoutTime_DMSM" SG_ 204 Front_AxleTorque_Max 0;
BA_ "GenSigTimeoutTime_DTCM" SG_ 204 Front_AxleTorque_Max 0;
BA_ "GenSigTimeoutTime_ECM" SG_ 204 Front_AxleTorque_Max 0;
BA_ "GenSigTimeoutTime_EVCU2" SG_ 204 Front_AxleTorque_Max 0;
BA_ "GenSigTimeoutTime_GNMM" SG_ 204 Front_AxleTorque_Max 0;
BA_ "GenSigTimeoutTime_HCP" SG_ 204 Front_AxleTorque_Max 0;
BA_ "GenSigTimeoutTime_IPC" SG_ 204 Front_AxleTorque_Max 0;
BA_ "GenSigTimeoutTime_RFHM" SG_ 204 Front_AxleTorque_Max 0;
BA_ "GenSigTimeoutTime_SGW" SG_ 204 Front_AxleTorque_Max 0;
BA_ "GenSigTimeoutTime_TCM" SG_ 204 Front_AxleTorque_Max 0;
BA_ "GenSigStartValue" SG_ 204 Front_AxleTorque_Min 32767;
BA_ "GenSigTimeoutTime_AGSM" SG_ 204 Front_AxleTorque_Min 0;
BA_ "GenSigTimeoutTime_BCM" SG_ 204 Front_AxleTorque_Min 0;
BA_ "GenSigTimeoutTime_CADM" SG_ 204 Front_AxleTorque_Min 0;
BA_ "GenSigTimeoutTime_DMSM" SG_ 204 Front_AxleTorque_Min 0;
BA_ "GenSigTimeoutTime_DTCM" SG_ 204 Front_AxleTorque_Min 0;
BA_ "GenSigTimeoutTime_ECM" SG_ 204 Front_AxleTorque_Min 0;
BA_ "GenSigTimeoutTime_EVCU2" SG_ 204 Front_AxleTorque_Min 0;
BA_ "GenSigTimeoutTime_GNMM" SG_ 204 Front_AxleTorque_Min 0;
BA_ "GenSigTimeoutTime_HCP" SG_ 204 Front_AxleTorque_Min 0;
BA_ "GenSigTimeoutTime_IPC" SG_ 204 Front_AxleTorque_Min 0;
BA_ "GenSigTimeoutTime_RFHM" SG_ 204 Front_AxleTorque_Min 0;
BA_ "GenSigTimeoutTime_SGW" SG_ 204 Front_AxleTorque_Min 0;
BA_ "GenSigTimeoutTime_TCM" SG_ 204 Front_AxleTorque_Min 0;
BA_ "GenSigTimeoutTime_AGSM" SG_ 204 MaxRegen_Diff_Axle_Torq 0;
BA_ "GenSigTimeoutTime_BCM" SG_ 204 MaxRegen_Diff_Axle_Torq 0;
BA_ "GenSigTimeoutTime_CADM" SG_ 204 MaxRegen_Diff_Axle_Torq 0;
BA_ "GenSigTimeoutTime_DMSM" SG_ 204 MaxRegen_Diff_Axle_Torq 0;
BA_ "GenSigTimeoutTime_DTCM" SG_ 204 MaxRegen_Diff_Axle_Torq 0;
BA_ "GenSigTimeoutTime_ECM" SG_ 204 MaxRegen_Diff_Axle_Torq 0;
BA_ "GenSigTimeoutTime_EVCU2" SG_ 204 MaxRegen_Diff_Axle_Torq 0;
BA_ "GenSigTimeoutTime_GNMM" SG_ 204 MaxRegen_Diff_Axle_Torq 0;
BA_ "GenSigTimeoutTime_HCP" SG_ 204 MaxRegen_Diff_Axle_Torq 0;
BA_ "GenSigTimeoutTime_IPC" SG_ 204 MaxRegen_Diff_Axle_Torq 0;
BA_ "GenSigTimeoutTime_RFHM" SG_ 204 MaxRegen_Diff_Axle_Torq 0;
BA_ "GenSigTimeoutTime_SGW" SG_ 204 MaxRegen_Diff_Axle_Torq 0;
BA_ "GenSigTimeoutTime_TCM" SG_ 204 MaxRegen_Diff_Axle_Torq 0;
BA_ "GenSigTimeoutTime_AGSM" SG_ 204 MaxRegen_Diff_Axle_Torq_Active 0;
BA_ "GenSigTimeoutTime_CADM" SG_ 204 MaxRegen_Diff_Axle_Torq_Active 0;
BA_ "GenSigTimeoutTime_DMSM" SG_ 204 MaxRegen_Diff_Axle_Torq_Active 0;
BA_ "GenSigTimeoutTime_DTCM" SG_ 204 MaxRegen_Diff_Axle_Torq_Active 0;
BA_ "GenSigTimeoutTime_ECM" SG_ 204 MaxRegen_Diff_Axle_Torq_Active 0;
BA_ "GenSigTimeoutTime_EVCU2" SG_ 204 MaxRegen_Diff_Axle_Torq_Active 0;
BA_ "GenSigTimeoutTime_GNMM" SG_ 204 MaxRegen_Diff_Axle_Torq_Active 0;
BA_ "GenSigTimeoutTime_HCP" SG_ 204 MaxRegen_Diff_Axle_Torq_Active 0;
BA_ "GenSigTimeoutTime_IPC" SG_ 204 MaxRegen_Diff_Axle_Torq_Active 0;
BA_ "GenSigTimeoutTime_RFHM" SG_ 204 MaxRegen_Diff_Axle_Torq_Active 0;
BA_ "GenSigTimeoutTime_SGW" SG_ 204 MaxRegen_Diff_Axle_Torq_Active 0;
BA_ "GenSigTimeoutTime_TCM" SG_ 204 MaxRegen_Diff_Axle_Torq_Active 0;
BA_ "GenSigTimeoutTime_AGSM" SG_ 204 MessageCounter_AXLE_TORQUE_FD_1 0;
BA_ "GenSigTimeoutTime_BCM" SG_ 204 MessageCounter_AXLE_TORQUE_FD_1 0;
BA_ "GenSigTimeoutTime_CADM" SG_ 204 MessageCounter_AXLE_TORQUE_FD_1 0;
BA_ "GenSigTimeoutTime_DMSM" SG_ 204 MessageCounter_AXLE_TORQUE_FD_1 0;
BA_ "GenSigTimeoutTime_DTCM" SG_ 204 MessageCounter_AXLE_TORQUE_FD_1 0;
BA_ "GenSigTimeoutTime_ECM" SG_ 204 MessageCounter_AXLE_TORQUE_FD_1 0;
BA_ "GenSigTimeoutTime_EVCU2" SG_ 204 MessageCounter_AXLE_TORQUE_FD_1 0;
BA_ "GenSigTimeoutTime_GNMM" SG_ 204 MessageCounter_AXLE_TORQUE_FD_1 0;
BA_ "GenSigTimeoutTime_HCP" SG_ 204 MessageCounter_AXLE_TORQUE_FD_1 0;
BA_ "GenSigTimeoutTime_IPC" SG_ 204 MessageCounter_AXLE_TORQUE_FD_1 0;
BA_ "GenSigTimeoutTime_RFHM" SG_ 204 MessageCounter_AXLE_TORQUE_FD_1 0;
BA_ "GenSigTimeoutTime_SGW" SG_ 204 MessageCounter_AXLE_TORQUE_FD_1 0;
BA_ "GenSigTimeoutTime_TCM" SG_ 204 MessageCounter_AXLE_TORQUE_FD_1 0;
BA_ "GenSigTimeoutTime_AGSM" SG_ 204 Rear_Axle_Est_Regen_Torq 0;
BA_ "GenSigTimeoutTime_BCM" SG_ 204 Rear_Axle_Est_Regen_Torq 0;
BA_ "GenSigTimeoutTime_CADM" SG_ 204 Rear_Axle_Est_Regen_Torq 0;
BA_ "GenSigTimeoutTime_DMSM" SG_ 204 Rear_Axle_Est_Regen_Torq 0;
BA_ "GenSigTimeoutTime_DTCM" SG_ 204 Rear_Axle_Est_Regen_Torq 0;
BA_ "GenSigTimeoutTime_ECM" SG_ 204 Rear_Axle_Est_Regen_Torq 0;
BA_ "GenSigTimeoutTime_EVCU2" SG_ 204 Rear_Axle_Est_Regen_Torq 0;
BA_ "GenSigTimeoutTime_GNMM" SG_ 204 Rear_Axle_Est_Regen_Torq 0;
BA_ "GenSigTimeoutTime_HCP" SG_ 204 Rear_Axle_Est_Regen_Torq 0;
BA_ "GenSigTimeoutTime_IPC" SG_ 204 Rear_Axle_Est_Regen_Torq 0;
BA_ "GenSigTimeoutTime_RFHM" SG_ 204 Rear_Axle_Est_Regen_Torq 0;
BA_ "GenSigTimeoutTime_SGW" SG_ 204 Rear_Axle_Est_Regen_Torq 0;
BA_ "GenSigTimeoutTime_TCM" SG_ 204 Rear_Axle_Est_Regen_Torq 0;
BA_ "GenSigTimeoutTime_AGSM" SG_ 204 Rear_Axle_Regen_Capacity 0;
BA_ "GenSigTimeoutTime_BCM" SG_ 204 Rear_Axle_Regen_Capacity 0;
BA_ "GenSigTimeoutTime_CADM" SG_ 204 Rear_Axle_Regen_Capacity 0;
BA_ "GenSigTimeoutTime_DMSM" SG_ 204 Rear_Axle_Regen_Capacity 0;
BA_ "GenSigTimeoutTime_DTCM" SG_ 204 Rear_Axle_Regen_Capacity 0;
BA_ "GenSigTimeoutTime_ECM" SG_ 204 Rear_Axle_Regen_Capacity 0;
BA_ "GenSigTimeoutTime_EVCU2" SG_ 204 Rear_Axle_Regen_Capacity 0;
BA_ "GenSigTimeoutTime_GNMM" SG_ 204 Rear_Axle_Regen_Capacity 0;
BA_ "GenSigTimeoutTime_HCP" SG_ 204 Rear_Axle_Regen_Capacity 0;
BA_ "GenSigTimeoutTime_IPC" SG_ 204 Rear_Axle_Regen_Capacity 0;
BA_ "GenSigTimeoutTime_RFHM" SG_ 204 Rear_Axle_Regen_Capacity 0;
BA_ "GenSigTimeoutTime_SGW" SG_ 204 Rear_Axle_Regen_Capacity 0;
BA_ "GenSigTimeoutTime_TCM" SG_ 204 Rear_Axle_Regen_Capacity 0;
BA_ "GenSigStartValue" SG_ 204 Rear_AxleTorque_Max 32767;
BA_ "GenSigTimeoutTime_AGSM" SG_ 204 Rear_AxleTorque_Max 0;
BA_ "GenSigTimeoutTime_BCM" SG_ 204 Rear_AxleTorque_Max 0;
BA_ "GenSigTimeoutTime_CADM" SG_ 204 Rear_AxleTorque_Max 0;
BA_ "GenSigTimeoutTime_DMSM" SG_ 204 Rear_AxleTorque_Max 0;
BA_ "GenSigTimeoutTime_DTCM" SG_ 204 Rear_AxleTorque_Max 0;
BA_ "GenSigTimeoutTime_ECM" SG_ 204 Rear_AxleTorque_Max 0;
BA_ "GenSigTimeoutTime_EVCU2" SG_ 204 Rear_AxleTorque_Max 0;
BA_ "GenSigTimeoutTime_GNMM" SG_ 204 Rear_AxleTorque_Max 0;
BA_ "GenSigTimeoutTime_HCP" SG_ 204 Rear_AxleTorque_Max 0;
BA_ "GenSigTimeoutTime_IPC" SG_ 204 Rear_AxleTorque_Max 0;
BA_ "GenSigTimeoutTime_RFHM" SG_ 204 Rear_AxleTorque_Max 0;
BA_ "GenSigTimeoutTime_SGW" SG_ 204 Rear_AxleTorque_Max 0;
BA_ "GenSigTimeoutTime_TCM" SG_ 204 Rear_AxleTorque_Max 0;
BA_ "GenSigStartValue" SG_ 204 Rear_AxleTorque_Min 32767;
BA_ "GenSigTimeoutTime_AGSM" SG_ 204 Rear_AxleTorque_Min 0;
BA_ "GenSigTimeoutTime_BCM" SG_ 204 Rear_AxleTorque_Min 0;
BA_ "GenSigTimeoutTime_CADM" SG_ 204 Rear_AxleTorque_Min 0;
BA_ "GenSigTimeoutTime_DMSM" SG_ 204 Rear_AxleTorque_Min 0;
BA_ "GenSigTimeoutTime_DTCM" SG_ 204 Rear_AxleTorque_Min 0;
BA_ "GenSigTimeoutTime_ECM" SG_ 204 Rear_AxleTorque_Min 0;
BA_ "GenSigTimeoutTime_EVCU2" SG_ 204 Rear_AxleTorque_Min 0;
BA_ "GenSigTimeoutTime_GNMM" SG_ 204 Rear_AxleTorque_Min 0;
BA_ "GenSigTimeoutTime_HCP" SG_ 204 Rear_AxleTorque_Min 0;
BA_ "GenSigTimeoutTime_IPC" SG_ 204 Rear_AxleTorque_Min 0;
BA_ "GenSigTimeoutTime_RFHM" SG_ 204 Rear_AxleTorque_Min 0;
BA_ "GenSigTimeoutTime_SGW" SG_ 204 Rear_AxleTorque_Min 0;
BA_ "GenSigTimeoutTime_TCM" SG_ 204 Rear_AxleTorque_Min 0;
BA_ "GenSigStartValue" SG_ 204 Total_AxleTorque_Max 32767;
BA_ "GenSigTimeoutTime_AGSM" SG_ 204 Total_AxleTorque_Max 0;
BA_ "GenSigTimeoutTime_BCM" SG_ 204 Total_AxleTorque_Max 0;
BA_ "GenSigTimeoutTime_CADM" SG_ 204 Total_AxleTorque_Max 0;
BA_ "GenSigTimeoutTime_DMSM" SG_ 204 Total_AxleTorque_Max 0;
BA_ "GenSigTimeoutTime_DTCM" SG_ 204 Total_AxleTorque_Max 0;
BA_ "GenSigTimeoutTime_ECM" SG_ 204 Total_AxleTorque_Max 0;
BA_ "GenSigTimeoutTime_EVCU2" SG_ 204 Total_AxleTorque_Max 0;
BA_ "GenSigTimeoutTime_GNMM" SG_ 204 Total_AxleTorque_Max 0;
BA_ "GenSigTimeoutTime_HCP" SG_ 204 Total_AxleTorque_Max 0;
BA_ "GenSigTimeoutTime_IPC" SG_ 204 Total_AxleTorque_Max 0;
BA_ "GenSigTimeoutTime_RFHM" SG_ 204 Total_AxleTorque_Max 0;
BA_ "GenSigTimeoutTime_SGW" SG_ 204 Total_AxleTorque_Max 0;
BA_ "GenSigTimeoutTime_TCM" SG_ 204 Total_AxleTorque_Max 0;
BA_ "GenSigStartValue" SG_ 204 Total_AxleTorque_Min 32767;
BA_ "GenSigTimeoutTime_AGSM" SG_ 204 Total_AxleTorque_Min 0;
BA_ "GenSigTimeoutTime_BCM" SG_ 204 Total_AxleTorque_Min 0;
BA_ "GenSigTimeoutTime_CADM" SG_ 204 Total_AxleTorque_Min 0;
BA_ "GenSigTimeoutTime_DMSM" SG_ 204 Total_AxleTorque_Min 0;
BA_ "GenSigTimeoutTime_DTCM" SG_ 204 Total_AxleTorque_Min 0;
BA_ "GenSigTimeoutTime_ECM" SG_ 204 Total_AxleTorque_Min 0;
BA_ "GenSigTimeoutTime_EVCU2" SG_ 204 Total_AxleTorque_Min 0;
BA_ "GenSigTimeoutTime_GNMM" SG_ 204 Total_AxleTorque_Min 0;
BA_ "GenSigTimeoutTime_HCP" SG_ 204 Total_AxleTorque_Min 0;
BA_ "GenSigTimeoutTime_IPC" SG_ 204 Total_AxleTorque_Min 0;
BA_ "GenSigTimeoutTime_RFHM" SG_ 204 Total_AxleTorque_Min 0;
BA_ "GenSigTimeoutTime_SGW" SG_ 204 Total_AxleTorque_Min 0;
BA_ "GenSigTimeoutTime_TCM" SG_ 204 Total_AxleTorque_Min 0;
BA_ "GenSigSendType" SG_ 247 ControlEncoding_TRM_Rq 1;
BA_ "GenSigTimeoutTime_AGSM" SG_ 247 ControlEncoding_TRM_Rq 0;
BA_ "GenSigTimeoutTime_BCM" SG_ 247 ControlEncoding_TRM_Rq 0;
BA_ "GenSigTimeoutTime_BSM" SG_ 247 ControlEncoding_TRM_Rq 0;
BA_ "GenSigTimeoutTime_CADM" SG_ 247 ControlEncoding_TRM_Rq 0;
BA_ "GenSigTimeoutTime_DMSM" SG_ 247 ControlEncoding_TRM_Rq 0;
BA_ "GenSigTimeoutTime_DTCM" SG_ 247 ControlEncoding_TRM_Rq 0;
BA_ "GenSigTimeoutTime_ECM" SG_ 247 ControlEncoding_TRM_Rq 0;
BA_ "GenSigTimeoutTime_EVCU2" SG_ 247 ControlEncoding_TRM_Rq 0;
BA_ "GenSigTimeoutTime_GNMM" SG_ 247 ControlEncoding_TRM_Rq 0;
BA_ "GenSigTimeoutTime_HCP" SG_ 247 ControlEncoding_TRM_Rq 0;
BA_ "GenSigTimeoutTime_IPC" SG_ 247 ControlEncoding_TRM_Rq 0;
BA_ "GenSigTimeoutTime_SGW" SG_ 247 ControlEncoding_TRM_Rq 0;
BA_ "GenSigTimeoutTime_TCM" SG_ 247 ControlEncoding_TRM_Rq 0;
BA_ "GenSigTimeoutTime_AGSM" SG_ 247 MiniCrypt_Rnd_TRM_Rq 0;
BA_ "GenSigTimeoutTime_BCM" SG_ 247 MiniCrypt_Rnd_TRM_Rq 0;
BA_ "GenSigTimeoutTime_BSM" SG_ 247 MiniCrypt_Rnd_TRM_Rq 0;
BA_ "GenSigTimeoutTime_CADM" SG_ 247 MiniCrypt_Rnd_TRM_Rq 0;
BA_ "GenSigTimeoutTime_DMSM" SG_ 247 MiniCrypt_Rnd_TRM_Rq 0;
BA_ "GenSigTimeoutTime_DTCM" SG_ 247 MiniCrypt_Rnd_TRM_Rq 0;
BA_ "GenSigTimeoutTime_ECM" SG_ 247 MiniCrypt_Rnd_TRM_Rq 0;
BA_ "GenSigTimeoutTime_EVCU2" SG_ 247 MiniCrypt_Rnd_TRM_Rq 0;
BA_ "GenSigTimeoutTime_GNMM" SG_ 247 MiniCrypt_Rnd_TRM_Rq 0;
BA_ "GenSigTimeoutTime_HCP" SG_ 247 MiniCrypt_Rnd_TRM_Rq 0;
BA_ "GenSigTimeoutTime_IPC" SG_ 247 MiniCrypt_Rnd_TRM_Rq 0;
BA_ "GenSigTimeoutTime_SGW" SG_ 247 MiniCrypt_Rnd_TRM_Rq 0;
BA_ "GenSigTimeoutTime_TCM" SG_ 247 MiniCrypt_Rnd_TRM_Rq 0;
BA_ "GenSigTimeoutTime_AGSM" SG_ 247 MiniCryptFCode_TRM_Rq 0;
BA_ "GenSigTimeoutTime_BCM" SG_ 247 MiniCryptFCode_TRM_Rq 0;
BA_ "GenSigTimeoutTime_BSM" SG_ 247 MiniCryptFCode_TRM_Rq 0;
BA_ "GenSigTimeoutTime_CADM" SG_ 247 MiniCryptFCode_TRM_Rq 0;
BA_ "GenSigTimeoutTime_DMSM" SG_ 247 MiniCryptFCode_TRM_Rq 0;
BA_ "GenSigTimeoutTime_DTCM" SG_ 247 MiniCryptFCode_TRM_Rq 0;
BA_ "GenSigTimeoutTime_ECM" SG_ 247 MiniCryptFCode_TRM_Rq 0;
BA_ "GenSigTimeoutTime_EVCU2" SG_ 247 MiniCryptFCode_TRM_Rq 0;
BA_ "GenSigTimeoutTime_GNMM" SG_ 247 MiniCryptFCode_TRM_Rq 0;
BA_ "GenSigTimeoutTime_HCP" SG_ 247 MiniCryptFCode_TRM_Rq 0;
BA_ "GenSigTimeoutTime_IPC" SG_ 247 MiniCryptFCode_TRM_Rq 0;
BA_ "GenSigTimeoutTime_SGW" SG_ 247 MiniCryptFCode_TRM_Rq 0;
BA_ "GenSigTimeoutTime_TCM" SG_ 247 MiniCryptFCode_TRM_Rq 0;
BA_ "GenSigSendType" SG_ 1153 CmdIgnSts 3;
BA_ "GenSigTimeoutTime_BCM" SG_ 1153 CmdIgnSts 0;
BA_ "GenSigSendType" SG_ 1153 CompressorACReqSts 3;
BA_ "GenSigTimeoutTime_AGSM" SG_ 1153 CompressorACReqSts 0;
BA_ "GenSigTimeoutTime_BCM" SG_ 1153 CompressorACReqSts 0;
BA_ "GenSigTimeoutTime_BSM" SG_ 1153 CompressorACReqSts 0;
BA_ "GenSigTimeoutTime_CADM" SG_ 1153 CompressorACReqSts 0;
BA_ "GenSigTimeoutTime_DMSM" SG_ 1153 CompressorACReqSts 0;
BA_ "GenSigTimeoutTime_DTCM" SG_ 1153 CompressorACReqSts 0;
BA_ "GenSigTimeoutTime_GNMM" SG_ 1153 CompressorACReqSts 0;
BA_ "GenSigTimeoutTime_HCP" SG_ 1153 CompressorACReqSts 0;
BA_ "GenSigTimeoutTime_IPC" SG_ 1153 CompressorACReqSts 0;
BA_ "GenSigTimeoutTime_RFHM" SG_ 1153 CompressorACReqSts 0;
BA_ "GenSigTimeoutTime_SGW" SG_ 1153 CompressorACReqSts 0;
BA_ "GenSigTimeoutTime_TCM" SG_ 1153 CompressorACReqSts 0;
BA_ "GenSigTimeoutTime_BCM" SG_ 1153 CRC_BCM10 0;
BA_ "GenSigTimeoutTime_DTCM" SG_ 1153 CRC_BCM10 0;
BA_ "GenSigTimeoutTime_SGW" SG_ 1153 CRC_BCM10 0;
BA_ "GenSigSendType" SG_ 1153 DAY_LGT_MD 3;
BA_ "GenSigTimeoutTime_BCM" SG_ 1153 DAY_LGT_MD 0;
BA_ "GenSigTimeoutTime_CADM" SG_ 1153 DAY_LGT_MD 0;
BA_ "GenSigTimeoutTime_DMSM" SG_ 1153 DAY_LGT_MD 0;
BA_ "GenSigTimeoutTime_DTCM" SG_ 1153 DAY_LGT_MD 0;
BA_ "GenSigTimeoutTime_ECM" SG_ 1153 DAY_LGT_MD 0;
BA_ "GenSigTimeoutTime_GNMM" SG_ 1153 DAY_LGT_MD 0;
BA_ "GenSigTimeoutTime_HCP" SG_ 1153 DAY_LGT_MD 0;
BA_ "GenSigSendType" SG_ 1153 ExteriorRearReleaseSwitchSts 3;
BA_ "GenSigTimeoutTime_AGSM" SG_ 1153 ExteriorRearReleaseSwitchSts 0;
BA_ "GenSigTimeoutTime_BCM" SG_ 1153 ExteriorRearReleaseSwitchSts 0;
BA_ "GenSigTimeoutTime_BSM" SG_ 1153 ExteriorRearReleaseSwitchSts 0;
BA_ "GenSigTimeoutTime_CADM" SG_ 1153 ExteriorRearReleaseSwitchSts 0;
BA_ "GenSigTimeoutTime_DMSM" SG_ 1153 ExteriorRearReleaseSwitchSts 0;
BA_ "GenSigTimeoutTime_DTCM" SG_ 1153 ExteriorRearReleaseSwitchSts 0;
BA_ "GenSigTimeoutTime_ECM" SG_ 1153 ExteriorRearReleaseSwitchSts 0;
BA_ "GenSigTimeoutTime_EVCU2" SG_ 1153 ExteriorRearReleaseSwitchSts 0;
BA_ "GenSigTimeoutTime_GNMM" SG_ 1153 ExteriorRearReleaseSwitchSts 0;
BA_ "GenSigTimeoutTime_HCP" SG_ 1153 ExteriorRearReleaseSwitchSts 0;
BA_ "GenSigTimeoutTime_IPC" SG_ 1153 ExteriorRearReleaseSwitchSts 0;
BA_ "GenSigTimeoutTime_SGW" SG_ 1153 ExteriorRearReleaseSwitchSts 0;
BA_ "GenSigTimeoutTime_TCM" SG_ 1153 ExteriorRearReleaseSwitchSts 0;
BA_ "GenSigStartValue" SG_ 1153 ExternalTemperatureC 511;
BA_ "GenSigTimeoutTime_BCM" SG_ 1153 ExternalTemperatureC 0;
BA_ "GenSigStartValue" SG_ 1153 ExternalTemperatureF 511;
BA_ "GenSigTimeoutTime_AGSM" SG_ 1153 ExternalTemperatureF 0;
BA_ "GenSigTimeoutTime_BCM" SG_ 1153 ExternalTemperatureF 0;
BA_ "GenSigTimeoutTime_BSM" SG_ 1153 ExternalTemperatureF 0;
BA_ "GenSigTimeoutTime_CADM" SG_ 1153 ExternalTemperatureF 0;
BA_ "GenSigTimeoutTime_DMSM" SG_ 1153 ExternalTemperatureF 0;
BA_ "GenSigTimeoutTime_DTCM" SG_ 1153 ExternalTemperatureF 0;
BA_ "GenSigTimeoutTime_ECM" SG_ 1153 ExternalTemperatureF 0;
BA_ "GenSigTimeoutTime_EVCU2" SG_ 1153 ExternalTemperatureF 0;
BA_ "GenSigTimeoutTime_GNMM" SG_ 1153 ExternalTemperatureF 0;
BA_ "GenSigTimeoutTime_HCP" SG_ 1153 ExternalTemperatureF 0;
BA_ "GenSigTimeoutTime_RFHM" SG_ 1153 ExternalTemperatureF 0;
BA_ "GenSigTimeoutTime_TCM" SG_ 1153 ExternalTemperatureF 0;
BA_ "GenSigSendType" SG_ 1153 FOA_Mobile_App_Alert 3;
BA_ "GenSigTimeoutTime_AGSM" SG_ 1153 FOA_Mobile_App_Alert 0;
BA_ "GenSigTimeoutTime_BCM" SG_ 1153 FOA_Mobile_App_Alert 0;
BA_ "GenSigTimeoutTime_BSM" SG_ 1153 FOA_Mobile_App_Alert 0;
BA_ "GenSigTimeoutTime_CADM" SG_ 1153 FOA_Mobile_App_Alert 0;
BA_ "GenSigTimeoutTime_DMSM" SG_ 1153 FOA_Mobile_App_Alert 0;
BA_ "GenSigTimeoutTime_DTCM" SG_ 1153 FOA_Mobile_App_Alert 0;
BA_ "GenSigTimeoutTime_ECM" SG_ 1153 FOA_Mobile_App_Alert 0;
BA_ "GenSigTimeoutTime_EVCU2" SG_ 1153 FOA_Mobile_App_Alert 0;
BA_ "GenSigTimeoutTime_GNMM" SG_ 1153 FOA_Mobile_App_Alert 0;
BA_ "GenSigTimeoutTime_HCP" SG_ 1153 FOA_Mobile_App_Alert 0;
BA_ "GenSigTimeoutTime_IPC" SG_ 1153 FOA_Mobile_App_Alert 0;
BA_ "GenSigTimeoutTime_RFHM" SG_ 1153 FOA_Mobile_App_Alert 0;
BA_ "GenSigTimeoutTime_TCM" SG_ 1153 FOA_Mobile_App_Alert 0;
BA_ "GenSigSendType" SG_ 1153 FOA_Msg_Req 3;
BA_ "GenSigTimeoutTime_AGSM" SG_ 1153 FOA_Msg_Req 0;
BA_ "GenSigTimeoutTime_BCM" SG_ 1153 FOA_Msg_Req 0;
BA_ "GenSigTimeoutTime_BSM" SG_ 1153 FOA_Msg_Req 0;
BA_ "GenSigTimeoutTime_CADM" SG_ 1153 FOA_Msg_Req 0;
BA_ "GenSigTimeoutTime_DMSM" SG_ 1153 FOA_Msg_Req 0;
BA_ "GenSigTimeoutTime_DTCM" SG_ 1153 FOA_Msg_Req 0;
BA_ "GenSigTimeoutTime_ECM" SG_ 1153 FOA_Msg_Req 0;
BA_ "GenSigTimeoutTime_EVCU2" SG_ 1153 FOA_Msg_Req 0;
BA_ "GenSigTimeoutTime_GNMM" SG_ 1153 FOA_Msg_Req 0;
BA_ "GenSigTimeoutTime_HCP" SG_ 1153 FOA_Msg_Req 0;
BA_ "GenSigTimeoutTime_RFHM" SG_ 1153 FOA_Msg_Req 0;
BA_ "GenSigTimeoutTime_TCM" SG_ 1153 FOA_Msg_Req 0;
BA_ "GenSigSendType" SG_ 1153 FOBSearchRequest 3;
BA_ "GenSigTimeoutTime_AGSM" SG_ 1153 FOBSearchRequest 0;
BA_ "GenSigTimeoutTime_BCM" SG_ 1153 FOBSearchRequest 0;
BA_ "GenSigTimeoutTime_BSM" SG_ 1153 FOBSearchRequest 0;
BA_ "GenSigTimeoutTime_CADM" SG_ 1153 FOBSearchRequest 0;
BA_ "GenSigTimeoutTime_DMSM" SG_ 1153 FOBSearchRequest 0;
BA_ "GenSigTimeoutTime_DTCM" SG_ 1153 FOBSearchRequest 0;
BA_ "GenSigTimeoutTime_ECM" SG_ 1153 FOBSearchRequest 0;
BA_ "GenSigTimeoutTime_EVCU2" SG_ 1153 FOBSearchRequest 0;
BA_ "GenSigTimeoutTime_GNMM" SG_ 1153 FOBSearchRequest 0;
BA_ "GenSigTimeoutTime_HCP" SG_ 1153 FOBSearchRequest 0;
BA_ "GenSigTimeoutTime_IPC" SG_ 1153 FOBSearchRequest 0;
BA_ "GenSigTimeoutTime_SGW" SG_ 1153 FOBSearchRequest 0;
BA_ "GenSigTimeoutTime_TCM" SG_ 1153 FOBSearchRequest 0;
BA_ "GenSigTimeoutTime_BCM" SG_ 1153 MessageCounter_BCM10 0;
BA_ "GenSigTimeoutTime_DTCM" SG_ 1153 MessageCounter_BCM10 0;
BA_ "GenSigTimeoutTime_SGW" SG_ 1153 MessageCounter_BCM10 0;
BA_ "GenSigSendType" SG_ 1153 PANEL_INTS 3;
BA_ "GenSigTimeoutTime_BCM" SG_ 1153 PANEL_INTS 0;
BA_ "GenSigTimeoutTime_BSM" SG_ 1153 PANEL_INTS 0;
BA_ "GenSigTimeoutTime_CADM" SG_ 1153 PANEL_INTS 0;
BA_ "GenSigTimeoutTime_DMSM" SG_ 1153 PANEL_INTS 0;
BA_ "GenSigTimeoutTime_DTCM" SG_ 1153 PANEL_INTS 0;
BA_ "GenSigTimeoutTime_ECM" SG_ 1153 PANEL_INTS 0;
BA_ "GenSigTimeoutTime_EVCU2" SG_ 1153 PANEL_INTS 0;
BA_ "GenSigTimeoutTime_GNMM" SG_ 1153 PANEL_INTS 0;
BA_ "GenSigTimeoutTime_HCP" SG_ 1153 PANEL_INTS 0;
BA_ "GenSigTimeoutTime_IPC" SG_ 1153 PANEL_INTS 0;
BA_ "GenSigTimeoutTime_AGSM" SG_ 1153 RemSt_InhibitSts 0;
BA_ "GenSigTimeoutTime_BCM" SG_ 1153 RemSt_InhibitSts 0;
BA_ "GenSigTimeoutTime_BSM" SG_ 1153 RemSt_InhibitSts 0;
BA_ "GenSigTimeoutTime_CADM" SG_ 1153 RemSt_InhibitSts 0;
BA_ "GenSigTimeoutTime_DMSM" SG_ 1153 RemSt_InhibitSts 0;
BA_ "GenSigTimeoutTime_DTCM" SG_ 1153 RemSt_InhibitSts 0;
BA_ "GenSigTimeoutTime_ECM" SG_ 1153 RemSt_InhibitSts 0;
BA_ "GenSigTimeoutTime_EVCU2" SG_ 1153 RemSt_InhibitSts 0;
BA_ "GenSigTimeoutTime_GNMM" SG_ 1153 RemSt_InhibitSts 0;
BA_ "GenSigTimeoutTime_HCP" SG_ 1153 RemSt_InhibitSts 0;
BA_ "GenSigTimeoutTime_RFHM" SG_ 1153 RemSt_InhibitSts 0;
BA_ "GenSigTimeoutTime_TCM" SG_ 1153 RemSt_InhibitSts 0;
BA_ "GenSigSendType" SG_ 1153 SCC_InhibitSts 3;
BA_ "GenSigTimeoutTime_AGSM" SG_ 1153 SCC_InhibitSts 0;
BA_ "GenSigTimeoutTime_BCM" SG_ 1153 SCC_InhibitSts 0;
BA_ "GenSigTimeoutTime_BSM" SG_ 1153 SCC_InhibitSts 0;
BA_ "GenSigTimeoutTime_CADM" SG_ 1153 SCC_InhibitSts 0;
BA_ "GenSigTimeoutTime_DMSM" SG_ 1153 SCC_InhibitSts 0;
BA_ "GenSigTimeoutTime_DTCM" SG_ 1153 SCC_InhibitSts 0;
BA_ "GenSigTimeoutTime_ECM" SG_ 1153 SCC_InhibitSts 0;
BA_ "GenSigTimeoutTime_EVCU2" SG_ 1153 SCC_InhibitSts 0;
BA_ "GenSigTimeoutTime_GNMM" SG_ 1153 SCC_InhibitSts 0;
BA_ "GenSigTimeoutTime_HCP" SG_ 1153 SCC_InhibitSts 0;
BA_ "GenSigTimeoutTime_RFHM" SG_ 1153 SCC_InhibitSts 0;
BA_ "GenSigTimeoutTime_SGW" SG_ 1153 SCC_InhibitSts 0;
BA_ "GenSigTimeoutTime_TCM" SG_ 1153 SCC_InhibitSts 0;
BA_ "GenSigSendType" SG_ 1153 SpSt_Pad1 3;
BA_ "GenSigTimeoutTime_AGSM" SG_ 1153 SpSt_Pad1 0;
BA_ "GenSigTimeoutTime_BCM" SG_ 1153 SpSt_Pad1 0;
BA_ "GenSigTimeoutTime_BSM" SG_ 1153 SpSt_Pad1 0;
BA_ "GenSigTimeoutTime_CADM" SG_ 1153 SpSt_Pad1 0;
BA_ "GenSigTimeoutTime_DMSM" SG_ 1153 SpSt_Pad1 0;
BA_ "GenSigTimeoutTime_DTCM" SG_ 1153 SpSt_Pad1 0;
BA_ "GenSigTimeoutTime_EVCU2" SG_ 1153 SpSt_Pad1 0;
BA_ "GenSigTimeoutTime_GNMM" SG_ 1153 SpSt_Pad1 0;
BA_ "GenSigTimeoutTime_HCP" SG_ 1153 SpSt_Pad1 0;
BA_ "GenSigTimeoutTime_IPC" SG_ 1153 SpSt_Pad1 0;
BA_ "GenSigTimeoutTime_RFHM" SG_ 1153 SpSt_Pad1 0;
BA_ "GenSigTimeoutTime_TCM" SG_ 1153 SpSt_Pad1 0;
BA_ "GenSigSendType" SG_ 1153 StTypSts 3;
BA_ "GenSigTimeoutTime_AGSM" SG_ 1153 StTypSts 0;
BA_ "GenSigTimeoutTime_BCM" SG_ 1153 StTypSts 0;
BA_ "GenSigTimeoutTime_BSM" SG_ 1153 StTypSts 0;
BA_ "GenSigTimeoutTime_CADM" SG_ 1153 StTypSts 0;
BA_ "GenSigTimeoutTime_DMSM" SG_ 1153 StTypSts 0;
BA_ "GenSigTimeoutTime_DTCM" SG_ 1153 StTypSts 0;
BA_ "GenSigTimeoutTime_ECM" SG_ 1153 StTypSts 0;
BA_ "GenSigTimeoutTime_EVCU2" SG_ 1153 StTypSts 0;
BA_ "GenSigTimeoutTime_GNMM" SG_ 1153 StTypSts 0;
BA_ "GenSigTimeoutTime_HCP" SG_ 1153 StTypSts 0;
BA_ "GenSigTimeoutTime_IPC" SG_ 1153 StTypSts 0;
BA_ "GenSigTimeoutTime_TCM" SG_ 1153 StTypSts 0;
BA_ "GenSigSendType" SG_ 1153 TurnIndicationSts 3;
BA_ "GenSigTimeoutTime_AGSM" SG_ 1153 TurnIndicationSts 0;
BA_ "GenSigTimeoutTime_BCM" SG_ 1153 TurnIndicationSts 0;
BA_ "GenSigTimeoutTime_BSM" SG_ 1153 TurnIndicationSts 0;
BA_ "GenSigTimeoutTime_DMSM" SG_ 1153 TurnIndicationSts 0;
BA_ "GenSigTimeoutTime_DTCM" SG_ 1153 TurnIndicationSts 0;
BA_ "GenSigTimeoutTime_ECM" SG_ 1153 TurnIndicationSts 0;
BA_ "GenSigTimeoutTime_EVCU2" SG_ 1153 TurnIndicationSts 0;
BA_ "GenSigTimeoutTime_GNMM" SG_ 1153 TurnIndicationSts 0;
BA_ "GenSigTimeoutTime_HCP" SG_ 1153 TurnIndicationSts 0;
BA_ "GenSigTimeoutTime_IPC" SG_ 1153 TurnIndicationSts 0;
BA_ "GenSigTimeoutTime_RFHM" SG_ 1153 TurnIndicationSts 0;
BA_ "GenSigTimeoutTime_TCM" SG_ 1153 TurnIndicationSts 0;
BA_ "GenSigSendType" SG_ 1153 WPR_SYS_AUTO 3;
BA_ "GenSigTimeoutTime_AGSM" SG_ 1153 WPR_SYS_AUTO 0;
BA_ "GenSigTimeoutTime_BCM" SG_ 1153 WPR_SYS_AUTO 0;
BA_ "GenSigTimeoutTime_BSM" SG_ 1153 WPR_SYS_AUTO 0;
BA_ "GenSigTimeoutTime_DMSM" SG_ 1153 WPR_SYS_AUTO 0;
BA_ "GenSigTimeoutTime_DTCM" SG_ 1153 WPR_SYS_AUTO 0;
BA_ "GenSigTimeoutTime_ECM" SG_ 1153 WPR_SYS_AUTO 0;
BA_ "GenSigTimeoutTime_EVCU2" SG_ 1153 WPR_SYS_AUTO 0;
BA_ "GenSigTimeoutTime_GNMM" SG_ 1153 WPR_SYS_AUTO 0;
BA_ "GenSigTimeoutTime_HCP" SG_ 1153 WPR_SYS_AUTO 0;
BA_ "GenSigTimeoutTime_IPC" SG_ 1153 WPR_SYS_AUTO 0;
BA_ "GenSigTimeoutTime_RFHM" SG_ 1153 WPR_SYS_AUTO 0;
BA_ "GenSigTimeoutTime_SGW" SG_ 1153 WPR_SYS_AUTO 0;
BA_ "GenSigTimeoutTime_TCM" SG_ 1153 WPR_SYS_AUTO 0;
BA_ "GenSigStartValue" SG_ 1430 A2D_DRV_TEMP_DR_POS 819;
BA_ "GenSigSendType" SG_ 1430 A2D_DRV_TEMP_DR_POS 3;
BA_ "GenSigTimeoutTime_AGSM" SG_ 1430 A2D_DRV_TEMP_DR_POS 0;
BA_ "GenSigTimeoutTime_BCM" SG_ 1430 A2D_DRV_TEMP_DR_POS 0;
BA_ "GenSigTimeoutTime_BSM" SG_ 1430 A2D_DRV_TEMP_DR_POS 0;
BA_ "GenSigTimeoutTime_CADM" SG_ 1430 A2D_DRV_TEMP_DR_POS 0;
BA_ "GenSigTimeoutTime_DMSM" SG_ 1430 A2D_DRV_TEMP_DR_POS 0;
BA_ "GenSigTimeoutTime_DTCM" SG_ 1430 A2D_DRV_TEMP_DR_POS 0;
BA_ "GenSigTimeoutTime_EVCU2" SG_ 1430 A2D_DRV_TEMP_DR_POS 0;
BA_ "GenSigTimeoutTime_GNMM" SG_ 1430 A2D_DRV_TEMP_DR_POS 0;
BA_ "GenSigTimeoutTime_HCP" SG_ 1430 A2D_DRV_TEMP_DR_POS 0;
BA_ "GenSigTimeoutTime_IPC" SG_ 1430 A2D_DRV_TEMP_DR_POS 0;
BA_ "GenSigTimeoutTime_RFHM" SG_ 1430 A2D_DRV_TEMP_DR_POS 0;
BA_ "GenSigTimeoutTime_SGW" SG_ 1430 A2D_DRV_TEMP_DR_POS 0;
BA_ "GenSigTimeoutTime_TCM" SG_ 1430 A2D_DRV_TEMP_DR_POS 0;
BA_ "GenSigSendType" SG_ 1430 AcOutputCurrentSts 3;
BA_ "GenSigTimeoutTime_AGSM" SG_ 1430 AcOutputCurrentSts 0;
BA_ "GenSigTimeoutTime_BCM" SG_ 1430 AcOutputCurrentSts 0;
BA_ "GenSigTimeoutTime_BSM" SG_ 1430 AcOutputCurrentSts 0;
BA_ "GenSigTimeoutTime_CADM" SG_ 1430 AcOutputCurrentSts 0;
BA_ "GenSigTimeoutTime_DMSM" SG_ 1430 AcOutputCurrentSts 0;
BA_ "GenSigTimeoutTime_DTCM" SG_ 1430 AcOutputCurrentSts 0;
BA_ "GenSigTimeoutTime_EVCU2" SG_ 1430 AcOutputCurrentSts 0;
BA_ "GenSigTimeoutTime_GNMM" SG_ 1430 AcOutputCurrentSts 0;
BA_ "GenSigTimeoutTime_HCP" SG_ 1430 AcOutputCurrentSts 0;
BA_ "GenSigTimeoutTime_IPC" SG_ 1430 AcOutputCurrentSts 0;
BA_ "GenSigTimeoutTime_RFHM" SG_ 1430 AcOutputCurrentSts 0;
BA_ "GenSigTimeoutTime_SGW" SG_ 1430 AcOutputCurrentSts 0;
BA_ "GenSigTimeoutTime_TCM" SG_ 1430 AcOutputCurrentSts 0;
BA_ "GenSigTimeoutTime_AGSM" SG_ 1430 Batt_ST_Crit 0;
BA_ "GenSigTimeoutTime_BCM" SG_ 1430 Batt_ST_Crit 0;
BA_ "GenSigTimeoutTime_BSM" SG_ 1430 Batt_ST_Crit 0;
BA_ "GenSigTimeoutTime_DMSM" SG_ 1430 Batt_ST_Crit 0;
BA_ "GenSigTimeoutTime_DTCM" SG_ 1430 Batt_ST_Crit 0;
BA_ "GenSigTimeoutTime_ECM" SG_ 1430 Batt_ST_Crit 0;
BA_ "GenSigTimeoutTime_EVCU2" SG_ 1430 Batt_ST_Crit 0;
BA_ "GenSigTimeoutTime_GNMM" SG_ 1430 Batt_ST_Crit 0;
BA_ "GenSigTimeoutTime_HCP" SG_ 1430 Batt_ST_Crit 0;
BA_ "GenSigTimeoutTime_RFHM" SG_ 1430 Batt_ST_Crit 0;
BA_ "GenSigTimeoutTime_TCM" SG_ 1430 Batt_ST_Crit 0;
BA_ "GenSigStartValue" SG_ 1430 CMP_DIR 15;
BA_ "GenSigSendType" SG_ 1430 CMP_DIR 3;
BA_ "GenSigTimeoutTime_AGSM" SG_ 1430 CMP_DIR 0;
BA_ "GenSigTimeoutTime_BCM" SG_ 1430 CMP_DIR 0;
BA_ "GenSigTimeoutTime_BSM" SG_ 1430 CMP_DIR 0;
BA_ "GenSigTimeoutTime_CADM" SG_ 1430 CMP_DIR 0;
BA_ "GenSigTimeoutTime_DMSM" SG_ 1430 CMP_DIR 0;
BA_ "GenSigTimeoutTime_DTCM" SG_ 1430 CMP_DIR 0;
BA_ "GenSigTimeoutTime_ECM" SG_ 1430 CMP_DIR 0;
BA_ "GenSigTimeoutTime_EVCU2" SG_ 1430 CMP_DIR 0;
BA_ "GenSigTimeoutTime_GNMM" SG_ 1430 CMP_DIR 0;
BA_ "GenSigTimeoutTime_HCP" SG_ 1430 CMP_DIR 0;
BA_ "GenSigTimeoutTime_RFHM" SG_ 1430 CMP_DIR 0;
BA_ "GenSigTimeoutTime_TCM" SG_ 1430 CMP_DIR 0;
BA_ "GenSigTimeoutTime_AGSM" SG_ 1430 CRC_BCM11 0;
BA_ "GenSigTimeoutTime_BCM" SG_ 1430 CRC_BCM11 0;
BA_ "GenSigTimeoutTime_BSM" SG_ 1430 CRC_BCM11 0;
BA_ "GenSigTimeoutTime_DMSM" SG_ 1430 CRC_BCM11 0;
BA_ "GenSigTimeoutTime_DTCM" SG_ 1430 CRC_BCM11 0;
BA_ "GenSigTimeoutTime_ECM" SG_ 1430 CRC_BCM11 0;
BA_ "GenSigTimeoutTime_EVCU2" SG_ 1430 CRC_BCM11 0;
BA_ "GenSigTimeoutTime_GNMM" SG_ 1430 CRC_BCM11 0;
BA_ "GenSigTimeoutTime_HCP" SG_ 1430 CRC_BCM11 0;
BA_ "GenSigTimeoutTime_IPC" SG_ 1430 CRC_BCM11 0;
BA_ "GenSigTimeoutTime_RFHM" SG_ 1430 CRC_BCM11 0;
BA_ "GenSigTimeoutTime_SGW" SG_ 1430 CRC_BCM11 0;
BA_ "GenSigTimeoutTime_TCM" SG_ 1430 CRC_BCM11 0;
BA_ "GenSigSendType" SG_ 1430 DSM_PDL_LKOUT 3;
BA_ "GenSigTimeoutTime_AGSM" SG_ 1430 DSM_PDL_LKOUT 0;
BA_ "GenSigTimeoutTime_BCM" SG_ 1430 DSM_PDL_LKOUT 0;
BA_ "GenSigTimeoutTime_BSM" SG_ 1430 DSM_PDL_LKOUT 0;
BA_ "GenSigTimeoutTime_CADM" SG_ 1430 DSM_PDL_LKOUT 0;
BA_ "GenSigTimeoutTime_DMSM" SG_ 1430 DSM_PDL_LKOUT 0;
BA_ "GenSigTimeoutTime_DTCM" SG_ 1430 DSM_PDL_LKOUT 0;
BA_ "GenSigTimeoutTime_ECM" SG_ 1430 DSM_PDL_LKOUT 0;
BA_ "GenSigTimeoutTime_EVCU2" SG_ 1430 DSM_PDL_LKOUT 0;
BA_ "GenSigTimeoutTime_GNMM" SG_ 1430 DSM_PDL_LKOUT 0;
BA_ "GenSigTimeoutTime_HCP" SG_ 1430 DSM_PDL_LKOUT 0;
BA_ "GenSigTimeoutTime_RFHM" SG_ 1430 DSM_PDL_LKOUT 0;
BA_ "GenSigTimeoutTime_SGW" SG_ 1430 DSM_PDL_LKOUT 0;
BA_ "GenSigTimeoutTime_TCM" SG_ 1430 DSM_PDL_LKOUT 0;
BA_ "GenSigTimeoutTime_AGSM" SG_ 1430 EngineOffTimer 0;
BA_ "GenSigTimeoutTime_BCM" SG_ 1430 EngineOffTimer 0;
BA_ "GenSigTimeoutTime_BSM" SG_ 1430 EngineOffTimer 0;
BA_ "GenSigTimeoutTime_CADM" SG_ 1430 EngineOffTimer 0;
BA_ "GenSigTimeoutTime_DMSM" SG_ 1430 EngineOffTimer 0;
BA_ "GenSigTimeoutTime_DTCM" SG_ 1430 EngineOffTimer 0;
BA_ "GenSigTimeoutTime_ECM" SG_ 1430 EngineOffTimer 0;
BA_ "GenSigTimeoutTime_EVCU2" SG_ 1430 EngineOffTimer 0;
BA_ "GenSigTimeoutTime_GNMM" SG_ 1430 EngineOffTimer 0;
BA_ "GenSigTimeoutTime_HCP" SG_ 1430 EngineOffTimer 0;
BA_ "GenSigTimeoutTime_IPC" SG_ 1430 EngineOffTimer 0;
BA_ "GenSigTimeoutTime_RFHM" SG_ 1430 EngineOffTimer 0;
BA_ "GenSigTimeoutTime_SGW" SG_ 1430 EngineOffTimer 0;
BA_ "GenSigTimeoutTime_TCM" SG_ 1430 EngineOffTimer 0;
BA_ "GenSigSendType" SG_ 1430 Gate_Req_PE 3;
BA_ "GenSigTimeoutTime_AGSM" SG_ 1430 Gate_Req_PE 0;
BA_ "GenSigTimeoutTime_BCM" SG_ 1430 Gate_Req_PE 0;
BA_ "GenSigTimeoutTime_BSM" SG_ 1430 Gate_Req_PE 0;
BA_ "GenSigTimeoutTime_CADM" SG_ 1430 Gate_Req_PE 0;
BA_ "GenSigTimeoutTime_DMSM" SG_ 1430 Gate_Req_PE 0;
BA_ "GenSigTimeoutTime_DTCM" SG_ 1430 Gate_Req_PE 0;
BA_ "GenSigTimeoutTime_ECM" SG_ 1430 Gate_Req_PE 0;
BA_ "GenSigTimeoutTime_EVCU2" SG_ 1430 Gate_Req_PE 0;
BA_ "GenSigTimeoutTime_GNMM" SG_ 1430 Gate_Req_PE 0;
BA_ "GenSigTimeoutTime_HCP" SG_ 1430 Gate_Req_PE 0;
BA_ "GenSigTimeoutTime_IPC" SG_ 1430 Gate_Req_PE 0;
BA_ "GenSigTimeoutTime_TCM" SG_ 1430 Gate_Req_PE 0;
BA_ "GenSigTimeoutTime_AGSM" SG_ 1430 MessageCounter_BCM11 0;
BA_ "GenSigTimeoutTime_BCM" SG_ 1430 MessageCounter_BCM11 0;
BA_ "GenSigTimeoutTime_BSM" SG_ 1430 MessageCounter_BCM11 0;
BA_ "GenSigTimeoutTime_DMSM" SG_ 1430 MessageCounter_BCM11 0;
BA_ "GenSigTimeoutTime_DTCM" SG_ 1430 MessageCounter_BCM11 0;
BA_ "GenSigTimeoutTime_ECM" SG_ 1430 MessageCounter_BCM11 0;
BA_ "GenSigTimeoutTime_EVCU2" SG_ 1430 MessageCounter_BCM11 0;
BA_ "GenSigTimeoutTime_GNMM" SG_ 1430 MessageCounter_BCM11 0;
BA_ "GenSigTimeoutTime_HCP" SG_ 1430 MessageCounter_BCM11 0;
BA_ "GenSigTimeoutTime_IPC" SG_ 1430 MessageCounter_BCM11 0;
BA_ "GenSigTimeoutTime_RFHM" SG_ 1430 MessageCounter_BCM11 0;
BA_ "GenSigTimeoutTime_SGW" SG_ 1430 MessageCounter_BCM11 0;
BA_ "GenSigTimeoutTime_TCM" SG_ 1430 MessageCounter_BCM11 0;
BA_ "GenSigSendType" SG_ 1430 MF_SWG_AJAR 3;
BA_ "GenSigTimeoutTime_AGSM" SG_ 1430 MF_SWG_AJAR 0;
BA_ "GenSigTimeoutTime_BCM" SG_ 1430 MF_SWG_AJAR 0;
BA_ "GenSigTimeoutTime_BSM" SG_ 1430 MF_SWG_AJAR 0;
BA_ "GenSigTimeoutTime_CADM" SG_ 1430 MF_SWG_AJAR 0;
BA_ "GenSigTimeoutTime_DMSM" SG_ 1430 MF_SWG_AJAR 0;
BA_ "GenSigTimeoutTime_DTCM" SG_ 1430 MF_SWG_AJAR 0;
BA_ "GenSigTimeoutTime_ECM" SG_ 1430 MF_SWG_AJAR 0;
BA_ "GenSigTimeoutTime_EVCU2" SG_ 1430 MF_SWG_AJAR 0;
BA_ "GenSigTimeoutTime_GNMM" SG_ 1430 MF_SWG_AJAR 0;
BA_ "GenSigTimeoutTime_HCP" SG_ 1430 MF_SWG_AJAR 0;
BA_ "GenSigTimeoutTime_RFHM" SG_ 1430 MF_SWG_AJAR 0;
BA_ "GenSigTimeoutTime_SGW" SG_ 1430 MF_SWG_AJAR 0;
BA_ "GenSigTimeoutTime_TCM" SG_ 1430 MF_SWG_AJAR 0;
BA_ "GenSigSendType" SG_ 1430 PanicModeActive 3;
BA_ "GenSigTimeoutTime_AGSM" SG_ 1430 PanicModeActive 0;
BA_ "GenSigTimeoutTime_BCM" SG_ 1430 PanicModeActive 0;
BA_ "GenSigTimeoutTime_BSM" SG_ 1430 PanicModeActive 0;
BA_ "GenSigTimeoutTime_CADM" SG_ 1430 PanicModeActive 0;
BA_ "GenSigTimeoutTime_DMSM" SG_ 1430 PanicModeActive 0;
BA_ "GenSigTimeoutTime_DTCM" SG_ 1430 PanicModeActive 0;
BA_ "GenSigTimeoutTime_ECM" SG_ 1430 PanicModeActive 0;
BA_ "GenSigTimeoutTime_EVCU2" SG_ 1430 PanicModeActive 0;
BA_ "GenSigTimeoutTime_GNMM" SG_ 1430 PanicModeActive 0;
BA_ "GenSigTimeoutTime_HCP" SG_ 1430 PanicModeActive 0;
BA_ "GenSigTimeoutTime_IPC" SG_ 1430 PanicModeActive 0;
BA_ "GenSigTimeoutTime_RFHM" SG_ 1430 PanicModeActive 0;
BA_ "GenSigTimeoutTime_TCM" SG_ 1430 PanicModeActive 0;
BA_ "GenSigSendType" SG_ 1430 Parallel_Prk_Ast_Pad1 3;
BA_ "GenSigTimeoutTime_AGSM" SG_ 1430 Parallel_Prk_Ast_Pad1 0;
BA_ "GenSigTimeoutTime_BCM" SG_ 1430 Parallel_Prk_Ast_Pad1 0;
BA_ "GenSigTimeoutTime_BSM" SG_ 1430 Parallel_Prk_Ast_Pad1 0;
BA_ "GenSigTimeoutTime_CADM" SG_ 1430 Parallel_Prk_Ast_Pad1 0;
BA_ "GenSigTimeoutTime_DMSM" SG_ 1430 Parallel_Prk_Ast_Pad1 0;
BA_ "GenSigTimeoutTime_DTCM" SG_ 1430 Parallel_Prk_Ast_Pad1 0;
BA_ "GenSigTimeoutTime_EVCU2" SG_ 1430 Parallel_Prk_Ast_Pad1 0;
BA_ "GenSigTimeoutTime_GNMM" SG_ 1430 Parallel_Prk_Ast_Pad1 0;
BA_ "GenSigTimeoutTime_HCP" SG_ 1430 Parallel_Prk_Ast_Pad1 0;
BA_ "GenSigTimeoutTime_IPC" SG_ 1430 Parallel_Prk_Ast_Pad1 0;
BA_ "GenSigTimeoutTime_RFHM" SG_ 1430 Parallel_Prk_Ast_Pad1 0;
BA_ "GenSigTimeoutTime_SGW" SG_ 1430 Parallel_Prk_Ast_Pad1 0;
BA_ "GenSigTimeoutTime_TCM" SG_ 1430 Parallel_Prk_Ast_Pad1 0;
BA_ "GenSigSendType" SG_ 1430 PFTM_Req_PE 3;
BA_ "GenSigTimeoutTime_AGSM" SG_ 1430 PFTM_Req_PE 0;
BA_ "GenSigTimeoutTime_BCM" SG_ 1430 PFTM_Req_PE 0;
BA_ "GenSigTimeoutTime_BSM" SG_ 1430 PFTM_Req_PE 0;
BA_ "GenSigTimeoutTime_CADM" SG_ 1430 PFTM_Req_PE 0;
BA_ "GenSigTimeoutTime_DMSM" SG_ 1430 PFTM_Req_PE 0;
BA_ "GenSigTimeoutTime_DTCM" SG_ 1430 PFTM_Req_PE 0;
BA_ "GenSigTimeoutTime_ECM" SG_ 1430 PFTM_Req_PE 0;
BA_ "GenSigTimeoutTime_EVCU2" SG_ 1430 PFTM_Req_PE 0;
BA_ "GenSigTimeoutTime_GNMM" SG_ 1430 PFTM_Req_PE 0;
BA_ "GenSigTimeoutTime_HCP" SG_ 1430 PFTM_Req_PE 0;
BA_ "GenSigTimeoutTime_IPC" SG_ 1430 PFTM_Req_PE 0;
BA_ "GenSigTimeoutTime_SGW" SG_ 1430 PFTM_Req_PE 0;
BA_ "GenSigTimeoutTime_TCM" SG_ 1430 PFTM_Req_PE 0;
BA_ "GenSigTimeoutTime_AGSM" SG_ 1430 PN14_LS_Actv 0;
BA_ "GenSigTimeoutTime_BCM" SG_ 1430 PN14_LS_Actv 0;
BA_ "GenSigTimeoutTime_BSM" SG_ 1430 PN14_LS_Actv 0;
BA_ "GenSigTimeoutTime_DMSM" SG_ 1430 PN14_LS_Actv 0;
BA_ "GenSigTimeoutTime_DTCM" SG_ 1430 PN14_LS_Actv 0;
BA_ "GenSigTimeoutTime_ECM" SG_ 1430 PN14_LS_Actv 0;
BA_ "GenSigTimeoutTime_EVCU2" SG_ 1430 PN14_LS_Actv 0;
BA_ "GenSigTimeoutTime_GNMM" SG_ 1430 PN14_LS_Actv 0;
BA_ "GenSigTimeoutTime_HCP" SG_ 1430 PN14_LS_Actv 0;
BA_ "GenSigTimeoutTime_RFHM" SG_ 1430 PN14_LS_Actv 0;
BA_ "GenSigTimeoutTime_TCM" SG_ 1430 PN14_LS_Actv 0;
BA_ "GenSigTimeoutTime_AGSM" SG_ 1430 PN14_LS_Lvl7 0;
BA_ "GenSigTimeoutTime_BCM" SG_ 1430 PN14_LS_Lvl7 0;
BA_ "GenSigTimeoutTime_BSM" SG_ 1430 PN14_LS_Lvl7 0;
BA_ "GenSigTimeoutTime_DMSM" SG_ 1430 PN14_LS_Lvl7 0;
BA_ "GenSigTimeoutTime_DTCM" SG_ 1430 PN14_LS_Lvl7 0;
BA_ "GenSigTimeoutTime_ECM" SG_ 1430 PN14_LS_Lvl7 0;
BA_ "GenSigTimeoutTime_EVCU2" SG_ 1430 PN14_LS_Lvl7 0;
BA_ "GenSigTimeoutTime_GNMM" SG_ 1430 PN14_LS_Lvl7 0;
BA_ "GenSigTimeoutTime_HCP" SG_ 1430 PN14_LS_Lvl7 0;
BA_ "GenSigTimeoutTime_IPC" SG_ 1430 PN14_LS_Lvl7 0;
BA_ "GenSigTimeoutTime_RFHM" SG_ 1430 PN14_LS_Lvl7 0;
BA_ "GenSigTimeoutTime_TCM" SG_ 1430 PN14_LS_Lvl7 0;
BA_ "GenSigSendType" SG_ 1430 StopStartClimateInfo 3;
BA_ "GenSigTimeoutTime_AGSM" SG_ 1430 StopStartClimateInfo 0;
BA_ "GenSigTimeoutTime_BCM" SG_ 1430 StopStartClimateInfo 0;
BA_ "GenSigTimeoutTime_BSM" SG_ 1430 StopStartClimateInfo 0;
BA_ "GenSigTimeoutTime_CADM" SG_ 1430 StopStartClimateInfo 0;
BA_ "GenSigTimeoutTime_DMSM" SG_ 1430 StopStartClimateInfo 0;
BA_ "GenSigTimeoutTime_DTCM" SG_ 1430 StopStartClimateInfo 0;
BA_ "GenSigTimeoutTime_GNMM" SG_ 1430 StopStartClimateInfo 0;
BA_ "GenSigTimeoutTime_HCP" SG_ 1430 StopStartClimateInfo 0;
BA_ "GenSigTimeoutTime_IPC" SG_ 1430 StopStartClimateInfo 0;
BA_ "GenSigTimeoutTime_RFHM" SG_ 1430 StopStartClimateInfo 0;
BA_ "GenSigTimeoutTime_TCM" SG_ 1430 StopStartClimateInfo 0;
BA_ "GenSigStartValue" SG_ 1431 AirTemp_Outsd 255;
BA_ "GenSigSendType" SG_ 1431 AirTemp_Outsd 3;
BA_ "GenSigTimeoutTime_AGSM" SG_ 1431 AirTemp_Outsd 0;
BA_ "GenSigTimeoutTime_BCM" SG_ 1431 AirTemp_Outsd 0;
BA_ "GenSigTimeoutTime_BSM" SG_ 1431 AirTemp_Outsd 0;
BA_ "GenSigTimeoutTime_CADM" SG_ 1431 AirTemp_Outsd 0;
BA_ "GenSigTimeoutTime_DMSM" SG_ 1431 AirTemp_Outsd 0;
BA_ "GenSigTimeoutTime_DTCM" SG_ 1431 AirTemp_Outsd 0;
BA_ "GenSigTimeoutTime_ECM" SG_ 1431 AirTemp_Outsd 0;
BA_ "GenSigTimeoutTime_EVCU2" SG_ 1431 AirTemp_Outsd 0;
BA_ "GenSigTimeoutTime_GNMM" SG_ 1431 AirTemp_Outsd 0;
BA_ "GenSigTimeoutTime_HCP" SG_ 1431 AirTemp_Outsd 0;
BA_ "GenSigTimeoutTime_IPC" SG_ 1431 AirTemp_Outsd 0;
BA_ "GenSigTimeoutTime_RFHM" SG_ 1431 AirTemp_Outsd 0;
BA_ "GenSigTimeoutTime_SGW" SG_ 1431 AirTemp_Outsd 0;
BA_ "GenSigTimeoutTime_TCM" SG_ 1431 AirTemp_Outsd 0;
BA_ "GenSigSendType" SG_ 1431 APARequestSts 3;
BA_ "GenSigTimeoutTime_AGSM" SG_ 1431 APARequestSts 0;
BA_ "GenSigTimeoutTime_BCM" SG_ 1431 APARequestSts 0;
BA_ "GenSigTimeoutTime_BSM" SG_ 1431 APARequestSts 0;
BA_ "GenSigTimeoutTime_CADM" SG_ 1431 APARequestSts 0;
BA_ "GenSigTimeoutTime_DMSM" SG_ 1431 APARequestSts 0;
BA_ "GenSigTimeoutTime_DTCM" SG_ 1431 APARequestSts 0;
BA_ "GenSigTimeoutTime_ECM" SG_ 1431 APARequestSts 0;
BA_ "GenSigTimeoutTime_EVCU2" SG_ 1431 APARequestSts 0;
BA_ "GenSigTimeoutTime_GNMM" SG_ 1431 APARequestSts 0;
BA_ "GenSigTimeoutTime_HCP" SG_ 1431 APARequestSts 0;
BA_ "GenSigTimeoutTime_IPC" SG_ 1431 APARequestSts 0;
BA_ "GenSigTimeoutTime_RFHM" SG_ 1431 APARequestSts 0;
BA_ "GenSigTimeoutTime_TCM" SG_ 1431 APARequestSts 0;
BA_ "GenSigSendType" SG_ 1431 AxleLckrSEL_SW 3;
BA_ "GenSigTimeoutTime_AGSM" SG_ 1431 AxleLckrSEL_SW 0;
BA_ "GenSigTimeoutTime_BCM" SG_ 1431 AxleLckrSEL_SW 0;
BA_ "GenSigTimeoutTime_BSM" SG_ 1431 AxleLckrSEL_SW 0;
BA_ "GenSigTimeoutTime_CADM" SG_ 1431 AxleLckrSEL_SW 0;
BA_ "GenSigTimeoutTime_DMSM" SG_ 1431 AxleLckrSEL_SW 0;
BA_ "GenSigTimeoutTime_ECM" SG_ 1431 AxleLckrSEL_SW 0;
BA_ "GenSigTimeoutTime_GNMM" SG_ 1431 AxleLckrSEL_SW 0;
BA_ "GenSigTimeoutTime_HCP" SG_ 1431 AxleLckrSEL_SW 0;
BA_ "GenSigTimeoutTime_IPC" SG_ 1431 AxleLckrSEL_SW 0;
BA_ "GenSigTimeoutTime_RFHM" SG_ 1431 AxleLckrSEL_SW 0;
BA_ "GenSigTimeoutTime_SGW" SG_ 1431 AxleLckrSEL_SW 0;
BA_ "GenSigTimeoutTime_TCM" SG_ 1431 AxleLckrSEL_SW 0;
BA_ "GenSigTimeoutTime_AGSM" SG_ 1431 CRC_BCM12 0;
BA_ "GenSigTimeoutTime_BCM" SG_ 1431 CRC_BCM12 0;
BA_ "GenSigTimeoutTime_DMSM" SG_ 1431 CRC_BCM12 0;
BA_ "GenSigTimeoutTime_DTCM" SG_ 1431 CRC_BCM12 0;
BA_ "GenSigTimeoutTime_ECM" SG_ 1431 CRC_BCM12 0;
BA_ "GenSigTimeoutTime_GNMM" SG_ 1431 CRC_BCM12 0;
BA_ "GenSigTimeoutTime_HCP" SG_ 1431 CRC_BCM12 0;
BA_ "GenSigTimeoutTime_IPC" SG_ 1431 CRC_BCM12 0;
BA_ "GenSigTimeoutTime_RFHM" SG_ 1431 CRC_BCM12 0;
BA_ "GenSigTimeoutTime_SGW" SG_ 1431 CRC_BCM12 0;
BA_ "GenSigSendType" SG_ 1431 DALM_Status 3;
BA_ "GenSigTimeoutTime_AGSM" SG_ 1431 DALM_Status 0;
BA_ "GenSigTimeoutTime_BCM" SG_ 1431 DALM_Status 0;
BA_ "GenSigTimeoutTime_BSM" SG_ 1431 DALM_Status 0;
BA_ "GenSigTimeoutTime_DMSM" SG_ 1431 DALM_Status 0;
BA_ "GenSigTimeoutTime_DTCM" SG_ 1431 DALM_Status 0;
BA_ "GenSigTimeoutTime_ECM" SG_ 1431 DALM_Status 0;
BA_ "GenSigTimeoutTime_EVCU2" SG_ 1431 DALM_Status 0;
BA_ "GenSigTimeoutTime_GNMM" SG_ 1431 DALM_Status 0;
BA_ "GenSigTimeoutTime_HCP" SG_ 1431 DALM_Status 0;
BA_ "GenSigTimeoutTime_IPC" SG_ 1431 DALM_Status 0;
BA_ "GenSigTimeoutTime_RFHM" SG_ 1431 DALM_Status 0;
BA_ "GenSigTimeoutTime_SGW" SG_ 1431 DALM_Status 0;
BA_ "GenSigTimeoutTime_TCM" SG_ 1431 DALM_Status 0;
BA_ "GenSigSendType" SG_ 1431 GlobDrvMdRq_BCM 3;
BA_ "GenSigTimeoutTime_AGSM" SG_ 1431 GlobDrvMdRq_BCM 0;
BA_ "GenSigTimeoutTime_BCM" SG_ 1431 GlobDrvMdRq_BCM 0;
BA_ "GenSigTimeoutTime_BSM" SG_ 1431 GlobDrvMdRq_BCM 0;
BA_ "GenSigTimeoutTime_CADM" SG_ 1431 GlobDrvMdRq_BCM 0;
BA_ "GenSigTimeoutTime_DMSM" SG_ 1431 GlobDrvMdRq_BCM 0;
BA_ "GenSigTimeoutTime_DTCM" SG_ 1431 GlobDrvMdRq_BCM 0;
BA_ "GenSigTimeoutTime_EVCU2" SG_ 1431 GlobDrvMdRq_BCM 0;
BA_ "GenSigTimeoutTime_GNMM" SG_ 1431 GlobDrvMdRq_BCM 0;
BA_ "GenSigTimeoutTime_HCP" SG_ 1431 GlobDrvMdRq_BCM 0;
BA_ "GenSigTimeoutTime_IPC" SG_ 1431 GlobDrvMdRq_BCM 0;
BA_ "GenSigTimeoutTime_RFHM" SG_ 1431 GlobDrvMdRq_BCM 0;
BA_ "GenSigTimeoutTime_SGW" SG_ 1431 GlobDrvMdRq_BCM 0;
BA_ "GenSigTimeoutTime_TCM" SG_ 1431 GlobDrvMdRq_BCM 0;
BA_ "GenSigStartValue" SG_ 1431 IGN_OFF_TIME_LNG 4095;
BA_ "GenSigTimeoutTime_AGSM" SG_ 1431 IGN_OFF_TIME_LNG 0;
BA_ "GenSigTimeoutTime_BCM" SG_ 1431 IGN_OFF_TIME_LNG 0;
BA_ "GenSigTimeoutTime_CADM" SG_ 1431 IGN_OFF_TIME_LNG 0;
BA_ "GenSigTimeoutTime_DMSM" SG_ 1431 IGN_OFF_TIME_LNG 0;
BA_ "GenSigTimeoutTime_ECM" SG_ 1431 IGN_OFF_TIME_LNG 0;
BA_ "GenSigTimeoutTime_EVCU2" SG_ 1431 IGN_OFF_TIME_LNG 0;
BA_ "GenSigTimeoutTime_GNMM" SG_ 1431 IGN_OFF_TIME_LNG 0;
BA_ "GenSigTimeoutTime_HCP" SG_ 1431 IGN_OFF_TIME_LNG 0;
BA_ "GenSigTimeoutTime_IPC" SG_ 1431 IGN_OFF_TIME_LNG 0;
BA_ "GenSigTimeoutTime_RFHM" SG_ 1431 IGN_OFF_TIME_LNG 0;
BA_ "GenSigSendType" SG_ 1431 Left_Button_BCM 3;
BA_ "GenSigTimeoutTime_AGSM" SG_ 1431 Left_Button_BCM 0;
BA_ "GenSigTimeoutTime_BCM" SG_ 1431 Left_Button_BCM 0;
BA_ "GenSigTimeoutTime_BSM" SG_ 1431 Left_Button_BCM 0;
BA_ "GenSigTimeoutTime_CADM" SG_ 1431 Left_Button_BCM 0;
BA_ "GenSigTimeoutTime_DMSM" SG_ 1431 Left_Button_BCM 0;
BA_ "GenSigTimeoutTime_DTCM" SG_ 1431 Left_Button_BCM 0;
BA_ "GenSigTimeoutTime_GNMM" SG_ 1431 Left_Button_BCM 0;
BA_ "GenSigTimeoutTime_HCP" SG_ 1431 Left_Button_BCM 0;
BA_ "GenSigTimeoutTime_IPC" SG_ 1431 Left_Button_BCM 0;
BA_ "GenSigTimeoutTime_RFHM" SG_ 1431 Left_Button_BCM 0;
BA_ "GenSigTimeoutTime_SGW" SG_ 1431 Left_Button_BCM 0;
BA_ "GenSigTimeoutTime_TCM" SG_ 1431 Left_Button_BCM 0;
BA_ "GenSigTimeoutTime_AGSM" SG_ 1431 MessageCounter_BCM12 0;
BA_ "GenSigTimeoutTime_BCM" SG_ 1431 MessageCounter_BCM12 0;
BA_ "GenSigTimeoutTime_DMSM" SG_ 1431 MessageCounter_BCM12 0;
BA_ "GenSigTimeoutTime_DTCM" SG_ 1431 MessageCounter_BCM12 0;
BA_ "GenSigTimeoutTime_ECM" SG_ 1431 MessageCounter_BCM12 0;
BA_ "GenSigTimeoutTime_GNMM" SG_ 1431 MessageCounter_BCM12 0;
BA_ "GenSigTimeoutTime_HCP" SG_ 1431 MessageCounter_BCM12 0;
BA_ "GenSigTimeoutTime_IPC" SG_ 1431 MessageCounter_BCM12 0;
BA_ "GenSigTimeoutTime_RFHM" SG_ 1431 MessageCounter_BCM12 0;
BA_ "GenSigTimeoutTime_SGW" SG_ 1431 MessageCounter_BCM12 0;
BA_ "GenSigSendType" SG_ 1431 PaddlesModeReq 3;
BA_ "GenSigTimeoutTime_AGSM" SG_ 1431 PaddlesModeReq 0;
BA_ "GenSigTimeoutTime_BCM" SG_ 1431 PaddlesModeReq 0;
BA_ "GenSigTimeoutTime_BSM" SG_ 1431 PaddlesModeReq 0;
BA_ "GenSigTimeoutTime_CADM" SG_ 1431 PaddlesModeReq 0;
BA_ "GenSigTimeoutTime_DMSM" SG_ 1431 PaddlesModeReq 0;
BA_ "GenSigTimeoutTime_DTCM" SG_ 1431 PaddlesModeReq 0;
BA_ "GenSigTimeoutTime_ECM" SG_ 1431 PaddlesModeReq 0;
BA_ "GenSigTimeoutTime_EVCU2" SG_ 1431 PaddlesModeReq 0;
BA_ "GenSigTimeoutTime_GNMM" SG_ 1431 PaddlesModeReq 0;
BA_ "GenSigTimeoutTime_HCP" SG_ 1431 PaddlesModeReq 0;
BA_ "GenSigTimeoutTime_IPC" SG_ 1431 PaddlesModeReq 0;
BA_ "GenSigTimeoutTime_RFHM" SG_ 1431 PaddlesModeReq 0;
BA_ "GenSigTimeoutTime_SGW" SG_ 1431 PaddlesModeReq 0;
BA_ "GenSigSendType" SG_ 1431 PAMRequestSts 3;
BA_ "GenSigTimeoutTime_AGSM" SG_ 1431 PAMRequestSts 0;
BA_ "GenSigTimeoutTime_BCM" SG_ 1431 PAMRequestSts 0;
BA_ "GenSigTimeoutTime_BSM" SG_ 1431 PAMRequestSts 0;
BA_ "GenSigTimeoutTime_CADM" SG_ 1431 PAMRequestSts 0;
BA_ "GenSigTimeoutTime_DMSM" SG_ 1431 PAMRequestSts 0;
BA_ "GenSigTimeoutTime_DTCM" SG_ 1431 PAMRequestSts 0;
BA_ "GenSigTimeoutTime_ECM" SG_ 1431 PAMRequestSts 0;
BA_ "GenSigTimeoutTime_EVCU2" SG_ 1431 PAMRequestSts 0;
BA_ "GenSigTimeoutTime_GNMM" SG_ 1431 PAMRequestSts 0;
BA_ "GenSigTimeoutTime_HCP" SG_ 1431 PAMRequestSts 0;
BA_ "GenSigTimeoutTime_IPC" SG_ 1431 PAMRequestSts 0;
BA_ "GenSigTimeoutTime_RFHM" SG_ 1431 PAMRequestSts 0;
BA_ "GenSigTimeoutTime_TCM" SG_ 1431 PAMRequestSts 0;
BA_ "GenSigSendType" SG_ 1431 PreCondCabinSts 3;
BA_ "GenSigTimeoutTime_AGSM" SG_ 1431 PreCondCabinSts 0;
BA_ "GenSigTimeoutTime_BCM" SG_ 1431 PreCondCabinSts 0;
BA_ "GenSigTimeoutTime_BSM" SG_ 1431 PreCondCabinSts 0;
BA_ "GenSigTimeoutTime_CADM" SG_ 1431 PreCondCabinSts 0;
BA_ "GenSigTimeoutTime_DMSM" SG_ 1431 PreCondCabinSts 0;
BA_ "GenSigTimeoutTime_DTCM" SG_ 1431 PreCondCabinSts 0;
BA_ "GenSigTimeoutTime_ECM" SG_ 1431 PreCondCabinSts 0;
BA_ "GenSigTimeoutTime_GNMM" SG_ 1431 PreCondCabinSts 0;
BA_ "GenSigTimeoutTime_HCP" SG_ 1431 PreCondCabinSts 0;
BA_ "GenSigTimeoutTime_IPC" SG_ 1431 PreCondCabinSts 0;
BA_ "GenSigTimeoutTime_RFHM" SG_ 1431 PreCondCabinSts 0;
BA_ "GenSigTimeoutTime_SGW" SG_ 1431 PreCondCabinSts 0;
BA_ "GenSigTimeoutTime_TCM" SG_ 1431 PreCondCabinSts 0;
BA_ "GenSigSendType" SG_ 1431 Right_Button_BCM 3;
BA_ "GenSigTimeoutTime_AGSM" SG_ 1431 Right_Button_BCM 0;
BA_ "GenSigTimeoutTime_BCM" SG_ 1431 Right_Button_BCM 0;
BA_ "GenSigTimeoutTime_BSM" SG_ 1431 Right_Button_BCM 0;
BA_ "GenSigTimeoutTime_CADM" SG_ 1431 Right_Button_BCM 0;
BA_ "GenSigTimeoutTime_DMSM" SG_ 1431 Right_Button_BCM 0;
BA_ "GenSigTimeoutTime_DTCM" SG_ 1431 Right_Button_BCM 0;
BA_ "GenSigTimeoutTime_GNMM" SG_ 1431 Right_Button_BCM 0;
BA_ "GenSigTimeoutTime_HCP" SG_ 1431 Right_Button_BCM 0;
BA_ "GenSigTimeoutTime_IPC" SG_ 1431 Right_Button_BCM 0;
BA_ "GenSigTimeoutTime_RFHM" SG_ 1431 Right_Button_BCM 0;
BA_ "GenSigTimeoutTime_SGW" SG_ 1431 Right_Button_BCM 0;
BA_ "GenSigTimeoutTime_TCM" SG_ 1431 Right_Button_BCM 0;
BA_ "GenSigSendType" SG_ 1431 SeatVib_Sts 3;
BA_ "GenSigTimeoutTime_AGSM" SG_ 1431 SeatVib_Sts 0;
BA_ "GenSigTimeoutTime_BCM" SG_ 1431 SeatVib_Sts 0;
BA_ "GenSigTimeoutTime_BSM" SG_ 1431 SeatVib_Sts 0;
BA_ "GenSigTimeoutTime_DMSM" SG_ 1431 SeatVib_Sts 0;
BA_ "GenSigTimeoutTime_DTCM" SG_ 1431 SeatVib_Sts 0;
BA_ "GenSigTimeoutTime_ECM" SG_ 1431 SeatVib_Sts 0;
BA_ "GenSigTimeoutTime_EVCU2" SG_ 1431 SeatVib_Sts 0;
BA_ "GenSigTimeoutTime_GNMM" SG_ 1431 SeatVib_Sts 0;
BA_ "GenSigTimeoutTime_HCP" SG_ 1431 SeatVib_Sts 0;
BA_ "GenSigTimeoutTime_IPC" SG_ 1431 SeatVib_Sts 0;
BA_ "GenSigTimeoutTime_RFHM" SG_ 1431 SeatVib_Sts 0;
BA_ "GenSigTimeoutTime_SGW" SG_ 1431 SeatVib_Sts 0;
BA_ "GenSigTimeoutTime_TCM" SG_ 1431 SeatVib_Sts 0;
BA_ "GenSigSendType" SG_ 1431 Switch_2WD_Rq 3;
BA_ "GenSigTimeoutTime_AGSM" SG_ 1431 Switch_2WD_Rq 0;
BA_ "GenSigTimeoutTime_BCM" SG_ 1431 Switch_2WD_Rq 0;
BA_ "GenSigTimeoutTime_BSM" SG_ 1431 Switch_2WD_Rq 0;
BA_ "GenSigTimeoutTime_CADM" SG_ 1431 Switch_2WD_Rq 0;
BA_ "GenSigTimeoutTime_DMSM" SG_ 1431 Switch_2WD_Rq 0;
BA_ "GenSigTimeoutTime_ECM" SG_ 1431 Switch_2WD_Rq 0;
BA_ "GenSigTimeoutTime_GNMM" SG_ 1431 Switch_2WD_Rq 0;
BA_ "GenSigTimeoutTime_HCP" SG_ 1431 Switch_2WD_Rq 0;
BA_ "GenSigTimeoutTime_IPC" SG_ 1431 Switch_2WD_Rq 0;
BA_ "GenSigTimeoutTime_RFHM" SG_ 1431 Switch_2WD_Rq 0;
BA_ "GenSigTimeoutTime_SGW" SG_ 1431 Switch_2WD_Rq 0;
BA_ "GenSigTimeoutTime_TCM" SG_ 1431 Switch_2WD_Rq 0;
BA_ "GenSigSendType" SG_ 1431 Switch_4AUTO_Rq 3;
BA_ "GenSigTimeoutTime_AGSM" SG_ 1431 Switch_4AUTO_Rq 0;
BA_ "GenSigTimeoutTime_BCM" SG_ 1431 Switch_4AUTO_Rq 0;
BA_ "GenSigTimeoutTime_BSM" SG_ 1431 Switch_4AUTO_Rq 0;
BA_ "GenSigTimeoutTime_CADM" SG_ 1431 Switch_4AUTO_Rq 0;
BA_ "GenSigTimeoutTime_DMSM" SG_ 1431 Switch_4AUTO_Rq 0;
BA_ "GenSigTimeoutTime_ECM" SG_ 1431 Switch_4AUTO_Rq 0;
BA_ "GenSigTimeoutTime_GNMM" SG_ 1431 Switch_4AUTO_Rq 0;
BA_ "GenSigTimeoutTime_HCP" SG_ 1431 Switch_4AUTO_Rq 0;
BA_ "GenSigTimeoutTime_IPC" SG_ 1431 Switch_4AUTO_Rq 0;
BA_ "GenSigTimeoutTime_RFHM" SG_ 1431 Switch_4AUTO_Rq 0;
BA_ "GenSigTimeoutTime_SGW" SG_ 1431 Switch_4AUTO_Rq 0;
BA_ "GenSigTimeoutTime_TCM" SG_ 1431 Switch_4AUTO_Rq 0;
BA_ "GenSigSendType" SG_ 1431 Switch_4LOCK_Rq 3;
BA_ "GenSigTimeoutTime_AGSM" SG_ 1431 Switch_4LOCK_Rq 0;
BA_ "GenSigTimeoutTime_BCM" SG_ 1431 Switch_4LOCK_Rq 0;
BA_ "GenSigTimeoutTime_BSM" SG_ 1431 Switch_4LOCK_Rq 0;
BA_ "GenSigTimeoutTime_CADM" SG_ 1431 Switch_4LOCK_Rq 0;
BA_ "GenSigTimeoutTime_DMSM" SG_ 1431 Switch_4LOCK_Rq 0;
BA_ "GenSigTimeoutTime_ECM" SG_ 1431 Switch_4LOCK_Rq 0;
BA_ "GenSigTimeoutTime_GNMM" SG_ 1431 Switch_4LOCK_Rq 0;
BA_ "GenSigTimeoutTime_HCP" SG_ 1431 Switch_4LOCK_Rq 0;
BA_ "GenSigTimeoutTime_IPC" SG_ 1431 Switch_4LOCK_Rq 0;
BA_ "GenSigTimeoutTime_RFHM" SG_ 1431 Switch_4LOCK_Rq 0;
BA_ "GenSigTimeoutTime_SGW" SG_ 1431 Switch_4LOCK_Rq 0;
BA_ "GenSigTimeoutTime_TCM" SG_ 1431 Switch_4LOCK_Rq 0;
BA_ "GenSigStartValue" SG_ 1431 Switch1_Rq 3;
BA_ "GenSigSendType" SG_ 1431 Switch1_Rq 3;
BA_ "GenSigTimeoutTime_AGSM" SG_ 1431 Switch1_Rq 0;
BA_ "GenSigTimeoutTime_BCM" SG_ 1431 Switch1_Rq 0;
BA_ "GenSigTimeoutTime_BSM" SG_ 1431 Switch1_Rq 0;
BA_ "GenSigTimeoutTime_CADM" SG_ 1431 Switch1_Rq 0;
BA_ "GenSigTimeoutTime_DMSM" SG_ 1431 Switch1_Rq 0;
BA_ "GenSigTimeoutTime_ECM" SG_ 1431 Switch1_Rq 0;
BA_ "GenSigTimeoutTime_EVCU2" SG_ 1431 Switch1_Rq 0;
BA_ "GenSigTimeoutTime_GNMM" SG_ 1431 Switch1_Rq 0;
BA_ "GenSigTimeoutTime_HCP" SG_ 1431 Switch1_Rq 0;
BA_ "GenSigTimeoutTime_IPC" SG_ 1431 Switch1_Rq 0;
BA_ "GenSigTimeoutTime_RFHM" SG_ 1431 Switch1_Rq 0;
BA_ "GenSigTimeoutTime_SGW" SG_ 1431 Switch1_Rq 0;
BA_ "GenSigTimeoutTime_TCM" SG_ 1431 Switch1_Rq 0;
BA_ "GenSigStartValue" SG_ 1431 Switch2_Rq 3;
BA_ "GenSigSendType" SG_ 1431 Switch2_Rq 3;
BA_ "GenSigTimeoutTime_AGSM" SG_ 1431 Switch2_Rq 0;
BA_ "GenSigTimeoutTime_BCM" SG_ 1431 Switch2_Rq 0;
BA_ "GenSigTimeoutTime_BSM" SG_ 1431 Switch2_Rq 0;
BA_ "GenSigTimeoutTime_CADM" SG_ 1431 Switch2_Rq 0;
BA_ "GenSigTimeoutTime_DMSM" SG_ 1431 Switch2_Rq 0;
BA_ "GenSigTimeoutTime_ECM" SG_ 1431 Switch2_Rq 0;
BA_ "GenSigTimeoutTime_GNMM" SG_ 1431 Switch2_Rq 0;
BA_ "GenSigTimeoutTime_HCP" SG_ 1431 Switch2_Rq 0;
BA_ "GenSigTimeoutTime_IPC" SG_ 1431 Switch2_Rq 0;
BA_ "GenSigTimeoutTime_RFHM" SG_ 1431 Switch2_Rq 0;
BA_ "GenSigTimeoutTime_SGW" SG_ 1431 Switch2_Rq 0;
BA_ "GenSigTimeoutTime_TCM" SG_ 1431 Switch2_Rq 0;
BA_ "GenSigSendType" SG_ 1431 TerrainModeInterfaceButton_BCM 3;
BA_ "GenSigTimeoutTime_AGSM" SG_ 1431 TerrainModeInterfaceButton_BCM 0;
BA_ "GenSigTimeoutTime_BCM" SG_ 1431 TerrainModeInterfaceButton_BCM 0;
BA_ "GenSigTimeoutTime_BSM" SG_ 1431 TerrainModeInterfaceButton_BCM 0;
BA_ "GenSigTimeoutTime_CADM" SG_ 1431 TerrainModeInterfaceButton_BCM 0;
BA_ "GenSigTimeoutTime_DMSM" SG_ 1431 TerrainModeInterfaceButton_BCM 0;
BA_ "GenSigTimeoutTime_DTCM" SG_ 1431 TerrainModeInterfaceButton_BCM 0;
BA_ "GenSigTimeoutTime_EVCU2" SG_ 1431 TerrainModeInterfaceButton_BCM 0;
BA_ "GenSigTimeoutTime_GNMM" SG_ 1431 TerrainModeInterfaceButton_BCM 0;
BA_ "GenSigTimeoutTime_HCP" SG_ 1431 TerrainModeInterfaceButton_BCM 0;
BA_ "GenSigTimeoutTime_IPC" SG_ 1431 TerrainModeInterfaceButton_BCM 0;
BA_ "GenSigTimeoutTime_RFHM" SG_ 1431 TerrainModeInterfaceButton_BCM 0;
BA_ "GenSigTimeoutTime_SGW" SG_ 1431 TerrainModeInterfaceButton_BCM 0;
BA_ "GenSigTimeoutTime_TCM" SG_ 1431 TerrainModeInterfaceButton_BCM 0;
BA_ "GenSigSendType" SG_ 1431 Tow_Request 3;
BA_ "GenSigTimeoutTime_AGSM" SG_ 1431 Tow_Request 0;
BA_ "GenSigTimeoutTime_BCM" SG_ 1431 Tow_Request 0;
BA_ "GenSigTimeoutTime_BSM" SG_ 1431 Tow_Request 0;
BA_ "GenSigTimeoutTime_CADM" SG_ 1431 Tow_Request 0;
BA_ "GenSigTimeoutTime_DMSM" SG_ 1431 Tow_Request 0;
BA_ "GenSigTimeoutTime_DTCM" SG_ 1431 Tow_Request 0;
BA_ "GenSigTimeoutTime_EVCU2" SG_ 1431 Tow_Request 0;
BA_ "GenSigTimeoutTime_GNMM" SG_ 1431 Tow_Request 0;
BA_ "GenSigTimeoutTime_HCP" SG_ 1431 Tow_Request 0;
BA_ "GenSigTimeoutTime_IPC" SG_ 1431 Tow_Request 0;
BA_ "GenSigTimeoutTime_RFHM" SG_ 1431 Tow_Request 0;
BA_ "GenSigTimeoutTime_SGW" SG_ 1431 Tow_Request 0;
BA_ "GenSigTimeoutTime_TCM" SG_ 1431 Tow_Request 0;
BA_ "GenSigSendType" SG_ 1431 TRAC_PSD 3;
BA_ "GenSigTimeoutTime_AGSM" SG_ 1431 TRAC_PSD 0;
BA_ "GenSigTimeoutTime_BCM" SG_ 1431 TRAC_PSD 0;
BA_ "GenSigTimeoutTime_CADM" SG_ 1431 TRAC_PSD 0;
BA_ "GenSigTimeoutTime_DMSM" SG_ 1431 TRAC_PSD 0;
BA_ "GenSigTimeoutTime_DTCM" SG_ 1431 TRAC_PSD 0;
BA_ "GenSigTimeoutTime_ECM" SG_ 1431 TRAC_PSD 0;
BA_ "GenSigTimeoutTime_EVCU2" SG_ 1431 TRAC_PSD 0;
BA_ "GenSigTimeoutTime_GNMM" SG_ 1431 TRAC_PSD 0;
BA_ "GenSigTimeoutTime_HCP" SG_ 1431 TRAC_PSD 0;
BA_ "GenSigTimeoutTime_IPC" SG_ 1431 TRAC_PSD 0;
BA_ "GenSigTimeoutTime_RFHM" SG_ 1431 TRAC_PSD 0;
BA_ "GenSigTimeoutTime_SGW" SG_ 1431 TRAC_PSD 0;
BA_ "GenSigTimeoutTime_TCM" SG_ 1431 TRAC_PSD 0;
BA_ "GenSigSendType" SG_ 1431 Trns_DrvMdReq_BCM 3;
BA_ "GenSigTimeoutTime_AGSM" SG_ 1431 Trns_DrvMdReq_BCM 0;
BA_ "GenSigTimeoutTime_BCM" SG_ 1431 Trns_DrvMdReq_BCM 0;
BA_ "GenSigTimeoutTime_BSM" SG_ 1431 Trns_DrvMdReq_BCM 0;
BA_ "GenSigTimeoutTime_CADM" SG_ 1431 Trns_DrvMdReq_BCM 0;
BA_ "GenSigTimeoutTime_DMSM" SG_ 1431 Trns_DrvMdReq_BCM 0;
BA_ "GenSigTimeoutTime_DTCM" SG_ 1431 Trns_DrvMdReq_BCM 0;
BA_ "GenSigTimeoutTime_EVCU2" SG_ 1431 Trns_DrvMdReq_BCM 0;
BA_ "GenSigTimeoutTime_GNMM" SG_ 1431 Trns_DrvMdReq_BCM 0;
BA_ "GenSigTimeoutTime_HCP" SG_ 1431 Trns_DrvMdReq_BCM 0;
BA_ "GenSigTimeoutTime_IPC" SG_ 1431 Trns_DrvMdReq_BCM 0;
BA_ "GenSigTimeoutTime_RFHM" SG_ 1431 Trns_DrvMdReq_BCM 0;
BA_ "GenSigTimeoutTime_SGW" SG_ 1431 Trns_DrvMdReq_BCM 0;
BA_ "GenSigTimeoutTime_TCM" SG_ 1431 Trns_DrvMdReq_BCM 0;
BA_ "GenSigSendType" SG_ 159 ACC_DistSwDec 1;
BA_ "GenSigTimeoutTime_AGSM" SG_ 159 ACC_DistSwDec 0;
BA_ "GenSigTimeoutTime_BCM" SG_ 159 ACC_DistSwDec 0;
BA_ "GenSigTimeoutTime_BSM" SG_ 159 ACC_DistSwDec 0;
BA_ "GenSigTimeoutTime_DMSM" SG_ 159 ACC_DistSwDec 0;
BA_ "GenSigTimeoutTime_DTCM" SG_ 159 ACC_DistSwDec 0;
BA_ "GenSigTimeoutTime_ECM" SG_ 159 ACC_DistSwDec 0;
BA_ "GenSigTimeoutTime_EVCU2" SG_ 159 ACC_DistSwDec 0;
BA_ "GenSigTimeoutTime_GNMM" SG_ 159 ACC_DistSwDec 0;
BA_ "GenSigTimeoutTime_HCP" SG_ 159 ACC_DistSwDec 0;
BA_ "GenSigTimeoutTime_IPC" SG_ 159 ACC_DistSwDec 0;
BA_ "GenSigTimeoutTime_RFHM" SG_ 159 ACC_DistSwDec 0;
BA_ "GenSigTimeoutTime_TCM" SG_ 159 ACC_DistSwDec 0;
BA_ "GenSigSendType" SG_ 159 ACC_DistSwInc 1;
BA_ "GenSigTimeoutTime_AGSM" SG_ 159 ACC_DistSwInc 0;
BA_ "GenSigTimeoutTime_BCM" SG_ 159 ACC_DistSwInc 0;
BA_ "GenSigTimeoutTime_BSM" SG_ 159 ACC_DistSwInc 0;
BA_ "GenSigTimeoutTime_DMSM" SG_ 159 ACC_DistSwInc 0;
BA_ "GenSigTimeoutTime_DTCM" SG_ 159 ACC_DistSwInc 0;
BA_ "GenSigTimeoutTime_ECM" SG_ 159 ACC_DistSwInc 0;
BA_ "GenSigTimeoutTime_EVCU2" SG_ 159 ACC_DistSwInc 0;
BA_ "GenSigTimeoutTime_GNMM" SG_ 159 ACC_DistSwInc 0;
BA_ "GenSigTimeoutTime_HCP" SG_ 159 ACC_DistSwInc 0;
BA_ "GenSigTimeoutTime_IPC" SG_ 159 ACC_DistSwInc 0;
BA_ "GenSigTimeoutTime_RFHM" SG_ 159 ACC_DistSwInc 0;
BA_ "GenSigTimeoutTime_TCM" SG_ 159 ACC_DistSwInc 0;
BA_ "GenSigSendType" SG_ 159 ACC_On 1;
BA_ "GenSigTimeoutTime_AGSM" SG_ 159 ACC_On 0;
BA_ "GenSigTimeoutTime_BCM" SG_ 159 ACC_On 0;
BA_ "GenSigTimeoutTime_DMSM" SG_ 159 ACC_On 0;
BA_ "GenSigTimeoutTime_DTCM" SG_ 159 ACC_On 0;
BA_ "GenSigTimeoutTime_ECM" SG_ 159 ACC_On 0;
BA_ "GenSigTimeoutTime_EVCU2" SG_ 159 ACC_On 0;
BA_ "GenSigTimeoutTime_GNMM" SG_ 159 ACC_On 0;
BA_ "GenSigTimeoutTime_HCP" SG_ 159 ACC_On 0;
BA_ "GenSigTimeoutTime_IPC" SG_ 159 ACC_On 0;
BA_ "GenSigTimeoutTime_RFHM" SG_ 159 ACC_On 0;
BA_ "GenSigTimeoutTime_TCM" SG_ 159 ACC_On 0;
BA_ "GenSigTimeoutTime_AGSM" SG_ 159 AcceleratorSts 0;
BA_ "GenSigTimeoutTime_BCM" SG_ 159 AcceleratorSts 0;
BA_ "GenSigTimeoutTime_DMSM" SG_ 159 AcceleratorSts 0;
BA_ "GenSigTimeoutTime_DTCM" SG_ 159 AcceleratorSts 0;
BA_ "GenSigTimeoutTime_EVCU2" SG_ 159 AcceleratorSts 0;
BA_ "GenSigTimeoutTime_GNMM" SG_ 159 AcceleratorSts 0;
BA_ "GenSigTimeoutTime_HCP" SG_ 159 AcceleratorSts 0;
BA_ "GenSigTimeoutTime_IPC" SG_ 159 AcceleratorSts 0;
BA_ "GenSigTimeoutTime_RFHM" SG_ 159 AcceleratorSts 0;
BA_ "GenSigTimeoutTime_TCM" SG_ 159 AcceleratorSts 0;
BA_ "GenSigTimeoutTime_AGSM" SG_ 159 CRC_BCM13 0;
BA_ "GenSigTimeoutTime_BCM" SG_ 159 CRC_BCM13 0;
BA_ "GenSigTimeoutTime_DMSM" SG_ 159 CRC_BCM13 0;
BA_ "GenSigTimeoutTime_DTCM" SG_ 159 CRC_BCM13 0;
BA_ "GenSigTimeoutTime_EVCU2" SG_ 159 CRC_BCM13 0;
BA_ "GenSigTimeoutTime_GNMM" SG_ 159 CRC_BCM13 0;
BA_ "GenSigTimeoutTime_HCP" SG_ 159 CRC_BCM13 0;
BA_ "GenSigTimeoutTime_IPC" SG_ 159 CRC_BCM13 0;
BA_ "GenSigTimeoutTime_RFHM" SG_ 159 CRC_BCM13 0;
BA_ "GenSigTimeoutTime_SGW" SG_ 159 CRC_BCM13 0;
BA_ "GenSigTimeoutTime_TCM" SG_ 159 CRC_BCM13 0;
BA_ "GenSigStartValue" SG_ 159 CRC_CSWC_1 255;
BA_ "GenSigTimeoutTime_AGSM" SG_ 159 CRC_CSWC_1 0;
BA_ "GenSigTimeoutTime_BCM" SG_ 159 CRC_CSWC_1 0;
BA_ "GenSigTimeoutTime_BSM" SG_ 159 CRC_CSWC_1 0;
BA_ "GenSigTimeoutTime_CADM" SG_ 159 CRC_CSWC_1 0;
BA_ "GenSigTimeoutTime_DMSM" SG_ 159 CRC_CSWC_1 0;
BA_ "GenSigTimeoutTime_DTCM" SG_ 159 CRC_CSWC_1 0;
BA_ "GenSigTimeoutTime_ECM" SG_ 159 CRC_CSWC_1 0;
BA_ "GenSigTimeoutTime_EVCU2" SG_ 159 CRC_CSWC_1 0;
BA_ "GenSigTimeoutTime_GNMM" SG_ 159 CRC_CSWC_1 0;
BA_ "GenSigTimeoutTime_HCP" SG_ 159 CRC_CSWC_1 0;
BA_ "GenSigTimeoutTime_IPC" SG_ 159 CRC_CSWC_1 0;
BA_ "GenSigTimeoutTime_RFHM" SG_ 159 CRC_CSWC_1 0;
BA_ "GenSigTimeoutTime_SGW" SG_ 159 CRC_CSWC_1 0;
BA_ "GenSigTimeoutTime_TCM" SG_ 159 CRC_CSWC_1 0;
BA_ "GenSigTimeoutTime_AGSM" SG_ 159 CruiseControlFailSts 0;
BA_ "GenSigTimeoutTime_BCM" SG_ 159 CruiseControlFailSts 0;
BA_ "GenSigTimeoutTime_BSM" SG_ 159 CruiseControlFailSts 0;
BA_ "GenSigTimeoutTime_DMSM" SG_ 159 CruiseControlFailSts 0;
BA_ "GenSigTimeoutTime_DTCM" SG_ 159 CruiseControlFailSts 0;
BA_ "GenSigTimeoutTime_ECM" SG_ 159 CruiseControlFailSts 0;
BA_ "GenSigTimeoutTime_EVCU2" SG_ 159 CruiseControlFailSts 0;
BA_ "GenSigTimeoutTime_GNMM" SG_ 159 CruiseControlFailSts 0;
BA_ "GenSigTimeoutTime_HCP" SG_ 159 CruiseControlFailSts 0;
BA_ "GenSigTimeoutTime_IPC" SG_ 159 CruiseControlFailSts 0;
BA_ "GenSigTimeoutTime_RFHM" SG_ 159 CruiseControlFailSts 0;
BA_ "GenSigTimeoutTime_SGW" SG_ 159 CruiseControlFailSts 0;
BA_ "GenSigTimeoutTime_TCM" SG_ 159 CruiseControlFailSts 0;
BA_ "GenSigTimeoutTime_AGSM" SG_ 159 CruiseControlOnOffSts 0;
BA_ "GenSigTimeoutTime_BCM" SG_ 159 CruiseControlOnOffSts 0;
BA_ "GenSigTimeoutTime_DMSM" SG_ 159 CruiseControlOnOffSts 0;
BA_ "GenSigTimeoutTime_DTCM" SG_ 159 CruiseControlOnOffSts 0;
BA_ "GenSigTimeoutTime_ECM" SG_ 159 CruiseControlOnOffSts 0;
BA_ "GenSigTimeoutTime_EVCU2" SG_ 159 CruiseControlOnOffSts 0;
BA_ "GenSigTimeoutTime_GNMM" SG_ 159 CruiseControlOnOffSts 0;
BA_ "GenSigTimeoutTime_HCP" SG_ 159 CruiseControlOnOffSts 0;
BA_ "GenSigTimeoutTime_IPC" SG_ 159 CruiseControlOnOffSts 0;
BA_ "GenSigTimeoutTime_RFHM" SG_ 159 CruiseControlOnOffSts 0;
BA_ "GenSigTimeoutTime_TCM" SG_ 159 CruiseControlOnOffSts 0;
BA_ "GenSigSendType" SG_ 159 CrusCnclSwitch 3;
BA_ "GenSigTimeoutTime_AGSM" SG_ 159 CrusCnclSwitch 0;
BA_ "GenSigTimeoutTime_BCM" SG_ 159 CrusCnclSwitch 0;
BA_ "GenSigTimeoutTime_DMSM" SG_ 159 CrusCnclSwitch 0;
BA_ "GenSigTimeoutTime_DTCM" SG_ 159 CrusCnclSwitch 0;
BA_ "GenSigTimeoutTime_ECM" SG_ 159 CrusCnclSwitch 0;
BA_ "GenSigTimeoutTime_EVCU2" SG_ 159 CrusCnclSwitch 0;
BA_ "GenSigTimeoutTime_GNMM" SG_ 159 CrusCnclSwitch 0;
BA_ "GenSigTimeoutTime_HCP" SG_ 159 CrusCnclSwitch 0;
BA_ "GenSigTimeoutTime_IPC" SG_ 159 CrusCnclSwitch 0;
BA_ "GenSigTimeoutTime_RFHM" SG_ 159 CrusCnclSwitch 0;
BA_ "GenSigTimeoutTime_TCM" SG_ 159 CrusCnclSwitch 0;
BA_ "GenSigTimeoutTime_AGSM" SG_ 159 DeceleratorSts 0;
BA_ "GenSigTimeoutTime_BCM" SG_ 159 DeceleratorSts 0;
BA_ "GenSigTimeoutTime_DMSM" SG_ 159 DeceleratorSts 0;
BA_ "GenSigTimeoutTime_DTCM" SG_ 159 DeceleratorSts 0;
BA_ "GenSigTimeoutTime_EVCU2" SG_ 159 DeceleratorSts 0;
BA_ "GenSigTimeoutTime_GNMM" SG_ 159 DeceleratorSts 0;
BA_ "GenSigTimeoutTime_HCP" SG_ 159 DeceleratorSts 0;
BA_ "GenSigTimeoutTime_IPC" SG_ 159 DeceleratorSts 0;
BA_ "GenSigTimeoutTime_RFHM" SG_ 159 DeceleratorSts 0;
BA_ "GenSigTimeoutTime_TCM" SG_ 159 DeceleratorSts 0;
BA_ "GenSigTimeoutTime_AGSM" SG_ 159 MC_CSWC_1 0;
BA_ "GenSigTimeoutTime_BCM" SG_ 159 MC_CSWC_1 0;
BA_ "GenSigTimeoutTime_BSM" SG_ 159 MC_CSWC_1 0;
BA_ "GenSigTimeoutTime_CADM" SG_ 159 MC_CSWC_1 0;
BA_ "GenSigTimeoutTime_DMSM" SG_ 159 MC_CSWC_1 0;
BA_ "GenSigTimeoutTime_DTCM" SG_ 159 MC_CSWC_1 0;
BA_ "GenSigTimeoutTime_ECM" SG_ 159 MC_CSWC_1 0;
BA_ "GenSigTimeoutTime_EVCU2" SG_ 159 MC_CSWC_1 0;
BA_ "GenSigTimeoutTime_GNMM" SG_ 159 MC_CSWC_1 0;
BA_ "GenSigTimeoutTime_HCP" SG_ 159 MC_CSWC_1 0;
BA_ "GenSigTimeoutTime_IPC" SG_ 159 MC_CSWC_1 0;
BA_ "GenSigTimeoutTime_RFHM" SG_ 159 MC_CSWC_1 0;
BA_ "GenSigTimeoutTime_SGW" SG_ 159 MC_CSWC_1 0;
BA_ "GenSigTimeoutTime_TCM" SG_ 159 MC_CSWC_1 0;
BA_ "GenSigTimeoutTime_AGSM" SG_ 159 MessageCounter_BCM13 0;
BA_ "GenSigTimeoutTime_BCM" SG_ 159 MessageCounter_BCM13 0;
BA_ "GenSigTimeoutTime_DMSM" SG_ 159 MessageCounter_BCM13 0;
BA_ "GenSigTimeoutTime_DTCM" SG_ 159 MessageCounter_BCM13 0;
BA_ "GenSigTimeoutTime_EVCU2" SG_ 159 MessageCounter_BCM13 0;
BA_ "GenSigTimeoutTime_GNMM" SG_ 159 MessageCounter_BCM13 0;
BA_ "GenSigTimeoutTime_HCP" SG_ 159 MessageCounter_BCM13 0;
BA_ "GenSigTimeoutTime_IPC" SG_ 159 MessageCounter_BCM13 0;
BA_ "GenSigTimeoutTime_RFHM" SG_ 159 MessageCounter_BCM13 0;
BA_ "GenSigTimeoutTime_SGW" SG_ 159 MessageCounter_BCM13 0;
BA_ "GenSigTimeoutTime_TCM" SG_ 159 MessageCounter_BCM13 0;
BA_ "GenSigTimeoutTime_AGSM" SG_ 159 ResumeSwitch 0;
BA_ "GenSigTimeoutTime_BCM" SG_ 159 ResumeSwitch 0;
BA_ "GenSigTimeoutTime_DMSM" SG_ 159 ResumeSwitch 0;
BA_ "GenSigTimeoutTime_DTCM" SG_ 159 ResumeSwitch 0;
BA_ "GenSigTimeoutTime_EVCU2" SG_ 159 ResumeSwitch 0;
BA_ "GenSigTimeoutTime_GNMM" SG_ 159 ResumeSwitch 0;
BA_ "GenSigTimeoutTime_HCP" SG_ 159 ResumeSwitch 0;
BA_ "GenSigTimeoutTime_IPC" SG_ 159 ResumeSwitch 0;
BA_ "GenSigTimeoutTime_RFHM" SG_ 159 ResumeSwitch 0;
BA_ "GenSigTimeoutTime_TCM" SG_ 159 ResumeSwitch 0;
BA_ "GenSigSendType" SG_ 736 Command_01Sts 3;
BA_ "GenSigTimeoutTime_AGSM" SG_ 736 Command_01Sts 0;
BA_ "GenSigTimeoutTime_BCM" SG_ 736 Command_01Sts 0;
BA_ "GenSigTimeoutTime_BSM" SG_ 736 Command_01Sts 0;
BA_ "GenSigTimeoutTime_DMSM" SG_ 736 Command_01Sts 0;
BA_ "GenSigTimeoutTime_DTCM" SG_ 736 Command_01Sts 0;
BA_ "GenSigTimeoutTime_ECM" SG_ 736 Command_01Sts 0;
BA_ "GenSigTimeoutTime_EVCU2" SG_ 736 Command_01Sts 0;
BA_ "GenSigTimeoutTime_GNMM" SG_ 736 Command_01Sts 0;
BA_ "GenSigTimeoutTime_HCP" SG_ 736 Command_01Sts 0;
BA_ "GenSigTimeoutTime_IPC" SG_ 736 Command_01Sts 0;
BA_ "GenSigTimeoutTime_RFHM" SG_ 736 Command_01Sts 0;
BA_ "GenSigTimeoutTime_TCM" SG_ 736 Command_01Sts 0;
BA_ "GenSigSendType" SG_ 736 Command_02Sts 3;
BA_ "GenSigTimeoutTime_AGSM" SG_ 736 Command_02Sts 0;
BA_ "GenSigTimeoutTime_BCM" SG_ 736 Command_02Sts 0;
BA_ "GenSigTimeoutTime_BSM" SG_ 736 Command_02Sts 0;
BA_ "GenSigTimeoutTime_DMSM" SG_ 736 Command_02Sts 0;
BA_ "GenSigTimeoutTime_DTCM" SG_ 736 Command_02Sts 0;
BA_ "GenSigTimeoutTime_ECM" SG_ 736 Command_02Sts 0;
BA_ "GenSigTimeoutTime_EVCU2" SG_ 736 Command_02Sts 0;
BA_ "GenSigTimeoutTime_GNMM" SG_ 736 Command_02Sts 0;
BA_ "GenSigTimeoutTime_HCP" SG_ 736 Command_02Sts 0;
BA_ "GenSigTimeoutTime_IPC" SG_ 736 Command_02Sts 0;
BA_ "GenSigTimeoutTime_RFHM" SG_ 736 Command_02Sts 0;
BA_ "GenSigTimeoutTime_TCM" SG_ 736 Command_02Sts 0;
BA_ "GenSigSendType" SG_ 736 Command_03Sts 3;
BA_ "GenSigTimeoutTime_AGSM" SG_ 736 Command_03Sts 0;
BA_ "GenSigTimeoutTime_BCM" SG_ 736 Command_03Sts 0;
BA_ "GenSigTimeoutTime_BSM" SG_ 736 Command_03Sts 0;
BA_ "GenSigTimeoutTime_DMSM" SG_ 736 Command_03Sts 0;
BA_ "GenSigTimeoutTime_DTCM" SG_ 736 Command_03Sts 0;
BA_ "GenSigTimeoutTime_ECM" SG_ 736 Command_03Sts 0;
BA_ "GenSigTimeoutTime_EVCU2" SG_ 736 Command_03Sts 0;
BA_ "GenSigTimeoutTime_GNMM" SG_ 736 Command_03Sts 0;
BA_ "GenSigTimeoutTime_HCP" SG_ 736 Command_03Sts 0;
BA_ "GenSigTimeoutTime_IPC" SG_ 736 Command_03Sts 0;
BA_ "GenSigTimeoutTime_RFHM" SG_ 736 Command_03Sts 0;
BA_ "GenSigTimeoutTime_TCM" SG_ 736 Command_03Sts 0;
BA_ "GenSigSendType" SG_ 736 Command_04Sts 3;
BA_ "GenSigTimeoutTime_AGSM" SG_ 736 Command_04Sts 0;
BA_ "GenSigTimeoutTime_BCM" SG_ 736 Command_04Sts 0;
BA_ "GenSigTimeoutTime_BSM" SG_ 736 Command_04Sts 0;
BA_ "GenSigTimeoutTime_DMSM" SG_ 736 Command_04Sts 0;
BA_ "GenSigTimeoutTime_DTCM" SG_ 736 Command_04Sts 0;
BA_ "GenSigTimeoutTime_ECM" SG_ 736 Command_04Sts 0;
BA_ "GenSigTimeoutTime_EVCU2" SG_ 736 Command_04Sts 0;
BA_ "GenSigTimeoutTime_GNMM" SG_ 736 Command_04Sts 0;
BA_ "GenSigTimeoutTime_HCP" SG_ 736 Command_04Sts 0;
BA_ "GenSigTimeoutTime_IPC" SG_ 736 Command_04Sts 0;
BA_ "GenSigTimeoutTime_RFHM" SG_ 736 Command_04Sts 0;
BA_ "GenSigTimeoutTime_TCM" SG_ 736 Command_04Sts 0;
BA_ "GenSigSendType" SG_ 736 Command_05Sts 3;
BA_ "GenSigTimeoutTime_AGSM" SG_ 736 Command_05Sts 0;
BA_ "GenSigTimeoutTime_BCM" SG_ 736 Command_05Sts 0;
BA_ "GenSigTimeoutTime_BSM" SG_ 736 Command_05Sts 0;
BA_ "GenSigTimeoutTime_DMSM" SG_ 736 Command_05Sts 0;
BA_ "GenSigTimeoutTime_DTCM" SG_ 736 Command_05Sts 0;
BA_ "GenSigTimeoutTime_ECM" SG_ 736 Command_05Sts 0;
BA_ "GenSigTimeoutTime_EVCU2" SG_ 736 Command_05Sts 0;
BA_ "GenSigTimeoutTime_GNMM" SG_ 736 Command_05Sts 0;
BA_ "GenSigTimeoutTime_HCP" SG_ 736 Command_05Sts 0;
BA_ "GenSigTimeoutTime_IPC" SG_ 736 Command_05Sts 0;
BA_ "GenSigTimeoutTime_RFHM" SG_ 736 Command_05Sts 0;
BA_ "GenSigTimeoutTime_TCM" SG_ 736 Command_05Sts 0;
BA_ "GenSigSendType" SG_ 736 Command_06Sts 3;
BA_ "GenSigTimeoutTime_AGSM" SG_ 736 Command_06Sts 0;
BA_ "GenSigTimeoutTime_BCM" SG_ 736 Command_06Sts 0;
BA_ "GenSigTimeoutTime_BSM" SG_ 736 Command_06Sts 0;
BA_ "GenSigTimeoutTime_DMSM" SG_ 736 Command_06Sts 0;
BA_ "GenSigTimeoutTime_DTCM" SG_ 736 Command_06Sts 0;
BA_ "GenSigTimeoutTime_ECM" SG_ 736 Command_06Sts 0;
BA_ "GenSigTimeoutTime_EVCU2" SG_ 736 Command_06Sts 0;
BA_ "GenSigTimeoutTime_GNMM" SG_ 736 Command_06Sts 0;
BA_ "GenSigTimeoutTime_HCP" SG_ 736 Command_06Sts 0;
BA_ "GenSigTimeoutTime_IPC" SG_ 736 Command_06Sts 0;
BA_ "GenSigTimeoutTime_RFHM" SG_ 736 Command_06Sts 0;
BA_ "GenSigTimeoutTime_TCM" SG_ 736 Command_06Sts 0;
BA_ "GenSigSendType" SG_ 736 Command_07Sts 3;
BA_ "GenSigTimeoutTime_AGSM" SG_ 736 Command_07Sts 0;
BA_ "GenSigTimeoutTime_BCM" SG_ 736 Command_07Sts 0;
BA_ "GenSigTimeoutTime_BSM" SG_ 736 Command_07Sts 0;
BA_ "GenSigTimeoutTime_DMSM" SG_ 736 Command_07Sts 0;
BA_ "GenSigTimeoutTime_DTCM" SG_ 736 Command_07Sts 0;
BA_ "GenSigTimeoutTime_ECM" SG_ 736 Command_07Sts 0;
BA_ "GenSigTimeoutTime_EVCU2" SG_ 736 Command_07Sts 0;
BA_ "GenSigTimeoutTime_GNMM" SG_ 736 Command_07Sts 0;
BA_ "GenSigTimeoutTime_HCP" SG_ 736 Command_07Sts 0;
BA_ "GenSigTimeoutTime_IPC" SG_ 736 Command_07Sts 0;
BA_ "GenSigTimeoutTime_RFHM" SG_ 736 Command_07Sts 0;
BA_ "GenSigTimeoutTime_TCM" SG_ 736 Command_07Sts 0;
BA_ "GenSigSendType" SG_ 736 Command_08Sts 3;
BA_ "GenSigTimeoutTime_AGSM" SG_ 736 Command_08Sts 0;
BA_ "GenSigTimeoutTime_BCM" SG_ 736 Command_08Sts 0;
BA_ "GenSigTimeoutTime_BSM" SG_ 736 Command_08Sts 0;
BA_ "GenSigTimeoutTime_DMSM" SG_ 736 Command_08Sts 0;
BA_ "GenSigTimeoutTime_DTCM" SG_ 736 Command_08Sts 0;
BA_ "GenSigTimeoutTime_ECM" SG_ 736 Command_08Sts 0;
BA_ "GenSigTimeoutTime_EVCU2" SG_ 736 Command_08Sts 0;
BA_ "GenSigTimeoutTime_GNMM" SG_ 736 Command_08Sts 0;
BA_ "GenSigTimeoutTime_HCP" SG_ 736 Command_08Sts 0;
BA_ "GenSigTimeoutTime_IPC" SG_ 736 Command_08Sts 0;
BA_ "GenSigTimeoutTime_RFHM" SG_ 736 Command_08Sts 0;
BA_ "GenSigTimeoutTime_TCM" SG_ 736 Command_08Sts 0;
BA_ "GenSigSendType" SG_ 736 Command_09Sts 3;
BA_ "GenSigTimeoutTime_AGSM" SG_ 736 Command_09Sts 0;
BA_ "GenSigTimeoutTime_BCM" SG_ 736 Command_09Sts 0;
BA_ "GenSigTimeoutTime_BSM" SG_ 736 Command_09Sts 0;
BA_ "GenSigTimeoutTime_DMSM" SG_ 736 Command_09Sts 0;
BA_ "GenSigTimeoutTime_DTCM" SG_ 736 Command_09Sts 0;
BA_ "GenSigTimeoutTime_ECM" SG_ 736 Command_09Sts 0;
BA_ "GenSigTimeoutTime_EVCU2" SG_ 736 Command_09Sts 0;
BA_ "GenSigTimeoutTime_GNMM" SG_ 736 Command_09Sts 0;
BA_ "GenSigTimeoutTime_HCP" SG_ 736 Command_09Sts 0;
BA_ "GenSigTimeoutTime_IPC" SG_ 736 Command_09Sts 0;
BA_ "GenSigTimeoutTime_RFHM" SG_ 736 Command_09Sts 0;
BA_ "GenSigTimeoutTime_TCM" SG_ 736 Command_09Sts 0;
BA_ "GenSigSendType" SG_ 736 Command_10Sts 3;
BA_ "GenSigTimeoutTime_AGSM" SG_ 736 Command_10Sts 0;
BA_ "GenSigTimeoutTime_BCM" SG_ 736 Command_10Sts 0;
BA_ "GenSigTimeoutTime_BSM" SG_ 736 Command_10Sts 0;
BA_ "GenSigTimeoutTime_DMSM" SG_ 736 Command_10Sts 0;
BA_ "GenSigTimeoutTime_DTCM" SG_ 736 Command_10Sts 0;
BA_ "GenSigTimeoutTime_ECM" SG_ 736 Command_10Sts 0;
BA_ "GenSigTimeoutTime_EVCU2" SG_ 736 Command_10Sts 0;
BA_ "GenSigTimeoutTime_GNMM" SG_ 736 Command_10Sts 0;
BA_ "GenSigTimeoutTime_HCP" SG_ 736 Command_10Sts 0;
BA_ "GenSigTimeoutTime_RFHM" SG_ 736 Command_10Sts 0;
BA_ "GenSigTimeoutTime_TCM" SG_ 736 Command_10Sts 0;
BA_ "GenSigSendType" SG_ 736 Command_11Sts 3;
BA_ "GenSigTimeoutTime_AGSM" SG_ 736 Command_11Sts 0;
BA_ "GenSigTimeoutTime_BCM" SG_ 736 Command_11Sts 0;
BA_ "GenSigTimeoutTime_BSM" SG_ 736 Command_11Sts 0;
BA_ "GenSigTimeoutTime_DMSM" SG_ 736 Command_11Sts 0;
BA_ "GenSigTimeoutTime_DTCM" SG_ 736 Command_11Sts 0;
BA_ "GenSigTimeoutTime_ECM" SG_ 736 Command_11Sts 0;
BA_ "GenSigTimeoutTime_EVCU2" SG_ 736 Command_11Sts 0;
BA_ "GenSigTimeoutTime_GNMM" SG_ 736 Command_11Sts 0;
BA_ "GenSigTimeoutTime_HCP" SG_ 736 Command_11Sts 0;
BA_ "GenSigTimeoutTime_RFHM" SG_ 736 Command_11Sts 0;
BA_ "GenSigTimeoutTime_TCM" SG_ 736 Command_11Sts 0;
BA_ "GenSigSendType" SG_ 736 Command_12Sts 3;
BA_ "GenSigTimeoutTime_AGSM" SG_ 736 Command_12Sts 0;
BA_ "GenSigTimeoutTime_BCM" SG_ 736 Command_12Sts 0;
BA_ "GenSigTimeoutTime_BSM" SG_ 736 Command_12Sts 0;
BA_ "GenSigTimeoutTime_DMSM" SG_ 736 Command_12Sts 0;
BA_ "GenSigTimeoutTime_DTCM" SG_ 736 Command_12Sts 0;
BA_ "GenSigTimeoutTime_ECM" SG_ 736 Command_12Sts 0;
BA_ "GenSigTimeoutTime_EVCU2" SG_ 736 Command_12Sts 0;
BA_ "GenSigTimeoutTime_GNMM" SG_ 736 Command_12Sts 0;
BA_ "GenSigTimeoutTime_HCP" SG_ 736 Command_12Sts 0;
BA_ "GenSigTimeoutTime_RFHM" SG_ 736 Command_12Sts 0;
BA_ "GenSigTimeoutTime_TCM" SG_ 736 Command_12Sts 0;
BA_ "GenSigSendType" SG_ 736 Command_13Sts 3;
BA_ "GenSigTimeoutTime_AGSM" SG_ 736 Command_13Sts 0;
BA_ "GenSigTimeoutTime_BCM" SG_ 736 Command_13Sts 0;
BA_ "GenSigTimeoutTime_BSM" SG_ 736 Command_13Sts 0;
BA_ "GenSigTimeoutTime_DMSM" SG_ 736 Command_13Sts 0;
BA_ "GenSigTimeoutTime_DTCM" SG_ 736 Command_13Sts 0;
BA_ "GenSigTimeoutTime_ECM" SG_ 736 Command_13Sts 0;
BA_ "GenSigTimeoutTime_EVCU2" SG_ 736 Command_13Sts 0;
BA_ "GenSigTimeoutTime_GNMM" SG_ 736 Command_13Sts 0;
BA_ "GenSigTimeoutTime_HCP" SG_ 736 Command_13Sts 0;
BA_ "GenSigTimeoutTime_RFHM" SG_ 736 Command_13Sts 0;
BA_ "GenSigTimeoutTime_TCM" SG_ 736 Command_13Sts 0;
BA_ "GenSigSendType" SG_ 736 Command_14Sts 3;
BA_ "GenSigTimeoutTime_AGSM" SG_ 736 Command_14Sts 0;
BA_ "GenSigTimeoutTime_BCM" SG_ 736 Command_14Sts 0;
BA_ "GenSigTimeoutTime_BSM" SG_ 736 Command_14Sts 0;
BA_ "GenSigTimeoutTime_DMSM" SG_ 736 Command_14Sts 0;
BA_ "GenSigTimeoutTime_DTCM" SG_ 736 Command_14Sts 0;
BA_ "GenSigTimeoutTime_ECM" SG_ 736 Command_14Sts 0;
BA_ "GenSigTimeoutTime_EVCU2" SG_ 736 Command_14Sts 0;
BA_ "GenSigTimeoutTime_GNMM" SG_ 736 Command_14Sts 0;
BA_ "GenSigTimeoutTime_HCP" SG_ 736 Command_14Sts 0;
BA_ "GenSigTimeoutTime_RFHM" SG_ 736 Command_14Sts 0;
BA_ "GenSigTimeoutTime_TCM" SG_ 736 Command_14Sts 0;
BA_ "GenSigSendType" SG_ 736 Command_15Sts 3;
BA_ "GenSigTimeoutTime_AGSM" SG_ 736 Command_15Sts 0;
BA_ "GenSigTimeoutTime_BCM" SG_ 736 Command_15Sts 0;
BA_ "GenSigTimeoutTime_BSM" SG_ 736 Command_15Sts 0;
BA_ "GenSigTimeoutTime_DMSM" SG_ 736 Command_15Sts 0;
BA_ "GenSigTimeoutTime_DTCM" SG_ 736 Command_15Sts 0;
BA_ "GenSigTimeoutTime_EVCU2" SG_ 736 Command_15Sts 0;
BA_ "GenSigTimeoutTime_GNMM" SG_ 736 Command_15Sts 0;
BA_ "GenSigTimeoutTime_HCP" SG_ 736 Command_15Sts 0;
BA_ "GenSigTimeoutTime_RFHM" SG_ 736 Command_15Sts 0;
BA_ "GenSigTimeoutTime_TCM" SG_ 736 Command_15Sts 0;
BA_ "GenSigTimeoutTime_AGSM" SG_ 736 CRC_BCM14 0;
BA_ "GenSigTimeoutTime_BCM" SG_ 736 CRC_BCM14 0;
BA_ "GenSigTimeoutTime_BSM" SG_ 736 CRC_BCM14 0;
BA_ "GenSigTimeoutTime_DMSM" SG_ 736 CRC_BCM14 0;
BA_ "GenSigTimeoutTime_DTCM" SG_ 736 CRC_BCM14 0;
BA_ "GenSigTimeoutTime_ECM" SG_ 736 CRC_BCM14 0;
BA_ "GenSigTimeoutTime_EVCU2" SG_ 736 CRC_BCM14 0;
BA_ "GenSigTimeoutTime_GNMM" SG_ 736 CRC_BCM14 0;
BA_ "GenSigTimeoutTime_HCP" SG_ 736 CRC_BCM14 0;
BA_ "GenSigTimeoutTime_RFHM" SG_ 736 CRC_BCM14 0;
BA_ "GenSigTimeoutTime_SGW" SG_ 736 CRC_BCM14 0;
BA_ "GenSigTimeoutTime_TCM" SG_ 736 CRC_BCM14 0;
BA_ "GenSigTimeoutTime_AGSM" SG_ 736 MessageCounter_BCM14 0;
BA_ "GenSigTimeoutTime_BCM" SG_ 736 MessageCounter_BCM14 0;
BA_ "GenSigTimeoutTime_BSM" SG_ 736 MessageCounter_BCM14 0;
BA_ "GenSigTimeoutTime_DMSM" SG_ 736 MessageCounter_BCM14 0;
BA_ "GenSigTimeoutTime_DTCM" SG_ 736 MessageCounter_BCM14 0;
BA_ "GenSigTimeoutTime_ECM" SG_ 736 MessageCounter_BCM14 0;
BA_ "GenSigTimeoutTime_EVCU2" SG_ 736 MessageCounter_BCM14 0;
BA_ "GenSigTimeoutTime_GNMM" SG_ 736 MessageCounter_BCM14 0;
BA_ "GenSigTimeoutTime_HCP" SG_ 736 MessageCounter_BCM14 0;
BA_ "GenSigTimeoutTime_RFHM" SG_ 736 MessageCounter_BCM14 0;
BA_ "GenSigTimeoutTime_SGW" SG_ 736 MessageCounter_BCM14 0;
BA_ "GenSigTimeoutTime_TCM" SG_ 736 MessageCounter_BCM14 0;
BA_ "GenSigTimeoutTime_AGSM" SG_ 512 BonnetAjarRawValSts_8 0;
BA_ "GenSigTimeoutTime_BCM" SG_ 512 BonnetAjarRawValSts_8 0;
BA_ "GenSigTimeoutTime_BSM" SG_ 512 BonnetAjarRawValSts_8 0;
BA_ "GenSigTimeoutTime_CADM" SG_ 512 BonnetAjarRawValSts_8 0;
BA_ "GenSigTimeoutTime_DMSM" SG_ 512 BonnetAjarRawValSts_8 0;
BA_ "GenSigTimeoutTime_DTCM" SG_ 512 BonnetAjarRawValSts_8 0;
BA_ "GenSigTimeoutTime_GNMM" SG_ 512 BonnetAjarRawValSts_8 0;
BA_ "GenSigTimeoutTime_HCP" SG_ 512 BonnetAjarRawValSts_8 0;
BA_ "GenSigTimeoutTime_IPC" SG_ 512 BonnetAjarRawValSts_8 0;
BA_ "GenSigTimeoutTime_RFHM" SG_ 512 BonnetAjarRawValSts_8 0;
BA_ "GenSigTimeoutTime_SGW" SG_ 512 BonnetAjarRawValSts_8 0;
BA_ "GenSigTimeoutTime_TCM" SG_ 512 BonnetAjarRawValSts_8 0;
BA_ "GenSigTimeoutTime_AGSM" SG_ 512 CRC_BCM18 0;
BA_ "GenSigTimeoutTime_BCM" SG_ 512 CRC_BCM18 0;
BA_ "GenSigTimeoutTime_CADM" SG_ 512 CRC_BCM18 0;
BA_ "GenSigTimeoutTime_DMSM" SG_ 512 CRC_BCM18 0;
BA_ "GenSigTimeoutTime_DTCM" SG_ 512 CRC_BCM18 0;
BA_ "GenSigTimeoutTime_GNMM" SG_ 512 CRC_BCM18 0;
BA_ "GenSigTimeoutTime_IPC" SG_ 512 CRC_BCM18 0;
BA_ "GenSigTimeoutTime_RFHM" SG_ 512 CRC_BCM18 0;
BA_ "GenSigTimeoutTime_SGW" SG_ 512 CRC_BCM18 0;
BA_ "GenSigTimeoutTime_AGSM" SG_ 512 DriverDoor2AjarRawValSts_8 0;
BA_ "GenSigTimeoutTime_BCM" SG_ 512 DriverDoor2AjarRawValSts_8 0;
BA_ "GenSigTimeoutTime_BSM" SG_ 512 DriverDoor2AjarRawValSts_8 0;
BA_ "GenSigTimeoutTime_CADM" SG_ 512 DriverDoor2AjarRawValSts_8 0;
BA_ "GenSigTimeoutTime_DMSM" SG_ 512 DriverDoor2AjarRawValSts_8 0;
BA_ "GenSigTimeoutTime_DTCM" SG_ 512 DriverDoor2AjarRawValSts_8 0;
BA_ "GenSigTimeoutTime_EVCU2" SG_ 512 DriverDoor2AjarRawValSts_8 0;
BA_ "GenSigTimeoutTime_GNMM" SG_ 512 DriverDoor2AjarRawValSts_8 0;
BA_ "GenSigTimeoutTime_HCP" SG_ 512 DriverDoor2AjarRawValSts_8 0;
BA_ "GenSigTimeoutTime_IPC" SG_ 512 DriverDoor2AjarRawValSts_8 0;
BA_ "GenSigTimeoutTime_RFHM" SG_ 512 DriverDoor2AjarRawValSts_8 0;
BA_ "GenSigTimeoutTime_SGW" SG_ 512 DriverDoor2AjarRawValSts_8 0;
BA_ "GenSigTimeoutTime_AGSM" SG_ 512 DriverDoor2AjarXtionSts 0;
BA_ "GenSigTimeoutTime_BCM" SG_ 512 DriverDoor2AjarXtionSts 0;
BA_ "GenSigTimeoutTime_BSM" SG_ 512 DriverDoor2AjarXtionSts 0;
BA_ "GenSigTimeoutTime_CADM" SG_ 512 DriverDoor2AjarXtionSts 0;
BA_ "GenSigTimeoutTime_DMSM" SG_ 512 DriverDoor2AjarXtionSts 0;
BA_ "GenSigTimeoutTime_DTCM" SG_ 512 DriverDoor2AjarXtionSts 0;
BA_ "GenSigTimeoutTime_EVCU2" SG_ 512 DriverDoor2AjarXtionSts 0;
BA_ "GenSigTimeoutTime_GNMM" SG_ 512 DriverDoor2AjarXtionSts 0;
BA_ "GenSigTimeoutTime_HCP" SG_ 512 DriverDoor2AjarXtionSts 0;
BA_ "GenSigTimeoutTime_IPC" SG_ 512 DriverDoor2AjarXtionSts 0;
BA_ "GenSigTimeoutTime_RFHM" SG_ 512 DriverDoor2AjarXtionSts 0;
BA_ "GenSigTimeoutTime_SGW" SG_ 512 DriverDoor2AjarXtionSts 0;
BA_ "GenSigTimeoutTime_TCM" SG_ 512 DriverDoor2AjarXtionSts 0;
BA_ "GenSigTimeoutTime_AGSM" SG_ 512 DriverDoorAjarRawValSts_8 0;
BA_ "GenSigTimeoutTime_BCM" SG_ 512 DriverDoorAjarRawValSts_8 0;
BA_ "GenSigTimeoutTime_BSM" SG_ 512 DriverDoorAjarRawValSts_8 0;
BA_ "GenSigTimeoutTime_CADM" SG_ 512 DriverDoorAjarRawValSts_8 0;
BA_ "GenSigTimeoutTime_DMSM" SG_ 512 DriverDoorAjarRawValSts_8 0;
BA_ "GenSigTimeoutTime_DTCM" SG_ 512 DriverDoorAjarRawValSts_8 0;
BA_ "GenSigTimeoutTime_EVCU2" SG_ 512 DriverDoorAjarRawValSts_8 0;
BA_ "GenSigTimeoutTime_GNMM" SG_ 512 DriverDoorAjarRawValSts_8 0;
BA_ "GenSigTimeoutTime_HCP" SG_ 512 DriverDoorAjarRawValSts_8 0;
BA_ "GenSigTimeoutTime_IPC" SG_ 512 DriverDoorAjarRawValSts_8 0;
BA_ "GenSigTimeoutTime_RFHM" SG_ 512 DriverDoorAjarRawValSts_8 0;
BA_ "GenSigTimeoutTime_SGW" SG_ 512 DriverDoorAjarRawValSts_8 0;
BA_ "GenSigTimeoutTime_AGSM" SG_ 512 DriverDoorAjarXtionSts 0;
BA_ "GenSigTimeoutTime_BCM" SG_ 512 DriverDoorAjarXtionSts 0;
BA_ "GenSigTimeoutTime_BSM" SG_ 512 DriverDoorAjarXtionSts 0;
BA_ "GenSigTimeoutTime_CADM" SG_ 512 DriverDoorAjarXtionSts 0;
BA_ "GenSigTimeoutTime_DMSM" SG_ 512 DriverDoorAjarXtionSts 0;
BA_ "GenSigTimeoutTime_DTCM" SG_ 512 DriverDoorAjarXtionSts 0;
BA_ "GenSigTimeoutTime_EVCU2" SG_ 512 DriverDoorAjarXtionSts 0;
BA_ "GenSigTimeoutTime_GNMM" SG_ 512 DriverDoorAjarXtionSts 0;
BA_ "GenSigTimeoutTime_HCP" SG_ 512 DriverDoorAjarXtionSts 0;
BA_ "GenSigTimeoutTime_IPC" SG_ 512 DriverDoorAjarXtionSts 0;
BA_ "GenSigTimeoutTime_RFHM" SG_ 512 DriverDoorAjarXtionSts 0;
BA_ "GenSigTimeoutTime_SGW" SG_ 512 DriverDoorAjarXtionSts 0;
BA_ "GenSigTimeoutTime_TCM" SG_ 512 DriverDoorAjarXtionSts 0;
BA_ "GenSigTimeoutTime_AGSM" SG_ 512 DRV_DR_UNLOCKING 0;
BA_ "GenSigTimeoutTime_BCM" SG_ 512 DRV_DR_UNLOCKING 0;
BA_ "GenSigTimeoutTime_BSM" SG_ 512 DRV_DR_UNLOCKING 0;
BA_ "GenSigTimeoutTime_CADM" SG_ 512 DRV_DR_UNLOCKING 0;
BA_ "GenSigTimeoutTime_DMSM" SG_ 512 DRV_DR_UNLOCKING 0;
BA_ "GenSigTimeoutTime_DTCM" SG_ 512 DRV_DR_UNLOCKING 0;
BA_ "GenSigTimeoutTime_ECM" SG_ 512 DRV_DR_UNLOCKING 0;
BA_ "GenSigTimeoutTime_GNMM" SG_ 512 DRV_DR_UNLOCKING 0;
BA_ "GenSigTimeoutTime_HCP" SG_ 512 DRV_DR_UNLOCKING 0;
BA_ "GenSigTimeoutTime_IPC" SG_ 512 DRV_DR_UNLOCKING 0;
BA_ "GenSigTimeoutTime_RFHM" SG_ 512 DRV_DR_UNLOCKING 0;
BA_ "GenSigTimeoutTime_SGW" SG_ 512 DRV_DR_UNLOCKING 0;
BA_ "GenSigTimeoutTime_TCM" SG_ 512 DRV_DR_UNLOCKING 0;
BA_ "GenSigTimeoutTime_AGSM" SG_ 512 LeakCheckTimerExpired 0;
BA_ "GenSigTimeoutTime_BCM" SG_ 512 LeakCheckTimerExpired 0;
BA_ "GenSigTimeoutTime_BSM" SG_ 512 LeakCheckTimerExpired 0;
BA_ "GenSigTimeoutTime_CADM" SG_ 512 LeakCheckTimerExpired 0;
BA_ "GenSigTimeoutTime_DMSM" SG_ 512 LeakCheckTimerExpired 0;
BA_ "GenSigTimeoutTime_DTCM" SG_ 512 LeakCheckTimerExpired 0;
BA_ "GenSigTimeoutTime_EVCU2" SG_ 512 LeakCheckTimerExpired 0;
BA_ "GenSigTimeoutTime_GNMM" SG_ 512 LeakCheckTimerExpired 0;
BA_ "GenSigTimeoutTime_HCP" SG_ 512 LeakCheckTimerExpired 0;
BA_ "GenSigTimeoutTime_IPC" SG_ 512 LeakCheckTimerExpired 0;
BA_ "GenSigTimeoutTime_RFHM" SG_ 512 LeakCheckTimerExpired 0;
BA_ "GenSigTimeoutTime_SGW" SG_ 512 LeakCheckTimerExpired 0;
BA_ "GenSigTimeoutTime_TCM" SG_ 512 LeakCheckTimerExpired 0;
BA_ "GenSigTimeoutTime_AGSM" SG_ 512 MessageCounter_BCM18 0;
BA_ "GenSigTimeoutTime_BCM" SG_ 512 MessageCounter_BCM18 0;
BA_ "GenSigTimeoutTime_CADM" SG_ 512 MessageCounter_BCM18 0;
BA_ "GenSigTimeoutTime_DMSM" SG_ 512 MessageCounter_BCM18 0;
BA_ "GenSigTimeoutTime_DTCM" SG_ 512 MessageCounter_BCM18 0;
BA_ "GenSigTimeoutTime_GNMM" SG_ 512 MessageCounter_BCM18 0;
BA_ "GenSigTimeoutTime_IPC" SG_ 512 MessageCounter_BCM18 0;
BA_ "GenSigTimeoutTime_RFHM" SG_ 512 MessageCounter_BCM18 0;
BA_ "GenSigTimeoutTime_SGW" SG_ 512 MessageCounter_BCM18 0;
BA_ "GenSigTimeoutTime_AGSM" SG_ 512 PsngrDoorAjarRawValSts 0;
BA_ "GenSigTimeoutTime_BCM" SG_ 512 PsngrDoorAjarRawValSts 0;
BA_ "GenSigTimeoutTime_BSM" SG_ 512 PsngrDoorAjarRawValSts 0;
BA_ "GenSigTimeoutTime_CADM" SG_ 512 PsngrDoorAjarRawValSts 0;
BA_ "GenSigTimeoutTime_DMSM" SG_ 512 PsngrDoorAjarRawValSts 0;
BA_ "GenSigTimeoutTime_DTCM" SG_ 512 PsngrDoorAjarRawValSts 0;
BA_ "GenSigTimeoutTime_ECM" SG_ 512 PsngrDoorAjarRawValSts 0;
BA_ "GenSigTimeoutTime_EVCU2" SG_ 512 PsngrDoorAjarRawValSts 0;
BA_ "GenSigTimeoutTime_GNMM" SG_ 512 PsngrDoorAjarRawValSts 0;
BA_ "GenSigTimeoutTime_HCP" SG_ 512 PsngrDoorAjarRawValSts 0;
BA_ "GenSigTimeoutTime_IPC" SG_ 512 PsngrDoorAjarRawValSts 0;
BA_ "GenSigTimeoutTime_RFHM" SG_ 512 PsngrDoorAjarRawValSts 0;
BA_ "GenSigTimeoutTime_SGW" SG_ 512 PsngrDoorAjarRawValSts 0;
BA_ "GenSigTimeoutTime_TCM" SG_ 512 PsngrDoorAjarRawValSts 0;
BA_ "GenSigTimeoutTime_AGSM" SG_ 256 BrkPdlStat_BCM 0;
BA_ "GenSigTimeoutTime_BCM" SG_ 256 BrkPdlStat_BCM 0;
BA_ "GenSigTimeoutTime_BSM" SG_ 256 BrkPdlStat_BCM 0;
BA_ "GenSigTimeoutTime_CADM" SG_ 256 BrkPdlStat_BCM 0;
BA_ "GenSigTimeoutTime_DMSM" SG_ 256 BrkPdlStat_BCM 0;
BA_ "GenSigTimeoutTime_DTCM" SG_ 256 BrkPdlStat_BCM 0;
BA_ "GenSigTimeoutTime_ECM" SG_ 256 BrkPdlStat_BCM 0;
BA_ "GenSigTimeoutTime_EVCU2" SG_ 256 BrkPdlStat_BCM 0;
BA_ "GenSigTimeoutTime_GNMM" SG_ 256 BrkPdlStat_BCM 0;
BA_ "GenSigTimeoutTime_HCP" SG_ 256 BrkPdlStat_BCM 0;
BA_ "GenSigTimeoutTime_IPC" SG_ 256 BrkPdlStat_BCM 0;
BA_ "GenSigTimeoutTime_SGW" SG_ 256 BrkPdlStat_BCM 0;
BA_ "GenSigTimeoutTime_TCM" SG_ 256 BrkPdlStat_BCM 0;
BA_ "GenSigTimeoutTime_BCM" SG_ 256 CRC_BCM2 0;
BA_ "GenSigTimeoutTime_DTCM" SG_ 256 CRC_BCM2 0;
BA_ "GenSigTimeoutTime_GNMM" SG_ 256 CRC_BCM2 0;
BA_ "GenSigTimeoutTime_RFHM" SG_ 256 CRC_BCM2 0;
BA_ "GenSigTimeoutTime_SGW" SG_ 256 CRC_BCM2 0;
BA_ "GenSigTimeoutTime_AGSM" SG_ 256 EngineOffRequest 0;
BA_ "GenSigTimeoutTime_BCM" SG_ 256 EngineOffRequest 0;
BA_ "GenSigTimeoutTime_BSM" SG_ 256 EngineOffRequest 0;
BA_ "GenSigTimeoutTime_CADM" SG_ 256 EngineOffRequest 0;
BA_ "GenSigTimeoutTime_DMSM" SG_ 256 EngineOffRequest 0;
BA_ "GenSigTimeoutTime_DTCM" SG_ 256 EngineOffRequest 0;
BA_ "GenSigTimeoutTime_EVCU2" SG_ 256 EngineOffRequest 0;
BA_ "GenSigTimeoutTime_GNMM" SG_ 256 EngineOffRequest 0;
BA_ "GenSigTimeoutTime_HCP" SG_ 256 EngineOffRequest 0;
BA_ "GenSigTimeoutTime_IPC" SG_ 256 EngineOffRequest 0;
BA_ "GenSigTimeoutTime_RFHM" SG_ 256 EngineOffRequest 0;
BA_ "GenSigTimeoutTime_SGW" SG_ 256 EngineOffRequest 0;
BA_ "GenSigTimeoutTime_TCM" SG_ 256 EngineOffRequest 0;
BA_ "GenSigTimeoutTime_AGSM" SG_ 256 KeyInIgnSts 0;
BA_ "GenSigTimeoutTime_BCM" SG_ 256 KeyInIgnSts 0;
BA_ "GenSigTimeoutTime_BSM" SG_ 256 KeyInIgnSts 0;
BA_ "GenSigTimeoutTime_CADM" SG_ 256 KeyInIgnSts 0;
BA_ "GenSigTimeoutTime_DMSM" SG_ 256 KeyInIgnSts 0;
BA_ "GenSigTimeoutTime_DTCM" SG_ 256 KeyInIgnSts 0;
BA_ "GenSigTimeoutTime_ECM" SG_ 256 KeyInIgnSts 0;
BA_ "GenSigTimeoutTime_GNMM" SG_ 256 KeyInIgnSts 0;
BA_ "GenSigTimeoutTime_IPC" SG_ 256 KeyInIgnSts 0;
BA_ "GenSigTimeoutTime_RFHM" SG_ 256 KeyInIgnSts 0;
BA_ "GenSigTimeoutTime_TCM" SG_ 256 KeyInIgnSts 0;
BA_ "GenSigTimeoutTime_BCM" SG_ 256 MessageCounter_BCM2 0;
BA_ "GenSigTimeoutTime_DTCM" SG_ 256 MessageCounter_BCM2 0;
BA_ "GenSigTimeoutTime_GNMM" SG_ 256 MessageCounter_BCM2 0;
BA_ "GenSigTimeoutTime_RFHM" SG_ 256 MessageCounter_BCM2 0;
BA_ "GenSigTimeoutTime_SGW" SG_ 256 MessageCounter_BCM2 0;
BA_ "GenSigTimeoutTime_BCM" SG_ 256 OperationalModeSts 0;
BA_ "GenSigTimeoutTime_EVCU2" SG_ 256 OperationalModeSts 0;
BA_ "GenSigTimeoutTime_AGSM" SG_ 256 RefuelRequest 0;
BA_ "GenSigTimeoutTime_BCM" SG_ 256 RefuelRequest 0;
BA_ "GenSigTimeoutTime_BSM" SG_ 256 RefuelRequest 0;
BA_ "GenSigTimeoutTime_CADM" SG_ 256 RefuelRequest 0;
BA_ "GenSigTimeoutTime_DMSM" SG_ 256 RefuelRequest 0;
BA_ "GenSigTimeoutTime_DTCM" SG_ 256 RefuelRequest 0;
BA_ "GenSigTimeoutTime_EVCU2" SG_ 256 RefuelRequest 0;
BA_ "GenSigTimeoutTime_GNMM" SG_ 256 RefuelRequest 0;
BA_ "GenSigTimeoutTime_HCP" SG_ 256 RefuelRequest 0;
BA_ "GenSigTimeoutTime_IPC" SG_ 256 RefuelRequest 0;
BA_ "GenSigTimeoutTime_RFHM" SG_ 256 RefuelRequest 0;
BA_ "GenSigTimeoutTime_SGW" SG_ 256 RefuelRequest 0;
BA_ "GenSigTimeoutTime_TCM" SG_ 256 RefuelRequest 0;
BA_ "GenSigTimeoutTime_AGSM" SG_ 256 RemStActvSts 0;
BA_ "GenSigTimeoutTime_BCM" SG_ 256 RemStActvSts 0;
BA_ "GenSigTimeoutTime_BSM" SG_ 256 RemStActvSts 0;
BA_ "GenSigTimeoutTime_DMSM" SG_ 256 RemStActvSts 0;
BA_ "GenSigTimeoutTime_DTCM" SG_ 256 RemStActvSts 0;
BA_ "GenSigTimeoutTime_ECM" SG_ 256 RemStActvSts 0;
BA_ "GenSigTimeoutTime_GNMM" SG_ 256 RemStActvSts 0;
BA_ "GenSigTimeoutTime_HCP" SG_ 256 RemStActvSts 0;
BA_ "GenSigTimeoutTime_TCM" SG_ 256 RemStActvSts 0;
BA_ "GenSigTimeoutTime_AGSM" SG_ 256 RemStActvSts_R 0;
BA_ "GenSigTimeoutTime_BCM" SG_ 256 RemStActvSts_R 0;
BA_ "GenSigTimeoutTime_BSM" SG_ 256 RemStActvSts_R 0;
BA_ "GenSigTimeoutTime_CADM" SG_ 256 RemStActvSts_R 0;
BA_ "GenSigTimeoutTime_DMSM" SG_ 256 RemStActvSts_R 0;
BA_ "GenSigTimeoutTime_GNMM" SG_ 256 RemStActvSts_R 0;
BA_ "GenSigTimeoutTime_HCP" SG_ 256 RemStActvSts_R 0;
BA_ "GenSigTimeoutTime_IPC" SG_ 256 RemStActvSts_R 0;
BA_ "GenSigTimeoutTime_RFHM" SG_ 256 RemStActvSts_R 0;
BA_ "GenSigTimeoutTime_SGW" SG_ 256 RemStActvSts_R 0;
BA_ "GenSigTimeoutTime_BCM" SG_ 256 SCCActvSts 0;
BA_ "GenSigTimeoutTime_BSM" SG_ 256 SCCActvSts 0;
BA_ "GenSigTimeoutTime_CADM" SG_ 256 SCCActvSts 0;
BA_ "GenSigTimeoutTime_DMSM" SG_ 256 SCCActvSts 0;
BA_ "GenSigTimeoutTime_DTCM" SG_ 256 SCCActvSts 0;
BA_ "GenSigTimeoutTime_ECM" SG_ 256 SCCActvSts 0;
BA_ "GenSigTimeoutTime_GNMM" SG_ 256 SCCActvSts 0;
BA_ "GenSigTimeoutTime_HCP" SG_ 256 SCCActvSts 0;
BA_ "GenSigTimeoutTime_TCM" SG_ 256 SCCActvSts 0;
BA_ "GenSigTimeoutTime_AGSM" SG_ 256 StartRelayBCMFault 0;
BA_ "GenSigTimeoutTime_BCM" SG_ 256 StartRelayBCMFault 0;
BA_ "GenSigTimeoutTime_BSM" SG_ 256 StartRelayBCMFault 0;
BA_ "GenSigTimeoutTime_CADM" SG_ 256 StartRelayBCMFault 0;
BA_ "GenSigTimeoutTime_DMSM" SG_ 256 StartRelayBCMFault 0;
BA_ "GenSigTimeoutTime_DTCM" SG_ 256 StartRelayBCMFault 0;
BA_ "GenSigTimeoutTime_EVCU2" SG_ 256 StartRelayBCMFault 0;
BA_ "GenSigTimeoutTime_GNMM" SG_ 256 StartRelayBCMFault 0;
BA_ "GenSigTimeoutTime_HCP" SG_ 256 StartRelayBCMFault 0;
BA_ "GenSigTimeoutTime_IPC" SG_ 256 StartRelayBCMFault 0;
BA_ "GenSigTimeoutTime_RFHM" SG_ 256 StartRelayBCMFault 0;
BA_ "GenSigTimeoutTime_TCM" SG_ 256 StartRelayBCMFault 0;
BA_ "GenSigTimeoutTime_AGSM" SG_ 256 StartRelayBCMSts 0;
BA_ "GenSigTimeoutTime_BCM" SG_ 256 StartRelayBCMSts 0;
BA_ "GenSigTimeoutTime_BSM" SG_ 256 StartRelayBCMSts 0;
BA_ "GenSigTimeoutTime_CADM" SG_ 256 StartRelayBCMSts 0;
BA_ "GenSigTimeoutTime_DMSM" SG_ 256 StartRelayBCMSts 0;
BA_ "GenSigTimeoutTime_DTCM" SG_ 256 StartRelayBCMSts 0;
BA_ "GenSigTimeoutTime_EVCU2" SG_ 256 StartRelayBCMSts 0;
BA_ "GenSigTimeoutTime_GNMM" SG_ 256 StartRelayBCMSts 0;
BA_ "GenSigTimeoutTime_HCP" SG_ 256 StartRelayBCMSts 0;
BA_ "GenSigTimeoutTime_IPC" SG_ 256 StartRelayBCMSts 0;
BA_ "GenSigTimeoutTime_RFHM" SG_ 256 StartRelayBCMSts 0;
BA_ "GenSigTimeoutTime_SGW" SG_ 256 StartRelayBCMSts 0;
BA_ "GenSigTimeoutTime_TCM" SG_ 256 StartRelayBCMSts 0;
BA_ "GenSigTimeoutTime_AGSM" SG_ 256 TurnIndicatorSts 0;
BA_ "GenSigTimeoutTime_BCM" SG_ 256 TurnIndicatorSts 0;
BA_ "GenSigTimeoutTime_BSM" SG_ 256 TurnIndicatorSts 0;
BA_ "GenSigTimeoutTime_DMSM" SG_ 256 TurnIndicatorSts 0;
BA_ "GenSigTimeoutTime_DTCM" SG_ 256 TurnIndicatorSts 0;
BA_ "GenSigTimeoutTime_ECM" SG_ 256 TurnIndicatorSts 0;
BA_ "GenSigTimeoutTime_EVCU2" SG_ 256 TurnIndicatorSts 0;
BA_ "GenSigTimeoutTime_GNMM" SG_ 256 TurnIndicatorSts 0;
BA_ "GenSigTimeoutTime_HCP" SG_ 256 TurnIndicatorSts 0;
BA_ "GenSigTimeoutTime_RFHM" SG_ 256 TurnIndicatorSts 0;
BA_ "GenSigTimeoutTime_TCM" SG_ 256 TurnIndicatorSts 0;
BA_ "GenSigSendType" SG_ 164 PFTM_Stat 3;
BA_ "GenSigTimeoutTime_AGSM" SG_ 164 PFTM_Stat 0;
BA_ "GenSigTimeoutTime_BCM" SG_ 164 PFTM_Stat 0;
BA_ "GenSigTimeoutTime_BSM" SG_ 164 PFTM_Stat 0;
BA_ "GenSigTimeoutTime_CADM" SG_ 164 PFTM_Stat 0;
BA_ "GenSigTimeoutTime_DMSM" SG_ 164 PFTM_Stat 0;
BA_ "GenSigTimeoutTime_DTCM" SG_ 164 PFTM_Stat 0;
BA_ "GenSigTimeoutTime_ECM" SG_ 164 PFTM_Stat 0;
BA_ "GenSigTimeoutTime_EVCU2" SG_ 164 PFTM_Stat 0;
BA_ "GenSigTimeoutTime_GNMM" SG_ 164 PFTM_Stat 0;
BA_ "GenSigTimeoutTime_HCP" SG_ 164 PFTM_Stat 0;
BA_ "GenSigTimeoutTime_RFHM" SG_ 164 PFTM_Stat 0;
BA_ "GenSigTimeoutTime_SGW" SG_ 164 PFTM_Stat 0;
BA_ "GenSigTimeoutTime_TCM" SG_ 164 PFTM_Stat 0;
BA_ "GenSigSendType" SG_ 164 PTG_Stat 3;
BA_ "GenSigTimeoutTime_AGSM" SG_ 164 PTG_Stat 0;
BA_ "GenSigTimeoutTime_BCM" SG_ 164 PTG_Stat 0;
BA_ "GenSigTimeoutTime_BSM" SG_ 164 PTG_Stat 0;
BA_ "GenSigTimeoutTime_CADM" SG_ 164 PTG_Stat 0;
BA_ "GenSigTimeoutTime_DMSM" SG_ 164 PTG_Stat 0;
BA_ "GenSigTimeoutTime_DTCM" SG_ 164 PTG_Stat 0;
BA_ "GenSigTimeoutTime_ECM" SG_ 164 PTG_Stat 0;
BA_ "GenSigTimeoutTime_EVCU2" SG_ 164 PTG_Stat 0;
BA_ "GenSigTimeoutTime_GNMM" SG_ 164 PTG_Stat 0;
BA_ "GenSigTimeoutTime_HCP" SG_ 164 PTG_Stat 0;
BA_ "GenSigTimeoutTime_RFHM" SG_ 164 PTG_Stat 0;
BA_ "GenSigTimeoutTime_SGW" SG_ 164 PTG_Stat 0;
BA_ "GenSigTimeoutTime_TCM" SG_ 164 PTG_Stat 0;
BA_ "GenSigSendType" SG_ 1826 Bed_Lighting_Stat 4;
BA_ "GenSigTimeoutTime_AGSM" SG_ 1826 Bed_Lighting_Stat 0;
BA_ "GenSigTimeoutTime_BCM" SG_ 1826 Bed_Lighting_Stat 0;
BA_ "GenSigTimeoutTime_BSM" SG_ 1826 Bed_Lighting_Stat 0;
BA_ "GenSigTimeoutTime_CADM" SG_ 1826 Bed_Lighting_Stat 0;
BA_ "GenSigTimeoutTime_DMSM" SG_ 1826 Bed_Lighting_Stat 0;
BA_ "GenSigTimeoutTime_DTCM" SG_ 1826 Bed_Lighting_Stat 0;
BA_ "GenSigTimeoutTime_ECM" SG_ 1826 Bed_Lighting_Stat 0;
BA_ "GenSigTimeoutTime_EVCU2" SG_ 1826 Bed_Lighting_Stat 0;
BA_ "GenSigTimeoutTime_GNMM" SG_ 1826 Bed_Lighting_Stat 0;
BA_ "GenSigTimeoutTime_HCP" SG_ 1826 Bed_Lighting_Stat 0;
BA_ "GenSigTimeoutTime_IPC" SG_ 1826 Bed_Lighting_Stat 0;
BA_ "GenSigTimeoutTime_RFHM" SG_ 1826 Bed_Lighting_Stat 0;
BA_ "GenSigTimeoutTime_SGW" SG_ 1826 Bed_Lighting_Stat 0;
BA_ "GenSigTimeoutTime_TCM" SG_ 1826 Bed_Lighting_Stat 0;
BA_ "GenSigTimeoutTime_AGSM" SG_ 1826 CargoLamp_Stat 0;
BA_ "GenSigTimeoutTime_BCM" SG_ 1826 CargoLamp_Stat 0;
BA_ "GenSigTimeoutTime_BSM" SG_ 1826 CargoLamp_Stat 0;
BA_ "GenSigTimeoutTime_CADM" SG_ 1826 CargoLamp_Stat 0;
BA_ "GenSigTimeoutTime_DMSM" SG_ 1826 CargoLamp_Stat 0;
BA_ "GenSigTimeoutTime_DTCM" SG_ 1826 CargoLamp_Stat 0;
BA_ "GenSigTimeoutTime_ECM" SG_ 1826 CargoLamp_Stat 0;
BA_ "GenSigTimeoutTime_EVCU2" SG_ 1826 CargoLamp_Stat 0;
BA_ "GenSigTimeoutTime_GNMM" SG_ 1826 CargoLamp_Stat 0;
BA_ "GenSigTimeoutTime_HCP" SG_ 1826 CargoLamp_Stat 0;
BA_ "GenSigTimeoutTime_RFHM" SG_ 1826 CargoLamp_Stat 0;
BA_ "GenSigTimeoutTime_SGW" SG_ 1826 CargoLamp_Stat 0;
BA_ "GenSigTimeoutTime_TCM" SG_ 1826 CargoLamp_Stat 0;
BA_ "GenSigSendType" SG_ 1826 Rr_Guide_Lgt_Stat 3;
BA_ "GenSigTimeoutTime_AGSM" SG_ 1826 Rr_Guide_Lgt_Stat 0;
BA_ "GenSigTimeoutTime_BCM" SG_ 1826 Rr_Guide_Lgt_Stat 0;
BA_ "GenSigTimeoutTime_BSM" SG_ 1826 Rr_Guide_Lgt_Stat 0;
BA_ "GenSigTimeoutTime_CADM" SG_ 1826 Rr_Guide_Lgt_Stat 0;
BA_ "GenSigTimeoutTime_DMSM" SG_ 1826 Rr_Guide_Lgt_Stat 0;
BA_ "GenSigTimeoutTime_DTCM" SG_ 1826 Rr_Guide_Lgt_Stat 0;
BA_ "GenSigTimeoutTime_ECM" SG_ 1826 Rr_Guide_Lgt_Stat 0;
BA_ "GenSigTimeoutTime_EVCU2" SG_ 1826 Rr_Guide_Lgt_Stat 0;
BA_ "GenSigTimeoutTime_GNMM" SG_ 1826 Rr_Guide_Lgt_Stat 0;
BA_ "GenSigTimeoutTime_HCP" SG_ 1826 Rr_Guide_Lgt_Stat 0;
BA_ "GenSigTimeoutTime_RFHM" SG_ 1826 Rr_Guide_Lgt_Stat 0;
BA_ "GenSigTimeoutTime_SGW" SG_ 1826 Rr_Guide_Lgt_Stat 0;
BA_ "GenSigTimeoutTime_TCM" SG_ 1826 Rr_Guide_Lgt_Stat 0;
BA_ "GenSigTimeoutTime_AGSM" SG_ 1826 UTL_CARGO_COMB 0;
BA_ "GenSigTimeoutTime_BCM" SG_ 1826 UTL_CARGO_COMB 0;
BA_ "GenSigTimeoutTime_BSM" SG_ 1826 UTL_CARGO_COMB 0;
BA_ "GenSigTimeoutTime_CADM" SG_ 1826 UTL_CARGO_COMB 0;
BA_ "GenSigTimeoutTime_DMSM" SG_ 1826 UTL_CARGO_COMB 0;
BA_ "GenSigTimeoutTime_DTCM" SG_ 1826 UTL_CARGO_COMB 0;
BA_ "GenSigTimeoutTime_ECM" SG_ 1826 UTL_CARGO_COMB 0;
BA_ "GenSigTimeoutTime_EVCU2" SG_ 1826 UTL_CARGO_COMB 0;
BA_ "GenSigTimeoutTime_GNMM" SG_ 1826 UTL_CARGO_COMB 0;
BA_ "GenSigTimeoutTime_HCP" SG_ 1826 UTL_CARGO_COMB 0;
BA_ "GenSigTimeoutTime_IPC" SG_ 1826 UTL_CARGO_COMB 0;
BA_ "GenSigTimeoutTime_RFHM" SG_ 1826 UTL_CARGO_COMB 0;
BA_ "GenSigTimeoutTime_SGW" SG_ 1826 UTL_CARGO_COMB 0;
BA_ "GenSigTimeoutTime_TCM" SG_ 1826 UTL_CARGO_COMB 0;
BA_ "GenSigTimeoutTime_AGSM" SG_ 602 CRC_BCM22 0;
BA_ "GenSigTimeoutTime_BCM" SG_ 602 CRC_BCM22 0;
BA_ "GenSigTimeoutTime_BSM" SG_ 602 CRC_BCM22 0;
BA_ "GenSigTimeoutTime_DMSM" SG_ 602 CRC_BCM22 0;
BA_ "GenSigTimeoutTime_DTCM" SG_ 602 CRC_BCM22 0;
BA_ "GenSigTimeoutTime_ECM" SG_ 602 CRC_BCM22 0;
BA_ "GenSigTimeoutTime_GNMM" SG_ 602 CRC_BCM22 0;
BA_ "GenSigTimeoutTime_HCP" SG_ 602 CRC_BCM22 0;
BA_ "GenSigTimeoutTime_IPC" SG_ 602 CRC_BCM22 0;
BA_ "GenSigTimeoutTime_RFHM" SG_ 602 CRC_BCM22 0;
BA_ "GenSigTimeoutTime_SGW" SG_ 602 CRC_BCM22 0;
BA_ "GenSigTimeoutTime_TCM" SG_ 602 CRC_BCM22 0;
BA_ "GenSigSendType" SG_ 602 FL_HS_STATFailSts 3;
BA_ "GenSigTimeoutTime_AGSM" SG_ 602 FL_HS_STATFailSts 0;
BA_ "GenSigTimeoutTime_BCM" SG_ 602 FL_HS_STATFailSts 0;
BA_ "GenSigTimeoutTime_BSM" SG_ 602 FL_HS_STATFailSts 0;
BA_ "GenSigTimeoutTime_CADM" SG_ 602 FL_HS_STATFailSts 0;
BA_ "GenSigTimeoutTime_DMSM" SG_ 602 FL_HS_STATFailSts 0;
BA_ "GenSigTimeoutTime_DTCM" SG_ 602 FL_HS_STATFailSts 0;
BA_ "GenSigTimeoutTime_ECM" SG_ 602 FL_HS_STATFailSts 0;
BA_ "GenSigTimeoutTime_GNMM" SG_ 602 FL_HS_STATFailSts 0;
BA_ "GenSigTimeoutTime_HCP" SG_ 602 FL_HS_STATFailSts 0;
BA_ "GenSigTimeoutTime_IPC" SG_ 602 FL_HS_STATFailSts 0;
BA_ "GenSigTimeoutTime_RFHM" SG_ 602 FL_HS_STATFailSts 0;
BA_ "GenSigTimeoutTime_TCM" SG_ 602 FL_HS_STATFailSts 0;
BA_ "GenSigSendType" SG_ 602 FL_HS_STATSts 3;
BA_ "GenSigTimeoutTime_AGSM" SG_ 602 FL_HS_STATSts 0;
BA_ "GenSigTimeoutTime_BCM" SG_ 602 FL_HS_STATSts 0;
BA_ "GenSigTimeoutTime_BSM" SG_ 602 FL_HS_STATSts 0;
BA_ "GenSigTimeoutTime_CADM" SG_ 602 FL_HS_STATSts 0;
BA_ "GenSigTimeoutTime_DMSM" SG_ 602 FL_HS_STATSts 0;
BA_ "GenSigTimeoutTime_DTCM" SG_ 602 FL_HS_STATSts 0;
BA_ "GenSigTimeoutTime_ECM" SG_ 602 FL_HS_STATSts 0;
BA_ "GenSigTimeoutTime_GNMM" SG_ 602 FL_HS_STATSts 0;
BA_ "GenSigTimeoutTime_HCP" SG_ 602 FL_HS_STATSts 0;
BA_ "GenSigTimeoutTime_IPC" SG_ 602 FL_HS_STATSts 0;
BA_ "GenSigTimeoutTime_RFHM" SG_ 602 FL_HS_STATSts 0;
BA_ "GenSigTimeoutTime_TCM" SG_ 602 FL_HS_STATSts 0;
BA_ "GenSigSendType" SG_ 602 FR_HS_STATFailSts 3;
BA_ "GenSigTimeoutTime_AGSM" SG_ 602 FR_HS_STATFailSts 0;
BA_ "GenSigTimeoutTime_BCM" SG_ 602 FR_HS_STATFailSts 0;
BA_ "GenSigTimeoutTime_BSM" SG_ 602 FR_HS_STATFailSts 0;
BA_ "GenSigTimeoutTime_CADM" SG_ 602 FR_HS_STATFailSts 0;
BA_ "GenSigTimeoutTime_DMSM" SG_ 602 FR_HS_STATFailSts 0;
BA_ "GenSigTimeoutTime_DTCM" SG_ 602 FR_HS_STATFailSts 0;
BA_ "GenSigTimeoutTime_ECM" SG_ 602 FR_HS_STATFailSts 0;
BA_ "GenSigTimeoutTime_GNMM" SG_ 602 FR_HS_STATFailSts 0;
BA_ "GenSigTimeoutTime_HCP" SG_ 602 FR_HS_STATFailSts 0;
BA_ "GenSigTimeoutTime_IPC" SG_ 602 FR_HS_STATFailSts 0;
BA_ "GenSigTimeoutTime_RFHM" SG_ 602 FR_HS_STATFailSts 0;
BA_ "GenSigTimeoutTime_TCM" SG_ 602 FR_HS_STATFailSts 0;
BA_ "GenSigSendType" SG_ 602 FR_HS_STATSts 3;
BA_ "GenSigTimeoutTime_AGSM" SG_ 602 FR_HS_STATSts 0;
BA_ "GenSigTimeoutTime_BCM" SG_ 602 FR_HS_STATSts 0;
BA_ "GenSigTimeoutTime_BSM" SG_ 602 FR_HS_STATSts 0;
BA_ "GenSigTimeoutTime_CADM" SG_ 602 FR_HS_STATSts 0;
BA_ "GenSigTimeoutTime_DMSM" SG_ 602 FR_HS_STATSts 0;
BA_ "GenSigTimeoutTime_DTCM" SG_ 602 FR_HS_STATSts 0;
BA_ "GenSigTimeoutTime_ECM" SG_ 602 FR_HS_STATSts 0;
BA_ "GenSigTimeoutTime_GNMM" SG_ 602 FR_HS_STATSts 0;
BA_ "GenSigTimeoutTime_HCP" SG_ 602 FR_HS_STATSts 0;
BA_ "GenSigTimeoutTime_IPC" SG_ 602 FR_HS_STATSts 0;
BA_ "GenSigTimeoutTime_RFHM" SG_ 602 FR_HS_STATSts 0;
BA_ "GenSigTimeoutTime_TCM" SG_ 602 FR_HS_STATSts 0;
BA_ "GenSigSendType" SG_ 602 HiBmLvr_Stat 3;
BA_ "GenSigTimeoutTime_AGSM" SG_ 602 HiBmLvr_Stat 0;
BA_ "GenSigTimeoutTime_BCM" SG_ 602 HiBmLvr_Stat 0;
BA_ "GenSigTimeoutTime_BSM" SG_ 602 HiBmLvr_Stat 0;
BA_ "GenSigTimeoutTime_DMSM" SG_ 602 HiBmLvr_Stat 0;
BA_ "GenSigTimeoutTime_DTCM" SG_ 602 HiBmLvr_Stat 0;
BA_ "GenSigTimeoutTime_ECM" SG_ 602 HiBmLvr_Stat 0;
BA_ "GenSigTimeoutTime_GNMM" SG_ 602 HiBmLvr_Stat 0;
BA_ "GenSigTimeoutTime_HCP" SG_ 602 HiBmLvr_Stat 0;
BA_ "GenSigTimeoutTime_RFHM" SG_ 602 HiBmLvr_Stat 0;
BA_ "GenSigTimeoutTime_SGW" SG_ 602 HiBmLvr_Stat 0;
BA_ "GenSigTimeoutTime_TCM" SG_ 602 HiBmLvr_Stat 0;
BA_ "GenSigTimeoutTime_AGSM" SG_ 602 MessageCounter_BCM22 0;
BA_ "GenSigTimeoutTime_BCM" SG_ 602 MessageCounter_BCM22 0;
BA_ "GenSigTimeoutTime_BSM" SG_ 602 MessageCounter_BCM22 0;
BA_ "GenSigTimeoutTime_DMSM" SG_ 602 MessageCounter_BCM22 0;
BA_ "GenSigTimeoutTime_DTCM" SG_ 602 MessageCounter_BCM22 0;
BA_ "GenSigTimeoutTime_ECM" SG_ 602 MessageCounter_BCM22 0;
BA_ "GenSigTimeoutTime_GNMM" SG_ 602 MessageCounter_BCM22 0;
BA_ "GenSigTimeoutTime_HCP" SG_ 602 MessageCounter_BCM22 0;
BA_ "GenSigTimeoutTime_IPC" SG_ 602 MessageCounter_BCM22 0;
BA_ "GenSigTimeoutTime_RFHM" SG_ 602 MessageCounter_BCM22 0;
BA_ "GenSigTimeoutTime_SGW" SG_ 602 MessageCounter_BCM22 0;
BA_ "GenSigTimeoutTime_TCM" SG_ 602 MessageCounter_BCM22 0;
BA_ "GenSigSendType" SG_ 602 TurnLeverLatched 3;
BA_ "GenSigTimeoutTime_AGSM" SG_ 602 TurnLeverLatched 0;
BA_ "GenSigTimeoutTime_BCM" SG_ 602 TurnLeverLatched 0;
BA_ "GenSigTimeoutTime_BSM" SG_ 602 TurnLeverLatched 0;
BA_ "GenSigTimeoutTime_DMSM" SG_ 602 TurnLeverLatched 0;
BA_ "GenSigTimeoutTime_DTCM" SG_ 602 TurnLeverLatched 0;
BA_ "GenSigTimeoutTime_ECM" SG_ 602 TurnLeverLatched 0;
BA_ "GenSigTimeoutTime_EVCU2" SG_ 602 TurnLeverLatched 0;
BA_ "GenSigTimeoutTime_GNMM" SG_ 602 TurnLeverLatched 0;
BA_ "GenSigTimeoutTime_HCP" SG_ 602 TurnLeverLatched 0;
BA_ "GenSigTimeoutTime_IPC" SG_ 602 TurnLeverLatched 0;
BA_ "GenSigTimeoutTime_RFHM" SG_ 602 TurnLeverLatched 0;
BA_ "GenSigTimeoutTime_SGW" SG_ 602 TurnLeverLatched 0;
BA_ "GenSigTimeoutTime_TCM" SG_ 602 TurnLeverLatched 0;
BA_ "GenSigSendType" SG_ 602 WprSw6Posn 3;
BA_ "GenSigTimeoutTime_AGSM" SG_ 602 WprSw6Posn 0;
BA_ "GenSigTimeoutTime_BCM" SG_ 602 WprSw6Posn 0;
BA_ "GenSigTimeoutTime_BSM" SG_ 602 WprSw6Posn 0;
BA_ "GenSigTimeoutTime_DMSM" SG_ 602 WprSw6Posn 0;
BA_ "GenSigTimeoutTime_DTCM" SG_ 602 WprSw6Posn 0;
BA_ "GenSigTimeoutTime_ECM" SG_ 602 WprSw6Posn 0;
BA_ "GenSigTimeoutTime_EVCU2" SG_ 602 WprSw6Posn 0;
BA_ "GenSigTimeoutTime_GNMM" SG_ 602 WprSw6Posn 0;
BA_ "GenSigTimeoutTime_HCP" SG_ 602 WprSw6Posn 0;
BA_ "GenSigTimeoutTime_IPC" SG_ 602 WprSw6Posn 0;
BA_ "GenSigTimeoutTime_RFHM" SG_ 602 WprSw6Posn 0;
BA_ "GenSigTimeoutTime_SGW" SG_ 602 WprSw6Posn 0;
BA_ "GenSigTimeoutTime_TCM" SG_ 602 WprSw6Posn 0;
BA_ "GenSigSendType" SG_ 1434 BCM_AUX1_HLEnbl 3;
BA_ "GenSigTimeoutTime_AGSM" SG_ 1434 BCM_AUX1_HLEnbl 0;
BA_ "GenSigTimeoutTime_BCM" SG_ 1434 BCM_AUX1_HLEnbl 0;
BA_ "GenSigTimeoutTime_BSM" SG_ 1434 BCM_AUX1_HLEnbl 0;
BA_ "GenSigTimeoutTime_CADM" SG_ 1434 BCM_AUX1_HLEnbl 0;
BA_ "GenSigTimeoutTime_DMSM" SG_ 1434 BCM_AUX1_HLEnbl 0;
BA_ "GenSigTimeoutTime_DTCM" SG_ 1434 BCM_AUX1_HLEnbl 0;
BA_ "GenSigTimeoutTime_ECM" SG_ 1434 BCM_AUX1_HLEnbl 0;
BA_ "GenSigTimeoutTime_EVCU2" SG_ 1434 BCM_AUX1_HLEnbl 0;
BA_ "GenSigTimeoutTime_GNMM" SG_ 1434 BCM_AUX1_HLEnbl 0;
BA_ "GenSigTimeoutTime_HCP" SG_ 1434 BCM_AUX1_HLEnbl 0;
BA_ "GenSigTimeoutTime_IPC" SG_ 1434 BCM_AUX1_HLEnbl 0;
BA_ "GenSigTimeoutTime_RFHM" SG_ 1434 BCM_AUX1_HLEnbl 0;
BA_ "GenSigTimeoutTime_SGW" SG_ 1434 BCM_AUX1_HLEnbl 0;
BA_ "GenSigTimeoutTime_TCM" SG_ 1434 BCM_AUX1_HLEnbl 0;
BA_ "GenSigSendType" SG_ 1434 BCM_AUX1_PWRMD 3;
BA_ "GenSigTimeoutTime_AGSM" SG_ 1434 BCM_AUX1_PWRMD 0;
BA_ "GenSigTimeoutTime_BCM" SG_ 1434 BCM_AUX1_PWRMD 0;
BA_ "GenSigTimeoutTime_BSM" SG_ 1434 BCM_AUX1_PWRMD 0;
BA_ "GenSigTimeoutTime_CADM" SG_ 1434 BCM_AUX1_PWRMD 0;
BA_ "GenSigTimeoutTime_DMSM" SG_ 1434 BCM_AUX1_PWRMD 0;
BA_ "GenSigTimeoutTime_DTCM" SG_ 1434 BCM_AUX1_PWRMD 0;
BA_ "GenSigTimeoutTime_ECM" SG_ 1434 BCM_AUX1_PWRMD 0;
BA_ "GenSigTimeoutTime_EVCU2" SG_ 1434 BCM_AUX1_PWRMD 0;
BA_ "GenSigTimeoutTime_GNMM" SG_ 1434 BCM_AUX1_PWRMD 0;
BA_ "GenSigTimeoutTime_HCP" SG_ 1434 BCM_AUX1_PWRMD 0;
BA_ "GenSigTimeoutTime_IPC" SG_ 1434 BCM_AUX1_PWRMD 0;
BA_ "GenSigTimeoutTime_RFHM" SG_ 1434 BCM_AUX1_PWRMD 0;
BA_ "GenSigTimeoutTime_SGW" SG_ 1434 BCM_AUX1_PWRMD 0;
BA_ "GenSigTimeoutTime_TCM" SG_ 1434 BCM_AUX1_PWRMD 0;
BA_ "GenSigSendType" SG_ 1434 BCM_AUX1_Type 3;
BA_ "GenSigTimeoutTime_AGSM" SG_ 1434 BCM_AUX1_Type 0;
BA_ "GenSigTimeoutTime_BCM" SG_ 1434 BCM_AUX1_Type 0;
BA_ "GenSigTimeoutTime_BSM" SG_ 1434 BCM_AUX1_Type 0;
BA_ "GenSigTimeoutTime_CADM" SG_ 1434 BCM_AUX1_Type 0;
BA_ "GenSigTimeoutTime_DMSM" SG_ 1434 BCM_AUX1_Type 0;
BA_ "GenSigTimeoutTime_DTCM" SG_ 1434 BCM_AUX1_Type 0;
BA_ "GenSigTimeoutTime_ECM" SG_ 1434 BCM_AUX1_Type 0;
BA_ "GenSigTimeoutTime_EVCU2" SG_ 1434 BCM_AUX1_Type 0;
BA_ "GenSigTimeoutTime_GNMM" SG_ 1434 BCM_AUX1_Type 0;
BA_ "GenSigTimeoutTime_HCP" SG_ 1434 BCM_AUX1_Type 0;
BA_ "GenSigTimeoutTime_IPC" SG_ 1434 BCM_AUX1_Type 0;
BA_ "GenSigTimeoutTime_RFHM" SG_ 1434 BCM_AUX1_Type 0;
BA_ "GenSigTimeoutTime_SGW" SG_ 1434 BCM_AUX1_Type 0;
BA_ "GenSigTimeoutTime_TCM" SG_ 1434 BCM_AUX1_Type 0;
BA_ "GenSigSendType" SG_ 1434 BCM_AUX2_HLEnbl 3;
BA_ "GenSigTimeoutTime_AGSM" SG_ 1434 BCM_AUX2_HLEnbl 0;
BA_ "GenSigTimeoutTime_BCM" SG_ 1434 BCM_AUX2_HLEnbl 0;
BA_ "GenSigTimeoutTime_BSM" SG_ 1434 BCM_AUX2_HLEnbl 0;
BA_ "GenSigTimeoutTime_CADM" SG_ 1434 BCM_AUX2_HLEnbl 0;
BA_ "GenSigTimeoutTime_DMSM" SG_ 1434 BCM_AUX2_HLEnbl 0;
BA_ "GenSigTimeoutTime_DTCM" SG_ 1434 BCM_AUX2_HLEnbl 0;
BA_ "GenSigTimeoutTime_ECM" SG_ 1434 BCM_AUX2_HLEnbl 0;
BA_ "GenSigTimeoutTime_EVCU2" SG_ 1434 BCM_AUX2_HLEnbl 0;
BA_ "GenSigTimeoutTime_GNMM" SG_ 1434 BCM_AUX2_HLEnbl 0;
BA_ "GenSigTimeoutTime_HCP" SG_ 1434 BCM_AUX2_HLEnbl 0;
BA_ "GenSigTimeoutTime_IPC" SG_ 1434 BCM_AUX2_HLEnbl 0;
BA_ "GenSigTimeoutTime_RFHM" SG_ 1434 BCM_AUX2_HLEnbl 0;
BA_ "GenSigTimeoutTime_SGW" SG_ 1434 BCM_AUX2_HLEnbl 0;
BA_ "GenSigTimeoutTime_TCM" SG_ 1434 BCM_AUX2_HLEnbl 0;
BA_ "GenSigSendType" SG_ 1434 BCM_AUX2_PWRMD 3;
BA_ "GenSigTimeoutTime_AGSM" SG_ 1434 BCM_AUX2_PWRMD 0;
BA_ "GenSigTimeoutTime_BCM" SG_ 1434 BCM_AUX2_PWRMD 0;
BA_ "GenSigTimeoutTime_BSM" SG_ 1434 BCM_AUX2_PWRMD 0;
BA_ "GenSigTimeoutTime_CADM" SG_ 1434 BCM_AUX2_PWRMD 0;
BA_ "GenSigTimeoutTime_DMSM" SG_ 1434 BCM_AUX2_PWRMD 0;
BA_ "GenSigTimeoutTime_DTCM" SG_ 1434 BCM_AUX2_PWRMD 0;
BA_ "GenSigTimeoutTime_ECM" SG_ 1434 BCM_AUX2_PWRMD 0;
BA_ "GenSigTimeoutTime_EVCU2" SG_ 1434 BCM_AUX2_PWRMD 0;
BA_ "GenSigTimeoutTime_GNMM" SG_ 1434 BCM_AUX2_PWRMD 0;
BA_ "GenSigTimeoutTime_HCP" SG_ 1434 BCM_AUX2_PWRMD 0;
BA_ "GenSigTimeoutTime_IPC" SG_ 1434 BCM_AUX2_PWRMD 0;
BA_ "GenSigTimeoutTime_RFHM" SG_ 1434 BCM_AUX2_PWRMD 0;
BA_ "GenSigTimeoutTime_SGW" SG_ 1434 BCM_AUX2_PWRMD 0;
BA_ "GenSigTimeoutTime_TCM" SG_ 1434 BCM_AUX2_PWRMD 0;
BA_ "GenSigSendType" SG_ 1434 BCM_AUX2_Type 3;
BA_ "GenSigTimeoutTime_AGSM" SG_ 1434 BCM_AUX2_Type 0;
BA_ "GenSigTimeoutTime_BCM" SG_ 1434 BCM_AUX2_Type 0;
BA_ "GenSigTimeoutTime_BSM" SG_ 1434 BCM_AUX2_Type 0;
BA_ "GenSigTimeoutTime_CADM" SG_ 1434 BCM_AUX2_Type 0;
BA_ "GenSigTimeoutTime_DMSM" SG_ 1434 BCM_AUX2_Type 0;
BA_ "GenSigTimeoutTime_DTCM" SG_ 1434 BCM_AUX2_Type 0;
BA_ "GenSigTimeoutTime_ECM" SG_ 1434 BCM_AUX2_Type 0;
BA_ "GenSigTimeoutTime_EVCU2" SG_ 1434 BCM_AUX2_Type 0;
BA_ "GenSigTimeoutTime_GNMM" SG_ 1434 BCM_AUX2_Type 0;
BA_ "GenSigTimeoutTime_HCP" SG_ 1434 BCM_AUX2_Type 0;
BA_ "GenSigTimeoutTime_IPC" SG_ 1434 BCM_AUX2_Type 0;
BA_ "GenSigTimeoutTime_RFHM" SG_ 1434 BCM_AUX2_Type 0;
BA_ "GenSigTimeoutTime_SGW" SG_ 1434 BCM_AUX2_Type 0;
BA_ "GenSigTimeoutTime_TCM" SG_ 1434 BCM_AUX2_Type 0;
BA_ "GenSigSendType" SG_ 1434 BCM_AUX3_HLEnbl 3;
BA_ "GenSigTimeoutTime_AGSM" SG_ 1434 BCM_AUX3_HLEnbl 0;
BA_ "GenSigTimeoutTime_BCM" SG_ 1434 BCM_AUX3_HLEnbl 0;
BA_ "GenSigTimeoutTime_BSM" SG_ 1434 BCM_AUX3_HLEnbl 0;
BA_ "GenSigTimeoutTime_CADM" SG_ 1434 BCM_AUX3_HLEnbl 0;
BA_ "GenSigTimeoutTime_DMSM" SG_ 1434 BCM_AUX3_HLEnbl 0;
BA_ "GenSigTimeoutTime_DTCM" SG_ 1434 BCM_AUX3_HLEnbl 0;
BA_ "GenSigTimeoutTime_ECM" SG_ 1434 BCM_AUX3_HLEnbl 0;
BA_ "GenSigTimeoutTime_EVCU2" SG_ 1434 BCM_AUX3_HLEnbl 0;
BA_ "GenSigTimeoutTime_GNMM" SG_ 1434 BCM_AUX3_HLEnbl 0;
BA_ "GenSigTimeoutTime_HCP" SG_ 1434 BCM_AUX3_HLEnbl 0;
BA_ "GenSigTimeoutTime_IPC" SG_ 1434 BCM_AUX3_HLEnbl 0;
BA_ "GenSigTimeoutTime_RFHM" SG_ 1434 BCM_AUX3_HLEnbl 0;
BA_ "GenSigTimeoutTime_SGW" SG_ 1434 BCM_AUX3_HLEnbl 0;
BA_ "GenSigTimeoutTime_TCM" SG_ 1434 BCM_AUX3_HLEnbl 0;
BA_ "GenSigSendType" SG_ 1434 BCM_AUX3_PWRMD 3;
BA_ "GenSigTimeoutTime_AGSM" SG_ 1434 BCM_AUX3_PWRMD 0;
BA_ "GenSigTimeoutTime_BCM" SG_ 1434 BCM_AUX3_PWRMD 0;
BA_ "GenSigTimeoutTime_BSM" SG_ 1434 BCM_AUX3_PWRMD 0;
BA_ "GenSigTimeoutTime_CADM" SG_ 1434 BCM_AUX3_PWRMD 0;
BA_ "GenSigTimeoutTime_DMSM" SG_ 1434 BCM_AUX3_PWRMD 0;
BA_ "GenSigTimeoutTime_DTCM" SG_ 1434 BCM_AUX3_PWRMD 0;
BA_ "GenSigTimeoutTime_ECM" SG_ 1434 BCM_AUX3_PWRMD 0;
BA_ "GenSigTimeoutTime_EVCU2" SG_ 1434 BCM_AUX3_PWRMD 0;
BA_ "GenSigTimeoutTime_GNMM" SG_ 1434 BCM_AUX3_PWRMD 0;
BA_ "GenSigTimeoutTime_HCP" SG_ 1434 BCM_AUX3_PWRMD 0;
BA_ "GenSigTimeoutTime_IPC" SG_ 1434 BCM_AUX3_PWRMD 0;
BA_ "GenSigTimeoutTime_RFHM" SG_ 1434 BCM_AUX3_PWRMD 0;
BA_ "GenSigTimeoutTime_SGW" SG_ 1434 BCM_AUX3_PWRMD 0;
BA_ "GenSigTimeoutTime_TCM" SG_ 1434 BCM_AUX3_PWRMD 0;
BA_ "GenSigSendType" SG_ 1434 BCM_AUX3_Type 3;
BA_ "GenSigTimeoutTime_AGSM" SG_ 1434 BCM_AUX3_Type 0;
BA_ "GenSigTimeoutTime_BCM" SG_ 1434 BCM_AUX3_Type 0;
BA_ "GenSigTimeoutTime_BSM" SG_ 1434 BCM_AUX3_Type 0;
BA_ "GenSigTimeoutTime_CADM" SG_ 1434 BCM_AUX3_Type 0;
BA_ "GenSigTimeoutTime_DMSM" SG_ 1434 BCM_AUX3_Type 0;
BA_ "GenSigTimeoutTime_DTCM" SG_ 1434 BCM_AUX3_Type 0;
BA_ "GenSigTimeoutTime_ECM" SG_ 1434 BCM_AUX3_Type 0;
BA_ "GenSigTimeoutTime_EVCU2" SG_ 1434 BCM_AUX3_Type 0;
BA_ "GenSigTimeoutTime_GNMM" SG_ 1434 BCM_AUX3_Type 0;
BA_ "GenSigTimeoutTime_HCP" SG_ 1434 BCM_AUX3_Type 0;
BA_ "GenSigTimeoutTime_IPC" SG_ 1434 BCM_AUX3_Type 0;
BA_ "GenSigTimeoutTime_RFHM" SG_ 1434 BCM_AUX3_Type 0;
BA_ "GenSigTimeoutTime_SGW" SG_ 1434 BCM_AUX3_Type 0;
BA_ "GenSigTimeoutTime_TCM" SG_ 1434 BCM_AUX3_Type 0;
BA_ "GenSigSendType" SG_ 1434 BCM_AUX4_HLEnbl 3;
BA_ "GenSigTimeoutTime_AGSM" SG_ 1434 BCM_AUX4_HLEnbl 0;
BA_ "GenSigTimeoutTime_BCM" SG_ 1434 BCM_AUX4_HLEnbl 0;
BA_ "GenSigTimeoutTime_BSM" SG_ 1434 BCM_AUX4_HLEnbl 0;
BA_ "GenSigTimeoutTime_CADM" SG_ 1434 BCM_AUX4_HLEnbl 0;
BA_ "GenSigTimeoutTime_DMSM" SG_ 1434 BCM_AUX4_HLEnbl 0;
BA_ "GenSigTimeoutTime_DTCM" SG_ 1434 BCM_AUX4_HLEnbl 0;
BA_ "GenSigTimeoutTime_ECM" SG_ 1434 BCM_AUX4_HLEnbl 0;
BA_ "GenSigTimeoutTime_EVCU2" SG_ 1434 BCM_AUX4_HLEnbl 0;
BA_ "GenSigTimeoutTime_GNMM" SG_ 1434 BCM_AUX4_HLEnbl 0;
BA_ "GenSigTimeoutTime_HCP" SG_ 1434 BCM_AUX4_HLEnbl 0;
BA_ "GenSigTimeoutTime_IPC" SG_ 1434 BCM_AUX4_HLEnbl 0;
BA_ "GenSigTimeoutTime_RFHM" SG_ 1434 BCM_AUX4_HLEnbl 0;
BA_ "GenSigTimeoutTime_SGW" SG_ 1434 BCM_AUX4_HLEnbl 0;
BA_ "GenSigTimeoutTime_TCM" SG_ 1434 BCM_AUX4_HLEnbl 0;
BA_ "GenSigSendType" SG_ 1434 BCM_AUX4_PWRMD 3;
BA_ "GenSigTimeoutTime_AGSM" SG_ 1434 BCM_AUX4_PWRMD 0;
BA_ "GenSigTimeoutTime_BCM" SG_ 1434 BCM_AUX4_PWRMD 0;
BA_ "GenSigTimeoutTime_BSM" SG_ 1434 BCM_AUX4_PWRMD 0;
BA_ "GenSigTimeoutTime_CADM" SG_ 1434 BCM_AUX4_PWRMD 0;
BA_ "GenSigTimeoutTime_DMSM" SG_ 1434 BCM_AUX4_PWRMD 0;
BA_ "GenSigTimeoutTime_DTCM" SG_ 1434 BCM_AUX4_PWRMD 0;
BA_ "GenSigTimeoutTime_ECM" SG_ 1434 BCM_AUX4_PWRMD 0;
BA_ "GenSigTimeoutTime_EVCU2" SG_ 1434 BCM_AUX4_PWRMD 0;
BA_ "GenSigTimeoutTime_GNMM" SG_ 1434 BCM_AUX4_PWRMD 0;
BA_ "GenSigTimeoutTime_HCP" SG_ 1434 BCM_AUX4_PWRMD 0;
BA_ "GenSigTimeoutTime_IPC" SG_ 1434 BCM_AUX4_PWRMD 0;
BA_ "GenSigTimeoutTime_RFHM" SG_ 1434 BCM_AUX4_PWRMD 0;
BA_ "GenSigTimeoutTime_SGW" SG_ 1434 BCM_AUX4_PWRMD 0;
BA_ "GenSigTimeoutTime_TCM" SG_ 1434 BCM_AUX4_PWRMD 0;
BA_ "GenSigSendType" SG_ 1434 BCM_AUX4_Type 3;
BA_ "GenSigTimeoutTime_AGSM" SG_ 1434 BCM_AUX4_Type 0;
BA_ "GenSigTimeoutTime_BCM" SG_ 1434 BCM_AUX4_Type 0;
BA_ "GenSigTimeoutTime_BSM" SG_ 1434 BCM_AUX4_Type 0;
BA_ "GenSigTimeoutTime_CADM" SG_ 1434 BCM_AUX4_Type 0;
BA_ "GenSigTimeoutTime_DMSM" SG_ 1434 BCM_AUX4_Type 0;
BA_ "GenSigTimeoutTime_DTCM" SG_ 1434 BCM_AUX4_Type 0;
BA_ "GenSigTimeoutTime_ECM" SG_ 1434 BCM_AUX4_Type 0;
BA_ "GenSigTimeoutTime_EVCU2" SG_ 1434 BCM_AUX4_Type 0;
BA_ "GenSigTimeoutTime_GNMM" SG_ 1434 BCM_AUX4_Type 0;
BA_ "GenSigTimeoutTime_HCP" SG_ 1434 BCM_AUX4_Type 0;
BA_ "GenSigTimeoutTime_IPC" SG_ 1434 BCM_AUX4_Type 0;
BA_ "GenSigTimeoutTime_RFHM" SG_ 1434 BCM_AUX4_Type 0;
BA_ "GenSigTimeoutTime_SGW" SG_ 1434 BCM_AUX4_Type 0;
BA_ "GenSigTimeoutTime_TCM" SG_ 1434 BCM_AUX4_Type 0;
BA_ "GenSigSendType" SG_ 1434 BCM_AUX5_HLEnbl 3;
BA_ "GenSigTimeoutTime_AGSM" SG_ 1434 BCM_AUX5_HLEnbl 0;
BA_ "GenSigTimeoutTime_BCM" SG_ 1434 BCM_AUX5_HLEnbl 0;
BA_ "GenSigTimeoutTime_BSM" SG_ 1434 BCM_AUX5_HLEnbl 0;
BA_ "GenSigTimeoutTime_CADM" SG_ 1434 BCM_AUX5_HLEnbl 0;
BA_ "GenSigTimeoutTime_DMSM" SG_ 1434 BCM_AUX5_HLEnbl 0;
BA_ "GenSigTimeoutTime_DTCM" SG_ 1434 BCM_AUX5_HLEnbl 0;
BA_ "GenSigTimeoutTime_ECM" SG_ 1434 BCM_AUX5_HLEnbl 0;
BA_ "GenSigTimeoutTime_EVCU2" SG_ 1434 BCM_AUX5_HLEnbl 0;
BA_ "GenSigTimeoutTime_GNMM" SG_ 1434 BCM_AUX5_HLEnbl 0;
BA_ "GenSigTimeoutTime_HCP" SG_ 1434 BCM_AUX5_HLEnbl 0;
BA_ "GenSigTimeoutTime_IPC" SG_ 1434 BCM_AUX5_HLEnbl 0;
BA_ "GenSigTimeoutTime_RFHM" SG_ 1434 BCM_AUX5_HLEnbl 0;
BA_ "GenSigTimeoutTime_SGW" SG_ 1434 BCM_AUX5_HLEnbl 0;
BA_ "GenSigTimeoutTime_TCM" SG_ 1434 BCM_AUX5_HLEnbl 0;
BA_ "GenSigSendType" SG_ 1434 BCM_AUX5_PWRMD 3;
BA_ "GenSigTimeoutTime_AGSM" SG_ 1434 BCM_AUX5_PWRMD 0;
BA_ "GenSigTimeoutTime_BCM" SG_ 1434 BCM_AUX5_PWRMD 0;
BA_ "GenSigTimeoutTime_BSM" SG_ 1434 BCM_AUX5_PWRMD 0;
BA_ "GenSigTimeoutTime_CADM" SG_ 1434 BCM_AUX5_PWRMD 0;
BA_ "GenSigTimeoutTime_DMSM" SG_ 1434 BCM_AUX5_PWRMD 0;
BA_ "GenSigTimeoutTime_DTCM" SG_ 1434 BCM_AUX5_PWRMD 0;
BA_ "GenSigTimeoutTime_ECM" SG_ 1434 BCM_AUX5_PWRMD 0;
BA_ "GenSigTimeoutTime_EVCU2" SG_ 1434 BCM_AUX5_PWRMD 0;
BA_ "GenSigTimeoutTime_GNMM" SG_ 1434 BCM_AUX5_PWRMD 0;
BA_ "GenSigTimeoutTime_HCP" SG_ 1434 BCM_AUX5_PWRMD 0;
BA_ "GenSigTimeoutTime_IPC" SG_ 1434 BCM_AUX5_PWRMD 0;
BA_ "GenSigTimeoutTime_RFHM" SG_ 1434 BCM_AUX5_PWRMD 0;
BA_ "GenSigTimeoutTime_SGW" SG_ 1434 BCM_AUX5_PWRMD 0;
BA_ "GenSigTimeoutTime_TCM" SG_ 1434 BCM_AUX5_PWRMD 0;
BA_ "GenSigSendType" SG_ 1434 BCM_AUX5_Type 3;
BA_ "GenSigTimeoutTime_AGSM" SG_ 1434 BCM_AUX5_Type 0;
BA_ "GenSigTimeoutTime_BCM" SG_ 1434 BCM_AUX5_Type 0;
BA_ "GenSigTimeoutTime_BSM" SG_ 1434 BCM_AUX5_Type 0;
BA_ "GenSigTimeoutTime_CADM" SG_ 1434 BCM_AUX5_Type 0;
BA_ "GenSigTimeoutTime_DMSM" SG_ 1434 BCM_AUX5_Type 0;
BA_ "GenSigTimeoutTime_DTCM" SG_ 1434 BCM_AUX5_Type 0;
BA_ "GenSigTimeoutTime_ECM" SG_ 1434 BCM_AUX5_Type 0;
BA_ "GenSigTimeoutTime_EVCU2" SG_ 1434 BCM_AUX5_Type 0;
BA_ "GenSigTimeoutTime_GNMM" SG_ 1434 BCM_AUX5_Type 0;
BA_ "GenSigTimeoutTime_HCP" SG_ 1434 BCM_AUX5_Type 0;
BA_ "GenSigTimeoutTime_IPC" SG_ 1434 BCM_AUX5_Type 0;
BA_ "GenSigTimeoutTime_RFHM" SG_ 1434 BCM_AUX5_Type 0;
BA_ "GenSigTimeoutTime_SGW" SG_ 1434 BCM_AUX5_Type 0;
BA_ "GenSigTimeoutTime_TCM" SG_ 1434 BCM_AUX5_Type 0;
BA_ "GenSigSendType" SG_ 1434 BCM_AUX6_HLEnbl 3;
BA_ "GenSigTimeoutTime_AGSM" SG_ 1434 BCM_AUX6_HLEnbl 0;
BA_ "GenSigTimeoutTime_BCM" SG_ 1434 BCM_AUX6_HLEnbl 0;
BA_ "GenSigTimeoutTime_BSM" SG_ 1434 BCM_AUX6_HLEnbl 0;
BA_ "GenSigTimeoutTime_CADM" SG_ 1434 BCM_AUX6_HLEnbl 0;
BA_ "GenSigTimeoutTime_DMSM" SG_ 1434 BCM_AUX6_HLEnbl 0;
BA_ "GenSigTimeoutTime_DTCM" SG_ 1434 BCM_AUX6_HLEnbl 0;
BA_ "GenSigTimeoutTime_ECM" SG_ 1434 BCM_AUX6_HLEnbl 0;
BA_ "GenSigTimeoutTime_EVCU2" SG_ 1434 BCM_AUX6_HLEnbl 0;
BA_ "GenSigTimeoutTime_GNMM" SG_ 1434 BCM_AUX6_HLEnbl 0;
BA_ "GenSigTimeoutTime_HCP" SG_ 1434 BCM_AUX6_HLEnbl 0;
BA_ "GenSigTimeoutTime_IPC" SG_ 1434 BCM_AUX6_HLEnbl 0;
BA_ "GenSigTimeoutTime_RFHM" SG_ 1434 BCM_AUX6_HLEnbl 0;
BA_ "GenSigTimeoutTime_SGW" SG_ 1434 BCM_AUX6_HLEnbl 0;
BA_ "GenSigTimeoutTime_TCM" SG_ 1434 BCM_AUX6_HLEnbl 0;
BA_ "GenSigSendType" SG_ 1434 BCM_AUX6_PWRMD 3;
BA_ "GenSigTimeoutTime_AGSM" SG_ 1434 BCM_AUX6_PWRMD 0;
BA_ "GenSigTimeoutTime_BCM" SG_ 1434 BCM_AUX6_PWRMD 0;
BA_ "GenSigTimeoutTime_BSM" SG_ 1434 BCM_AUX6_PWRMD 0;
BA_ "GenSigTimeoutTime_CADM" SG_ 1434 BCM_AUX6_PWRMD 0;
BA_ "GenSigTimeoutTime_DMSM" SG_ 1434 BCM_AUX6_PWRMD 0;
BA_ "GenSigTimeoutTime_DTCM" SG_ 1434 BCM_AUX6_PWRMD 0;
BA_ "GenSigTimeoutTime_ECM" SG_ 1434 BCM_AUX6_PWRMD 0;
BA_ "GenSigTimeoutTime_EVCU2" SG_ 1434 BCM_AUX6_PWRMD 0;
BA_ "GenSigTimeoutTime_GNMM" SG_ 1434 BCM_AUX6_PWRMD 0;
BA_ "GenSigTimeoutTime_HCP" SG_ 1434 BCM_AUX6_PWRMD 0;
BA_ "GenSigTimeoutTime_IPC" SG_ 1434 BCM_AUX6_PWRMD 0;
BA_ "GenSigTimeoutTime_RFHM" SG_ 1434 BCM_AUX6_PWRMD 0;
BA_ "GenSigTimeoutTime_SGW" SG_ 1434 BCM_AUX6_PWRMD 0;
BA_ "GenSigTimeoutTime_TCM" SG_ 1434 BCM_AUX6_PWRMD 0;
BA_ "GenSigSendType" SG_ 1434 BCM_AUX6_Type 3;
BA_ "GenSigTimeoutTime_AGSM" SG_ 1434 BCM_AUX6_Type 0;
BA_ "GenSigTimeoutTime_BCM" SG_ 1434 BCM_AUX6_Type 0;
BA_ "GenSigTimeoutTime_BSM" SG_ 1434 BCM_AUX6_Type 0;
BA_ "GenSigTimeoutTime_CADM" SG_ 1434 BCM_AUX6_Type 0;
BA_ "GenSigTimeoutTime_DMSM" SG_ 1434 BCM_AUX6_Type 0;
BA_ "GenSigTimeoutTime_DTCM" SG_ 1434 BCM_AUX6_Type 0;
BA_ "GenSigTimeoutTime_ECM" SG_ 1434 BCM_AUX6_Type 0;
BA_ "GenSigTimeoutTime_EVCU2" SG_ 1434 BCM_AUX6_Type 0;
BA_ "GenSigTimeoutTime_GNMM" SG_ 1434 BCM_AUX6_Type 0;
BA_ "GenSigTimeoutTime_HCP" SG_ 1434 BCM_AUX6_Type 0;
BA_ "GenSigTimeoutTime_IPC" SG_ 1434 BCM_AUX6_Type 0;
BA_ "GenSigTimeoutTime_RFHM" SG_ 1434 BCM_AUX6_Type 0;
BA_ "GenSigTimeoutTime_SGW" SG_ 1434 BCM_AUX6_Type 0;
BA_ "GenSigTimeoutTime_TCM" SG_ 1434 BCM_AUX6_Type 0;
BA_ "GenSigStartValue" SG_ 1434 Cfg_Aux_PTO 7;
BA_ "GenSigSendType" SG_ 1434 Cfg_Aux_PTO 3;
BA_ "GenSigTimeoutTime_AGSM" SG_ 1434 Cfg_Aux_PTO 0;
BA_ "GenSigTimeoutTime_BCM" SG_ 1434 Cfg_Aux_PTO 0;
BA_ "GenSigTimeoutTime_BSM" SG_ 1434 Cfg_Aux_PTO 0;
BA_ "GenSigTimeoutTime_CADM" SG_ 1434 Cfg_Aux_PTO 0;
BA_ "GenSigTimeoutTime_DMSM" SG_ 1434 Cfg_Aux_PTO 0;
BA_ "GenSigTimeoutTime_DTCM" SG_ 1434 Cfg_Aux_PTO 0;
BA_ "GenSigTimeoutTime_ECM" SG_ 1434 Cfg_Aux_PTO 0;
BA_ "GenSigTimeoutTime_EVCU2" SG_ 1434 Cfg_Aux_PTO 0;
BA_ "GenSigTimeoutTime_GNMM" SG_ 1434 Cfg_Aux_PTO 0;
BA_ "GenSigTimeoutTime_HCP" SG_ 1434 Cfg_Aux_PTO 0;
BA_ "GenSigTimeoutTime_IPC" SG_ 1434 Cfg_Aux_PTO 0;
BA_ "GenSigTimeoutTime_RFHM" SG_ 1434 Cfg_Aux_PTO 0;
BA_ "GenSigTimeoutTime_SGW" SG_ 1434 Cfg_Aux_PTO 0;
BA_ "GenSigTimeoutTime_TCM" SG_ 1434 Cfg_Aux_PTO 0;
BA_ "GenSigSendType" SG_ 1434 GeneratorModeActive 4;
BA_ "GenSigTimeoutTime_AGSM" SG_ 1434 GeneratorModeActive 0;
BA_ "GenSigTimeoutTime_BCM" SG_ 1434 GeneratorModeActive 0;
BA_ "GenSigTimeoutTime_BSM" SG_ 1434 GeneratorModeActive 0;
BA_ "GenSigTimeoutTime_CADM" SG_ 1434 GeneratorModeActive 0;
BA_ "GenSigTimeoutTime_DMSM" SG_ 1434 GeneratorModeActive 0;
BA_ "GenSigTimeoutTime_DTCM" SG_ 1434 GeneratorModeActive 0;
BA_ "GenSigTimeoutTime_ECM" SG_ 1434 GeneratorModeActive 0;
BA_ "GenSigTimeoutTime_EVCU2" SG_ 1434 GeneratorModeActive 0;
BA_ "GenSigTimeoutTime_GNMM" SG_ 1434 GeneratorModeActive 0;
BA_ "GenSigTimeoutTime_HCP" SG_ 1434 GeneratorModeActive 0;
BA_ "GenSigTimeoutTime_RFHM" SG_ 1434 GeneratorModeActive 0;
BA_ "GenSigTimeoutTime_TCM" SG_ 1434 GeneratorModeActive 0;
BA_ "GenSigSendType" SG_ 1434 GeneratorModeSwitch 3;
BA_ "GenSigTimeoutTime_AGSM" SG_ 1434 GeneratorModeSwitch 0;
BA_ "GenSigTimeoutTime_BCM" SG_ 1434 GeneratorModeSwitch 0;
BA_ "GenSigTimeoutTime_BSM" SG_ 1434 GeneratorModeSwitch 0;
BA_ "GenSigTimeoutTime_CADM" SG_ 1434 GeneratorModeSwitch 0;
BA_ "GenSigTimeoutTime_DMSM" SG_ 1434 GeneratorModeSwitch 0;
BA_ "GenSigTimeoutTime_DTCM" SG_ 1434 GeneratorModeSwitch 0;
BA_ "GenSigTimeoutTime_ECM" SG_ 1434 GeneratorModeSwitch 0;
BA_ "GenSigTimeoutTime_EVCU2" SG_ 1434 GeneratorModeSwitch 0;
BA_ "GenSigTimeoutTime_GNMM" SG_ 1434 GeneratorModeSwitch 0;
BA_ "GenSigTimeoutTime_HCP" SG_ 1434 GeneratorModeSwitch 0;
BA_ "GenSigTimeoutTime_IPC" SG_ 1434 GeneratorModeSwitch 0;
BA_ "GenSigTimeoutTime_RFHM" SG_ 1434 GeneratorModeSwitch 0;
BA_ "GenSigTimeoutTime_TCM" SG_ 1434 GeneratorModeSwitch 0;
BA_ "GenSigStartValue" SG_ 1434 HRLS_Ambient_Light_Level 255;
BA_ "GenSigSendType" SG_ 1434 HRLS_Ambient_Light_Level 3;
BA_ "GenSigTimeoutTime_AGSM" SG_ 1434 HRLS_Ambient_Light_Level 0;
BA_ "GenSigTimeoutTime_BCM" SG_ 1434 HRLS_Ambient_Light_Level 0;
BA_ "GenSigTimeoutTime_BSM" SG_ 1434 HRLS_Ambient_Light_Level 0;
BA_ "GenSigTimeoutTime_CADM" SG_ 1434 HRLS_Ambient_Light_Level 0;
BA_ "GenSigTimeoutTime_DMSM" SG_ 1434 HRLS_Ambient_Light_Level 0;
BA_ "GenSigTimeoutTime_DTCM" SG_ 1434 HRLS_Ambient_Light_Level 0;
BA_ "GenSigTimeoutTime_ECM" SG_ 1434 HRLS_Ambient_Light_Level 0;
BA_ "GenSigTimeoutTime_EVCU2" SG_ 1434 HRLS_Ambient_Light_Level 0;
BA_ "GenSigTimeoutTime_GNMM" SG_ 1434 HRLS_Ambient_Light_Level 0;
BA_ "GenSigTimeoutTime_HCP" SG_ 1434 HRLS_Ambient_Light_Level 0;
BA_ "GenSigTimeoutTime_RFHM" SG_ 1434 HRLS_Ambient_Light_Level 0;
BA_ "GenSigTimeoutTime_SGW" SG_ 1434 HRLS_Ambient_Light_Level 0;
BA_ "GenSigTimeoutTime_TCM" SG_ 1434 HRLS_Ambient_Light_Level 0;
BA_ "GenSigSendType" SG_ 1434 INV_CARGO_OnState 3;
BA_ "GenSigTimeoutTime_AGSM" SG_ 1434 INV_CARGO_OnState 0;
BA_ "GenSigTimeoutTime_BCM" SG_ 1434 INV_CARGO_OnState 0;
BA_ "GenSigTimeoutTime_BSM" SG_ 1434 INV_CARGO_OnState 0;
BA_ "GenSigTimeoutTime_CADM" SG_ 1434 INV_CARGO_OnState 0;
BA_ "GenSigTimeoutTime_DMSM" SG_ 1434 INV_CARGO_OnState 0;
BA_ "GenSigTimeoutTime_DTCM" SG_ 1434 INV_CARGO_OnState 0;
BA_ "GenSigTimeoutTime_ECM" SG_ 1434 INV_CARGO_OnState 0;
BA_ "GenSigTimeoutTime_EVCU2" SG_ 1434 INV_CARGO_OnState 0;
BA_ "GenSigTimeoutTime_GNMM" SG_ 1434 INV_CARGO_OnState 0;
BA_ "GenSigTimeoutTime_HCP" SG_ 1434 INV_CARGO_OnState 0;
BA_ "GenSigTimeoutTime_RFHM" SG_ 1434 INV_CARGO_OnState 0;
BA_ "GenSigTimeoutTime_SGW" SG_ 1434 INV_CARGO_OnState 0;
BA_ "GenSigTimeoutTime_TCM" SG_ 1434 INV_CARGO_OnState 0;
BA_ "GenSigTimeoutTime_AGSM" SG_ 1434 PowerDraw 0;
BA_ "GenSigTimeoutTime_BCM" SG_ 1434 PowerDraw 0;
BA_ "GenSigTimeoutTime_BSM" SG_ 1434 PowerDraw 0;
BA_ "GenSigTimeoutTime_CADM" SG_ 1434 PowerDraw 0;
BA_ "GenSigTimeoutTime_DMSM" SG_ 1434 PowerDraw 0;
BA_ "GenSigTimeoutTime_DTCM" SG_ 1434 PowerDraw 0;
BA_ "GenSigTimeoutTime_EVCU2" SG_ 1434 PowerDraw 0;
BA_ "GenSigTimeoutTime_GNMM" SG_ 1434 PowerDraw 0;
BA_ "GenSigTimeoutTime_IPC" SG_ 1434 PowerDraw 0;
BA_ "GenSigTimeoutTime_RFHM" SG_ 1434 PowerDraw 0;
BA_ "GenSigTimeoutTime_TCM" SG_ 1434 PowerDraw 0;
BA_ "GenSigSendType" SG_ 1434 PSS_Display 3;
BA_ "GenSigTimeoutTime_AGSM" SG_ 1434 PSS_Display 0;
BA_ "GenSigTimeoutTime_BCM" SG_ 1434 PSS_Display 0;
BA_ "GenSigTimeoutTime_BSM" SG_ 1434 PSS_Display 0;
BA_ "GenSigTimeoutTime_CADM" SG_ 1434 PSS_Display 0;
BA_ "GenSigTimeoutTime_DMSM" SG_ 1434 PSS_Display 0;
BA_ "GenSigTimeoutTime_DTCM" SG_ 1434 PSS_Display 0;
BA_ "GenSigTimeoutTime_ECM" SG_ 1434 PSS_Display 0;
BA_ "GenSigTimeoutTime_EVCU2" SG_ 1434 PSS_Display 0;
BA_ "GenSigTimeoutTime_GNMM" SG_ 1434 PSS_Display 0;
BA_ "GenSigTimeoutTime_HCP" SG_ 1434 PSS_Display 0;
BA_ "GenSigTimeoutTime_RFHM" SG_ 1434 PSS_Display 0;
BA_ "GenSigTimeoutTime_SGW" SG_ 1434 PSS_Display 0;
BA_ "GenSigTimeoutTime_TCM" SG_ 1434 PSS_Display 0;
BA_ "GenSigSendType" SG_ 1434 Radio_Theme 3;
BA_ "GenSigTimeoutTime_AGSM" SG_ 1434 Radio_Theme 0;
BA_ "GenSigTimeoutTime_BCM" SG_ 1434 Radio_Theme 0;
BA_ "GenSigTimeoutTime_BSM" SG_ 1434 Radio_Theme 0;
BA_ "GenSigTimeoutTime_CADM" SG_ 1434 Radio_Theme 0;
BA_ "GenSigTimeoutTime_DMSM" SG_ 1434 Radio_Theme 0;
BA_ "GenSigTimeoutTime_DTCM" SG_ 1434 Radio_Theme 0;
BA_ "GenSigTimeoutTime_ECM" SG_ 1434 Radio_Theme 0;
BA_ "GenSigTimeoutTime_EVCU2" SG_ 1434 Radio_Theme 0;
BA_ "GenSigTimeoutTime_GNMM" SG_ 1434 Radio_Theme 0;
BA_ "GenSigTimeoutTime_HCP" SG_ 1434 Radio_Theme 0;
BA_ "GenSigTimeoutTime_RFHM" SG_ 1434 Radio_Theme 0;
BA_ "GenSigTimeoutTime_SGW" SG_ 1434 Radio_Theme 0;
BA_ "GenSigTimeoutTime_TCM" SG_ 1434 Radio_Theme 0;
BA_ "GenSigSendType" SG_ 1434 VehAcc_Display 4;
BA_ "GenSigTimeoutTime_AGSM" SG_ 1434 VehAcc_Display 0;
BA_ "GenSigTimeoutTime_BCM" SG_ 1434 VehAcc_Display 0;
BA_ "GenSigTimeoutTime_BSM" SG_ 1434 VehAcc_Display 0;
BA_ "GenSigTimeoutTime_CADM" SG_ 1434 VehAcc_Display 0;
BA_ "GenSigTimeoutTime_DMSM" SG_ 1434 VehAcc_Display 0;
BA_ "GenSigTimeoutTime_DTCM" SG_ 1434 VehAcc_Display 0;
BA_ "GenSigTimeoutTime_ECM" SG_ 1434 VehAcc_Display 0;
BA_ "GenSigTimeoutTime_EVCU2" SG_ 1434 VehAcc_Display 0;
BA_ "GenSigTimeoutTime_GNMM" SG_ 1434 VehAcc_Display 0;
BA_ "GenSigTimeoutTime_HCP" SG_ 1434 VehAcc_Display 0;
BA_ "GenSigTimeoutTime_RFHM" SG_ 1434 VehAcc_Display 0;
BA_ "GenSigTimeoutTime_SGW" SG_ 1434 VehAcc_Display 0;
BA_ "GenSigTimeoutTime_TCM" SG_ 1434 VehAcc_Display 0;
BA_ "GenSigSendType" SG_ 1434 Worksite_Inverter_Active 4;
BA_ "GenSigTimeoutTime_AGSM" SG_ 1434 Worksite_Inverter_Active 0;
BA_ "GenSigTimeoutTime_BCM" SG_ 1434 Worksite_Inverter_Active 0;
BA_ "GenSigTimeoutTime_BSM" SG_ 1434 Worksite_Inverter_Active 0;
BA_ "GenSigTimeoutTime_CADM" SG_ 1434 Worksite_Inverter_Active 0;
BA_ "GenSigTimeoutTime_DMSM" SG_ 1434 Worksite_Inverter_Active 0;
BA_ "GenSigTimeoutTime_DTCM" SG_ 1434 Worksite_Inverter_Active 0;
BA_ "GenSigTimeoutTime_EVCU2" SG_ 1434 Worksite_Inverter_Active 0;
BA_ "GenSigTimeoutTime_GNMM" SG_ 1434 Worksite_Inverter_Active 0;
BA_ "GenSigTimeoutTime_IPC" SG_ 1434 Worksite_Inverter_Active 0;
BA_ "GenSigTimeoutTime_RFHM" SG_ 1434 Worksite_Inverter_Active 0;
BA_ "GenSigTimeoutTime_TCM" SG_ 1434 Worksite_Inverter_Active 0;
BA_ "GenSigSendType" SG_ 1434 Worksite_Inverter_RadioSwitch 3;
BA_ "GenSigTimeoutTime_AGSM" SG_ 1434 Worksite_Inverter_RadioSwitch 0;
BA_ "GenSigTimeoutTime_BCM" SG_ 1434 Worksite_Inverter_RadioSwitch 0;
BA_ "GenSigTimeoutTime_BSM" SG_ 1434 Worksite_Inverter_RadioSwitch 0;
BA_ "GenSigTimeoutTime_CADM" SG_ 1434 Worksite_Inverter_RadioSwitch 0;
BA_ "GenSigTimeoutTime_DMSM" SG_ 1434 Worksite_Inverter_RadioSwitch 0;
BA_ "GenSigTimeoutTime_DTCM" SG_ 1434 Worksite_Inverter_RadioSwitch 0;
BA_ "GenSigTimeoutTime_ECM" SG_ 1434 Worksite_Inverter_RadioSwitch 0;
BA_ "GenSigTimeoutTime_EVCU2" SG_ 1434 Worksite_Inverter_RadioSwitch 0;
BA_ "GenSigTimeoutTime_GNMM" SG_ 1434 Worksite_Inverter_RadioSwitch 0;
BA_ "GenSigTimeoutTime_HCP" SG_ 1434 Worksite_Inverter_RadioSwitch 0;
BA_ "GenSigTimeoutTime_IPC" SG_ 1434 Worksite_Inverter_RadioSwitch 0;
BA_ "GenSigTimeoutTime_RFHM" SG_ 1434 Worksite_Inverter_RadioSwitch 0;
BA_ "GenSigTimeoutTime_TCM" SG_ 1434 Worksite_Inverter_RadioSwitch 0;
BA_ "GenSigTimeoutTime_AGSM" SG_ 1069 CRC_BCM24 0;
BA_ "GenSigTimeoutTime_BCM" SG_ 1069 CRC_BCM24 0;
BA_ "GenSigTimeoutTime_CADM" SG_ 1069 CRC_BCM24 0;
BA_ "GenSigTimeoutTime_DMSM" SG_ 1069 CRC_BCM24 0;
BA_ "GenSigTimeoutTime_DTCM" SG_ 1069 CRC_BCM24 0;
BA_ "GenSigTimeoutTime_ECM" SG_ 1069 CRC_BCM24 0;
BA_ "GenSigTimeoutTime_EVCU2" SG_ 1069 CRC_BCM24 0;
BA_ "GenSigTimeoutTime_GNMM" SG_ 1069 CRC_BCM24 0;
BA_ "GenSigTimeoutTime_HCP" SG_ 1069 CRC_BCM24 0;
BA_ "GenSigTimeoutTime_RFHM" SG_ 1069 CRC_BCM24 0;
BA_ "GenSigTimeoutTime_SGW" SG_ 1069 CRC_BCM24 0;
BA_ "GenSigTimeoutTime_TCM" SG_ 1069 CRC_BCM24 0;
BA_ "GenSigTimeoutTime_AGSM" SG_ 1069 FronWasherSts 0;
BA_ "GenSigTimeoutTime_BCM" SG_ 1069 FronWasherSts 0;
BA_ "GenSigTimeoutTime_BSM" SG_ 1069 FronWasherSts 0;
BA_ "GenSigTimeoutTime_CADM" SG_ 1069 FronWasherSts 0;
BA_ "GenSigTimeoutTime_DMSM" SG_ 1069 FronWasherSts 0;
BA_ "GenSigTimeoutTime_DTCM" SG_ 1069 FronWasherSts 0;
BA_ "GenSigTimeoutTime_ECM" SG_ 1069 FronWasherSts 0;
BA_ "GenSigTimeoutTime_EVCU2" SG_ 1069 FronWasherSts 0;
BA_ "GenSigTimeoutTime_GNMM" SG_ 1069 FronWasherSts 0;
BA_ "GenSigTimeoutTime_HCP" SG_ 1069 FronWasherSts 0;
BA_ "GenSigTimeoutTime_IPC" SG_ 1069 FronWasherSts 0;
BA_ "GenSigTimeoutTime_RFHM" SG_ 1069 FronWasherSts 0;
BA_ "GenSigTimeoutTime_SGW" SG_ 1069 FronWasherSts 0;
BA_ "GenSigTimeoutTime_TCM" SG_ 1069 FronWasherSts 0;
BA_ "GenSigSendType" SG_ 1069 HazardCluster 3;
BA_ "GenSigTimeoutTime_AGSM" SG_ 1069 HazardCluster 0;
BA_ "GenSigTimeoutTime_BCM" SG_ 1069 HazardCluster 0;
BA_ "GenSigTimeoutTime_BSM" SG_ 1069 HazardCluster 0;
BA_ "GenSigTimeoutTime_CADM" SG_ 1069 HazardCluster 0;
BA_ "GenSigTimeoutTime_DMSM" SG_ 1069 HazardCluster 0;
BA_ "GenSigTimeoutTime_DTCM" SG_ 1069 HazardCluster 0;
BA_ "GenSigTimeoutTime_ECM" SG_ 1069 HazardCluster 0;
BA_ "GenSigTimeoutTime_EVCU2" SG_ 1069 HazardCluster 0;
BA_ "GenSigTimeoutTime_GNMM" SG_ 1069 HazardCluster 0;
BA_ "GenSigTimeoutTime_HCP" SG_ 1069 HazardCluster 0;
BA_ "GenSigTimeoutTime_RFHM" SG_ 1069 HazardCluster 0;
BA_ "GenSigTimeoutTime_SGW" SG_ 1069 HazardCluster 0;
BA_ "GenSigTimeoutTime_TCM" SG_ 1069 HazardCluster 0;
BA_ "GenSigTimeoutTime_AGSM" SG_ 1069 MessageCounter_BCM24 0;
BA_ "GenSigTimeoutTime_BCM" SG_ 1069 MessageCounter_BCM24 0;
BA_ "GenSigTimeoutTime_CADM" SG_ 1069 MessageCounter_BCM24 0;
BA_ "GenSigTimeoutTime_DMSM" SG_ 1069 MessageCounter_BCM24 0;
BA_ "GenSigTimeoutTime_DTCM" SG_ 1069 MessageCounter_BCM24 0;
BA_ "GenSigTimeoutTime_ECM" SG_ 1069 MessageCounter_BCM24 0;
BA_ "GenSigTimeoutTime_EVCU2" SG_ 1069 MessageCounter_BCM24 0;
BA_ "GenSigTimeoutTime_GNMM" SG_ 1069 MessageCounter_BCM24 0;
BA_ "GenSigTimeoutTime_HCP" SG_ 1069 MessageCounter_BCM24 0;
BA_ "GenSigTimeoutTime_RFHM" SG_ 1069 MessageCounter_BCM24 0;
BA_ "GenSigTimeoutTime_SGW" SG_ 1069 MessageCounter_BCM24 0;
BA_ "GenSigTimeoutTime_TCM" SG_ 1069 MessageCounter_BCM24 0;
BA_ "GenSigSendType" SG_ 1069 ReverseLamp 3;
BA_ "GenSigTimeoutTime_AGSM" SG_ 1069 ReverseLamp 0;
BA_ "GenSigTimeoutTime_BCM" SG_ 1069 ReverseLamp 0;
BA_ "GenSigTimeoutTime_BSM" SG_ 1069 ReverseLamp 0;
BA_ "GenSigTimeoutTime_CADM" SG_ 1069 ReverseLamp 0;
BA_ "GenSigTimeoutTime_DMSM" SG_ 1069 ReverseLamp 0;
BA_ "GenSigTimeoutTime_DTCM" SG_ 1069 ReverseLamp 0;
BA_ "GenSigTimeoutTime_ECM" SG_ 1069 ReverseLamp 0;
BA_ "GenSigTimeoutTime_EVCU2" SG_ 1069 ReverseLamp 0;
BA_ "GenSigTimeoutTime_GNMM" SG_ 1069 ReverseLamp 0;
BA_ "GenSigTimeoutTime_HCP" SG_ 1069 ReverseLamp 0;
BA_ "GenSigTimeoutTime_IPC" SG_ 1069 ReverseLamp 0;
BA_ "GenSigTimeoutTime_RFHM" SG_ 1069 ReverseLamp 0;
BA_ "GenSigTimeoutTime_TCM" SG_ 1069 ReverseLamp 0;
BA_ "GenSigSendType" SG_ 603 HVACDRVTemp 3;
BA_ "GenSigTimeoutTime_AGSM" SG_ 603 HVACDRVTemp 0;
BA_ "GenSigTimeoutTime_BCM" SG_ 603 HVACDRVTemp 0;
BA_ "GenSigTimeoutTime_BSM" SG_ 603 HVACDRVTemp 0;
BA_ "GenSigTimeoutTime_CADM" SG_ 603 HVACDRVTemp 0;
BA_ "GenSigTimeoutTime_DMSM" SG_ 603 HVACDRVTemp 0;
BA_ "GenSigTimeoutTime_DTCM" SG_ 603 HVACDRVTemp 0;
BA_ "GenSigTimeoutTime_ECM" SG_ 603 HVACDRVTemp 0;
BA_ "GenSigTimeoutTime_EVCU2" SG_ 603 HVACDRVTemp 0;
BA_ "GenSigTimeoutTime_GNMM" SG_ 603 HVACDRVTemp 0;
BA_ "GenSigTimeoutTime_HCP" SG_ 603 HVACDRVTemp 0;
BA_ "GenSigTimeoutTime_IPC" SG_ 603 HVACDRVTemp 0;
BA_ "GenSigTimeoutTime_RFHM" SG_ 603 HVACDRVTemp 0;
BA_ "GenSigTimeoutTime_TCM" SG_ 603 HVACDRVTemp 0;
BA_ "GenSigSendType" SG_ 603 HVACPSNTemp 3;
BA_ "GenSigTimeoutTime_AGSM" SG_ 603 HVACPSNTemp 0;
BA_ "GenSigTimeoutTime_BCM" SG_ 603 HVACPSNTemp 0;
BA_ "GenSigTimeoutTime_BSM" SG_ 603 HVACPSNTemp 0;
BA_ "GenSigTimeoutTime_CADM" SG_ 603 HVACPSNTemp 0;
BA_ "GenSigTimeoutTime_DMSM" SG_ 603 HVACPSNTemp 0;
BA_ "GenSigTimeoutTime_DTCM" SG_ 603 HVACPSNTemp 0;
BA_ "GenSigTimeoutTime_ECM" SG_ 603 HVACPSNTemp 0;
BA_ "GenSigTimeoutTime_EVCU2" SG_ 603 HVACPSNTemp 0;
BA_ "GenSigTimeoutTime_GNMM" SG_ 603 HVACPSNTemp 0;
BA_ "GenSigTimeoutTime_HCP" SG_ 603 HVACPSNTemp 0;
BA_ "GenSigTimeoutTime_IPC" SG_ 603 HVACPSNTemp 0;
BA_ "GenSigTimeoutTime_RFHM" SG_ 603 HVACPSNTemp 0;
BA_ "GenSigTimeoutTime_TCM" SG_ 603 HVACPSNTemp 0;
VAL_ 1445 ADC_Stat_2 0 "MODE_1" 1 "MODE_2" 2 "MODE_3" 3 "MODE_4" 4 "MODE_4" 5 "MODE_5" 6 "MODE_6" 7 "SNA";
VAL_ 1445 ADS_SrvSys 0 "FALSE" 1 "TRUE";
VAL_ 1445 ASCM_HMI_Stat 0 "NONE" 1 "ASCM_RedSpd" 2 "ASCM_LvlnPrmt" 3 "ASCM_Cooldn" 4 "ASCM_Dr" 5 "ASCM_Srv" 6 "ASCM_SysFail" 7 "ASCM_VLSt" 8 "ASCM_TJM_Disp" 9 "ASCM_LowClr" 10 "ASCM_Highlr" 11 "ASCM_TM_Disp" 12 "ASCM_WAL_Disp" 14 "ASCM_AeroDslb" 15 "ASCM_LNP_Speed" 16 "ASCM_LNP_MaxPayload" 17 "ASCM_LNP_Minload" 18 "ASCM_LNP_LimitedPayload" 19 "ASCM_BDL_Enbl" 20 "ASCM_BDL_Complete" 21 "ASCM_BDL_Unsucc" 22 "ASCM_EEHNA" 23 "ASCM_START_STOP" 24 "ASCM_PARK" 25 "ASCM_AERO" 26 "ASCM_NVL" 27 "ASCM_OR1" 28 "ASCM_ORL2" 29 "ASCM_PSS" 30 "OFFROAD_HEIGHT_AUTO_TERRAIN" 31 "SNA";
VAL_ 1445 ASCM_RemStat 0 "NONE" 1 "ACTIVE" 2 "DISABLE" 3 "SNA";
VAL_ 1445 ASCM_Srv 0 "FALSE" 1 "TRUE";
VAL_ 1445 ASCM_Stat 0 "NONE" 1 "DUMP" 2 "PARK" 3 "AERO" 4 "NVL" 5 "OR1" 6 "ORL2" 7 "Lifter" 8 "RAISE" 9 "LOWER" 10 "SYSFAIL" 11 "SRVS" 12 "AERO2" 13 "Clearance2" 15 "SNA";
VAL_ 1445 ASCM_StatDisp 0 "NONE" 1 "DUMP" 2 "PARK" 3 "AERO" 4 "NVL" 5 "OR1" 6 "ORL2" 7 "Lifter" 8 "RAISE" 9 "LOWER" 10 "BDL" 11 "AERO2" 12 "AUTOMATIC_LEVEL_ONLY" 13 "ASCM_LNP_PAYLOAD" 15 "SNA";
VAL_ 1445 ASCM_SysFail 0 "FALSE" 1 "TRUE";
VAL_ 1445 ASCM_SYSFAIL_HMI 0 "None" 1 "ASCM_Sysfail_OR1" 2 "ASCM_Sysfail_ORL2" 3 "Sysfail_Slammed";
VAL_ 1445 Loading_Lv 0 "LND" 1 "LIGHT" 2 "FULL" 3 "OVERLOAD_1" 4 "OVERLOAD_2" 5 "PROTECTION" 6 "MIP" 7 "SNA";
VAL_ 1445 Tgt_Level 0 "TR_Dump" 1 "Park" 2 "AERO" 3 "STD" 4 "OR1" 5 "ORL2" 6 "AERO2" 7 "SNA";
VAL_ 1445 TJM_Enbl 0 "FALSE" 1 "TRUE";
VAL_ 204 Axle_Torque_DrvReqMod 65535 "SNA";
VAL_ 204 Axle_TorqueStatic_D_TTC 65535 "SNA";
VAL_ 204 Front_Axle_Est_Regen_Torq 16383 "SNA";
VAL_ 204 Front_Axle_Regen_Capacity 16383 "SNA";
VAL_ 204 Front_AxleTorque_Max 65535 "SNA";
VAL_ 204 Front_AxleTorque_Min 65535 "SNA";
VAL_ 204 MaxRegen_Diff_Axle_Torq 32767 "SNA";
VAL_ 204 MaxRegen_Diff_Axle_Torq_Active 0 "Not_Active" 1 "Active";
VAL_ 204 Rear_Axle_Est_Regen_Torq 16383 "SNA";
VAL_ 204 Rear_Axle_Regen_Capacity 16383 "SNA";
VAL_ 204 Rear_AxleTorque_Max 65535 "SNA";
VAL_ 204 Rear_AxleTorque_Min 65535 "SNA";
VAL_ 204 Total_AxleTorque_Max 65535 "SNA";
VAL_ 204 Total_AxleTorque_Min 65535 "SNA";
VAL_ 1153 CmdIgnSts 0 "Initialization" 1 "IGN_LK" 3 "ACC" 4 "RUN" 5 "START" 7 "SNA";
VAL_ 1153 CompressorACReqSts 0 "Not_Active" 1 "Active";
VAL_ 1153 DAY_LGT_MD 0 "Night" 1 "Day";
VAL_ 1153 ExteriorRearReleaseSwitchSts 0 "Not_Pressed" 1 "Pressed";
VAL_ 1153 ExternalTemperatureC 511 "SNA";
VAL_ 1153 ExternalTemperatureF 511 "SNA";
VAL_ 1153 FOA_Mobile_App_Alert 0 "Not_Active" 1 "Active";
VAL_ 1153 FOA_Msg_Req 0 "No_Msg" 1 "FOA_TURNED_OFF_ALERT" 2 "FOA_FAULTED" 3 "FOA_ARMED_ALERT" 4 "FOA_LEVEL1_ALERT" 5 "FOA_LEVEL2_ALERT" 6 "FOA_LEVEL2_ALERT_CONNECTIVITY";
VAL_ 1153 FOBSearchRequest 0 "NO_ACTION" 1 "REQUEST_SEARCH" 2 "RESULT_RECEIVED" 3 "RESERVED";
VAL_ 1153 PANEL_INTS 255 "SNA";
VAL_ 1153 RemSt_InhibitSts 0 "INHIBIT_DEFAUILT" 1 "TIME_OUT_RUN" 2 "TIME_OUT_CUST_MODE" 3 "KEY_IN_RUN" 4 "DRV_DOOR_AJAR" 5 "PASS_DOOR_AJAR" 6 "LR_DOOR_AJAR" 7 "RR_DOOR_AJAR" 8 "START_COUNTER" 9 "FAIL_COUNTER" 10 "LOW_RPM_SHUTDOWN" 11 "KEY_IN_IGN" 12 "BRAKE_PRESSED" 13 "HAZARD_LAMP_ON" 14 "NOT_IN_PARK" 15 "VEH_SPEED_HIGH" 16 "HOOD_AJAR" 17 "TRUNK_LIFTGATE" 18 "VTA_ALARM" 19 "PANIC_MODE" 20 "BATT_VOLT_HIGH" 21 "BATT_VOLT_LOW" 22 "POWER_LOSS" 23 "MIL_ON" 24 "OIL_PRESSURE_LOW" 25 "COOLANT_TEMP_HIGH" 26 "RPM_HIGH" 27 "CRANK_NO_START" 28 "REMOTE_OFF_RQ" 29 "RS_DISABLED_PREV" 30 "NOT_CONFIGURED" 31 "NO_HOOD_SWITCH" 32 "NO_AUTO_TRANS" 33 "NOT_ENABLED" 34 "INVALID_SKIM_KEY" 35 "IGN_SNA" 36 "IGN_NOT_LOCK" 37 "GLOW_PLUG_TIMEOUT" 38 "LOW_FUEL" 39 "ETC_LAMP_ON" 40 "LOGISTIC_MODE" 41 "COLD_START_LAMP_FLASH" 42 "ABORT_CRANKING_ENABLE" 43 "RFHUB_HS_FAIL" 44 "FAIL_HCSS" 45 "FOTA_INSTALL_FAIL" 46 "PSA_NOT_ACTIVE" 47 "ESL_NOT_UNLOCKED" 62 "EPB_NO_RESP" 63 "SNA";
VAL_ 1153 SCC_InhibitSts 0 "INHIBIT_DEFAUILT" 1 "TIME_OUT_RUN" 2 "TIME_OUT_CUST_MODE" 3 "KEY_IN_RUN" 4 "DRV_DOOR_AJAR" 5 "PASS_DOOR_AJAR" 6 "LR_DOOR_AJAR" 7 "RR_DOOR_AJAR" 8 "START_COUNTER" 9 "FAIL_COUNTER" 10 "LOW_RPM_SHUTDOWN" 11 "KEY_IN_IGN" 12 "BRAKE_PRESSED" 13 "HAZARD_LAMP_ON" 14 "NOT_IN_PARK" 15 "VEH_SPEED_HIGH" 16 "HOOD_AJAR" 17 "TRUNK_LIFTGATE" 18 "VTA_ALARM" 19 "PANIC_MODE" 20 "BATT_VOLT_HIGH" 21 "BATT_VOLT_LOW" 22 "POWER_LOSS" 23 "MIL_ON" 24 "OIL_PRESSURE_LOW" 25 "COOLANT_TEMP_HIGH" 26 "RPM_HIGH" 27 "CRANK_NO_START" 28 "REMOTE_OFF_RQ" 29 "RS_DISABLED_PREV" 30 "NOT_CONFIGURED" 31 "NO_HOOD_SWITCH" 32 "NO_AUTO_TRANS" 33 "NOT_ENABLED" 34 "INVALID_SKIM_KEY" 35 "IGN_SNA" 36 "IGN_NOT_LOCK" 37 "GLOW_PLUG_TIMEOUT" 38 "LOW_FUEL" 39 "ETC_LAMP_ON" 40 "LOGISTIC_MODE" 41 "COLD_START_LAMP_FLASH" 44 "FAIL_HCSS" 45 "FOTA_INSTALL_FAIL" 62 "EPB_NO_RESP" 63 "SNA";
VAL_ 1153 SpSt_Pad1 0 "Not_Selected" 1 "Sw1_Activated" 2 "Sw2_Activated" 3 "Sw1_and_Sw2_Activated" 4 "Invalid_State" 5 "Short_to_Ground" 6 "Short_to_Power" 7 "SNA";
VAL_ 1153 StTypSts 0 "ST_NOT_ACT" 1 "NOR_ST" 2 "TIP_ST" 3 "REM_ST" 7 "SNA";
VAL_ 1153 TurnIndicationSts 0 "Center" 1 "Right" 2 "Left" 3 "SNA";
VAL_ 1153 WPR_SYS_AUTO 0 "SNA";
VAL_ 1430 A2D_DRV_TEMP_DR_POS 1023 "SNA";
VAL_ 1430 AcOutputCurrentSts 255 "SNA";
VAL_ 1430 Batt_ST_Crit 0 "False" 1 "True";
VAL_ 1430 CMP_DIR 0 "CMP_N" 1 "CMP_N_E" 2 "CMP_E" 3 "CMP_S_E" 4 "CMP_S" 5 "CMP_S_W" 6 "CMP_W" 7 "CMP_N_W" 15 "SNA";
VAL_ 1430 DSM_PDL_LKOUT 0 "LKOUT_NONE" 1 "LKOUT_CRUISE" 2 "LKOUT_TX_REV" 3 "AP_DSBL" 7 "SNA";
VAL_ 1430 EngineOffTimer 4095 "SNA";
VAL_ 1430 Gate_Req_PE 0 "No PE Request" 1 "Handle PE Request" 2 "Button PE Request" 3 "Hands-Free PE Request";
VAL_ 1430 MF_SWG_AJAR 0 "Not_Ajar" 1 "Ajar";
VAL_ 1430 PanicModeActive 0 "Not_Active" 1 "Active";
VAL_ 1430 Parallel_Prk_Ast_Pad1 0 "Not_Selected" 1 "Sw1_Activated" 2 "Sw2_Activated" 3 "Sw1_and_Sw2_Activated" 4 "Invalid_State" 5 "Short_to_Ground" 6 "Short_to_Power" 7 "SNA";
VAL_ 1430 PFTM_Req_PE 0 "No_PE_Request" 1 "Handle_PE_Request" 2 "Button_PE_Request" 3 "Hands_Free_Request";
VAL_ 1430 PN14_LS_Actv 0 "Not_Active" 1 "Active";
VAL_ 1430 PN14_LS_Lvl7 0 "Not_Active" 1 "Active";
VAL_ 1430 StopStartClimateInfo 0 "SPST_ON" 1 "CABIN_HI" 2 "CABIN_LO" 3 "MAX_AC" 4 "FT_DEFROST" 5 "EBL" 7 "SNA";
VAL_ 1431 AirTemp_Outsd 255 "SNA";
VAL_ 1431 APARequestSts 0 "Not_Pressed" 1 "Pressed";
VAL_ 1431 AxleLckrSEL_SW 0 "NOT_PSD" 1 "UP_PSD" 2 "DOWN_PSD" 3 "SNA";
VAL_ 1431 DALM_Status 0 "No_Fault" 1 "Fault";
VAL_ 1431 GlobDrvMdRq_BCM 0 "NONE" 1 "AUTO" 2 "SPORT" 3 "TRACK" 4 "SNOW" 5 "VALET" 6 "ROCK" 7 "TOW" 8 "ECO" 9 "LAUNCH" 10 "ALL" 11 "CUSTOM" 12 "MUD" 13 "SAND " 14 "PLUS" 15 "ICE" 16 "DYNAMIC" 17 "OFFROAD" 18 "BAJA" 19 "MUD_SAND" 20 "DRAG" 31 "SNA";
VAL_ 1431 IGN_OFF_TIME_LNG 4095 "SNA";
VAL_ 1431 Left_Button_BCM 0 "Not_Activated" 1 "Activated" 5 "Short_to_Ground_Fault" 6 "Open_Short_to_Power_Fault" 7 "SNA";
VAL_ 1431 PaddlesModeReq 0 "NONE" 1 "DIS" 2 "EN" 3 "SNA";
VAL_ 1431 PAMRequestSts 0 "Not_Pressed" 1 "Pressed";
VAL_ 1431 PreCondCabinSts 0 "Off" 1 "On" 2 "SPR" 3 "SNA";
VAL_ 1431 Right_Button_BCM 0 "Not_Activated" 1 "Activated" 5 "Short_to_Ground_Fault" 6 "Open_Short_to_Power_Fault" 7 "SNA";
VAL_ 1431 SeatVib_Sts 0 "INIT" 1 "IDLE" 2 "ACTIVE" 3 "FAULTED";
VAL_ 1431 Switch_2WD_Rq 0 "Not Pressed" 1 "Pressed" 3 "SNA";
VAL_ 1431 Switch_4AUTO_Rq 0 "Not Pressed" 1 "Pressed" 3 "SNA";
VAL_ 1431 Switch_4LOCK_Rq 0 "Not Pressed" 1 "Pressed" 3 "SNA";
VAL_ 1431 Switch1_Rq 0 "NOT_PSD" 1 "PSD" 2 "Not_Defined" 3 "SNA";
VAL_ 1431 Switch2_Rq 0 "NOT_PSD" 1 "PSD" 2 "Not_Defined" 3 "SNA";
VAL_ 1431 TerrainModeInterfaceButton_BCM 0 "Not_Activated" 1 "Activated" 5 "Short_to_Ground_Fault" 6 "Open_Short_to_Power_Fault" 7 "SNA";
VAL_ 1431 Tow_Request 0 "Not_Pressed" 1 "Pressed" 5 "Short_to_Ground_Fault" 6 "Open_Short_to_Power_Fault" 7 "SNA";
VAL_ 1431 TRAC_PSD 0 "NOT_PRESSED" 1 "PRESSED";
VAL_ 1431 Trns_DrvMdReq_BCM 0 "NP" 1 "STREET" 2 "VALET" 3 "SPORT" 4 "S_PLUS" 5 "TRACK" 6 "ECO" 7 "SNOW" 8 "ROCK " 9 "TOW" 10 "DRAG" 11 "MUD" 12 "SAND" 13 "BAJA" 14 "OFFROAD" 31 "SNA";
VAL_ 159 ACC_DistSwDec 0 "Not_Active" 1 "Active";
VAL_ 159 ACC_DistSwInc 0 "Not_Active" 1 "Active";
VAL_ 159 ACC_On 0 "Not_Active" 1 "Active";
VAL_ 159 AcceleratorSts 0 "Not_Active" 1 "Active";
VAL_ 159 CruiseControlFailSts 0 "Fail_Not_Present" 1 "Fail_Present";
VAL_ 159 CruiseControlOnOffSts 0 "Not_Active" 1 "Active";
VAL_ 159 CrusCnclSwitch 0 "Not_Active" 1 "Active";
VAL_ 159 DeceleratorSts 0 "Not_Active" 1 "Active";
VAL_ 159 ResumeSwitch 0 "Not_Active" 1 "Active";
VAL_ 736 Command_01Sts 0 "Not_Pressed" 1 "Pressed" 3 "SNA";
VAL_ 736 Command_02Sts 0 "Not_Pressed" 1 "Pressed" 3 "SNA";
VAL_ 736 Command_03Sts 0 "Not_Pressed" 1 "Pressed" 3 "SNA";
VAL_ 736 Command_04Sts 0 "Not_Pressed" 1 "Pressed" 3 "SNA";
VAL_ 736 Command_05Sts 0 "Not_Pressed" 1 "Pressed" 3 "SNA";
VAL_ 736 Command_06Sts 0 "Not_Pressed" 1 "Pressed" 3 "SNA";
VAL_ 736 Command_07Sts 0 "Not_Pressed" 1 "Pressed" 3 "SNA";
VAL_ 736 Command_08Sts 0 "Not_Pressed" 1 "Pressed" 3 "SNA";
VAL_ 736 Command_09Sts 0 "Not_Pressed" 1 "Pressed" 3 "SNA";
VAL_ 736 Command_10Sts 0 "Not_Pressed" 1 "Pressed" 3 "SNA";
VAL_ 736 Command_11Sts 0 "Not_Pressed" 1 "Pressed" 3 "SNA";
VAL_ 736 Command_12Sts 0 "Not_Pressed" 1 "Pressed" 3 "SNA";
VAL_ 736 Command_13Sts 0 "Not_Pressed" 1 "Pressed" 3 "SNA";
VAL_ 736 Command_14Sts 0 "Not_Pressed" 1 "Pressed" 3 "SNA";
VAL_ 736 Command_15Sts 0 "Not_Pressed" 1 "Pressed" 3 "SNA";
VAL_ 512 DriverDoor2AjarXtionSts 1 "NONE" 2 "TRNS" 3 "SNA";
VAL_ 512 DriverDoorAjarXtionSts 1 "NONE" 2 "TRNS" 3 "SNA";
VAL_ 512 DRV_DR_UNLOCKING 0 "Not_Active" 1 "Active";
VAL_ 512 LeakCheckTimerExpired 0 "NOT" 1 "ELAPSED" 3 "SNA";
VAL_ 256 BrkPdlStat_BCM 0 "UPSTOP" 1 "PSD" 2 "NDEF2" 3 "SNA";
VAL_ 256 EngineOffRequest 0 "Not_Active" 1 "Active";
VAL_ 256 KeyInIgnSts 0 "KEY_DEF" 1 "KEY_NOT_IN_IGN" 2 "KEY_IN_IGN" 3 "SNA";
VAL_ 256 OperationalModeSts 0 "Initialization" 1 "Ignition_Off_WithoutKey" 2 "Ignition_Off" 3 "Ignition_Acc" 4 "Ignition_On" 5 "Ignition_Pre_Start" 6 "Ignition_Start" 7 "Ignition_Cranking" 8 "Ignition_On_EngOn" 9 "Ignition_Pre_Acc" 10 "Ignition_Pre_Off" 11 "Automatic_Cranking" 12 "Automatic_Stop" 13 "Key_Authenticated" 14 "Not_Used" 15 "SNA";
VAL_ 256 RefuelRequest 0 "NO" 1 "Refuel" 3 "SNA";
VAL_ 256 RemStActvSts 0 "Remote Start Not Active" 1 "Remote Start Active";
VAL_ 256 RemStActvSts_R 0 "Remote Start Not Active" 1 "Remote Start Active";
VAL_ 256 SCCActvSts 0 "Remote Start Not Active" 1 "Remote Start Active";
VAL_ 256 StartRelayBCMFault 0 "Not_Present" 1 "Present";
VAL_ 256 StartRelayBCMSts 0 "OFF" 1 "ON";
VAL_ 256 TurnIndicatorSts 0 "Center" 1 "Right" 2 "Left" 3 "SNA";
VAL_ 164 PFTM_Stat 0 "No_Issue" 1 "Unlock_to_Operate" 2 "Put_in_Park_to_Operate" 3 "Function_Disabled" 4 "Hood_Error_Limited_speed" 5 "Obstacle_Detected" 6 "Manually_Close_to_Operate" 7 "Reserved" 8 "Adjustable_Height_Unavailable" 9 "Close_Hood_to_shift_to_Drive" 10 "Hands_free_Contaminated" 11 "Service_Power_Hood" 12 "Hood_Status_Error" 13 "Emergency_Release_Activated" 14 "Manually_Open_to_Operate" 15 "SNA";
VAL_ 164 PTG_Stat 0 "No_Issue" 1 "Unlock_to_Operate" 2 "Put_in_Park_to_Operate" 3 "Function_Disabled" 4 "Rear_Area_Clear_Press_Again" 5 "Obstacle_Detected" 6 "Manually_Close_to_Operate" 7 "Reserved2" 8 "Reserved3" 10 "Reserved4" 15 "SNA";
VAL_ 1826 Bed_Lighting_Stat 0 "OFF" 1 "ON";
VAL_ 1826 CargoLamp_Stat 0 "OFF" 1 "ON";
VAL_ 1826 Rr_Guide_Lgt_Stat 0 "OFF" 1 "ON";
VAL_ 1826 UTL_CARGO_COMB 0 "DISABLED" 1 "ENABLED";
VAL_ 602 FL_HS_STATFailSts 0 "Fail_Not_Present" 1 "Fail_Present";
VAL_ 602 FL_HS_STATSts 0 "Heated_seat_off" 1 "Heated_seat_low" 2 "Heated_seat_medium" 3 "Heated_seat_high";
VAL_ 602 FR_HS_STATFailSts 0 "Fail_Not_Present" 1 "Fail_Present";
VAL_ 602 FR_HS_STATSts 0 "Heated_seat_off" 1 "Heated_seat_low" 2 "Heated_seat_medium" 3 "Heated_seat_high";
VAL_ 602 HiBmLvr_Stat 0 "Idle" 1 "HIBM_ON_PSD" 2 "HIBM_FLASH_ON_PSD" 3 "SNA";
VAL_ 602 TurnLeverLatched 0 "Not Set" 1 "Set";
VAL_ 602 WprSw6Posn 0 "OFF" 1 "INTERVAL1" 2 "INTERVAL2" 3 "INTERVAL3" 4 "INTERVAL4" 5 "INTERVAL5" 6 "INTERVAL6" 13 "WPR_LOW" 14 "WPR_HI" 15 "SNA";
VAL_ 1434 BCM_AUX1_HLEnbl 1 "Enabled";
VAL_ 1434 BCM_AUX1_PWRMD 0 "Ignition" 1 "Battery";
VAL_ 1434 BCM_AUX1_Type 0 "Latching" 1 "Momentary";
VAL_ 1434 BCM_AUX2_HLEnbl 1 "Enabled";
VAL_ 1434 BCM_AUX2_PWRMD 0 "Ignition" 1 "Battery";
VAL_ 1434 BCM_AUX2_Type 0 "Latching" 1 "Momentary";
VAL_ 1434 BCM_AUX3_HLEnbl 1 "Enabled";
VAL_ 1434 BCM_AUX3_PWRMD 0 "Ignition" 1 "Battery";
VAL_ 1434 BCM_AUX3_Type 0 "Latching" 1 "Momentary";
VAL_ 1434 BCM_AUX4_HLEnbl 1 "Enabled";
VAL_ 1434 BCM_AUX4_PWRMD 0 "Ignition" 1 "Battery";
VAL_ 1434 BCM_AUX4_Type 0 "Latching" 1 "Momentary";
VAL_ 1434 BCM_AUX5_HLEnbl 1 "Enabled";
VAL_ 1434 BCM_AUX5_PWRMD 0 "Ignition" 1 "Battery";
VAL_ 1434 BCM_AUX5_Type 0 "Latching" 1 "Momentary";
VAL_ 1434 BCM_AUX6_HLEnbl 1 "Enabled";
VAL_ 1434 BCM_AUX6_PWRMD 0 "Ignition" 1 "Battery";
VAL_ 1434 BCM_AUX6_Type 0 "Latching" 1 "Momentary";
VAL_ 1434 Cfg_Aux_PTO 0 "NONE" 3 "FOUR_CUTOFF" 4 "FOUR" 5 "FIVE" 6 "SIX" 7 "SNA";
VAL_ 1434 GeneratorModeActive 0 "Not_Active" 1 "Active";
VAL_ 1434 GeneratorModeSwitch 0 "OFF" 1 "ON";
VAL_ 1434 HRLS_Ambient_Light_Level 255 "SNA";
VAL_ 1434 INV_CARGO_OnState 0 "None" 1 "Disable" 2 "Enable" 3 "SNA";
VAL_ 1434 PSS_Display 0 "OK" 1 "L_OBS_DET" 2 "R_OBS_DET" 3 "L_STEP_DSBL" 4 "R_STEP_DSBL" 5 "PK" 6 "Reserved" 9 "BOTH_DEPLOYED" 10 "BOTH_RETRACTED" 15 "SNA";
VAL_ 1434 VehAcc_Display 0 "OK" 1 "UNLK" 2 "PK" 3 "DSBL" 15 "SNA";
VAL_ 1434 Worksite_Inverter_Active 0 "Not_Active" 1 "Active";
VAL_ 1434 Worksite_Inverter_RadioSwitch 0 "OFF" 1 "ON";
VAL_ 1069 FronWasherSts 0 "None" 1 "Wash Request";
VAL_ 1069 HazardCluster 0 "Not_Set" 1 "Set";
VAL_ 1069 ReverseLamp 0 "Not_Set" 1 "Set";
VAL_ 603 HVACDRVTemp 0 "Initialization" 1 "Full Cold" 62 "Full Hot" 63 "SNA";
VAL_ 603 HVACPSNTemp 0 "Initialization" 1 "Full Cold" 62 "Full Hot" 63 "SNA";
