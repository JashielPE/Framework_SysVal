VERSION ""

NS_ :

BS_:

BU_: AGSM BCM BSM CADM DMSM DTCM ECM EVCU2 GNMM HCP IPC RFHM SGW TCM
BO_ 518 ENGINE_FD_5: 32 ECM
 SG_ AirFuelRatio : 175|8@0+ (0.1,5.5) [5.5|18] "Lambda" IPC,SGW
 SG_ CRC_ENGINE5 : 191|8@0+ (1,0) [0|255] "-" BCM,BSM,CADM,HCP,TCM
 SG_ ECM_CODE_CLR_W : 141|1@0+ (1,0) [0|0] "0" BSM,EVCU2,HCP,TCM
 SG_ ECM_READINESS_RESET_W : 140|1@0+ (1,0) [0|0] "0" BSM,EVCU2,HCP,TCM
 SG_ EngineReadyForESS_W : 116|1@0+ (1,0) [0|1] "-" TCM
 SG_ EngTrqMaxCorrFctr_W : 127|8@0+ (0.0078,0) [0|1.98] "Nm" TCM
 SG_ GrMax_Rq_ECM_W : 135|4@0+ (1,0) [0|15] "-" TCM
 SG_ GrMin_Rq_ECM_W : 139|4@0+ (1,0) [0|15] "-" TCM
 SG_ IntkAirTempIntrClr : 167|8@0+ (1,-64) [-64|190] "°C" IPC,SGW
 SG_ LTR_CoolantTemp : 71|8@0+ (1,-64) [-64|190] "°C" IPC,SGW
 SG_ MessageCounter_ENGINE5 : 179|4@0+ (1,0) [0|15] "-" BCM,BSM,CADM,HCP,TCM
 SG_ PdlPosActual : 87|8@0+ (0.4,0) [0|100] "%" BCM,BSM,CADM,SGW
 SG_ RPMOverRev_W : 115|1@0+ (1,0) [0|1] "-" Vector__XXX

BO_ 751 ENGINE_FD_6: 32 ECM
 SG_ CRC_ENGINE6 : 191|8@0+ (1,0) [0|255] "-" BCM,BSM,CADM,DTCM,IPC,TCM
 SG_ DrvAway_Alert : 161|1@0+ (1,0) [0|1] "-" BCM,IPC
 SG_ DrvAway_Indications : 14|3@0+ (1,0) [0|2] "0" IPC
 SG_ DrvAway_Inhibit : 15|1@0+ (1,0) [0|1] "-" IPC
 SG_ ECM_FOTA_Conflict : 8|1@0+ (1,0) [0|1] "-" SGW
 SG_ ECM_MSG_RQ : 47|5@0+ (1,0) [0|0] "-" SGW
 SG_ EngineWaterTemp : 95|8@0+ (1,-40) [-40|215] "°C" BCM,EVCU2,IPC,SGW,TCM
 SG_ FuelConsumption_GAG : 103|16@0+ (0.0022,0) [0|144.1748] "litres/hour" SGW
 SG_ GearShiftIndication : 157|2@0+ (1,0) [0|3] "-" SGW
 SG_ HP_MODE_STS : 23|3@0+ (1,0) [0|6] "0" Vector__XXX
 SG_ LeakCheckTimerValue : 56|9@0+ (1,0) [0|510] "min" BCM
 SG_ LeakTestRequest : 160|1@0+ (1,0) [0|1] "-" BCM
 SG_ LeakTestSts : 169|2@0+ (1,0) [0|0] "0" BCM
 SG_ MessageCounter_ENGINE6 : 179|4@0+ (1,0) [0|15] "-" BCM,BSM,CADM,DTCM,IPC,TCM
 SG_ SAMInfo : 147|4@0+ (1,0) [0|14] "-" BCM
 SG_ Selector_SystemFailSts : 172|1@0+ (1,0) [0|1] "0" IPC
 SG_ StarterProtectionTime : 7|8@0+ (1,0) [0|254] "sec" IPC
 SG_ StartProtectionInhibit : 183|2@0+ (1,0) [0|0] "-" IPC
 SG_ StartRelayBCMFeedbackFault : 167|1@0+ (1,0) [0|1] "-" BCM
 SG_ StartRelayECMFeedbackFault : 163|1@0+ (1,0) [0|1] "-" BCM,SGW
 SG_ Terrain_HMI_Rq_ECM : 36|5@0+ (1,0) [0|30] "-" IPC
 SG_ TerrainModeDesiredStat : 28|5@0+ (1,0) [0|30] "0" BCM,IPC,SGW
 SG_ TerrainModeInterfaceButton_ECM : 11|3@0+ (1,0) [0|6] "-" SGW
 SG_ TerrainModeStat_ECM : 61|5@0+ (1,0) [0|30] "" BCM,BSM,CADM,DTCM,EVCU2,IPC,SGW,TCM
 SG_ Trns_DrvMd_CfgSts_ECM : 55|8@0+ (1,0) [0|30] "0" SGW
 SG_ Trns_DrvMdReq_ECM : 77|5@0+ (1,0) [0|30] "-" TCM

BO_ 1448 ENGINE_FD_7: 32 ECM
 SG_ CompressorSts : 85|2@0+ (1,0) [0|3] "-" BCM,SGW,TCM
 SG_ CRC_ENGINE7 : 191|8@0+ (1,0) [0|255] "-" BCM,CADM,IPC,TCM
 SG_ ECM_THA_Resp : 73|2@0+ (1,0) [0|2] "-" BCM
 SG_ ECM_WARN_BTO : 147|1@0+ (1,0) [0|1] "-" IPC
 SG_ ECM_WARN_BTO_1 : 138|1@0+ (1,0) [0|1] "-" IPC
 SG_ EMSFailSts : 82|2@0+ (1,0) [0|3] "-" BCM,CADM,IPC,SGW
 SG_ EngineOperatingMode : 124|3@0+ (1,0) [0|7] "-" SGW
 SG_ ETCFailSts : 115|2@0+ (1,0) [0|3] "-" BCM,IPC,SGW
 SG_ ExhaustTemperature : 135|8@0+ (4,0) [0|1020] "°C" EVCU2,SGW
 SG_ FuelMM_Sts : 145|2@0+ (1,0) [0|0] "-" IPC
 SG_ HoursOilLifeRst : 35|12@0+ (1,0) [0|4000] "Hours" BCM
 SG_ KNK_MG_TRIGGER : 71|3@0+ (1,0) [0|3] "" IPC
 SG_ MessageCounter_ENGINE7 : 179|4@0+ (1,0) [0|15] "-" BCM,CADM,IPC,TCM
 SG_ MntncSts : 137|2@0+ (1,0) [0|3] "-" IPC,SGW
 SG_ OilLifeSts : 90|2@0+ (1,0) [0|3] "-" SGW
 SG_ OilPressureSts : 119|1@0+ (1,0) [0|1] "-" BCM,IPC,SGW
 SG_ PerfShftRq_HUD : 175|2@0+ (1,0) [0|3] "-" IPC
 SG_ SpStDispstat : 53|6@0+ (1,0) [0|63] "-" BCM,IPC,SGW,TCM
 SG_ SpStIndRq : 58|1@0+ (1,0) [0|1] "-" IPC
 SG_ SpStSwStat : 55|2@0+ (1,0) [0|3] "-" BCM,IPC,SGW

BO_ 1055 ENGINE_FD_8: 32 ECM
 SG_ AFTER_RUN_STATUS : 21|1@0+ (1,0) [0|1] "-" SGW
 SG_ AM_ECM_Prsnt : 103|2@0+ (1,0) [0|2] "-" BCM
 SG_ COOLING_REQUIRED_STATUS : 20|1@0+ (1,0) [0|1] "-" SGW
 SG_ CRC_ENGINE8 : 191|8@0+ (1,0) [0|255] "-" EVCU2,HCP,TCM
 SG_ GF_Charge : 127|16@0+ (0.2,0) [0|13106.8] "mg/cycle/cyl" BCM,EVCU2,SGW
 SG_ HOOD_AJAR_STATUS : 23|1@0+ (1,0) [0|1] "-" SGW
 SG_ LTR_TARGET_TEMP : 95|8@0+ (1,-40) [-40|214] "deg C" SGW
 SG_ MAP_4_BAR : 96|9@0+ (0.8,0) [0|408] "kPa" BCM,BSM,HCP,SGW
 SG_ MdsAct : 25|1@0+ (1,0) [0|1] "-" IPC,SGW,TCM
 SG_ MdsActforANC : 32|1@0+ (1,0) [0|1] "-" BCM
 SG_ MessageCounter_ENGINE8 : 179|4@0+ (1,0) [0|15] "-" EVCU2,HCP,TCM
 SG_ OIL_PRESS : 159|8@0+ (4,0) [0|1016] "kPaG" IPC,SGW
 SG_ PSI_EnableSts : 7|1@0+ (1,0) [0|1] "-" SGW
 SG_ PSI_Gr1_RPM : 87|8@0+ (250,500) [500|7500] "rpm" SGW
 SG_ PSI_Gr2_RPM : 79|8@0+ (250,500) [500|7500] "rpm" SGW
 SG_ PSI_Gr3_RPM : 71|8@0+ (250,500) [500|7500] "rpm" SGW
 SG_ PSI_Gr4_RPM : 63|8@0+ (250,500) [500|7500] "rpm" SGW
 SG_ PSI_Gr5_RPM : 55|8@0+ (250,500) [500|7500] "rpm" SGW
 SG_ PSI_Max_RPM : 101|5@0+ (100,2000) [2000|8000] "rpm" SGW
 SG_ RACE_CLDWN_BATT_STAT : 22|1@0+ (1,0) [0|1] "-" SGW
 SG_ RACE_CLDWN_DEAC_TIME : 137|10@0+ (1,0) [0|1022] "sec" SGW
 SG_ RACE_CLDWN_SEL : 19|1@0+ (1,0) [0|1] "-" SGW
 SG_ RefuelEvent : 44|3@0+ (1,0) [0|0] "-" BCM
 SG_ RefuelIndication : 47|3@0+ (1,0) [0|7] "-" IPC
 SG_ RevOilLifeRst : 167|16@0+ (1000,0) [0|65534000] "Rev's" BCM
 SG_ SYSTEM_STATUS : 26|1@0+ (1,0) [0|1] "-" SGW

BO_ 271 ENGINE_HYBD_FD_1: 64 ECM
 SG_ AccPos : 343|8@0+ (0.392157,0) [0|100] "%" HCP
 SG_ AccPosV : 214|1@0+ (1,0) [0|1] "" HCP
 SG_ Cam_Exh_1_Locked : 231|1@0+ (1,0) [0|0] "-" Vector__XXX
 SG_ Cam_Exh_2_Locked : 230|1@0+ (1,0) [0|0] "-" Vector__XXX
 SG_ Cam_Int_1_Locked : 229|1@0+ (1,0) [0|0] "-" Vector__XXX
 SG_ Cam_Int_2_Locked : 228|1@0+ (1,0) [0|0] "-" Vector__XXX
 SG_ CmndFlyWheelTorqPotential : 99|12@0+ (0.32,-300.16) [-300.16|1008] "Nm" HCP
 SG_ CmndFlyWheelTorqPrdtd : 115|12@0+ (0.32,-300.16) [-300.16|1008] "Nm" HCP
 SG_ CmndFlyWheelTorqRespTyp : 165|2@0+ (1,0) [0|0] "-" HCP
 SG_ Crank_Locked : 247|1@0+ (1,0) [0|0] "-" Vector__XXX
 SG_ Crank_Maturing_Fault : 246|1@0+ (1,0) [0|0] "-" Vector__XXX
 SG_ CRC_ENGINE_HYBD_FD_1 : 447|8@0+ (1,0) [0|255] "-" HCP,TCM
 SG_ CylOff : 245|1@0+ (1,0) [0|0] "-" EVCU2,HCP
 SG_ DrvrIntndedFlyWheelTorq : 131|12@0+ (0.32,-300.16) [-300.16|1008] "Nm" HCP
 SG_ DrvrIntndedFlyWheelTorqRaw : 147|12@0+ (0.32,-300.16) [-300.16|1008] "Nm" HCP
 SG_ DrvrIntndedFlyWheelTorqRawV : 181|1@0+ (1,0) [0|0] "-" HCP
 SG_ DrvrIntndedFlyWheelTorqV : 180|1@0+ (1,0) [0|0] "-" HCP
 SG_ ECM_Crank_Phase : 372|3@0+ (1,0) [0|7] "-" HCP
 SG_ ECM_VTD_Freeze : 85|2@0+ (1,0) [0|3] "-" EVCU2
 SG_ ECMReq_Remedial_Stop : 135|2@0+ (1,0) [0|0] "-" EVCU2
 SG_ ECU_A2D_Failure : 244|1@0+ (1,0) [0|0] "-" HCP
 SG_ EngActStdyStTorq : 259|12@0+ (0.32,-300.16) [-300.16|1008] "Nm" HCP
 SG_ EngActStdyStTorqV : 263|1@0+ (1,0) [0|0] "-" HCP
 SG_ EngActuatorsStat : 133|2@0+ (1,0) [0|0] "-" HCP
 SG_ EngAirFlwStdyStTorq : 275|12@0+ (0.32,-300.16) [-300.16|1008] "Nm" HCP
 SG_ EngAirFlwStdyStTorqV : 262|1@0+ (1,0) [0|0] "-" HCP
 SG_ EngCmbstnCmnd : 199|1@0+ (1,0) [0|0] "-" EVCU2,HCP
 SG_ EngCylDeactEnCondMet : 261|1@0+ (1,0) [0|0] "-" HCP
 SG_ EngCylDeactMd : 151|2@0+ (1,0) [0|0] "-" HCP
 SG_ EngDFCO_Allw : 260|1@0+ (1,0) [0|0] "-" EVCU2,HCP
 SG_ EngDFCO_Req : 279|1@0+ (1,0) [0|0] "-" EVCU2,HCP
 SG_ EngDFCO_St : 278|1@0+ (1,0) [0|0] "-" EVCU2,HCP
 SG_ Engine_Sync_720 : 277|1@0+ (1,0) [0|0] "-" Vector__XXX
 SG_ EngOffRecom : 276|1@0+ (1,0) [0|0] "-" EVCU2,HCP
 SG_ EngRqStTyp : 103|4@0+ (1,0) [0|0] "-" HCP
 SG_ EngRunCrnkAct : 295|1@0+ (1,0) [0|0] "-" HCP
 SG_ EngSysFld : 294|1@0+ (1,0) [0|0] "-" HCP
 SG_ EngTrqReserveReq : 351|8@0+ (0.32,0) [0|81.28] "Nm" HCP
 SG_ ESS_Engine_State_EE : 119|4@0+ (1,0) [0|0] "-" EVCU2,HCP
 SG_ ETRQ_Mode : 362|3@0+ (1,0) [0|5] "-" HCP
 SG_ Feedback_HCP : 293|1@0+ (1,0) [0|0] "-" HCP
 SG_ HybActEngTorqRespTyp : 149|2@0+ (1,0) [0|0] "-" HCP
 SG_ MaxOffEngTorqCap : 163|12@0+ (0.32,-300.16) [-300.16|1008] "Nm" HCP
 SG_ MaxPrdtdEngTorqCap : 179|12@0+ (0.32,-300.16) [-300.16|1008] "Nm" HCP
 SG_ MaxPrdtdEngTorqCapV : 198|1@0+ (1,0) [0|0] "-" HCP
 SG_ MessageCounter_ENGINE_HYBD_FD_1 : 435|4@0+ (1,0) [0|15] "-" HCP,TCM
 SG_ MinAirFlowMinSparkTorqCap : 195|12@0+ (0.32,-300.16) [-300.16|1008] "Nm" HCP
 SG_ MinAirFlowMinSparkTorqCapV : 197|1@0+ (1,0) [0|0] "-" HCP
 SG_ MinEngTorqCap : 211|12@0+ (0.32,-300.16) [-300.16|1008] "Nm" HCP
 SG_ MinEngTorqCapV : 196|1@0+ (1,0) [0|0] "-" HCP
 SG_ MinImmedEngTorqCap : 227|12@0+ (0.32,-300.16) [-300.16|1008] "Nm" HCP
 SG_ MinImmedEngTorqCapV : 215|1@0+ (1,0) [0|0] "-" HCP
 SG_ MinPrdtdEngRunTorqCap : 243|12@0+ (0.32,-300.16) [-300.16|1008] "Nm" HCP
 SG_ MinPrdtdEngRunTorqCapV : 213|1@0+ (1,0) [0|0] "-" HCP
 SG_ PT_BrakePdlPosn : 383|8@0+ (0.4,0) [0|101.6] "%" HCP
 SG_ PT_BrkPedDscrtInpStat : 292|1@0+ (1,0) [0|0] "-" HCP
 SG_ PT_BrkPedDscrtInpStatV : 311|1@0+ (1,0) [0|0] "-" HCP
 SG_ PT_CrnkAct : 310|1@0+ (1,0) [0|0] "-" HCP
 SG_ PTCrnkAbrted : 309|1@0+ (1,0) [0|0] "-" HCP
 SG_ Sum_FW_ID_Fst : 367|5@0+ (1,0) [0|30] "-" HCP
 SG_ Sum_FW_ID_Slw : 327|5@0+ (1,0) [0|30] "-" HCP
 SG_ T_max_FW : 291|12@0+ (0.32,-300.16) [-300.16|1008] "Nm" HCP
 SG_ T_min_FW : 307|12@0+ (0.32,-300.16) [-300.16|1008] "Nm" HCP
 SG_ TLC_LRN_Rq : 322|1@0+ (1,0) [0|0] "-" EVCU2,HCP

BO_ 1035 ENGINE_HYBD_FD_3: 32 ECM
 SG_ AGSposn : 134|7@0+ (1,0) [0|100] "%" HCP
 SG_ CRC_ENGINE_HYBD_FD_3 : 191|8@0+ (1,0) [0|255] "-" BSM,EVCU2,HCP
 SG_ ECM_AirflowRequest : 87|7@0+ (1,0) [0|127] "%" EVCU2
 SG_ ECM_WorkSite_Invtr_Sts : 181|2@0+ (1,0) [0|3] "-" HCP
 SG_ EngCltTmp : 167|8@0+ (1,-40) [-40|214] "°C" EVCU2,HCP
 SG_ EngCltTmpV : 69|1@0+ (1,0) [0|1] "" EVCU2,HCP
 SG_ EngHalfCylSpdMaxLim : 20|13@0+ (1,0) [0|8160] "rpm" HCP
 SG_ EngHalfCylSpdMinLim : 36|13@0+ (1,0) [0|8160] "rpm" HCP
 SG_ EngOutofFuel : 151|1@0+ (1,0) [0|0] "-" EVCU2,HCP
 SG_ EngSpd : 7|16@0+ (0.125,0) [0|8160] "rpm" HCP
 SG_ EngSpdStat : 38|2@0+ (1,0) [0|0] "-" HCP
 SG_ LTR_PumpSpeedAct : 142|7@0+ (1,0) [0|100] "%" HCP,SGW
 SG_ MaxEngSpdCap : 52|13@0+ (1,0) [0|8160] "rpm" HCP
 SG_ MessageCounter_ENGINE_HYBD_FD_3 : 179|4@0+ (1,0) [0|15] "-" BSM,EVCU2,HCP
 SG_ MinEngSpdCap : 68|13@0+ (1,0) [0|8160] "rpm" HCP
 SG_ RadFanReq : 158|7@0+ (1,0) [0|100] "%" HCP
 SG_ ServiceHybSys : 55|1@0+ (1,0) [0|0] "-" HCP

BO_ 1328 ENGINE_HYBD_FD_4: 32 ECM
 SG_ CatHtgStateActive : 20|1@0+ (1,0) [0|0] "-" EVCU2,HCP
 SG_ CatTempMaint : 23|1@0+ (1,0) [0|1] "-" EVCU2
 SG_ CRC_ENGINE_HYBD_FD_4 : 191|8@0+ (1,0) [0|255] "-" HCP
 SG_ EngTorqACCCapability : 79|8@0+ (0.32,0) [0|81.28] "Nm" HCP
 SG_ EngTorqCapbltyEngOpMd : 21|1@0+ (1,0) [0|0] "-" HCP
 SG_ EngTorqCapbltyFrmCntr : 7|4@0+ (1,0) [0|15] "-" HCP
 SG_ EngTorqCapbltyMaxOffTorq : 3|12@0+ (0.32,-300.16) [-300.16|1008] "Nm" HCP
 SG_ EngTorqCapbltyMaxTorq : 19|12@0+ (0.32,-300.16) [-300.16|1008] "Nm" HCP
 SG_ EngTorqCapbltyMinRunTorq : 35|12@0+ (0.32,-300.16) [-300.16|1008] "Nm" HCP
 SG_ EngTorqCapbltyMinTorq : 51|12@0+ (0.32,-300.16) [-300.16|1008] "Nm" HCP
 SG_ EngTorqCapbltyRefEngSpd : 71|8@0+ (32,0) [0|8160] "rpm" HCP
 SG_ MessageCounter_ENGINE_HYBD_FD_4 : 179|4@0+ (1,0) [0|15] "-" HCP

BO_ 264 EPS_FD_1: 32 BCM
 SG_ CRC_EPS1 : 191|8@0+ (1,0) [0|255] "-" BSM,DMSM,DTCM,ECM,EVCU2,TCM
 SG_ ElectricSteeringFailSts : 37|1@0+ (1,0) [0|1] "-" DTCM,EVCU2
 SG_ EngineFanRequestActivation : 38|1@0+ (1,0) [0|1] "-" ECM
 SG_ LwsAngle : 7|16@0+ (0.1,-720) [-720|720] "°" BSM,DMSM,DTCM,ECM,EVCU2,IPC,SGW,TCM
 SG_ LwsAngleType : 52|2@0+ (1,0) [0|2] "-" BSM,IPC
 SG_ LwsCalibration : 36|1@0+ (1,0) [0|1] "-" BSM,IPC
 SG_ LwsSpeed : 19|12@0+ (1,-2000) [-2000|2094] "°/s" ECM,EVCU2,IPC
 SG_ MessageCounter_EPS1 : 179|4@0+ (1,0) [0|15] "-" BSM,DMSM,DTCM,ECM,EVCU2,TCM

BO_ 1056 EPS_FD_2: 32 BCM
 SG_ CRC_EPS2 : 191|8@0+ (1,0) [0|255] "0" IPC
 SG_ EPS_Warn_Disp_Rq : 87|3@0+ (1,0) [0|3] "" ECM,IPC,SGW
 SG_ MessageCounter_EPS2 : 179|4@0+ (1,0) [0|15] "0" IPC

BO_ 1460 FOTA_MASTER: 32 SGW
 SG_ CADM_Big_ECU_Package : 3|1@0+ (1,0) [0|1] "" CADM
 SG_ FOTA_Install_Type : 21|2@0+ (1,0) [0|3] "" ECM,EVCU2
 SG_ FOTA_Installation_Status : 23|2@0+ (1,0) [0|3] "" EVCU2,RFHM
 SG_ FOTA_Purge : 13|1@0+ (1,0) [0|1] "" CADM
 SG_ FOTA_Status : 7|4@0+ (1,0) [0|15] "" BCM,BSM,CADM,ECM,IPC,RFHM,TCM
 SG_ Safe_State : 0|1@0+ (1,0) [0|1] "" CADM
 SG_ WakeUpECM : 14|1@0+ (1,0) [0|1] "" BCM

CM_ SG_ 518 AirFuelRatio "Air To fuel ratio";
CM_ SG_ 518 CRC_ENGINE5 "CRC according to SAE J1850 standard at each frame transmission.";
CM_ SG_ 518 ECM_CODE_CLR_W "Handshake for not to send";
CM_ SG_ 518 ECM_READINESS_RESET_W "Handshake for not to send";
CM_ SG_ 518 EngineReadyForESS_W "ESS request HIS charget (1=do charge)";
CM_ SG_ 518 EngTrqMaxCorrFctr_W "Factor of reduction from max torque based on ambient conditions";
CM_ SG_ 518 GrMax_Rq_ECM_W "Target gear upper limit (ECM requested limit)";
CM_ SG_ 518 GrMin_Rq_ECM_W "Target gear lower limit (ECM requested limit)";
CM_ SG_ 518 IntkAirTempIntrClr "Intake air temperature post intercooler";
CM_ SG_ 518 LTR_CoolantTemp "Low temp radiator (intercooler) coolant temperature";
CM_ SG_ 518 MessageCounter_ENGINE5 "This signal is a counter used for safety checks strategies. This counter is incremented of 1 (one) unit at each frame transmission.";
CM_ SG_ 518 PdlPosActual "Actual pedal position.";
CM_ SG_ 518 RPMOverRev_W "-";
CM_ SG_ 751 CRC_ENGINE6 "CRC according to SAE J1850 standard at each frame transmission.";
CM_ SG_ 751 DrvAway_Alert "Drive Away Alert; True = [1]";
CM_ SG_ 751 DrvAway_Indications "Drive Away Inhibit Indications";
CM_ SG_ 751 DrvAway_Inhibit "Drive Away Inhibit; True = [1]";
CM_ SG_ 751 ECM_FOTA_Conflict "ECM Conflict with FOTA";
CM_ SG_ 751 ECM_MSG_RQ "ECM Driver Instruction Messages";
CM_ SG_ 751 EngineWaterTemp "-";
CM_ SG_ 751 FuelConsumption_GAG "It represents istantaneous consumption information sent on network";
CM_ SG_ 751 GearShiftIndication "-";
CM_ SG_ 751 HP_MODE_STS "Engine power mode personalization status";
CM_ SG_ 751 LeakCheckTimerValue "Requested leak test timer value";
CM_ SG_ 751 LeakTestRequest "Leak test is requested after powerdown; No request = [0], Leak test requested = [1]";
CM_ SG_ 751 LeakTestSts "Status of leak test";
CM_ SG_ 751 MessageCounter_ENGINE6 "This signal is a counter used for safety checks strategies. This counter is incremented of 1 (one) unit at each frame transmission.";
CM_ SG_ 751 SAMInfo "-";
CM_ SG_ 751 Selector_SystemFailSts "Used to require a vehicle modality";
CM_ SG_ 751 StarterProtectionTime "Starter protection time";
CM_ SG_ 751 StartProtectionInhibit "Starter protection status";
CM_ SG_ 751 StartRelayBCMFeedbackFault "-";
CM_ SG_ 751 StartRelayECMFeedbackFault "-";
CM_ SG_ 751 TerrainModeDesiredStat "Signal indicates customer desired terrain mode status";
CM_ SG_ 751 TerrainModeInterfaceButton_ECM "Signal Indicates G/T or TRX Button activated or Not Activated by driver";
CM_ SG_ 751 TerrainModeStat_ECM "Used to require a vehicle modality";
CM_ SG_ 751 Trns_DrvMd_CfgSts_ECM "The requested state of the drive mode feature";
CM_ SG_ 751 Trns_DrvMdReq_ECM "The requested state of the drive mode feature";
CM_ SG_ 1448 CompressorSts "This signal gives information about the present status of A/C external request and actual A/C activation by ECM.";
CM_ SG_ 1448 CRC_ENGINE7 "CRC according to SAE J1850 standard at each frame transmission.";
CM_ SG_ 1448 ECM_THA_Resp "ECM speed limiting availability response for trailer hitch assist";
CM_ SG_ 1448 ECM_WARN_BTO "A new message will be displayed on cluster when both brake and gas pedal are pressed simultaneously";
CM_ SG_ 1448 ECM_WARN_BTO_1 "A new message will be displayed on cluster when both brake and gas pedal are pressed simultaneously - without ETC lamp";
CM_ SG_ 1448 EMSFailSts "This signal is used  to switch on and off the engine control system warning lamp (called MI for EOBD applications)";
CM_ SG_ 1448 EngineOperatingMode "This signal indicates the engine operating mode (normal or after-treatment systems regeneration)";
CM_ SG_ 1448 ETCFailSts "This signal is used  to switch on and off  ETC lamp to give informations about faults not EOBD relevant.";
CM_ SG_ 1448 ExhaustTemperature "This signal indicates the exhaust engine temperature after combustion or after-treatment systems (if applicable)";
CM_ SG_ 1448 FuelMM_Sts "Fuel maintenance mode status";
CM_ SG_ 1448 HoursOilLifeRst "Hours since last oil life reset";
CM_ SG_ 1448 KNK_MG_TRIGGER "Engine is experiencing high levels of LSPI (mega-knock)";
CM_ SG_ 1448 MessageCounter_ENGINE7 "This signal is a counter used for safety checks strategies. This counter is incremented of 1 (one) unit at each frame transmission.";
CM_ SG_ 1448 MntncSts "Maintenance reminder status";
CM_ SG_ 1448 OilLifeSts "This information is related to engine oil life algorithm, currently used on Diesel engines equipped with DPF.";
CM_ SG_ 1448 OilPressureSts "This signal  indicates oil pressure status (High or low).";
CM_ SG_ 1448 PerfShftRq_HUD "Performance transmission shift request HUD";
CM_ SG_ 1448 SpStDispstat "Stop start display status";
CM_ SG_ 1448 SpStIndRq "Stop start indicator request";
CM_ SG_ 1448 SpStSwStat "Stop start switch status";
CM_ SG_ 1055 AFTER_RUN_STATUS "Quick cooldown feature; Active = [1]";
CM_ SG_ 1055 AM_ECM_Prsnt "Aftermarket ECM present";
CM_ SG_ 1055 COOLING_REQUIRED_STATUS "Status of LTR system requiring cooling; Required = [1]";
CM_ SG_ 1055 CRC_ENGINE8 "CRC according to SAE J1850 standard at each frame transmission.";
CM_ SG_ 1055 GF_Charge "EDR ONLY - Port flow per cylinder per stroke";
CM_ SG_ 1055 HOOD_AJAR_STATUS "Hood adjar for cooldown feature; Open = [1]";
CM_ SG_ 1055 LTR_TARGET_TEMP "LTR target temperature in degC";
CM_ SG_ 1055 MAP_4_BAR "Engine manifold pressure (4 bar range)";
CM_ SG_ 1055 MdsAct "MDS Active";
CM_ SG_ 1055 MdsActforANC "MDS active for ANC; Active = [1]";
CM_ SG_ 1055 MessageCounter_ENGINE8 "This signal is a counter used for safety checks strategies. This counter is incremented of 1 (one) unit at each frame transmission.";
CM_ SG_ 1055 OIL_PRESS "Oil pressure";
CM_ SG_ 1055 PSI_EnableSts "Performance shift indication enabled status; enabled = [1]";
CM_ SG_ 1055 PSI_Gr1_RPM "Actual rpm set point for performance shift indication; 500 indicates not set";
CM_ SG_ 1055 PSI_Gr2_RPM "Actual rpm set point for performance shift indication; 500 indicates not set";
CM_ SG_ 1055 PSI_Gr3_RPM "Actual rpm set point for performance shift indication; 500 indicates not set";
CM_ SG_ 1055 PSI_Gr4_RPM "Actual rpm set point for performance shift indication; 500 indicates not set";
CM_ SG_ 1055 PSI_Gr5_RPM "Actual rpm set point for performance shift indication; 500 indicates not set";
CM_ SG_ 1055 PSI_Max_RPM "Maximum selectable RPM for PSI feature";
CM_ SG_ 1055 RACE_CLDWN_BATT_STAT "Battery health for quick cooldown feature; Acceptable = [1]";
CM_ SG_ 1055 RACE_CLDWN_DEAC_TIME "Race cooldown time remaining before deactivation";
CM_ SG_ 1055 RACE_CLDWN_SEL "State of user selected quick cooldown feature; Selected = [1]";
CM_ SG_ 1055 RefuelEvent "Status of refuel event";
CM_ SG_ 1055 RefuelIndication "Indication to the driver about the status of the refuel system";
CM_ SG_ 1055 RevOilLifeRst "Engine revolutions since last oil life reset";
CM_ SG_ 1055 SYSTEM_STATUS "System faults; Acive faults = [1]";
CM_ SG_ 271 AccPos "Accelerator Effective Position";
CM_ SG_ 271 AccPosV "Accelerator Effective Position Validity";
CM_ SG_ 271 Cam_Exh_1_Locked "Indicates the camshaft driver has locked the camshaft position (exhaust cam bank 1)";
CM_ SG_ 271 Cam_Exh_2_Locked "Indicates the camshaft driver has locked the camshaft position (exhaust cam bank 2)";
CM_ SG_ 271 Cam_Int_1_Locked "Indicates the camshaft driver has locked the camshaft position (intake cam bank 1)";
CM_ SG_ 271 Cam_Int_2_Locked "Indicates the camshaft driver has locked the camshaft position (intake cam bank 2)";
CM_ SG_ 271 CmndFlyWheelTorqPotential "Commanded Flywheel Torque Potential";
CM_ SG_ 271 CmndFlyWheelTorqPrdtd "Commanded Flywheel Torque: Predicted Torque";
CM_ SG_ 271 CmndFlyWheelTorqRespTyp "Commanded Flywheel Torque Response Type";
CM_ SG_ 271 Crank_Locked "Indicates that the crankshaft has locked its position";
CM_ SG_ 271 Crank_Maturing_Fault "Indicates ECM is maturing a crank fault diagnostic";
CM_ SG_ 271 CRC_ENGINE_HYBD_FD_1 "CRC according to SAE J1850 standard at each frame transmission.";
CM_ SG_ 271 CylOff "Cylinder off due to misfire";
CM_ SG_ 271 DrvrIntndedFlyWheelTorq "Driver Intended Flywheel Torque";
CM_ SG_ 271 DrvrIntndedFlyWheelTorqRaw "Driver Intended Flywheel Torque Raw";
CM_ SG_ 271 DrvrIntndedFlyWheelTorqRawV "Driver Intended Flywheel Torque Raw Validity";
CM_ SG_ 271 DrvrIntndedFlyWheelTorqV "Driver Intended Flywheel Torque Validity";
CM_ SG_ 271 ECM_Crank_Phase "BSG applications between the ECM and HCP";
CM_ SG_ 271 ECM_VTD_Freeze "ECM request for ITID Freeze";
CM_ SG_ 271 ECMReq_Remedial_Stop "Engine Stop Request";
CM_ SG_ 271 ECU_A2D_Failure "AVD Failure Flag";
CM_ SG_ 271 EngActStdyStTorq "Engine actual steady state torque (current conditions)";
CM_ SG_ 271 EngActStdyStTorqV "Engine actual steady state torque validity; Invalid = [1]";
CM_ SG_ 271 EngActuatorsStat "Engine Actuator Status for Autostop";
CM_ SG_ 271 EngAirFlwStdyStTorq "Engine airflow steady state torque (potential)";
CM_ SG_ 271 EngAirFlwStdyStTorqV "Engine airflow steady state torque validity; Invalid = [1]";
CM_ SG_ 271 EngCmbstnCmnd "Engine combustion commanded";
CM_ SG_ 271 EngCylDeactEnCondMet "Engine cylinder deactivation enable conditions met";
CM_ SG_ 271 EngCylDeactMd "Engine Cylinder Deactivation Mode";
CM_ SG_ 271 EngDFCO_Allw "Engine deceleration fuel cut off allowed";
CM_ SG_ 271 EngDFCO_Req "Engine deceleration fuel cut off requested";
CM_ SG_ 271 EngDFCO_St "Engine deceleration fuel cut off state";
CM_ SG_ 271 Engine_Sync_720 "Indicates that the crank and cams have synchronized";
CM_ SG_ 271 EngOffRecom "Engine off recommendation";
CM_ SG_ 271 EngRqStTyp "Engine requested start type";
CM_ SG_ 271 EngRunCrnkAct "ECM run crank terminal status, 1=active";
CM_ SG_ 271 EngSysFld "Engine System Failed";
CM_ SG_ 271 EngTrqReserveReq "Engine Torque Reserve Request";
CM_ SG_ 271 ESS_Engine_State_EE "ESS Engine State";
CM_ SG_ 271 ETRQ_Mode "Enumeration of combustion torque mode";
CM_ SG_ 271 Feedback_HCP "Indication that the ECM is receiving valid data from the HCP. 0 - False; 1 - True.";
CM_ SG_ 271 HybActEngTorqRespTyp "Hybrid Actual Engine Torque Response Type";
CM_ SG_ 271 MaxOffEngTorqCap "Capacity Max-off";
CM_ SG_ 271 MaxPrdtdEngTorqCap "Maximum predicted engine torque capacity";
CM_ SG_ 271 MaxPrdtdEngTorqCapV "Maximum predicted engine torque capacity validity; Invalid = [1]";
CM_ SG_ 271 MessageCounter_ENGINE_HYBD_FD_1 "This signal is a counter used for safety checks strategies. This counter is incremented of 1 (one) unit at each frame transmission.";
CM_ SG_ 271 MinAirFlowMinSparkTorqCap "Engine Torque capacity at minimum air flow and  minimum spark";
CM_ SG_ 271 MinAirFlowMinSparkTorqCapV "Engine Torque capacity at minimum air flow and  minimum spark validity; Invalid = [1]";
CM_ SG_ 271 MinEngTorqCap "Minimum engine torque capacity (min air flow, fuel off)";
CM_ SG_ 271 MinEngTorqCapV "Minimum engine torque capacity validity; Invalid = [1]";
CM_ SG_ 271 MinImmedEngTorqCap "Minimum immediate engine torque capacity (current air flow, minimum spark)";
CM_ SG_ 271 MinImmedEngTorqCapV "Minimum immediate engine torque capacity validity; Invalid = [1]";
CM_ SG_ 271 MinPrdtdEngRunTorqCap "Minimum predicted engine run torque capacity (minimum air flow, MBT spark)";
CM_ SG_ 271 MinPrdtdEngRunTorqCapV "Minimum predicted engine run torque capacity validity; Invalid = [1]";
CM_ SG_ 271 PT_BrakePdlPosn "Brake pedal travel sensor 0-100% (0 = upstop)";
CM_ SG_ 271 PT_BrkPedDscrtInpStat "Powertrain brake pedal discrete input status";
CM_ SG_ 271 PT_BrkPedDscrtInpStatV "Powertrain brake pedal discrete input status validity; Invalid = [1]";
CM_ SG_ 271 PT_CrnkAct "Powertrain crank active";
CM_ SG_ 271 PTCrnkAbrted "Powertrain crank aborted";
CM_ SG_ 271 Sum_FW_ID_Fst "Enumeration of system controlling combustion fast path";
CM_ SG_ 271 Sum_FW_ID_Slw "Enumeration of system controlling combustion slow path";
CM_ SG_ 271 T_max_FW "T_max_FW";
CM_ SG_ 271 T_min_FW "T_min_FW";
CM_ SG_ 271 TLC_LRN_Rq "TLC learning request";
CM_ SG_ 1035 AGSposn ".";
CM_ SG_ 1035 CRC_ENGINE_HYBD_FD_3 "CRC according to SAE J1850 standard at each frame transmission.";
CM_ SG_ 1035 ECM_AirflowRequest "ECM Air Flow Request to the hybrid controller combining AGS and Fan requests";
CM_ SG_ 1035 ECM_WorkSite_Invtr_Sts "ECM 2KW Inverter support status";
CM_ SG_ 1035 EngCltTmp "Engine Coolant Temp";
CM_ SG_ 1035 EngCltTmpV "Engine Coolant Temperature Validity";
CM_ SG_ 1035 EngHalfCylSpdMaxLim "Engine Half Cylinder Speed Maximum Limit";
CM_ SG_ 1035 EngHalfCylSpdMinLim "Engine Half Cylinder Speed Minimum Limit";
CM_ SG_ 1035 EngOutofFuel "Engine System Failed (limp home = 1)";
CM_ SG_ 1035 EngSpd "Engine speed";
CM_ SG_ 1035 EngSpdStat "Engine speed status";
CM_ SG_ 1035 LTR_PumpSpeedAct "Low temperature radiator pump actual flow speed";
CM_ SG_ 1035 MaxEngSpdCap "Maximum Engine Speed Capacity";
CM_ SG_ 1035 MessageCounter_ENGINE_HYBD_FD_3 "This signal is a counter used for safety checks strategies. This counter is incremented of 1 (one) unit at each frame transmission.";
CM_ SG_ 1035 MinEngSpdCap "Minimum Engine Speed Capacity";
CM_ SG_ 1035 RadFanReq "Radiator Fan request";
CM_ SG_ 1035 ServiceHybSys "Service Hybrid system; True = [1]";
CM_ SG_ 1328 CatHtgStateActive "Catalysator Heating Status Request, 0- no request, 1 - request";
CM_ SG_ 1328 CatTempMaint "Catalyst Temperature Maintenance Flag";
CM_ SG_ 1328 CRC_ENGINE_HYBD_FD_4 "CRC according to SAE J1850 standard at each frame transmission.";
CM_ SG_ 1328 EngTorqACCCapability "Eng Trq to be subtracted from the entire capability curve on the HCP side";
CM_ SG_ 1328 EngTorqCapbltyEngOpMd "Engine operating mode [0] = non-MDS, [1] = MDS";
CM_ SG_ 1328 EngTorqCapbltyFrmCntr "Engine Torque Capability: Frame Counter (4 bit)";
CM_ SG_ 1328 EngTorqCapbltyMaxOffTorq "Capability Max-off";
CM_ SG_ 1328 EngTorqCapbltyMaxTorq "Engine torque capability: maximum torque";
CM_ SG_ 1328 EngTorqCapbltyMinRunTorq "Engine torque capability: minimum run torque (fuel on)";
CM_ SG_ 1328 EngTorqCapbltyMinTorq "Engine torque capability: minimum torque (fuel off)";
CM_ SG_ 1328 EngTorqCapbltyRefEngSpd "Engine torque capability: reference engine speed";
CM_ SG_ 1328 MessageCounter_ENGINE_HYBD_FD_4 "This signal is a counter used for safety checks strategies. This counter is incremented of 1 (one) unit at each frame transmission.";
CM_ SG_ 264 CRC_EPS1 "CRC according to SAE J1850 standard at each frame transmission.";
CM_ SG_ 264 ElectricSteeringFailSts "It indicates if system EPS has an internal fault.";
CM_ SG_ 264 EngineFanRequestActivation "This signal is used to activate the cooling fun by the electric power steering.";
CM_ SG_ 264 LwsAngle "This signal indicates the steering angle value, counterclockwise positive.";
CM_ SG_ 264 LwsAngleType "This signal indicates whether the angle sensor is absolute (all the possible turns/degrees) or not absolute (relative, torque only, etc.).";
CM_ SG_ 264 LwsCalibration "This signal indicates if the sensor has been calibrated and therefore the steering angle value is exported over Can.";
CM_ SG_ 264 LwsSpeed "This signal indicates the steering speed value, counterclockwise positive.";
CM_ SG_ 264 MessageCounter_EPS1 "This signal is a counter used for safety checks strategies. This counter is incremented of 1 (one) unit at each frame transmission.";
CM_ SG_ 1056 CRC_EPS2 "CRC according to SAE J1850 standard at each frame transmission.";
CM_ SG_ 1056 EPS_Warn_Disp_Rq "Electric Power Steering Warning Display Request";
CM_ SG_ 1056 MessageCounter_EPS2 "This signal is a counter used for safety checks strategies. This counter is incremented of 1 (one) unit at each frame transmission.";
CM_ SG_ 1460 CADM_Big_ECU_Package "CADM_Big_ECU_Package";
CM_ SG_ 1460 FOTA_Install_Type "Type of FOTA Installation";
CM_ SG_ 1460 FOTA_Installation_Status "FOTA Installation Status";
CM_ SG_ 1460 FOTA_Purge "Target ECUs to Purge Downloaded FOTA Images";
CM_ SG_ 1460 FOTA_Status "FOTA_Status";
CM_ SG_ 1460 Safe_State "Safe_State";
CM_ SG_ 1460 WakeUpECM "When signal active BCM wakes up ECM through hardwire";

BA_DEF_ SG_ "GenSigStartValue" INT 0 2147483647;
BA_DEF_ SG_ "GenSigInactiveValue" INT 0 2147483647;
BA_DEF_ SG_ "GenSigSendType" ENUM "NotUsed","OnWrite","OnWriteWithRepetition","OnChange","OnChangeWithRepetition","IfActive","IfActiveWithRepetition","NoSigSendType";
BA_DEF_ SG_ "SystemSignalLongSymbol" STRING ;
BA_DEF_ SG_ "GenSigTimeoutTime_AGSM" INT 0 65535;
BA_DEF_ SG_ "GenSigTimeoutTime_BCM" INT 0 65535;
BA_DEF_ SG_ "GenSigTimeoutTime_BSM" INT 0 65535;
BA_DEF_ SG_ "GenSigTimeoutTime_CADM" INT 0 65535;
BA_DEF_ SG_ "GenSigTimeoutTime_DMSM" INT 0 65535;
BA_DEF_ SG_ "GenSigTimeoutTime_DTCM" INT 0 65535;
BA_DEF_ SG_ "GenSigTimeoutTime_ECM" INT 0 65535;
BA_DEF_ SG_ "GenSigTimeoutTime_EVCU2" INT 0 65535;
BA_DEF_ SG_ "GenSigTimeoutTime_GNMM" INT 0 65535;
BA_DEF_ SG_ "GenSigTimeoutTime_HCP" INT 0 65535;
BA_DEF_ SG_ "GenSigTimeoutTime_IPC" INT 0 65535;
BA_DEF_ SG_ "GenSigTimeoutTime_RFHM" INT 0 65535;
BA_DEF_ SG_ "GenSigTimeoutTime_SGW" INT 0 65535;
BA_DEF_ SG_ "GenSigTimeoutTime_TCM" INT 0 65535;
BA_DEF_ BO_ "DiagRequest" ENUM "No","Yes";
BA_DEF_ BO_ "Type" ENUM "P","C","PE","COC","PE_Cntrl","E","E_Cntrl","OC","S","BAF","DC","EM","MM","ISO-TP","-";
BA_DEF_ BO_ "DiagResponse" ENUM "No","Yes";
BA_DEF_ BO_ "NmMessage" ENUM "No","Yes";
BA_DEF_ BO_ "GenMsgSendType" ENUM "Cyclic","NotUsed","NotUsed","NotUsed","NotUsed","NotUsed","NotUsed","NotUsed","NoMsgSendType";
BA_DEF_ BO_ "GenMsgNrOfRepetition" INT 0 255;
BA_DEF_ BO_ "GenMsgILSupport" ENUM "No","Yes";
BA_DEF_ BO_ "GenMsgStartDelayTime" INT 0 65535;
BA_DEF_ BO_ "GenMsgCycleTimeFast" INT 0 65535;
BA_DEF_ BO_ "GenMsgCycleTime" INT 0 65535;
BA_DEF_ BO_ "GenMsgDelayTime" INT 0 65535;
BA_DEF_ BO_ "NmAsrMessage" ENUM "No","Yes";
BA_DEF_ BO_ "DiagState" ENUM "No","Yes";
BA_DEF_ BO_ "DiagConnection" HEX 0 65535;
BA_DEF_ BO_ "VFrameFormat" ENUM "StandardCAN","ExtendedCAN","reserved","reserved","reserved","reserved","reserved","reserved","reserved","reserved","reserved","reserved","reserved","reserved","StandardCAN_FD","ExtendedCAN_FD";
BA_DEF_ BO_ "CANFD_BRS" ENUM "0","1";
BA_DEF_DEF_ "DiagRequest" "No";
BA_DEF_DEF_ "Type" "-";
BA_DEF_DEF_ "DiagResponse" "No";
BA_DEF_DEF_ "NmMessage" "No";
BA_DEF_DEF_ "GenMsgSendType" "NoMsgSendType";
BA_DEF_DEF_ "GenMsgNrOfRepetition" 0;
BA_DEF_DEF_ "GenMsgILSupport" "No";
BA_DEF_DEF_ "GenMsgStartDelayTime" 0;
BA_DEF_DEF_ "GenMsgCycleTimeFast" 0;
BA_DEF_DEF_ "GenMsgCycleTime" 0;
BA_DEF_DEF_ "GenMsgDelayTime" 0;
BA_DEF_DEF_ "NmAsrMessage" "No";
BA_DEF_DEF_ "DiagState" "No";
BA_DEF_DEF_ "DiagConnection" 0;
BA_DEF_DEF_ "VFrameFormat" "StandardCAN_FD";
BA_DEF_DEF_ "CANFD_BRS" "0";
BA_DEF_DEF_ "GenSigStartValue" 0;
BA_DEF_DEF_ "GenSigInactiveValue" 0;
BA_DEF_DEF_ "GenSigSendType" "NoSigSendType";
BA_DEF_DEF_ "SystemSignalLongSymbol" "";
BA_DEF_DEF_ "GenSigTimeoutTime_AGSM" 2500;
BA_DEF_DEF_ "GenSigTimeoutTime_BCM" 2500;
BA_DEF_DEF_ "GenSigTimeoutTime_BSM" 2500;
BA_DEF_DEF_ "GenSigTimeoutTime_CADM" 2500;
BA_DEF_DEF_ "GenSigTimeoutTime_DMSM" 2500;
BA_DEF_DEF_ "GenSigTimeoutTime_DTCM" 2500;
BA_DEF_DEF_ "GenSigTimeoutTime_ECM" 2500;
BA_DEF_DEF_ "GenSigTimeoutTime_EVCU2" 2500;
BA_DEF_DEF_ "GenSigTimeoutTime_GNMM" 2500;
BA_DEF_DEF_ "GenSigTimeoutTime_HCP" 2500;
BA_DEF_DEF_ "GenSigTimeoutTime_IPC" 2500;
BA_DEF_DEF_ "GenSigTimeoutTime_RFHM" 2500;
BA_DEF_DEF_ "GenSigTimeoutTime_SGW" 2500;
BA_DEF_DEF_ "GenSigTimeoutTime_TCM" 2500;
BA_ "Type" BO_ 518 1;
BA_ "GenMsgSendType" BO_ 518 0;
BA_ "GenMsgILSupport" BO_ 518 1;
BA_ "GenMsgCycleTime" BO_ 518 20;
BA_ "CANFD_BRS" BO_ 518 1;
BA_ "Type" BO_ 751 1;
BA_ "GenMsgSendType" BO_ 751 0;
BA_ "GenMsgILSupport" BO_ 751 1;
BA_ "GenMsgCycleTime" BO_ 751 50;
BA_ "CANFD_BRS" BO_ 751 1;
BA_ "Type" BO_ 1448 3;
BA_ "GenMsgSendType" BO_ 1448 0;
BA_ "GenMsgNrOfRepetition" BO_ 1448 2;
BA_ "GenMsgILSupport" BO_ 1448 1;
BA_ "GenMsgCycleTimeFast" BO_ 1448 20;
BA_ "GenMsgCycleTime" BO_ 1448 1000;
BA_ "GenMsgDelayTime" BO_ 1448 20;
BA_ "CANFD_BRS" BO_ 1448 1;
BA_ "Type" BO_ 1055 1;
BA_ "GenMsgSendType" BO_ 1055 0;
BA_ "GenMsgILSupport" BO_ 1055 1;
BA_ "GenMsgCycleTime" BO_ 1055 100;
BA_ "CANFD_BRS" BO_ 1055 1;
BA_ "Type" BO_ 271 1;
BA_ "GenMsgSendType" BO_ 271 0;
BA_ "GenMsgILSupport" BO_ 271 1;
BA_ "GenMsgCycleTime" BO_ 271 10;
BA_ "CANFD_BRS" BO_ 271 1;
BA_ "Type" BO_ 1035 1;
BA_ "GenMsgSendType" BO_ 1035 0;
BA_ "GenMsgILSupport" BO_ 1035 1;
BA_ "GenMsgCycleTime" BO_ 1035 100;
BA_ "CANFD_BRS" BO_ 1035 1;
BA_ "Type" BO_ 1328 1;
BA_ "GenMsgSendType" BO_ 1328 0;
BA_ "GenMsgILSupport" BO_ 1328 1;
BA_ "GenMsgCycleTime" BO_ 1328 200;
BA_ "CANFD_BRS" BO_ 1328 1;
BA_ "Type" BO_ 264 1;
BA_ "GenMsgSendType" BO_ 264 0;
BA_ "GenMsgILSupport" BO_ 264 1;
BA_ "GenMsgStartDelayTime" BO_ 264 5;
BA_ "GenMsgCycleTime" BO_ 264 10;
BA_ "CANFD_BRS" BO_ 264 1;
BA_ "Type" BO_ 1056 1;
BA_ "GenMsgSendType" BO_ 1056 0;
BA_ "GenMsgILSupport" BO_ 1056 1;
BA_ "GenMsgStartDelayTime" BO_ 1056 70;
BA_ "GenMsgCycleTime" BO_ 1056 100;
BA_ "CANFD_BRS" BO_ 1056 1;
BA_ "Type" BO_ 1460 3;
BA_ "GenMsgSendType" BO_ 1460 0;
BA_ "GenMsgILSupport" BO_ 1460 1;
BA_ "GenMsgCycleTime" BO_ 1460 1000;
BA_ "GenMsgDelayTime" BO_ 1460 20;
BA_ "CANFD_BRS" BO_ 1460 1;
BA_ "GenSigStartValue" SG_ 518 AirFuelRatio 255;
BA_ "GenSigTimeoutTime_AGSM" SG_ 518 AirFuelRatio 0;
BA_ "GenSigTimeoutTime_BCM" SG_ 518 AirFuelRatio 0;
BA_ "GenSigTimeoutTime_BSM" SG_ 518 AirFuelRatio 0;
BA_ "GenSigTimeoutTime_CADM" SG_ 518 AirFuelRatio 0;
BA_ "GenSigTimeoutTime_DMSM" SG_ 518 AirFuelRatio 0;
BA_ "GenSigTimeoutTime_DTCM" SG_ 518 AirFuelRatio 0;
BA_ "GenSigTimeoutTime_ECM" SG_ 518 AirFuelRatio 0;
BA_ "GenSigTimeoutTime_EVCU2" SG_ 518 AirFuelRatio 0;
BA_ "GenSigTimeoutTime_GNMM" SG_ 518 AirFuelRatio 0;
BA_ "GenSigTimeoutTime_HCP" SG_ 518 AirFuelRatio 0;
BA_ "GenSigTimeoutTime_RFHM" SG_ 518 AirFuelRatio 0;
BA_ "GenSigTimeoutTime_TCM" SG_ 518 AirFuelRatio 0;
BA_ "GenSigTimeoutTime_AGSM" SG_ 518 CRC_ENGINE5 0;
BA_ "GenSigTimeoutTime_DMSM" SG_ 518 CRC_ENGINE5 0;
BA_ "GenSigTimeoutTime_DTCM" SG_ 518 CRC_ENGINE5 0;
BA_ "GenSigTimeoutTime_ECM" SG_ 518 CRC_ENGINE5 0;
BA_ "GenSigTimeoutTime_EVCU2" SG_ 518 CRC_ENGINE5 0;
BA_ "GenSigTimeoutTime_GNMM" SG_ 518 CRC_ENGINE5 0;
BA_ "GenSigTimeoutTime_IPC" SG_ 518 CRC_ENGINE5 0;
BA_ "GenSigTimeoutTime_RFHM" SG_ 518 CRC_ENGINE5 0;
BA_ "GenSigTimeoutTime_SGW" SG_ 518 CRC_ENGINE5 0;
BA_ "GenSigTimeoutTime_AGSM" SG_ 518 ECM_CODE_CLR_W 0;
BA_ "GenSigTimeoutTime_BCM" SG_ 518 ECM_CODE_CLR_W 0;
BA_ "GenSigTimeoutTime_CADM" SG_ 518 ECM_CODE_CLR_W 0;
BA_ "GenSigTimeoutTime_DMSM" SG_ 518 ECM_CODE_CLR_W 0;
BA_ "GenSigTimeoutTime_DTCM" SG_ 518 ECM_CODE_CLR_W 0;
BA_ "GenSigTimeoutTime_ECM" SG_ 518 ECM_CODE_CLR_W 0;
BA_ "GenSigTimeoutTime_GNMM" SG_ 518 ECM_CODE_CLR_W 0;
BA_ "GenSigTimeoutTime_IPC" SG_ 518 ECM_CODE_CLR_W 0;
BA_ "GenSigTimeoutTime_RFHM" SG_ 518 ECM_CODE_CLR_W 0;
BA_ "GenSigTimeoutTime_SGW" SG_ 518 ECM_CODE_CLR_W 0;
BA_ "GenSigTimeoutTime_AGSM" SG_ 518 ECM_READINESS_RESET_W 0;
BA_ "GenSigTimeoutTime_BCM" SG_ 518 ECM_READINESS_RESET_W 0;
BA_ "GenSigTimeoutTime_CADM" SG_ 518 ECM_READINESS_RESET_W 0;
BA_ "GenSigTimeoutTime_DMSM" SG_ 518 ECM_READINESS_RESET_W 0;
BA_ "GenSigTimeoutTime_DTCM" SG_ 518 ECM_READINESS_RESET_W 0;
BA_ "GenSigTimeoutTime_ECM" SG_ 518 ECM_READINESS_RESET_W 0;
BA_ "GenSigTimeoutTime_GNMM" SG_ 518 ECM_READINESS_RESET_W 0;
BA_ "GenSigTimeoutTime_IPC" SG_ 518 ECM_READINESS_RESET_W 0;
BA_ "GenSigTimeoutTime_RFHM" SG_ 518 ECM_READINESS_RESET_W 0;
BA_ "GenSigTimeoutTime_SGW" SG_ 518 ECM_READINESS_RESET_W 0;
BA_ "GenSigTimeoutTime_AGSM" SG_ 518 EngineReadyForESS_W 0;
BA_ "GenSigTimeoutTime_BCM" SG_ 518 EngineReadyForESS_W 0;
BA_ "GenSigTimeoutTime_BSM" SG_ 518 EngineReadyForESS_W 0;
BA_ "GenSigTimeoutTime_CADM" SG_ 518 EngineReadyForESS_W 0;
BA_ "GenSigTimeoutTime_DMSM" SG_ 518 EngineReadyForESS_W 0;
BA_ "GenSigTimeoutTime_DTCM" SG_ 518 EngineReadyForESS_W 0;
BA_ "GenSigTimeoutTime_ECM" SG_ 518 EngineReadyForESS_W 0;
BA_ "GenSigTimeoutTime_EVCU2" SG_ 518 EngineReadyForESS_W 0;
BA_ "GenSigTimeoutTime_GNMM" SG_ 518 EngineReadyForESS_W 0;
BA_ "GenSigTimeoutTime_HCP" SG_ 518 EngineReadyForESS_W 0;
BA_ "GenSigTimeoutTime_IPC" SG_ 518 EngineReadyForESS_W 0;
BA_ "GenSigTimeoutTime_RFHM" SG_ 518 EngineReadyForESS_W 0;
BA_ "GenSigTimeoutTime_SGW" SG_ 518 EngineReadyForESS_W 0;
BA_ "GenSigStartValue" SG_ 518 EngTrqMaxCorrFctr_W 255;
BA_ "GenSigTimeoutTime_AGSM" SG_ 518 EngTrqMaxCorrFctr_W 0;
BA_ "GenSigTimeoutTime_BCM" SG_ 518 EngTrqMaxCorrFctr_W 0;
BA_ "GenSigTimeoutTime_BSM" SG_ 518 EngTrqMaxCorrFctr_W 0;
BA_ "GenSigTimeoutTime_CADM" SG_ 518 EngTrqMaxCorrFctr_W 0;
BA_ "GenSigTimeoutTime_DMSM" SG_ 518 EngTrqMaxCorrFctr_W 0;
BA_ "GenSigTimeoutTime_DTCM" SG_ 518 EngTrqMaxCorrFctr_W 0;
BA_ "GenSigTimeoutTime_ECM" SG_ 518 EngTrqMaxCorrFctr_W 0;
BA_ "GenSigTimeoutTime_EVCU2" SG_ 518 EngTrqMaxCorrFctr_W 0;
BA_ "GenSigTimeoutTime_GNMM" SG_ 518 EngTrqMaxCorrFctr_W 0;
BA_ "GenSigTimeoutTime_HCP" SG_ 518 EngTrqMaxCorrFctr_W 0;
BA_ "GenSigTimeoutTime_IPC" SG_ 518 EngTrqMaxCorrFctr_W 0;
BA_ "GenSigTimeoutTime_RFHM" SG_ 518 EngTrqMaxCorrFctr_W 0;
BA_ "GenSigTimeoutTime_SGW" SG_ 518 EngTrqMaxCorrFctr_W 0;
BA_ "GenSigTimeoutTime_AGSM" SG_ 518 GrMax_Rq_ECM_W 0;
BA_ "GenSigTimeoutTime_BCM" SG_ 518 GrMax_Rq_ECM_W 0;
BA_ "GenSigTimeoutTime_BSM" SG_ 518 GrMax_Rq_ECM_W 0;
BA_ "GenSigTimeoutTime_CADM" SG_ 518 GrMax_Rq_ECM_W 0;
BA_ "GenSigTimeoutTime_DMSM" SG_ 518 GrMax_Rq_ECM_W 0;
BA_ "GenSigTimeoutTime_DTCM" SG_ 518 GrMax_Rq_ECM_W 0;
BA_ "GenSigTimeoutTime_ECM" SG_ 518 GrMax_Rq_ECM_W 0;
BA_ "GenSigTimeoutTime_EVCU2" SG_ 518 GrMax_Rq_ECM_W 0;
BA_ "GenSigTimeoutTime_GNMM" SG_ 518 GrMax_Rq_ECM_W 0;
BA_ "GenSigTimeoutTime_HCP" SG_ 518 GrMax_Rq_ECM_W 0;
BA_ "GenSigTimeoutTime_IPC" SG_ 518 GrMax_Rq_ECM_W 0;
BA_ "GenSigTimeoutTime_RFHM" SG_ 518 GrMax_Rq_ECM_W 0;
BA_ "GenSigTimeoutTime_SGW" SG_ 518 GrMax_Rq_ECM_W 0;
BA_ "GenSigTimeoutTime_AGSM" SG_ 518 GrMin_Rq_ECM_W 0;
BA_ "GenSigTimeoutTime_BCM" SG_ 518 GrMin_Rq_ECM_W 0;
BA_ "GenSigTimeoutTime_BSM" SG_ 518 GrMin_Rq_ECM_W 0;
BA_ "GenSigTimeoutTime_CADM" SG_ 518 GrMin_Rq_ECM_W 0;
BA_ "GenSigTimeoutTime_DMSM" SG_ 518 GrMin_Rq_ECM_W 0;
BA_ "GenSigTimeoutTime_DTCM" SG_ 518 GrMin_Rq_ECM_W 0;
BA_ "GenSigTimeoutTime_ECM" SG_ 518 GrMin_Rq_ECM_W 0;
BA_ "GenSigTimeoutTime_EVCU2" SG_ 518 GrMin_Rq_ECM_W 0;
BA_ "GenSigTimeoutTime_GNMM" SG_ 518 GrMin_Rq_ECM_W 0;
BA_ "GenSigTimeoutTime_HCP" SG_ 518 GrMin_Rq_ECM_W 0;
BA_ "GenSigTimeoutTime_IPC" SG_ 518 GrMin_Rq_ECM_W 0;
BA_ "GenSigTimeoutTime_RFHM" SG_ 518 GrMin_Rq_ECM_W 0;
BA_ "GenSigTimeoutTime_SGW" SG_ 518 GrMin_Rq_ECM_W 0;
BA_ "GenSigStartValue" SG_ 518 IntkAirTempIntrClr 255;
BA_ "GenSigTimeoutTime_AGSM" SG_ 518 IntkAirTempIntrClr 0;
BA_ "GenSigTimeoutTime_BCM" SG_ 518 IntkAirTempIntrClr 0;
BA_ "GenSigTimeoutTime_BSM" SG_ 518 IntkAirTempIntrClr 0;
BA_ "GenSigTimeoutTime_CADM" SG_ 518 IntkAirTempIntrClr 0;
BA_ "GenSigTimeoutTime_DMSM" SG_ 518 IntkAirTempIntrClr 0;
BA_ "GenSigTimeoutTime_DTCM" SG_ 518 IntkAirTempIntrClr 0;
BA_ "GenSigTimeoutTime_ECM" SG_ 518 IntkAirTempIntrClr 0;
BA_ "GenSigTimeoutTime_EVCU2" SG_ 518 IntkAirTempIntrClr 0;
BA_ "GenSigTimeoutTime_GNMM" SG_ 518 IntkAirTempIntrClr 0;
BA_ "GenSigTimeoutTime_HCP" SG_ 518 IntkAirTempIntrClr 0;
BA_ "GenSigTimeoutTime_RFHM" SG_ 518 IntkAirTempIntrClr 0;
BA_ "GenSigTimeoutTime_TCM" SG_ 518 IntkAirTempIntrClr 0;
BA_ "GenSigStartValue" SG_ 518 LTR_CoolantTemp 255;
BA_ "GenSigTimeoutTime_AGSM" SG_ 518 LTR_CoolantTemp 0;
BA_ "GenSigTimeoutTime_BCM" SG_ 518 LTR_CoolantTemp 0;
BA_ "GenSigTimeoutTime_BSM" SG_ 518 LTR_CoolantTemp 0;
BA_ "GenSigTimeoutTime_CADM" SG_ 518 LTR_CoolantTemp 0;
BA_ "GenSigTimeoutTime_DMSM" SG_ 518 LTR_CoolantTemp 0;
BA_ "GenSigTimeoutTime_DTCM" SG_ 518 LTR_CoolantTemp 0;
BA_ "GenSigTimeoutTime_ECM" SG_ 518 LTR_CoolantTemp 0;
BA_ "GenSigTimeoutTime_EVCU2" SG_ 518 LTR_CoolantTemp 0;
BA_ "GenSigTimeoutTime_GNMM" SG_ 518 LTR_CoolantTemp 0;
BA_ "GenSigTimeoutTime_HCP" SG_ 518 LTR_CoolantTemp 0;
BA_ "GenSigTimeoutTime_RFHM" SG_ 518 LTR_CoolantTemp 0;
BA_ "GenSigTimeoutTime_TCM" SG_ 518 LTR_CoolantTemp 0;
BA_ "GenSigTimeoutTime_AGSM" SG_ 518 MessageCounter_ENGINE5 0;
BA_ "GenSigTimeoutTime_DMSM" SG_ 518 MessageCounter_ENGINE5 0;
BA_ "GenSigTimeoutTime_DTCM" SG_ 518 MessageCounter_ENGINE5 0;
BA_ "GenSigTimeoutTime_ECM" SG_ 518 MessageCounter_ENGINE5 0;
BA_ "GenSigTimeoutTime_EVCU2" SG_ 518 MessageCounter_ENGINE5 0;
BA_ "GenSigTimeoutTime_GNMM" SG_ 518 MessageCounter_ENGINE5 0;
BA_ "GenSigTimeoutTime_IPC" SG_ 518 MessageCounter_ENGINE5 0;
BA_ "GenSigTimeoutTime_RFHM" SG_ 518 MessageCounter_ENGINE5 0;
BA_ "GenSigTimeoutTime_SGW" SG_ 518 MessageCounter_ENGINE5 0;
BA_ "GenSigStartValue" SG_ 518 PdlPosActual 1;
BA_ "GenSigTimeoutTime_AGSM" SG_ 518 PdlPosActual 0;
BA_ "GenSigTimeoutTime_DMSM" SG_ 518 PdlPosActual 0;
BA_ "GenSigTimeoutTime_DTCM" SG_ 518 PdlPosActual 0;
BA_ "GenSigTimeoutTime_ECM" SG_ 518 PdlPosActual 0;
BA_ "GenSigTimeoutTime_EVCU2" SG_ 518 PdlPosActual 0;
BA_ "GenSigTimeoutTime_GNMM" SG_ 518 PdlPosActual 0;
BA_ "GenSigTimeoutTime_HCP" SG_ 518 PdlPosActual 0;
BA_ "GenSigTimeoutTime_IPC" SG_ 518 PdlPosActual 0;
BA_ "GenSigTimeoutTime_RFHM" SG_ 518 PdlPosActual 0;
BA_ "GenSigTimeoutTime_TCM" SG_ 518 PdlPosActual 0;
BA_ "GenSigTimeoutTime_AGSM" SG_ 518 RPMOverRev_W 0;
BA_ "GenSigTimeoutTime_BCM" SG_ 518 RPMOverRev_W 0;
BA_ "GenSigTimeoutTime_BSM" SG_ 518 RPMOverRev_W 0;
BA_ "GenSigTimeoutTime_CADM" SG_ 518 RPMOverRev_W 0;
BA_ "GenSigTimeoutTime_DMSM" SG_ 518 RPMOverRev_W 0;
BA_ "GenSigTimeoutTime_DTCM" SG_ 518 RPMOverRev_W 0;
BA_ "GenSigTimeoutTime_ECM" SG_ 518 RPMOverRev_W 0;
BA_ "GenSigTimeoutTime_EVCU2" SG_ 518 RPMOverRev_W 0;
BA_ "GenSigTimeoutTime_GNMM" SG_ 518 RPMOverRev_W 0;
BA_ "GenSigTimeoutTime_HCP" SG_ 518 RPMOverRev_W 0;
BA_ "GenSigTimeoutTime_IPC" SG_ 518 RPMOverRev_W 0;
BA_ "GenSigTimeoutTime_RFHM" SG_ 518 RPMOverRev_W 0;
BA_ "GenSigTimeoutTime_SGW" SG_ 518 RPMOverRev_W 0;
BA_ "GenSigTimeoutTime_TCM" SG_ 518 RPMOverRev_W 0;
BA_ "GenSigTimeoutTime_AGSM" SG_ 751 CRC_ENGINE6 0;
BA_ "GenSigTimeoutTime_DMSM" SG_ 751 CRC_ENGINE6 0;
BA_ "GenSigTimeoutTime_ECM" SG_ 751 CRC_ENGINE6 0;
BA_ "GenSigTimeoutTime_EVCU2" SG_ 751 CRC_ENGINE6 0;
BA_ "GenSigTimeoutTime_GNMM" SG_ 751 CRC_ENGINE6 0;
BA_ "GenSigTimeoutTime_HCP" SG_ 751 CRC_ENGINE6 0;
BA_ "GenSigTimeoutTime_RFHM" SG_ 751 CRC_ENGINE6 0;
BA_ "GenSigTimeoutTime_SGW" SG_ 751 CRC_ENGINE6 0;
BA_ "GenSigTimeoutTime_AGSM" SG_ 751 DrvAway_Alert 0;
BA_ "GenSigTimeoutTime_BSM" SG_ 751 DrvAway_Alert 0;
BA_ "GenSigTimeoutTime_CADM" SG_ 751 DrvAway_Alert 0;
BA_ "GenSigTimeoutTime_DMSM" SG_ 751 DrvAway_Alert 0;
BA_ "GenSigTimeoutTime_DTCM" SG_ 751 DrvAway_Alert 0;
BA_ "GenSigTimeoutTime_ECM" SG_ 751 DrvAway_Alert 0;
BA_ "GenSigTimeoutTime_EVCU2" SG_ 751 DrvAway_Alert 0;
BA_ "GenSigTimeoutTime_GNMM" SG_ 751 DrvAway_Alert 0;
BA_ "GenSigTimeoutTime_HCP" SG_ 751 DrvAway_Alert 0;
BA_ "GenSigTimeoutTime_RFHM" SG_ 751 DrvAway_Alert 0;
BA_ "GenSigTimeoutTime_SGW" SG_ 751 DrvAway_Alert 0;
BA_ "GenSigTimeoutTime_TCM" SG_ 751 DrvAway_Alert 0;
BA_ "GenSigSendType" SG_ 751 DrvAway_Indications 3;
BA_ "GenSigTimeoutTime_AGSM" SG_ 751 DrvAway_Indications 0;
BA_ "GenSigTimeoutTime_BCM" SG_ 751 DrvAway_Indications 0;
BA_ "GenSigTimeoutTime_BSM" SG_ 751 DrvAway_Indications 0;
BA_ "GenSigTimeoutTime_CADM" SG_ 751 DrvAway_Indications 0;
BA_ "GenSigTimeoutTime_DMSM" SG_ 751 DrvAway_Indications 0;
BA_ "GenSigTimeoutTime_DTCM" SG_ 751 DrvAway_Indications 0;
BA_ "GenSigTimeoutTime_ECM" SG_ 751 DrvAway_Indications 0;
BA_ "GenSigTimeoutTime_EVCU2" SG_ 751 DrvAway_Indications 0;
BA_ "GenSigTimeoutTime_GNMM" SG_ 751 DrvAway_Indications 0;
BA_ "GenSigTimeoutTime_HCP" SG_ 751 DrvAway_Indications 0;
BA_ "GenSigTimeoutTime_RFHM" SG_ 751 DrvAway_Indications 0;
BA_ "GenSigTimeoutTime_SGW" SG_ 751 DrvAway_Indications 0;
BA_ "GenSigTimeoutTime_TCM" SG_ 751 DrvAway_Indications 0;
BA_ "GenSigTimeoutTime_AGSM" SG_ 751 DrvAway_Inhibit 0;
BA_ "GenSigTimeoutTime_BCM" SG_ 751 DrvAway_Inhibit 0;
BA_ "GenSigTimeoutTime_BSM" SG_ 751 DrvAway_Inhibit 0;
BA_ "GenSigTimeoutTime_CADM" SG_ 751 DrvAway_Inhibit 0;
BA_ "GenSigTimeoutTime_DMSM" SG_ 751 DrvAway_Inhibit 0;
BA_ "GenSigTimeoutTime_DTCM" SG_ 751 DrvAway_Inhibit 0;
BA_ "GenSigTimeoutTime_ECM" SG_ 751 DrvAway_Inhibit 0;
BA_ "GenSigTimeoutTime_EVCU2" SG_ 751 DrvAway_Inhibit 0;
BA_ "GenSigTimeoutTime_GNMM" SG_ 751 DrvAway_Inhibit 0;
BA_ "GenSigTimeoutTime_HCP" SG_ 751 DrvAway_Inhibit 0;
BA_ "GenSigTimeoutTime_RFHM" SG_ 751 DrvAway_Inhibit 0;
BA_ "GenSigTimeoutTime_SGW" SG_ 751 DrvAway_Inhibit 0;
BA_ "GenSigTimeoutTime_TCM" SG_ 751 DrvAway_Inhibit 0;
BA_ "GenSigTimeoutTime_AGSM" SG_ 751 ECM_FOTA_Conflict 0;
BA_ "GenSigTimeoutTime_BCM" SG_ 751 ECM_FOTA_Conflict 0;
BA_ "GenSigTimeoutTime_BSM" SG_ 751 ECM_FOTA_Conflict 0;
BA_ "GenSigTimeoutTime_CADM" SG_ 751 ECM_FOTA_Conflict 0;
BA_ "GenSigTimeoutTime_DMSM" SG_ 751 ECM_FOTA_Conflict 0;
BA_ "GenSigTimeoutTime_DTCM" SG_ 751 ECM_FOTA_Conflict 0;
BA_ "GenSigTimeoutTime_ECM" SG_ 751 ECM_FOTA_Conflict 0;
BA_ "GenSigTimeoutTime_EVCU2" SG_ 751 ECM_FOTA_Conflict 0;
BA_ "GenSigTimeoutTime_GNMM" SG_ 751 ECM_FOTA_Conflict 0;
BA_ "GenSigTimeoutTime_HCP" SG_ 751 ECM_FOTA_Conflict 0;
BA_ "GenSigTimeoutTime_IPC" SG_ 751 ECM_FOTA_Conflict 0;
BA_ "GenSigTimeoutTime_RFHM" SG_ 751 ECM_FOTA_Conflict 0;
BA_ "GenSigTimeoutTime_TCM" SG_ 751 ECM_FOTA_Conflict 0;
BA_ "GenSigTimeoutTime_AGSM" SG_ 751 ECM_MSG_RQ 0;
BA_ "GenSigTimeoutTime_BCM" SG_ 751 ECM_MSG_RQ 0;
BA_ "GenSigTimeoutTime_BSM" SG_ 751 ECM_MSG_RQ 0;
BA_ "GenSigTimeoutTime_CADM" SG_ 751 ECM_MSG_RQ 0;
BA_ "GenSigTimeoutTime_DMSM" SG_ 751 ECM_MSG_RQ 0;
BA_ "GenSigTimeoutTime_DTCM" SG_ 751 ECM_MSG_RQ 0;
BA_ "GenSigTimeoutTime_ECM" SG_ 751 ECM_MSG_RQ 0;
BA_ "GenSigTimeoutTime_EVCU2" SG_ 751 ECM_MSG_RQ 0;
BA_ "GenSigTimeoutTime_GNMM" SG_ 751 ECM_MSG_RQ 0;
BA_ "GenSigTimeoutTime_HCP" SG_ 751 ECM_MSG_RQ 0;
BA_ "GenSigTimeoutTime_IPC" SG_ 751 ECM_MSG_RQ 0;
BA_ "GenSigTimeoutTime_RFHM" SG_ 751 ECM_MSG_RQ 0;
BA_ "GenSigTimeoutTime_TCM" SG_ 751 ECM_MSG_RQ 0;
BA_ "GenSigTimeoutTime_AGSM" SG_ 751 EngineWaterTemp 0;
BA_ "GenSigTimeoutTime_BSM" SG_ 751 EngineWaterTemp 0;
BA_ "GenSigTimeoutTime_CADM" SG_ 751 EngineWaterTemp 0;
BA_ "GenSigTimeoutTime_DMSM" SG_ 751 EngineWaterTemp 0;
BA_ "GenSigTimeoutTime_DTCM" SG_ 751 EngineWaterTemp 0;
BA_ "GenSigTimeoutTime_ECM" SG_ 751 EngineWaterTemp 0;
BA_ "GenSigTimeoutTime_GNMM" SG_ 751 EngineWaterTemp 0;
BA_ "GenSigTimeoutTime_HCP" SG_ 751 EngineWaterTemp 0;
BA_ "GenSigTimeoutTime_RFHM" SG_ 751 EngineWaterTemp 0;
BA_ "GenSigTimeoutTime_AGSM" SG_ 751 FuelConsumption_GAG 0;
BA_ "GenSigTimeoutTime_BCM" SG_ 751 FuelConsumption_GAG 0;
BA_ "GenSigTimeoutTime_BSM" SG_ 751 FuelConsumption_GAG 0;
BA_ "GenSigTimeoutTime_CADM" SG_ 751 FuelConsumption_GAG 0;
BA_ "GenSigTimeoutTime_DMSM" SG_ 751 FuelConsumption_GAG 0;
BA_ "GenSigTimeoutTime_DTCM" SG_ 751 FuelConsumption_GAG 0;
BA_ "GenSigTimeoutTime_ECM" SG_ 751 FuelConsumption_GAG 0;
BA_ "GenSigTimeoutTime_EVCU2" SG_ 751 FuelConsumption_GAG 0;
BA_ "GenSigTimeoutTime_GNMM" SG_ 751 FuelConsumption_GAG 0;
BA_ "GenSigTimeoutTime_HCP" SG_ 751 FuelConsumption_GAG 0;
BA_ "GenSigTimeoutTime_IPC" SG_ 751 FuelConsumption_GAG 0;
BA_ "GenSigTimeoutTime_RFHM" SG_ 751 FuelConsumption_GAG 0;
BA_ "GenSigTimeoutTime_TCM" SG_ 751 FuelConsumption_GAG 0;
BA_ "GenSigTimeoutTime_AGSM" SG_ 751 GearShiftIndication 0;
BA_ "GenSigTimeoutTime_BCM" SG_ 751 GearShiftIndication 0;
BA_ "GenSigTimeoutTime_BSM" SG_ 751 GearShiftIndication 0;
BA_ "GenSigTimeoutTime_CADM" SG_ 751 GearShiftIndication 0;
BA_ "GenSigTimeoutTime_DMSM" SG_ 751 GearShiftIndication 0;
BA_ "GenSigTimeoutTime_DTCM" SG_ 751 GearShiftIndication 0;
BA_ "GenSigTimeoutTime_ECM" SG_ 751 GearShiftIndication 0;
BA_ "GenSigTimeoutTime_EVCU2" SG_ 751 GearShiftIndication 0;
BA_ "GenSigTimeoutTime_GNMM" SG_ 751 GearShiftIndication 0;
BA_ "GenSigTimeoutTime_HCP" SG_ 751 GearShiftIndication 0;
BA_ "GenSigTimeoutTime_IPC" SG_ 751 GearShiftIndication 0;
BA_ "GenSigTimeoutTime_RFHM" SG_ 751 GearShiftIndication 0;
BA_ "GenSigTimeoutTime_TCM" SG_ 751 GearShiftIndication 0;
BA_ "GenSigTimeoutTime_AGSM" SG_ 751 HP_MODE_STS 0;
BA_ "GenSigTimeoutTime_BCM" SG_ 751 HP_MODE_STS 0;
BA_ "GenSigTimeoutTime_BSM" SG_ 751 HP_MODE_STS 0;
BA_ "GenSigTimeoutTime_CADM" SG_ 751 HP_MODE_STS 0;
BA_ "GenSigTimeoutTime_DMSM" SG_ 751 HP_MODE_STS 0;
BA_ "GenSigTimeoutTime_DTCM" SG_ 751 HP_MODE_STS 0;
BA_ "GenSigTimeoutTime_ECM" SG_ 751 HP_MODE_STS 0;
BA_ "GenSigTimeoutTime_EVCU2" SG_ 751 HP_MODE_STS 0;
BA_ "GenSigTimeoutTime_GNMM" SG_ 751 HP_MODE_STS 0;
BA_ "GenSigTimeoutTime_HCP" SG_ 751 HP_MODE_STS 0;
BA_ "GenSigTimeoutTime_IPC" SG_ 751 HP_MODE_STS 0;
BA_ "GenSigTimeoutTime_RFHM" SG_ 751 HP_MODE_STS 0;
BA_ "GenSigTimeoutTime_SGW" SG_ 751 HP_MODE_STS 0;
BA_ "GenSigTimeoutTime_TCM" SG_ 751 HP_MODE_STS 0;
BA_ "GenSigTimeoutTime_AGSM" SG_ 751 LeakCheckTimerValue 0;
BA_ "GenSigTimeoutTime_BSM" SG_ 751 LeakCheckTimerValue 0;
BA_ "GenSigTimeoutTime_CADM" SG_ 751 LeakCheckTimerValue 0;
BA_ "GenSigTimeoutTime_DMSM" SG_ 751 LeakCheckTimerValue 0;
BA_ "GenSigTimeoutTime_DTCM" SG_ 751 LeakCheckTimerValue 0;
BA_ "GenSigTimeoutTime_ECM" SG_ 751 LeakCheckTimerValue 0;
BA_ "GenSigTimeoutTime_EVCU2" SG_ 751 LeakCheckTimerValue 0;
BA_ "GenSigTimeoutTime_GNMM" SG_ 751 LeakCheckTimerValue 0;
BA_ "GenSigTimeoutTime_HCP" SG_ 751 LeakCheckTimerValue 0;
BA_ "GenSigTimeoutTime_IPC" SG_ 751 LeakCheckTimerValue 0;
BA_ "GenSigTimeoutTime_RFHM" SG_ 751 LeakCheckTimerValue 0;
BA_ "GenSigTimeoutTime_SGW" SG_ 751 LeakCheckTimerValue 0;
BA_ "GenSigTimeoutTime_TCM" SG_ 751 LeakCheckTimerValue 0;
BA_ "GenSigTimeoutTime_AGSM" SG_ 751 LeakTestRequest 0;
BA_ "GenSigTimeoutTime_BSM" SG_ 751 LeakTestRequest 0;
BA_ "GenSigTimeoutTime_CADM" SG_ 751 LeakTestRequest 0;
BA_ "GenSigTimeoutTime_DMSM" SG_ 751 LeakTestRequest 0;
BA_ "GenSigTimeoutTime_DTCM" SG_ 751 LeakTestRequest 0;
BA_ "GenSigTimeoutTime_ECM" SG_ 751 LeakTestRequest 0;
BA_ "GenSigTimeoutTime_EVCU2" SG_ 751 LeakTestRequest 0;
BA_ "GenSigTimeoutTime_GNMM" SG_ 751 LeakTestRequest 0;
BA_ "GenSigTimeoutTime_HCP" SG_ 751 LeakTestRequest 0;
BA_ "GenSigTimeoutTime_IPC" SG_ 751 LeakTestRequest 0;
BA_ "GenSigTimeoutTime_RFHM" SG_ 751 LeakTestRequest 0;
BA_ "GenSigTimeoutTime_SGW" SG_ 751 LeakTestRequest 0;
BA_ "GenSigTimeoutTime_TCM" SG_ 751 LeakTestRequest 0;
BA_ "GenSigTimeoutTime_AGSM" SG_ 751 LeakTestSts 0;
BA_ "GenSigTimeoutTime_BSM" SG_ 751 LeakTestSts 0;
BA_ "GenSigTimeoutTime_CADM" SG_ 751 LeakTestSts 0;
BA_ "GenSigTimeoutTime_DMSM" SG_ 751 LeakTestSts 0;
BA_ "GenSigTimeoutTime_DTCM" SG_ 751 LeakTestSts 0;
BA_ "GenSigTimeoutTime_ECM" SG_ 751 LeakTestSts 0;
BA_ "GenSigTimeoutTime_EVCU2" SG_ 751 LeakTestSts 0;
BA_ "GenSigTimeoutTime_GNMM" SG_ 751 LeakTestSts 0;
BA_ "GenSigTimeoutTime_HCP" SG_ 751 LeakTestSts 0;
BA_ "GenSigTimeoutTime_IPC" SG_ 751 LeakTestSts 0;
BA_ "GenSigTimeoutTime_RFHM" SG_ 751 LeakTestSts 0;
BA_ "GenSigTimeoutTime_SGW" SG_ 751 LeakTestSts 0;
BA_ "GenSigTimeoutTime_TCM" SG_ 751 LeakTestSts 0;
BA_ "GenSigTimeoutTime_AGSM" SG_ 751 MessageCounter_ENGINE6 0;
BA_ "GenSigTimeoutTime_DMSM" SG_ 751 MessageCounter_ENGINE6 0;
BA_ "GenSigTimeoutTime_ECM" SG_ 751 MessageCounter_ENGINE6 0;
BA_ "GenSigTimeoutTime_EVCU2" SG_ 751 MessageCounter_ENGINE6 0;
BA_ "GenSigTimeoutTime_GNMM" SG_ 751 MessageCounter_ENGINE6 0;
BA_ "GenSigTimeoutTime_HCP" SG_ 751 MessageCounter_ENGINE6 0;
BA_ "GenSigTimeoutTime_RFHM" SG_ 751 MessageCounter_ENGINE6 0;
BA_ "GenSigTimeoutTime_SGW" SG_ 751 MessageCounter_ENGINE6 0;
BA_ "GenSigStartValue" SG_ 751 SAMInfo 15;
BA_ "GenSigTimeoutTime_AGSM" SG_ 751 SAMInfo 0;
BA_ "GenSigTimeoutTime_BSM" SG_ 751 SAMInfo 0;
BA_ "GenSigTimeoutTime_CADM" SG_ 751 SAMInfo 0;
BA_ "GenSigTimeoutTime_DMSM" SG_ 751 SAMInfo 0;
BA_ "GenSigTimeoutTime_DTCM" SG_ 751 SAMInfo 0;
BA_ "GenSigTimeoutTime_ECM" SG_ 751 SAMInfo 0;
BA_ "GenSigTimeoutTime_EVCU2" SG_ 751 SAMInfo 0;
BA_ "GenSigTimeoutTime_GNMM" SG_ 751 SAMInfo 0;
BA_ "GenSigTimeoutTime_HCP" SG_ 751 SAMInfo 0;
BA_ "GenSigTimeoutTime_IPC" SG_ 751 SAMInfo 0;
BA_ "GenSigTimeoutTime_RFHM" SG_ 751 SAMInfo 0;
BA_ "GenSigTimeoutTime_SGW" SG_ 751 SAMInfo 0;
BA_ "GenSigTimeoutTime_TCM" SG_ 751 SAMInfo 0;
BA_ "GenSigTimeoutTime_AGSM" SG_ 751 Selector_SystemFailSts 0;
BA_ "GenSigTimeoutTime_BCM" SG_ 751 Selector_SystemFailSts 0;
BA_ "GenSigTimeoutTime_BSM" SG_ 751 Selector_SystemFailSts 0;
BA_ "GenSigTimeoutTime_CADM" SG_ 751 Selector_SystemFailSts 0;
BA_ "GenSigTimeoutTime_DMSM" SG_ 751 Selector_SystemFailSts 0;
BA_ "GenSigTimeoutTime_DTCM" SG_ 751 Selector_SystemFailSts 0;
BA_ "GenSigTimeoutTime_ECM" SG_ 751 Selector_SystemFailSts 0;
BA_ "GenSigTimeoutTime_EVCU2" SG_ 751 Selector_SystemFailSts 0;
BA_ "GenSigTimeoutTime_GNMM" SG_ 751 Selector_SystemFailSts 0;
BA_ "GenSigTimeoutTime_HCP" SG_ 751 Selector_SystemFailSts 0;
BA_ "GenSigTimeoutTime_RFHM" SG_ 751 Selector_SystemFailSts 0;
BA_ "GenSigTimeoutTime_SGW" SG_ 751 Selector_SystemFailSts 0;
BA_ "GenSigTimeoutTime_TCM" SG_ 751 Selector_SystemFailSts 0;
BA_ "GenSigTimeoutTime_AGSM" SG_ 751 StarterProtectionTime 0;
BA_ "GenSigTimeoutTime_BCM" SG_ 751 StarterProtectionTime 0;
BA_ "GenSigTimeoutTime_BSM" SG_ 751 StarterProtectionTime 0;
BA_ "GenSigTimeoutTime_CADM" SG_ 751 StarterProtectionTime 0;
BA_ "GenSigTimeoutTime_DMSM" SG_ 751 StarterProtectionTime 0;
BA_ "GenSigTimeoutTime_DTCM" SG_ 751 StarterProtectionTime 0;
BA_ "GenSigTimeoutTime_ECM" SG_ 751 StarterProtectionTime 0;
BA_ "GenSigTimeoutTime_EVCU2" SG_ 751 StarterProtectionTime 0;
BA_ "GenSigTimeoutTime_GNMM" SG_ 751 StarterProtectionTime 0;
BA_ "GenSigTimeoutTime_HCP" SG_ 751 StarterProtectionTime 0;
BA_ "GenSigTimeoutTime_RFHM" SG_ 751 StarterProtectionTime 0;
BA_ "GenSigTimeoutTime_SGW" SG_ 751 StarterProtectionTime 0;
BA_ "GenSigTimeoutTime_TCM" SG_ 751 StarterProtectionTime 0;
BA_ "GenSigTimeoutTime_AGSM" SG_ 751 StartProtectionInhibit 0;
BA_ "GenSigTimeoutTime_BCM" SG_ 751 StartProtectionInhibit 0;
BA_ "GenSigTimeoutTime_BSM" SG_ 751 StartProtectionInhibit 0;
BA_ "GenSigTimeoutTime_CADM" SG_ 751 StartProtectionInhibit 0;
BA_ "GenSigTimeoutTime_DMSM" SG_ 751 StartProtectionInhibit 0;
BA_ "GenSigTimeoutTime_DTCM" SG_ 751 StartProtectionInhibit 0;
BA_ "GenSigTimeoutTime_ECM" SG_ 751 StartProtectionInhibit 0;
BA_ "GenSigTimeoutTime_EVCU2" SG_ 751 StartProtectionInhibit 0;
BA_ "GenSigTimeoutTime_GNMM" SG_ 751 StartProtectionInhibit 0;
BA_ "GenSigTimeoutTime_HCP" SG_ 751 StartProtectionInhibit 0;
BA_ "GenSigTimeoutTime_RFHM" SG_ 751 StartProtectionInhibit 0;
BA_ "GenSigTimeoutTime_SGW" SG_ 751 StartProtectionInhibit 0;
BA_ "GenSigTimeoutTime_TCM" SG_ 751 StartProtectionInhibit 0;
BA_ "GenSigTimeoutTime_AGSM" SG_ 751 StartRelayBCMFeedbackFault 0;
BA_ "GenSigTimeoutTime_BSM" SG_ 751 StartRelayBCMFeedbackFault 0;
BA_ "GenSigTimeoutTime_CADM" SG_ 751 StartRelayBCMFeedbackFault 0;
BA_ "GenSigTimeoutTime_DMSM" SG_ 751 StartRelayBCMFeedbackFault 0;
BA_ "GenSigTimeoutTime_DTCM" SG_ 751 StartRelayBCMFeedbackFault 0;
BA_ "GenSigTimeoutTime_ECM" SG_ 751 StartRelayBCMFeedbackFault 0;
BA_ "GenSigTimeoutTime_EVCU2" SG_ 751 StartRelayBCMFeedbackFault 0;
BA_ "GenSigTimeoutTime_GNMM" SG_ 751 StartRelayBCMFeedbackFault 0;
BA_ "GenSigTimeoutTime_HCP" SG_ 751 StartRelayBCMFeedbackFault 0;
BA_ "GenSigTimeoutTime_IPC" SG_ 751 StartRelayBCMFeedbackFault 0;
BA_ "GenSigTimeoutTime_RFHM" SG_ 751 StartRelayBCMFeedbackFault 0;
BA_ "GenSigTimeoutTime_SGW" SG_ 751 StartRelayBCMFeedbackFault 0;
BA_ "GenSigTimeoutTime_TCM" SG_ 751 StartRelayBCMFeedbackFault 0;
BA_ "GenSigTimeoutTime_AGSM" SG_ 751 StartRelayECMFeedbackFault 0;
BA_ "GenSigTimeoutTime_BSM" SG_ 751 StartRelayECMFeedbackFault 0;
BA_ "GenSigTimeoutTime_CADM" SG_ 751 StartRelayECMFeedbackFault 0;
BA_ "GenSigTimeoutTime_DMSM" SG_ 751 StartRelayECMFeedbackFault 0;
BA_ "GenSigTimeoutTime_DTCM" SG_ 751 StartRelayECMFeedbackFault 0;
BA_ "GenSigTimeoutTime_ECM" SG_ 751 StartRelayECMFeedbackFault 0;
BA_ "GenSigTimeoutTime_EVCU2" SG_ 751 StartRelayECMFeedbackFault 0;
BA_ "GenSigTimeoutTime_GNMM" SG_ 751 StartRelayECMFeedbackFault 0;
BA_ "GenSigTimeoutTime_HCP" SG_ 751 StartRelayECMFeedbackFault 0;
BA_ "GenSigTimeoutTime_IPC" SG_ 751 StartRelayECMFeedbackFault 0;
BA_ "GenSigTimeoutTime_RFHM" SG_ 751 StartRelayECMFeedbackFault 0;
BA_ "GenSigTimeoutTime_TCM" SG_ 751 StartRelayECMFeedbackFault 0;
BA_ "GenSigSendType" SG_ 751 Terrain_HMI_Rq_ECM 3;
BA_ "GenSigTimeoutTime_AGSM" SG_ 751 Terrain_HMI_Rq_ECM 0;
BA_ "GenSigTimeoutTime_BCM" SG_ 751 Terrain_HMI_Rq_ECM 0;
BA_ "GenSigTimeoutTime_BSM" SG_ 751 Terrain_HMI_Rq_ECM 0;
BA_ "GenSigTimeoutTime_CADM" SG_ 751 Terrain_HMI_Rq_ECM 0;
BA_ "GenSigTimeoutTime_DMSM" SG_ 751 Terrain_HMI_Rq_ECM 0;
BA_ "GenSigTimeoutTime_DTCM" SG_ 751 Terrain_HMI_Rq_ECM 0;
BA_ "GenSigTimeoutTime_ECM" SG_ 751 Terrain_HMI_Rq_ECM 0;
BA_ "GenSigTimeoutTime_EVCU2" SG_ 751 Terrain_HMI_Rq_ECM 0;
BA_ "GenSigTimeoutTime_GNMM" SG_ 751 Terrain_HMI_Rq_ECM 0;
BA_ "GenSigTimeoutTime_HCP" SG_ 751 Terrain_HMI_Rq_ECM 0;
BA_ "GenSigTimeoutTime_RFHM" SG_ 751 Terrain_HMI_Rq_ECM 0;
BA_ "GenSigTimeoutTime_SGW" SG_ 751 Terrain_HMI_Rq_ECM 0;
BA_ "GenSigTimeoutTime_TCM" SG_ 751 Terrain_HMI_Rq_ECM 0;
BA_ "GenSigSendType" SG_ 751 TerrainModeDesiredStat 3;
BA_ "GenSigTimeoutTime_AGSM" SG_ 751 TerrainModeDesiredStat 0;
BA_ "GenSigTimeoutTime_BSM" SG_ 751 TerrainModeDesiredStat 0;
BA_ "GenSigTimeoutTime_CADM" SG_ 751 TerrainModeDesiredStat 0;
BA_ "GenSigTimeoutTime_DMSM" SG_ 751 TerrainModeDesiredStat 0;
BA_ "GenSigTimeoutTime_DTCM" SG_ 751 TerrainModeDesiredStat 0;
BA_ "GenSigTimeoutTime_ECM" SG_ 751 TerrainModeDesiredStat 0;
BA_ "GenSigTimeoutTime_EVCU2" SG_ 751 TerrainModeDesiredStat 0;
BA_ "GenSigTimeoutTime_GNMM" SG_ 751 TerrainModeDesiredStat 0;
BA_ "GenSigTimeoutTime_HCP" SG_ 751 TerrainModeDesiredStat 0;
BA_ "GenSigTimeoutTime_RFHM" SG_ 751 TerrainModeDesiredStat 0;
BA_ "GenSigTimeoutTime_TCM" SG_ 751 TerrainModeDesiredStat 0;
BA_ "GenSigTimeoutTime_AGSM" SG_ 751 TerrainModeInterfaceButton_ECM 0;
BA_ "GenSigTimeoutTime_BCM" SG_ 751 TerrainModeInterfaceButton_ECM 0;
BA_ "GenSigTimeoutTime_BSM" SG_ 751 TerrainModeInterfaceButton_ECM 0;
BA_ "GenSigTimeoutTime_CADM" SG_ 751 TerrainModeInterfaceButton_ECM 0;
BA_ "GenSigTimeoutTime_DMSM" SG_ 751 TerrainModeInterfaceButton_ECM 0;
BA_ "GenSigTimeoutTime_DTCM" SG_ 751 TerrainModeInterfaceButton_ECM 0;
BA_ "GenSigTimeoutTime_ECM" SG_ 751 TerrainModeInterfaceButton_ECM 0;
BA_ "GenSigTimeoutTime_EVCU2" SG_ 751 TerrainModeInterfaceButton_ECM 0;
BA_ "GenSigTimeoutTime_GNMM" SG_ 751 TerrainModeInterfaceButton_ECM 0;
BA_ "GenSigTimeoutTime_HCP" SG_ 751 TerrainModeInterfaceButton_ECM 0;
BA_ "GenSigTimeoutTime_IPC" SG_ 751 TerrainModeInterfaceButton_ECM 0;
BA_ "GenSigTimeoutTime_RFHM" SG_ 751 TerrainModeInterfaceButton_ECM 0;
BA_ "GenSigTimeoutTime_TCM" SG_ 751 TerrainModeInterfaceButton_ECM 0;
BA_ "GenSigStartValue" SG_ 751 TerrainModeStat_ECM 31;
BA_ "GenSigTimeoutTime_AGSM" SG_ 751 TerrainModeStat_ECM 0;
BA_ "GenSigTimeoutTime_DMSM" SG_ 751 TerrainModeStat_ECM 0;
BA_ "GenSigTimeoutTime_ECM" SG_ 751 TerrainModeStat_ECM 0;
BA_ "GenSigTimeoutTime_GNMM" SG_ 751 TerrainModeStat_ECM 0;
BA_ "GenSigTimeoutTime_HCP" SG_ 751 TerrainModeStat_ECM 0;
BA_ "GenSigTimeoutTime_RFHM" SG_ 751 TerrainModeStat_ECM 0;
BA_ "GenSigTimeoutTime_AGSM" SG_ 751 Trns_DrvMd_CfgSts_ECM 0;
BA_ "GenSigTimeoutTime_BCM" SG_ 751 Trns_DrvMd_CfgSts_ECM 0;
BA_ "GenSigTimeoutTime_BSM" SG_ 751 Trns_DrvMd_CfgSts_ECM 0;
BA_ "GenSigTimeoutTime_CADM" SG_ 751 Trns_DrvMd_CfgSts_ECM 0;
BA_ "GenSigTimeoutTime_DMSM" SG_ 751 Trns_DrvMd_CfgSts_ECM 0;
BA_ "GenSigTimeoutTime_DTCM" SG_ 751 Trns_DrvMd_CfgSts_ECM 0;
BA_ "GenSigTimeoutTime_ECM" SG_ 751 Trns_DrvMd_CfgSts_ECM 0;
BA_ "GenSigTimeoutTime_EVCU2" SG_ 751 Trns_DrvMd_CfgSts_ECM 0;
BA_ "GenSigTimeoutTime_GNMM" SG_ 751 Trns_DrvMd_CfgSts_ECM 0;
BA_ "GenSigTimeoutTime_HCP" SG_ 751 Trns_DrvMd_CfgSts_ECM 0;
BA_ "GenSigTimeoutTime_IPC" SG_ 751 Trns_DrvMd_CfgSts_ECM 0;
BA_ "GenSigTimeoutTime_RFHM" SG_ 751 Trns_DrvMd_CfgSts_ECM 0;
BA_ "GenSigTimeoutTime_TCM" SG_ 751 Trns_DrvMd_CfgSts_ECM 0;
BA_ "GenSigTimeoutTime_AGSM" SG_ 751 Trns_DrvMdReq_ECM 0;
BA_ "GenSigTimeoutTime_BCM" SG_ 751 Trns_DrvMdReq_ECM 0;
BA_ "GenSigTimeoutTime_BSM" SG_ 751 Trns_DrvMdReq_ECM 0;
BA_ "GenSigTimeoutTime_CADM" SG_ 751 Trns_DrvMdReq_ECM 0;
BA_ "GenSigTimeoutTime_DMSM" SG_ 751 Trns_DrvMdReq_ECM 0;
BA_ "GenSigTimeoutTime_DTCM" SG_ 751 Trns_DrvMdReq_ECM 0;
BA_ "GenSigTimeoutTime_ECM" SG_ 751 Trns_DrvMdReq_ECM 0;
BA_ "GenSigTimeoutTime_EVCU2" SG_ 751 Trns_DrvMdReq_ECM 0;
BA_ "GenSigTimeoutTime_GNMM" SG_ 751 Trns_DrvMdReq_ECM 0;
BA_ "GenSigTimeoutTime_HCP" SG_ 751 Trns_DrvMdReq_ECM 0;
BA_ "GenSigTimeoutTime_IPC" SG_ 751 Trns_DrvMdReq_ECM 0;
BA_ "GenSigTimeoutTime_RFHM" SG_ 751 Trns_DrvMdReq_ECM 0;
BA_ "GenSigTimeoutTime_SGW" SG_ 751 Trns_DrvMdReq_ECM 0;
BA_ "GenSigStartValue" SG_ 1448 CompressorSts 2;
BA_ "GenSigSendType" SG_ 1448 CompressorSts 3;
BA_ "GenSigTimeoutTime_AGSM" SG_ 1448 CompressorSts 0;
BA_ "GenSigTimeoutTime_BSM" SG_ 1448 CompressorSts 0;
BA_ "GenSigTimeoutTime_CADM" SG_ 1448 CompressorSts 0;
BA_ "GenSigTimeoutTime_DMSM" SG_ 1448 CompressorSts 0;
BA_ "GenSigTimeoutTime_DTCM" SG_ 1448 CompressorSts 0;
BA_ "GenSigTimeoutTime_ECM" SG_ 1448 CompressorSts 0;
BA_ "GenSigTimeoutTime_EVCU2" SG_ 1448 CompressorSts 0;
BA_ "GenSigTimeoutTime_GNMM" SG_ 1448 CompressorSts 0;
BA_ "GenSigTimeoutTime_HCP" SG_ 1448 CompressorSts 0;
BA_ "GenSigTimeoutTime_IPC" SG_ 1448 CompressorSts 0;
BA_ "GenSigTimeoutTime_RFHM" SG_ 1448 CompressorSts 0;
BA_ "GenSigTimeoutTime_AGSM" SG_ 1448 CRC_ENGINE7 0;
BA_ "GenSigTimeoutTime_BSM" SG_ 1448 CRC_ENGINE7 0;
BA_ "GenSigTimeoutTime_DMSM" SG_ 1448 CRC_ENGINE7 0;
BA_ "GenSigTimeoutTime_DTCM" SG_ 1448 CRC_ENGINE7 0;
BA_ "GenSigTimeoutTime_ECM" SG_ 1448 CRC_ENGINE7 0;
BA_ "GenSigTimeoutTime_EVCU2" SG_ 1448 CRC_ENGINE7 0;
BA_ "GenSigTimeoutTime_GNMM" SG_ 1448 CRC_ENGINE7 0;
BA_ "GenSigTimeoutTime_HCP" SG_ 1448 CRC_ENGINE7 0;
BA_ "GenSigTimeoutTime_RFHM" SG_ 1448 CRC_ENGINE7 0;
BA_ "GenSigTimeoutTime_SGW" SG_ 1448 CRC_ENGINE7 0;
BA_ "GenSigSendType" SG_ 1448 ECM_THA_Resp 4;
BA_ "GenSigTimeoutTime_AGSM" SG_ 1448 ECM_THA_Resp 0;
BA_ "GenSigTimeoutTime_BSM" SG_ 1448 ECM_THA_Resp 0;
BA_ "GenSigTimeoutTime_CADM" SG_ 1448 ECM_THA_Resp 0;
BA_ "GenSigTimeoutTime_DMSM" SG_ 1448 ECM_THA_Resp 0;
BA_ "GenSigTimeoutTime_DTCM" SG_ 1448 ECM_THA_Resp 0;
BA_ "GenSigTimeoutTime_ECM" SG_ 1448 ECM_THA_Resp 0;
BA_ "GenSigTimeoutTime_EVCU2" SG_ 1448 ECM_THA_Resp 0;
BA_ "GenSigTimeoutTime_GNMM" SG_ 1448 ECM_THA_Resp 0;
BA_ "GenSigTimeoutTime_HCP" SG_ 1448 ECM_THA_Resp 0;
BA_ "GenSigTimeoutTime_IPC" SG_ 1448 ECM_THA_Resp 0;
BA_ "GenSigTimeoutTime_RFHM" SG_ 1448 ECM_THA_Resp 0;
BA_ "GenSigTimeoutTime_SGW" SG_ 1448 ECM_THA_Resp 0;
BA_ "GenSigTimeoutTime_TCM" SG_ 1448 ECM_THA_Resp 0;
BA_ "GenSigSendType" SG_ 1448 ECM_WARN_BTO 3;
BA_ "GenSigTimeoutTime_AGSM" SG_ 1448 ECM_WARN_BTO 0;
BA_ "GenSigTimeoutTime_BCM" SG_ 1448 ECM_WARN_BTO 0;
BA_ "GenSigTimeoutTime_BSM" SG_ 1448 ECM_WARN_BTO 0;
BA_ "GenSigTimeoutTime_CADM" SG_ 1448 ECM_WARN_BTO 0;
BA_ "GenSigTimeoutTime_DMSM" SG_ 1448 ECM_WARN_BTO 0;
BA_ "GenSigTimeoutTime_DTCM" SG_ 1448 ECM_WARN_BTO 0;
BA_ "GenSigTimeoutTime_ECM" SG_ 1448 ECM_WARN_BTO 0;
BA_ "GenSigTimeoutTime_EVCU2" SG_ 1448 ECM_WARN_BTO 0;
BA_ "GenSigTimeoutTime_GNMM" SG_ 1448 ECM_WARN_BTO 0;
BA_ "GenSigTimeoutTime_HCP" SG_ 1448 ECM_WARN_BTO 0;
BA_ "GenSigTimeoutTime_RFHM" SG_ 1448 ECM_WARN_BTO 0;
BA_ "GenSigTimeoutTime_SGW" SG_ 1448 ECM_WARN_BTO 0;
BA_ "GenSigTimeoutTime_TCM" SG_ 1448 ECM_WARN_BTO 0;
BA_ "GenSigSendType" SG_ 1448 ECM_WARN_BTO_1 3;
BA_ "GenSigTimeoutTime_AGSM" SG_ 1448 ECM_WARN_BTO_1 0;
BA_ "GenSigTimeoutTime_BCM" SG_ 1448 ECM_WARN_BTO_1 0;
BA_ "GenSigTimeoutTime_BSM" SG_ 1448 ECM_WARN_BTO_1 0;
BA_ "GenSigTimeoutTime_CADM" SG_ 1448 ECM_WARN_BTO_1 0;
BA_ "GenSigTimeoutTime_DMSM" SG_ 1448 ECM_WARN_BTO_1 0;
BA_ "GenSigTimeoutTime_DTCM" SG_ 1448 ECM_WARN_BTO_1 0;
BA_ "GenSigTimeoutTime_ECM" SG_ 1448 ECM_WARN_BTO_1 0;
BA_ "GenSigTimeoutTime_EVCU2" SG_ 1448 ECM_WARN_BTO_1 0;
BA_ "GenSigTimeoutTime_GNMM" SG_ 1448 ECM_WARN_BTO_1 0;
BA_ "GenSigTimeoutTime_HCP" SG_ 1448 ECM_WARN_BTO_1 0;
BA_ "GenSigTimeoutTime_RFHM" SG_ 1448 ECM_WARN_BTO_1 0;
BA_ "GenSigTimeoutTime_SGW" SG_ 1448 ECM_WARN_BTO_1 0;
BA_ "GenSigTimeoutTime_TCM" SG_ 1448 ECM_WARN_BTO_1 0;
BA_ "GenSigStartValue" SG_ 1448 EMSFailSts 2;
BA_ "GenSigSendType" SG_ 1448 EMSFailSts 3;
BA_ "GenSigTimeoutTime_AGSM" SG_ 1448 EMSFailSts 0;
BA_ "GenSigTimeoutTime_BSM" SG_ 1448 EMSFailSts 0;
BA_ "GenSigTimeoutTime_DMSM" SG_ 1448 EMSFailSts 0;
BA_ "GenSigTimeoutTime_DTCM" SG_ 1448 EMSFailSts 0;
BA_ "GenSigTimeoutTime_ECM" SG_ 1448 EMSFailSts 0;
BA_ "GenSigTimeoutTime_EVCU2" SG_ 1448 EMSFailSts 0;
BA_ "GenSigTimeoutTime_GNMM" SG_ 1448 EMSFailSts 0;
BA_ "GenSigTimeoutTime_HCP" SG_ 1448 EMSFailSts 0;
BA_ "GenSigTimeoutTime_RFHM" SG_ 1448 EMSFailSts 0;
BA_ "GenSigTimeoutTime_TCM" SG_ 1448 EMSFailSts 0;
BA_ "GenSigSendType" SG_ 1448 EngineOperatingMode 3;
BA_ "GenSigTimeoutTime_AGSM" SG_ 1448 EngineOperatingMode 0;
BA_ "GenSigTimeoutTime_BCM" SG_ 1448 EngineOperatingMode 0;
BA_ "GenSigTimeoutTime_BSM" SG_ 1448 EngineOperatingMode 0;
BA_ "GenSigTimeoutTime_CADM" SG_ 1448 EngineOperatingMode 0;
BA_ "GenSigTimeoutTime_DMSM" SG_ 1448 EngineOperatingMode 0;
BA_ "GenSigTimeoutTime_DTCM" SG_ 1448 EngineOperatingMode 0;
BA_ "GenSigTimeoutTime_ECM" SG_ 1448 EngineOperatingMode 0;
BA_ "GenSigTimeoutTime_EVCU2" SG_ 1448 EngineOperatingMode 0;
BA_ "GenSigTimeoutTime_GNMM" SG_ 1448 EngineOperatingMode 0;
BA_ "GenSigTimeoutTime_HCP" SG_ 1448 EngineOperatingMode 0;
BA_ "GenSigTimeoutTime_IPC" SG_ 1448 EngineOperatingMode 0;
BA_ "GenSigTimeoutTime_RFHM" SG_ 1448 EngineOperatingMode 0;
BA_ "GenSigTimeoutTime_TCM" SG_ 1448 EngineOperatingMode 0;
BA_ "GenSigSendType" SG_ 1448 ETCFailSts 3;
BA_ "GenSigTimeoutTime_AGSM" SG_ 1448 ETCFailSts 0;
BA_ "GenSigTimeoutTime_BSM" SG_ 1448 ETCFailSts 0;
BA_ "GenSigTimeoutTime_CADM" SG_ 1448 ETCFailSts 0;
BA_ "GenSigTimeoutTime_DMSM" SG_ 1448 ETCFailSts 0;
BA_ "GenSigTimeoutTime_DTCM" SG_ 1448 ETCFailSts 0;
BA_ "GenSigTimeoutTime_ECM" SG_ 1448 ETCFailSts 0;
BA_ "GenSigTimeoutTime_EVCU2" SG_ 1448 ETCFailSts 0;
BA_ "GenSigTimeoutTime_GNMM" SG_ 1448 ETCFailSts 0;
BA_ "GenSigTimeoutTime_HCP" SG_ 1448 ETCFailSts 0;
BA_ "GenSigTimeoutTime_RFHM" SG_ 1448 ETCFailSts 0;
BA_ "GenSigTimeoutTime_TCM" SG_ 1448 ETCFailSts 0;
BA_ "GenSigSendType" SG_ 1448 ExhaustTemperature 3;
BA_ "GenSigTimeoutTime_AGSM" SG_ 1448 ExhaustTemperature 0;
BA_ "GenSigTimeoutTime_BCM" SG_ 1448 ExhaustTemperature 0;
BA_ "GenSigTimeoutTime_BSM" SG_ 1448 ExhaustTemperature 0;
BA_ "GenSigTimeoutTime_CADM" SG_ 1448 ExhaustTemperature 0;
BA_ "GenSigTimeoutTime_DMSM" SG_ 1448 ExhaustTemperature 0;
BA_ "GenSigTimeoutTime_DTCM" SG_ 1448 ExhaustTemperature 0;
BA_ "GenSigTimeoutTime_ECM" SG_ 1448 ExhaustTemperature 0;
BA_ "GenSigTimeoutTime_GNMM" SG_ 1448 ExhaustTemperature 0;
BA_ "GenSigTimeoutTime_HCP" SG_ 1448 ExhaustTemperature 0;
BA_ "GenSigTimeoutTime_IPC" SG_ 1448 ExhaustTemperature 0;
BA_ "GenSigTimeoutTime_RFHM" SG_ 1448 ExhaustTemperature 0;
BA_ "GenSigTimeoutTime_TCM" SG_ 1448 ExhaustTemperature 0;
BA_ "GenSigTimeoutTime_AGSM" SG_ 1448 FuelMM_Sts 0;
BA_ "GenSigTimeoutTime_BCM" SG_ 1448 FuelMM_Sts 0;
BA_ "GenSigTimeoutTime_BSM" SG_ 1448 FuelMM_Sts 0;
BA_ "GenSigTimeoutTime_CADM" SG_ 1448 FuelMM_Sts 0;
BA_ "GenSigTimeoutTime_DMSM" SG_ 1448 FuelMM_Sts 0;
BA_ "GenSigTimeoutTime_DTCM" SG_ 1448 FuelMM_Sts 0;
BA_ "GenSigTimeoutTime_ECM" SG_ 1448 FuelMM_Sts 0;
BA_ "GenSigTimeoutTime_EVCU2" SG_ 1448 FuelMM_Sts 0;
BA_ "GenSigTimeoutTime_GNMM" SG_ 1448 FuelMM_Sts 0;
BA_ "GenSigTimeoutTime_HCP" SG_ 1448 FuelMM_Sts 0;
BA_ "GenSigTimeoutTime_RFHM" SG_ 1448 FuelMM_Sts 0;
BA_ "GenSigTimeoutTime_SGW" SG_ 1448 FuelMM_Sts 0;
BA_ "GenSigTimeoutTime_TCM" SG_ 1448 FuelMM_Sts 0;
BA_ "GenSigStartValue" SG_ 1448 HoursOilLifeRst 4095;
BA_ "GenSigTimeoutTime_AGSM" SG_ 1448 HoursOilLifeRst 0;
BA_ "GenSigTimeoutTime_BSM" SG_ 1448 HoursOilLifeRst 0;
BA_ "GenSigTimeoutTime_CADM" SG_ 1448 HoursOilLifeRst 0;
BA_ "GenSigTimeoutTime_DMSM" SG_ 1448 HoursOilLifeRst 0;
BA_ "GenSigTimeoutTime_DTCM" SG_ 1448 HoursOilLifeRst 0;
BA_ "GenSigTimeoutTime_ECM" SG_ 1448 HoursOilLifeRst 0;
BA_ "GenSigTimeoutTime_EVCU2" SG_ 1448 HoursOilLifeRst 0;
BA_ "GenSigTimeoutTime_GNMM" SG_ 1448 HoursOilLifeRst 0;
BA_ "GenSigTimeoutTime_HCP" SG_ 1448 HoursOilLifeRst 0;
BA_ "GenSigTimeoutTime_IPC" SG_ 1448 HoursOilLifeRst 0;
BA_ "GenSigTimeoutTime_RFHM" SG_ 1448 HoursOilLifeRst 0;
BA_ "GenSigTimeoutTime_SGW" SG_ 1448 HoursOilLifeRst 0;
BA_ "GenSigTimeoutTime_TCM" SG_ 1448 HoursOilLifeRst 0;
BA_ "GenSigSendType" SG_ 1448 KNK_MG_TRIGGER 3;
BA_ "GenSigTimeoutTime_AGSM" SG_ 1448 KNK_MG_TRIGGER 0;
BA_ "GenSigTimeoutTime_BCM" SG_ 1448 KNK_MG_TRIGGER 0;
BA_ "GenSigTimeoutTime_BSM" SG_ 1448 KNK_MG_TRIGGER 0;
BA_ "GenSigTimeoutTime_CADM" SG_ 1448 KNK_MG_TRIGGER 0;
BA_ "GenSigTimeoutTime_DMSM" SG_ 1448 KNK_MG_TRIGGER 0;
BA_ "GenSigTimeoutTime_DTCM" SG_ 1448 KNK_MG_TRIGGER 0;
BA_ "GenSigTimeoutTime_ECM" SG_ 1448 KNK_MG_TRIGGER 0;
BA_ "GenSigTimeoutTime_EVCU2" SG_ 1448 KNK_MG_TRIGGER 0;
BA_ "GenSigTimeoutTime_GNMM" SG_ 1448 KNK_MG_TRIGGER 0;
BA_ "GenSigTimeoutTime_HCP" SG_ 1448 KNK_MG_TRIGGER 0;
BA_ "GenSigTimeoutTime_RFHM" SG_ 1448 KNK_MG_TRIGGER 0;
BA_ "GenSigTimeoutTime_SGW" SG_ 1448 KNK_MG_TRIGGER 0;
BA_ "GenSigTimeoutTime_TCM" SG_ 1448 KNK_MG_TRIGGER 0;
BA_ "GenSigTimeoutTime_AGSM" SG_ 1448 MessageCounter_ENGINE7 0;
BA_ "GenSigTimeoutTime_BSM" SG_ 1448 MessageCounter_ENGINE7 0;
BA_ "GenSigTimeoutTime_DMSM" SG_ 1448 MessageCounter_ENGINE7 0;
BA_ "GenSigTimeoutTime_DTCM" SG_ 1448 MessageCounter_ENGINE7 0;
BA_ "GenSigTimeoutTime_ECM" SG_ 1448 MessageCounter_ENGINE7 0;
BA_ "GenSigTimeoutTime_EVCU2" SG_ 1448 MessageCounter_ENGINE7 0;
BA_ "GenSigTimeoutTime_GNMM" SG_ 1448 MessageCounter_ENGINE7 0;
BA_ "GenSigTimeoutTime_HCP" SG_ 1448 MessageCounter_ENGINE7 0;
BA_ "GenSigTimeoutTime_RFHM" SG_ 1448 MessageCounter_ENGINE7 0;
BA_ "GenSigTimeoutTime_SGW" SG_ 1448 MessageCounter_ENGINE7 0;
BA_ "GenSigTimeoutTime_AGSM" SG_ 1448 MntncSts 0;
BA_ "GenSigTimeoutTime_BCM" SG_ 1448 MntncSts 0;
BA_ "GenSigTimeoutTime_BSM" SG_ 1448 MntncSts 0;
BA_ "GenSigTimeoutTime_CADM" SG_ 1448 MntncSts 0;
BA_ "GenSigTimeoutTime_DMSM" SG_ 1448 MntncSts 0;
BA_ "GenSigTimeoutTime_DTCM" SG_ 1448 MntncSts 0;
BA_ "GenSigTimeoutTime_ECM" SG_ 1448 MntncSts 0;
BA_ "GenSigTimeoutTime_EVCU2" SG_ 1448 MntncSts 0;
BA_ "GenSigTimeoutTime_GNMM" SG_ 1448 MntncSts 0;
BA_ "GenSigTimeoutTime_HCP" SG_ 1448 MntncSts 0;
BA_ "GenSigTimeoutTime_RFHM" SG_ 1448 MntncSts 0;
BA_ "GenSigTimeoutTime_TCM" SG_ 1448 MntncSts 0;
BA_ "GenSigSendType" SG_ 1448 OilLifeSts 3;
BA_ "GenSigTimeoutTime_AGSM" SG_ 1448 OilLifeSts 0;
BA_ "GenSigTimeoutTime_BCM" SG_ 1448 OilLifeSts 0;
BA_ "GenSigTimeoutTime_BSM" SG_ 1448 OilLifeSts 0;
BA_ "GenSigTimeoutTime_CADM" SG_ 1448 OilLifeSts 0;
BA_ "GenSigTimeoutTime_DMSM" SG_ 1448 OilLifeSts 0;
BA_ "GenSigTimeoutTime_DTCM" SG_ 1448 OilLifeSts 0;
BA_ "GenSigTimeoutTime_ECM" SG_ 1448 OilLifeSts 0;
BA_ "GenSigTimeoutTime_EVCU2" SG_ 1448 OilLifeSts 0;
BA_ "GenSigTimeoutTime_GNMM" SG_ 1448 OilLifeSts 0;
BA_ "GenSigTimeoutTime_HCP" SG_ 1448 OilLifeSts 0;
BA_ "GenSigTimeoutTime_IPC" SG_ 1448 OilLifeSts 0;
BA_ "GenSigTimeoutTime_RFHM" SG_ 1448 OilLifeSts 0;
BA_ "GenSigTimeoutTime_TCM" SG_ 1448 OilLifeSts 0;
BA_ "GenSigStartValue" SG_ 1448 OilPressureSts 1;
BA_ "GenSigSendType" SG_ 1448 OilPressureSts 3;
BA_ "GenSigTimeoutTime_AGSM" SG_ 1448 OilPressureSts 0;
BA_ "GenSigTimeoutTime_BSM" SG_ 1448 OilPressureSts 0;
BA_ "GenSigTimeoutTime_CADM" SG_ 1448 OilPressureSts 0;
BA_ "GenSigTimeoutTime_DMSM" SG_ 1448 OilPressureSts 0;
BA_ "GenSigTimeoutTime_DTCM" SG_ 1448 OilPressureSts 0;
BA_ "GenSigTimeoutTime_ECM" SG_ 1448 OilPressureSts 0;
BA_ "GenSigTimeoutTime_EVCU2" SG_ 1448 OilPressureSts 0;
BA_ "GenSigTimeoutTime_GNMM" SG_ 1448 OilPressureSts 0;
BA_ "GenSigTimeoutTime_HCP" SG_ 1448 OilPressureSts 0;
BA_ "GenSigTimeoutTime_RFHM" SG_ 1448 OilPressureSts 0;
BA_ "GenSigTimeoutTime_TCM" SG_ 1448 OilPressureSts 0;
BA_ "GenSigSendType" SG_ 1448 PerfShftRq_HUD 3;
BA_ "GenSigTimeoutTime_AGSM" SG_ 1448 PerfShftRq_HUD 0;
BA_ "GenSigTimeoutTime_BCM" SG_ 1448 PerfShftRq_HUD 0;
BA_ "GenSigTimeoutTime_BSM" SG_ 1448 PerfShftRq_HUD 0;
BA_ "GenSigTimeoutTime_CADM" SG_ 1448 PerfShftRq_HUD 0;
BA_ "GenSigTimeoutTime_DMSM" SG_ 1448 PerfShftRq_HUD 0;
BA_ "GenSigTimeoutTime_DTCM" SG_ 1448 PerfShftRq_HUD 0;
BA_ "GenSigTimeoutTime_ECM" SG_ 1448 PerfShftRq_HUD 0;
BA_ "GenSigTimeoutTime_EVCU2" SG_ 1448 PerfShftRq_HUD 0;
BA_ "GenSigTimeoutTime_GNMM" SG_ 1448 PerfShftRq_HUD 0;
BA_ "GenSigTimeoutTime_HCP" SG_ 1448 PerfShftRq_HUD 0;
BA_ "GenSigTimeoutTime_RFHM" SG_ 1448 PerfShftRq_HUD 0;
BA_ "GenSigTimeoutTime_SGW" SG_ 1448 PerfShftRq_HUD 0;
BA_ "GenSigTimeoutTime_TCM" SG_ 1448 PerfShftRq_HUD 0;
BA_ "GenSigSendType" SG_ 1448 SpStDispstat 3;
BA_ "GenSigTimeoutTime_AGSM" SG_ 1448 SpStDispstat 0;
BA_ "GenSigTimeoutTime_BSM" SG_ 1448 SpStDispstat 0;
BA_ "GenSigTimeoutTime_CADM" SG_ 1448 SpStDispstat 0;
BA_ "GenSigTimeoutTime_DMSM" SG_ 1448 SpStDispstat 0;
BA_ "GenSigTimeoutTime_DTCM" SG_ 1448 SpStDispstat 0;
BA_ "GenSigTimeoutTime_ECM" SG_ 1448 SpStDispstat 0;
BA_ "GenSigTimeoutTime_EVCU2" SG_ 1448 SpStDispstat 0;
BA_ "GenSigTimeoutTime_GNMM" SG_ 1448 SpStDispstat 0;
BA_ "GenSigTimeoutTime_HCP" SG_ 1448 SpStDispstat 0;
BA_ "GenSigTimeoutTime_RFHM" SG_ 1448 SpStDispstat 0;
BA_ "GenSigSendType" SG_ 1448 SpStIndRq 3;
BA_ "GenSigTimeoutTime_AGSM" SG_ 1448 SpStIndRq 0;
BA_ "GenSigTimeoutTime_BCM" SG_ 1448 SpStIndRq 0;
BA_ "GenSigTimeoutTime_BSM" SG_ 1448 SpStIndRq 0;
BA_ "GenSigTimeoutTime_CADM" SG_ 1448 SpStIndRq 0;
BA_ "GenSigTimeoutTime_DMSM" SG_ 1448 SpStIndRq 0;
BA_ "GenSigTimeoutTime_DTCM" SG_ 1448 SpStIndRq 0;
BA_ "GenSigTimeoutTime_ECM" SG_ 1448 SpStIndRq 0;
BA_ "GenSigTimeoutTime_EVCU2" SG_ 1448 SpStIndRq 0;
BA_ "GenSigTimeoutTime_GNMM" SG_ 1448 SpStIndRq 0;
BA_ "GenSigTimeoutTime_HCP" SG_ 1448 SpStIndRq 0;
BA_ "GenSigTimeoutTime_RFHM" SG_ 1448 SpStIndRq 0;
BA_ "GenSigTimeoutTime_SGW" SG_ 1448 SpStIndRq 0;
BA_ "GenSigTimeoutTime_TCM" SG_ 1448 SpStIndRq 0;
BA_ "GenSigSendType" SG_ 1448 SpStSwStat 3;
BA_ "GenSigTimeoutTime_AGSM" SG_ 1448 SpStSwStat 0;
BA_ "GenSigTimeoutTime_BSM" SG_ 1448 SpStSwStat 0;
BA_ "GenSigTimeoutTime_CADM" SG_ 1448 SpStSwStat 0;
BA_ "GenSigTimeoutTime_DMSM" SG_ 1448 SpStSwStat 0;
BA_ "GenSigTimeoutTime_DTCM" SG_ 1448 SpStSwStat 0;
BA_ "GenSigTimeoutTime_ECM" SG_ 1448 SpStSwStat 0;
BA_ "GenSigTimeoutTime_EVCU2" SG_ 1448 SpStSwStat 0;
BA_ "GenSigTimeoutTime_GNMM" SG_ 1448 SpStSwStat 0;
BA_ "GenSigTimeoutTime_HCP" SG_ 1448 SpStSwStat 0;
BA_ "GenSigTimeoutTime_RFHM" SG_ 1448 SpStSwStat 0;
BA_ "GenSigTimeoutTime_TCM" SG_ 1448 SpStSwStat 0;
BA_ "GenSigTimeoutTime_AGSM" SG_ 1055 AFTER_RUN_STATUS 0;
BA_ "GenSigTimeoutTime_BCM" SG_ 1055 AFTER_RUN_STATUS 0;
BA_ "GenSigTimeoutTime_BSM" SG_ 1055 AFTER_RUN_STATUS 0;
BA_ "GenSigTimeoutTime_CADM" SG_ 1055 AFTER_RUN_STATUS 0;
BA_ "GenSigTimeoutTime_DMSM" SG_ 1055 AFTER_RUN_STATUS 0;
BA_ "GenSigTimeoutTime_DTCM" SG_ 1055 AFTER_RUN_STATUS 0;
BA_ "GenSigTimeoutTime_ECM" SG_ 1055 AFTER_RUN_STATUS 0;
BA_ "GenSigTimeoutTime_EVCU2" SG_ 1055 AFTER_RUN_STATUS 0;
BA_ "GenSigTimeoutTime_GNMM" SG_ 1055 AFTER_RUN_STATUS 0;
BA_ "GenSigTimeoutTime_HCP" SG_ 1055 AFTER_RUN_STATUS 0;
BA_ "GenSigTimeoutTime_IPC" SG_ 1055 AFTER_RUN_STATUS 0;
BA_ "GenSigTimeoutTime_RFHM" SG_ 1055 AFTER_RUN_STATUS 0;
BA_ "GenSigTimeoutTime_TCM" SG_ 1055 AFTER_RUN_STATUS 0;
BA_ "GenSigTimeoutTime_AGSM" SG_ 1055 AM_ECM_Prsnt 0;
BA_ "GenSigTimeoutTime_BSM" SG_ 1055 AM_ECM_Prsnt 0;
BA_ "GenSigTimeoutTime_CADM" SG_ 1055 AM_ECM_Prsnt 0;
BA_ "GenSigTimeoutTime_DMSM" SG_ 1055 AM_ECM_Prsnt 0;
BA_ "GenSigTimeoutTime_DTCM" SG_ 1055 AM_ECM_Prsnt 0;
BA_ "GenSigTimeoutTime_ECM" SG_ 1055 AM_ECM_Prsnt 0;
BA_ "GenSigTimeoutTime_EVCU2" SG_ 1055 AM_ECM_Prsnt 0;
BA_ "GenSigTimeoutTime_GNMM" SG_ 1055 AM_ECM_Prsnt 0;
BA_ "GenSigTimeoutTime_HCP" SG_ 1055 AM_ECM_Prsnt 0;
BA_ "GenSigTimeoutTime_IPC" SG_ 1055 AM_ECM_Prsnt 0;
BA_ "GenSigTimeoutTime_RFHM" SG_ 1055 AM_ECM_Prsnt 0;
BA_ "GenSigTimeoutTime_SGW" SG_ 1055 AM_ECM_Prsnt 0;
BA_ "GenSigTimeoutTime_TCM" SG_ 1055 AM_ECM_Prsnt 0;
BA_ "GenSigTimeoutTime_AGSM" SG_ 1055 COOLING_REQUIRED_STATUS 0;
BA_ "GenSigTimeoutTime_BCM" SG_ 1055 COOLING_REQUIRED_STATUS 0;
BA_ "GenSigTimeoutTime_BSM" SG_ 1055 COOLING_REQUIRED_STATUS 0;
BA_ "GenSigTimeoutTime_CADM" SG_ 1055 COOLING_REQUIRED_STATUS 0;
BA_ "GenSigTimeoutTime_DMSM" SG_ 1055 COOLING_REQUIRED_STATUS 0;
BA_ "GenSigTimeoutTime_DTCM" SG_ 1055 COOLING_REQUIRED_STATUS 0;
BA_ "GenSigTimeoutTime_ECM" SG_ 1055 COOLING_REQUIRED_STATUS 0;
BA_ "GenSigTimeoutTime_EVCU2" SG_ 1055 COOLING_REQUIRED_STATUS 0;
BA_ "GenSigTimeoutTime_GNMM" SG_ 1055 COOLING_REQUIRED_STATUS 0;
BA_ "GenSigTimeoutTime_HCP" SG_ 1055 COOLING_REQUIRED_STATUS 0;
BA_ "GenSigTimeoutTime_IPC" SG_ 1055 COOLING_REQUIRED_STATUS 0;
BA_ "GenSigTimeoutTime_RFHM" SG_ 1055 COOLING_REQUIRED_STATUS 0;
BA_ "GenSigTimeoutTime_TCM" SG_ 1055 COOLING_REQUIRED_STATUS 0;
BA_ "GenSigTimeoutTime_AGSM" SG_ 1055 CRC_ENGINE8 0;
BA_ "GenSigTimeoutTime_BCM" SG_ 1055 CRC_ENGINE8 0;
BA_ "GenSigTimeoutTime_BSM" SG_ 1055 CRC_ENGINE8 0;
BA_ "GenSigTimeoutTime_CADM" SG_ 1055 CRC_ENGINE8 0;
BA_ "GenSigTimeoutTime_DMSM" SG_ 1055 CRC_ENGINE8 0;
BA_ "GenSigTimeoutTime_DTCM" SG_ 1055 CRC_ENGINE8 0;
BA_ "GenSigTimeoutTime_ECM" SG_ 1055 CRC_ENGINE8 0;
BA_ "GenSigTimeoutTime_GNMM" SG_ 1055 CRC_ENGINE8 0;
BA_ "GenSigTimeoutTime_IPC" SG_ 1055 CRC_ENGINE8 0;
BA_ "GenSigTimeoutTime_RFHM" SG_ 1055 CRC_ENGINE8 0;
BA_ "GenSigTimeoutTime_SGW" SG_ 1055 CRC_ENGINE8 0;
BA_ "GenSigTimeoutTime_AGSM" SG_ 1055 GF_Charge 0;
BA_ "GenSigTimeoutTime_BSM" SG_ 1055 GF_Charge 0;
BA_ "GenSigTimeoutTime_CADM" SG_ 1055 GF_Charge 0;
BA_ "GenSigTimeoutTime_DMSM" SG_ 1055 GF_Charge 0;
BA_ "GenSigTimeoutTime_DTCM" SG_ 1055 GF_Charge 0;
BA_ "GenSigTimeoutTime_ECM" SG_ 1055 GF_Charge 0;
BA_ "GenSigTimeoutTime_GNMM" SG_ 1055 GF_Charge 0;
BA_ "GenSigTimeoutTime_HCP" SG_ 1055 GF_Charge 0;
BA_ "GenSigTimeoutTime_IPC" SG_ 1055 GF_Charge 0;
BA_ "GenSigTimeoutTime_RFHM" SG_ 1055 GF_Charge 0;
BA_ "GenSigTimeoutTime_TCM" SG_ 1055 GF_Charge 0;
BA_ "GenSigTimeoutTime_AGSM" SG_ 1055 HOOD_AJAR_STATUS 0;
BA_ "GenSigTimeoutTime_BCM" SG_ 1055 HOOD_AJAR_STATUS 0;
BA_ "GenSigTimeoutTime_BSM" SG_ 1055 HOOD_AJAR_STATUS 0;
BA_ "GenSigTimeoutTime_CADM" SG_ 1055 HOOD_AJAR_STATUS 0;
BA_ "GenSigTimeoutTime_DMSM" SG_ 1055 HOOD_AJAR_STATUS 0;
BA_ "GenSigTimeoutTime_DTCM" SG_ 1055 HOOD_AJAR_STATUS 0;
BA_ "GenSigTimeoutTime_ECM" SG_ 1055 HOOD_AJAR_STATUS 0;
BA_ "GenSigTimeoutTime_EVCU2" SG_ 1055 HOOD_AJAR_STATUS 0;
BA_ "GenSigTimeoutTime_GNMM" SG_ 1055 HOOD_AJAR_STATUS 0;
BA_ "GenSigTimeoutTime_HCP" SG_ 1055 HOOD_AJAR_STATUS 0;
BA_ "GenSigTimeoutTime_IPC" SG_ 1055 HOOD_AJAR_STATUS 0;
BA_ "GenSigTimeoutTime_RFHM" SG_ 1055 HOOD_AJAR_STATUS 0;
BA_ "GenSigTimeoutTime_TCM" SG_ 1055 HOOD_AJAR_STATUS 0;
BA_ "GenSigTimeoutTime_AGSM" SG_ 1055 LTR_TARGET_TEMP 0;
BA_ "GenSigTimeoutTime_BCM" SG_ 1055 LTR_TARGET_TEMP 0;
BA_ "GenSigTimeoutTime_BSM" SG_ 1055 LTR_TARGET_TEMP 0;
BA_ "GenSigTimeoutTime_CADM" SG_ 1055 LTR_TARGET_TEMP 0;
BA_ "GenSigTimeoutTime_DMSM" SG_ 1055 LTR_TARGET_TEMP 0;
BA_ "GenSigTimeoutTime_DTCM" SG_ 1055 LTR_TARGET_TEMP 0;
BA_ "GenSigTimeoutTime_ECM" SG_ 1055 LTR_TARGET_TEMP 0;
BA_ "GenSigTimeoutTime_EVCU2" SG_ 1055 LTR_TARGET_TEMP 0;
BA_ "GenSigTimeoutTime_GNMM" SG_ 1055 LTR_TARGET_TEMP 0;
BA_ "GenSigTimeoutTime_HCP" SG_ 1055 LTR_TARGET_TEMP 0;
BA_ "GenSigTimeoutTime_IPC" SG_ 1055 LTR_TARGET_TEMP 0;
BA_ "GenSigTimeoutTime_RFHM" SG_ 1055 LTR_TARGET_TEMP 0;
BA_ "GenSigTimeoutTime_TCM" SG_ 1055 LTR_TARGET_TEMP 0;
BA_ "GenSigStartValue" SG_ 1055 MAP_4_BAR 511;
BA_ "GenSigTimeoutTime_AGSM" SG_ 1055 MAP_4_BAR 0;
BA_ "GenSigTimeoutTime_CADM" SG_ 1055 MAP_4_BAR 0;
BA_ "GenSigTimeoutTime_DMSM" SG_ 1055 MAP_4_BAR 0;
BA_ "GenSigTimeoutTime_DTCM" SG_ 1055 MAP_4_BAR 0;
BA_ "GenSigTimeoutTime_ECM" SG_ 1055 MAP_4_BAR 0;
BA_ "GenSigTimeoutTime_EVCU2" SG_ 1055 MAP_4_BAR 0;
BA_ "GenSigTimeoutTime_GNMM" SG_ 1055 MAP_4_BAR 0;
BA_ "GenSigTimeoutTime_IPC" SG_ 1055 MAP_4_BAR 0;
BA_ "GenSigTimeoutTime_RFHM" SG_ 1055 MAP_4_BAR 0;
BA_ "GenSigTimeoutTime_TCM" SG_ 1055 MAP_4_BAR 0;
BA_ "GenSigTimeoutTime_AGSM" SG_ 1055 MdsAct 0;
BA_ "GenSigTimeoutTime_BCM" SG_ 1055 MdsAct 0;
BA_ "GenSigTimeoutTime_BSM" SG_ 1055 MdsAct 0;
BA_ "GenSigTimeoutTime_CADM" SG_ 1055 MdsAct 0;
BA_ "GenSigTimeoutTime_DMSM" SG_ 1055 MdsAct 0;
BA_ "GenSigTimeoutTime_DTCM" SG_ 1055 MdsAct 0;
BA_ "GenSigTimeoutTime_ECM" SG_ 1055 MdsAct 0;
BA_ "GenSigTimeoutTime_EVCU2" SG_ 1055 MdsAct 0;
BA_ "GenSigTimeoutTime_GNMM" SG_ 1055 MdsAct 0;
BA_ "GenSigTimeoutTime_HCP" SG_ 1055 MdsAct 0;
BA_ "GenSigTimeoutTime_RFHM" SG_ 1055 MdsAct 0;
BA_ "GenSigTimeoutTime_AGSM" SG_ 1055 MdsActforANC 0;
BA_ "GenSigTimeoutTime_BSM" SG_ 1055 MdsActforANC 0;
BA_ "GenSigTimeoutTime_CADM" SG_ 1055 MdsActforANC 0;
BA_ "GenSigTimeoutTime_DMSM" SG_ 1055 MdsActforANC 0;
BA_ "GenSigTimeoutTime_DTCM" SG_ 1055 MdsActforANC 0;
BA_ "GenSigTimeoutTime_ECM" SG_ 1055 MdsActforANC 0;
BA_ "GenSigTimeoutTime_EVCU2" SG_ 1055 MdsActforANC 0;
BA_ "GenSigTimeoutTime_GNMM" SG_ 1055 MdsActforANC 0;
BA_ "GenSigTimeoutTime_HCP" SG_ 1055 MdsActforANC 0;
BA_ "GenSigTimeoutTime_IPC" SG_ 1055 MdsActforANC 0;
BA_ "GenSigTimeoutTime_RFHM" SG_ 1055 MdsActforANC 0;
BA_ "GenSigTimeoutTime_SGW" SG_ 1055 MdsActforANC 0;
BA_ "GenSigTimeoutTime_TCM" SG_ 1055 MdsActforANC 0;
BA_ "GenSigTimeoutTime_AGSM" SG_ 1055 MessageCounter_ENGINE8 0;
BA_ "GenSigTimeoutTime_BCM" SG_ 1055 MessageCounter_ENGINE8 0;
BA_ "GenSigTimeoutTime_BSM" SG_ 1055 MessageCounter_ENGINE8 0;
BA_ "GenSigTimeoutTime_CADM" SG_ 1055 MessageCounter_ENGINE8 0;
BA_ "GenSigTimeoutTime_DMSM" SG_ 1055 MessageCounter_ENGINE8 0;
BA_ "GenSigTimeoutTime_DTCM" SG_ 1055 MessageCounter_ENGINE8 0;
BA_ "GenSigTimeoutTime_ECM" SG_ 1055 MessageCounter_ENGINE8 0;
BA_ "GenSigTimeoutTime_GNMM" SG_ 1055 MessageCounter_ENGINE8 0;
BA_ "GenSigTimeoutTime_IPC" SG_ 1055 MessageCounter_ENGINE8 0;
BA_ "GenSigTimeoutTime_RFHM" SG_ 1055 MessageCounter_ENGINE8 0;
BA_ "GenSigTimeoutTime_SGW" SG_ 1055 MessageCounter_ENGINE8 0;
BA_ "GenSigStartValue" SG_ 1055 OIL_PRESS 255;
BA_ "GenSigTimeoutTime_AGSM" SG_ 1055 OIL_PRESS 0;
BA_ "GenSigTimeoutTime_BCM" SG_ 1055 OIL_PRESS 0;
BA_ "GenSigTimeoutTime_BSM" SG_ 1055 OIL_PRESS 0;
BA_ "GenSigTimeoutTime_CADM" SG_ 1055 OIL_PRESS 0;
BA_ "GenSigTimeoutTime_DMSM" SG_ 1055 OIL_PRESS 0;
BA_ "GenSigTimeoutTime_DTCM" SG_ 1055 OIL_PRESS 0;
BA_ "GenSigTimeoutTime_ECM" SG_ 1055 OIL_PRESS 0;
BA_ "GenSigTimeoutTime_EVCU2" SG_ 1055 OIL_PRESS 0;
BA_ "GenSigTimeoutTime_GNMM" SG_ 1055 OIL_PRESS 0;
BA_ "GenSigTimeoutTime_HCP" SG_ 1055 OIL_PRESS 0;
BA_ "GenSigTimeoutTime_RFHM" SG_ 1055 OIL_PRESS 0;
BA_ "GenSigTimeoutTime_TCM" SG_ 1055 OIL_PRESS 0;
BA_ "GenSigTimeoutTime_AGSM" SG_ 1055 PSI_EnableSts 0;
BA_ "GenSigTimeoutTime_BCM" SG_ 1055 PSI_EnableSts 0;
BA_ "GenSigTimeoutTime_BSM" SG_ 1055 PSI_EnableSts 0;
BA_ "GenSigTimeoutTime_CADM" SG_ 1055 PSI_EnableSts 0;
BA_ "GenSigTimeoutTime_DMSM" SG_ 1055 PSI_EnableSts 0;
BA_ "GenSigTimeoutTime_DTCM" SG_ 1055 PSI_EnableSts 0;
BA_ "GenSigTimeoutTime_ECM" SG_ 1055 PSI_EnableSts 0;
BA_ "GenSigTimeoutTime_EVCU2" SG_ 1055 PSI_EnableSts 0;
BA_ "GenSigTimeoutTime_GNMM" SG_ 1055 PSI_EnableSts 0;
BA_ "GenSigTimeoutTime_HCP" SG_ 1055 PSI_EnableSts 0;
BA_ "GenSigTimeoutTime_IPC" SG_ 1055 PSI_EnableSts 0;
BA_ "GenSigTimeoutTime_RFHM" SG_ 1055 PSI_EnableSts 0;
BA_ "GenSigTimeoutTime_TCM" SG_ 1055 PSI_EnableSts 0;
BA_ "GenSigTimeoutTime_AGSM" SG_ 1055 PSI_Gr1_RPM 0;
BA_ "GenSigTimeoutTime_BCM" SG_ 1055 PSI_Gr1_RPM 0;
BA_ "GenSigTimeoutTime_BSM" SG_ 1055 PSI_Gr1_RPM 0;
BA_ "GenSigTimeoutTime_CADM" SG_ 1055 PSI_Gr1_RPM 0;
BA_ "GenSigTimeoutTime_DMSM" SG_ 1055 PSI_Gr1_RPM 0;
BA_ "GenSigTimeoutTime_DTCM" SG_ 1055 PSI_Gr1_RPM 0;
BA_ "GenSigTimeoutTime_ECM" SG_ 1055 PSI_Gr1_RPM 0;
BA_ "GenSigTimeoutTime_EVCU2" SG_ 1055 PSI_Gr1_RPM 0;
BA_ "GenSigTimeoutTime_GNMM" SG_ 1055 PSI_Gr1_RPM 0;
BA_ "GenSigTimeoutTime_HCP" SG_ 1055 PSI_Gr1_RPM 0;
BA_ "GenSigTimeoutTime_IPC" SG_ 1055 PSI_Gr1_RPM 0;
BA_ "GenSigTimeoutTime_RFHM" SG_ 1055 PSI_Gr1_RPM 0;
BA_ "GenSigTimeoutTime_TCM" SG_ 1055 PSI_Gr1_RPM 0;
BA_ "GenSigTimeoutTime_AGSM" SG_ 1055 PSI_Gr2_RPM 0;
BA_ "GenSigTimeoutTime_BCM" SG_ 1055 PSI_Gr2_RPM 0;
BA_ "GenSigTimeoutTime_BSM" SG_ 1055 PSI_Gr2_RPM 0;
BA_ "GenSigTimeoutTime_CADM" SG_ 1055 PSI_Gr2_RPM 0;
BA_ "GenSigTimeoutTime_DMSM" SG_ 1055 PSI_Gr2_RPM 0;
BA_ "GenSigTimeoutTime_DTCM" SG_ 1055 PSI_Gr2_RPM 0;
BA_ "GenSigTimeoutTime_ECM" SG_ 1055 PSI_Gr2_RPM 0;
BA_ "GenSigTimeoutTime_EVCU2" SG_ 1055 PSI_Gr2_RPM 0;
BA_ "GenSigTimeoutTime_GNMM" SG_ 1055 PSI_Gr2_RPM 0;
BA_ "GenSigTimeoutTime_HCP" SG_ 1055 PSI_Gr2_RPM 0;
BA_ "GenSigTimeoutTime_IPC" SG_ 1055 PSI_Gr2_RPM 0;
BA_ "GenSigTimeoutTime_RFHM" SG_ 1055 PSI_Gr2_RPM 0;
BA_ "GenSigTimeoutTime_TCM" SG_ 1055 PSI_Gr2_RPM 0;
BA_ "GenSigTimeoutTime_AGSM" SG_ 1055 PSI_Gr3_RPM 0;
BA_ "GenSigTimeoutTime_BCM" SG_ 1055 PSI_Gr3_RPM 0;
BA_ "GenSigTimeoutTime_BSM" SG_ 1055 PSI_Gr3_RPM 0;
BA_ "GenSigTimeoutTime_CADM" SG_ 1055 PSI_Gr3_RPM 0;
BA_ "GenSigTimeoutTime_DMSM" SG_ 1055 PSI_Gr3_RPM 0;
BA_ "GenSigTimeoutTime_DTCM" SG_ 1055 PSI_Gr3_RPM 0;
BA_ "GenSigTimeoutTime_ECM" SG_ 1055 PSI_Gr3_RPM 0;
BA_ "GenSigTimeoutTime_EVCU2" SG_ 1055 PSI_Gr3_RPM 0;
BA_ "GenSigTimeoutTime_GNMM" SG_ 1055 PSI_Gr3_RPM 0;
BA_ "GenSigTimeoutTime_HCP" SG_ 1055 PSI_Gr3_RPM 0;
BA_ "GenSigTimeoutTime_IPC" SG_ 1055 PSI_Gr3_RPM 0;
BA_ "GenSigTimeoutTime_RFHM" SG_ 1055 PSI_Gr3_RPM 0;
BA_ "GenSigTimeoutTime_TCM" SG_ 1055 PSI_Gr3_RPM 0;
BA_ "GenSigTimeoutTime_AGSM" SG_ 1055 PSI_Gr4_RPM 0;
BA_ "GenSigTimeoutTime_BCM" SG_ 1055 PSI_Gr4_RPM 0;
BA_ "GenSigTimeoutTime_BSM" SG_ 1055 PSI_Gr4_RPM 0;
BA_ "GenSigTimeoutTime_CADM" SG_ 1055 PSI_Gr4_RPM 0;
BA_ "GenSigTimeoutTime_DMSM" SG_ 1055 PSI_Gr4_RPM 0;
BA_ "GenSigTimeoutTime_DTCM" SG_ 1055 PSI_Gr4_RPM 0;
BA_ "GenSigTimeoutTime_ECM" SG_ 1055 PSI_Gr4_RPM 0;
BA_ "GenSigTimeoutTime_EVCU2" SG_ 1055 PSI_Gr4_RPM 0;
BA_ "GenSigTimeoutTime_GNMM" SG_ 1055 PSI_Gr4_RPM 0;
BA_ "GenSigTimeoutTime_HCP" SG_ 1055 PSI_Gr4_RPM 0;
BA_ "GenSigTimeoutTime_IPC" SG_ 1055 PSI_Gr4_RPM 0;
BA_ "GenSigTimeoutTime_RFHM" SG_ 1055 PSI_Gr4_RPM 0;
BA_ "GenSigTimeoutTime_TCM" SG_ 1055 PSI_Gr4_RPM 0;
BA_ "GenSigTimeoutTime_AGSM" SG_ 1055 PSI_Gr5_RPM 0;
BA_ "GenSigTimeoutTime_BCM" SG_ 1055 PSI_Gr5_RPM 0;
BA_ "GenSigTimeoutTime_BSM" SG_ 1055 PSI_Gr5_RPM 0;
BA_ "GenSigTimeoutTime_CADM" SG_ 1055 PSI_Gr5_RPM 0;
BA_ "GenSigTimeoutTime_DMSM" SG_ 1055 PSI_Gr5_RPM 0;
BA_ "GenSigTimeoutTime_DTCM" SG_ 1055 PSI_Gr5_RPM 0;
BA_ "GenSigTimeoutTime_ECM" SG_ 1055 PSI_Gr5_RPM 0;
BA_ "GenSigTimeoutTime_EVCU2" SG_ 1055 PSI_Gr5_RPM 0;
BA_ "GenSigTimeoutTime_GNMM" SG_ 1055 PSI_Gr5_RPM 0;
BA_ "GenSigTimeoutTime_HCP" SG_ 1055 PSI_Gr5_RPM 0;
BA_ "GenSigTimeoutTime_IPC" SG_ 1055 PSI_Gr5_RPM 0;
BA_ "GenSigTimeoutTime_RFHM" SG_ 1055 PSI_Gr5_RPM 0;
BA_ "GenSigTimeoutTime_TCM" SG_ 1055 PSI_Gr5_RPM 0;
BA_ "GenSigTimeoutTime_AGSM" SG_ 1055 PSI_Max_RPM 0;
BA_ "GenSigTimeoutTime_BCM" SG_ 1055 PSI_Max_RPM 0;
BA_ "GenSigTimeoutTime_BSM" SG_ 1055 PSI_Max_RPM 0;
BA_ "GenSigTimeoutTime_CADM" SG_ 1055 PSI_Max_RPM 0;
BA_ "GenSigTimeoutTime_DMSM" SG_ 1055 PSI_Max_RPM 0;
BA_ "GenSigTimeoutTime_DTCM" SG_ 1055 PSI_Max_RPM 0;
BA_ "GenSigTimeoutTime_ECM" SG_ 1055 PSI_Max_RPM 0;
BA_ "GenSigTimeoutTime_EVCU2" SG_ 1055 PSI_Max_RPM 0;
BA_ "GenSigTimeoutTime_GNMM" SG_ 1055 PSI_Max_RPM 0;
BA_ "GenSigTimeoutTime_HCP" SG_ 1055 PSI_Max_RPM 0;
BA_ "GenSigTimeoutTime_IPC" SG_ 1055 PSI_Max_RPM 0;
BA_ "GenSigTimeoutTime_RFHM" SG_ 1055 PSI_Max_RPM 0;
BA_ "GenSigTimeoutTime_TCM" SG_ 1055 PSI_Max_RPM 0;
BA_ "GenSigTimeoutTime_AGSM" SG_ 1055 RACE_CLDWN_BATT_STAT 0;
BA_ "GenSigTimeoutTime_BCM" SG_ 1055 RACE_CLDWN_BATT_STAT 0;
BA_ "GenSigTimeoutTime_BSM" SG_ 1055 RACE_CLDWN_BATT_STAT 0;
BA_ "GenSigTimeoutTime_CADM" SG_ 1055 RACE_CLDWN_BATT_STAT 0;
BA_ "GenSigTimeoutTime_DMSM" SG_ 1055 RACE_CLDWN_BATT_STAT 0;
BA_ "GenSigTimeoutTime_DTCM" SG_ 1055 RACE_CLDWN_BATT_STAT 0;
BA_ "GenSigTimeoutTime_ECM" SG_ 1055 RACE_CLDWN_BATT_STAT 0;
BA_ "GenSigTimeoutTime_EVCU2" SG_ 1055 RACE_CLDWN_BATT_STAT 0;
BA_ "GenSigTimeoutTime_GNMM" SG_ 1055 RACE_CLDWN_BATT_STAT 0;
BA_ "GenSigTimeoutTime_HCP" SG_ 1055 RACE_CLDWN_BATT_STAT 0;
BA_ "GenSigTimeoutTime_IPC" SG_ 1055 RACE_CLDWN_BATT_STAT 0;
BA_ "GenSigTimeoutTime_RFHM" SG_ 1055 RACE_CLDWN_BATT_STAT 0;
BA_ "GenSigTimeoutTime_TCM" SG_ 1055 RACE_CLDWN_BATT_STAT 0;
BA_ "GenSigTimeoutTime_AGSM" SG_ 1055 RACE_CLDWN_DEAC_TIME 0;
BA_ "GenSigTimeoutTime_BCM" SG_ 1055 RACE_CLDWN_DEAC_TIME 0;
BA_ "GenSigTimeoutTime_BSM" SG_ 1055 RACE_CLDWN_DEAC_TIME 0;
BA_ "GenSigTimeoutTime_CADM" SG_ 1055 RACE_CLDWN_DEAC_TIME 0;
BA_ "GenSigTimeoutTime_DMSM" SG_ 1055 RACE_CLDWN_DEAC_TIME 0;
BA_ "GenSigTimeoutTime_DTCM" SG_ 1055 RACE_CLDWN_DEAC_TIME 0;
BA_ "GenSigTimeoutTime_ECM" SG_ 1055 RACE_CLDWN_DEAC_TIME 0;
BA_ "GenSigTimeoutTime_EVCU2" SG_ 1055 RACE_CLDWN_DEAC_TIME 0;
BA_ "GenSigTimeoutTime_GNMM" SG_ 1055 RACE_CLDWN_DEAC_TIME 0;
BA_ "GenSigTimeoutTime_HCP" SG_ 1055 RACE_CLDWN_DEAC_TIME 0;
BA_ "GenSigTimeoutTime_IPC" SG_ 1055 RACE_CLDWN_DEAC_TIME 0;
BA_ "GenSigTimeoutTime_RFHM" SG_ 1055 RACE_CLDWN_DEAC_TIME 0;
BA_ "GenSigTimeoutTime_TCM" SG_ 1055 RACE_CLDWN_DEAC_TIME 0;
BA_ "GenSigTimeoutTime_AGSM" SG_ 1055 RACE_CLDWN_SEL 0;
BA_ "GenSigTimeoutTime_BCM" SG_ 1055 RACE_CLDWN_SEL 0;
BA_ "GenSigTimeoutTime_BSM" SG_ 1055 RACE_CLDWN_SEL 0;
BA_ "GenSigTimeoutTime_CADM" SG_ 1055 RACE_CLDWN_SEL 0;
BA_ "GenSigTimeoutTime_DMSM" SG_ 1055 RACE_CLDWN_SEL 0;
BA_ "GenSigTimeoutTime_DTCM" SG_ 1055 RACE_CLDWN_SEL 0;
BA_ "GenSigTimeoutTime_ECM" SG_ 1055 RACE_CLDWN_SEL 0;
BA_ "GenSigTimeoutTime_EVCU2" SG_ 1055 RACE_CLDWN_SEL 0;
BA_ "GenSigTimeoutTime_GNMM" SG_ 1055 RACE_CLDWN_SEL 0;
BA_ "GenSigTimeoutTime_HCP" SG_ 1055 RACE_CLDWN_SEL 0;
BA_ "GenSigTimeoutTime_IPC" SG_ 1055 RACE_CLDWN_SEL 0;
BA_ "GenSigTimeoutTime_RFHM" SG_ 1055 RACE_CLDWN_SEL 0;
BA_ "GenSigTimeoutTime_TCM" SG_ 1055 RACE_CLDWN_SEL 0;
BA_ "GenSigTimeoutTime_AGSM" SG_ 1055 RefuelEvent 0;
BA_ "GenSigTimeoutTime_BSM" SG_ 1055 RefuelEvent 0;
BA_ "GenSigTimeoutTime_CADM" SG_ 1055 RefuelEvent 0;
BA_ "GenSigTimeoutTime_DMSM" SG_ 1055 RefuelEvent 0;
BA_ "GenSigTimeoutTime_DTCM" SG_ 1055 RefuelEvent 0;
BA_ "GenSigTimeoutTime_ECM" SG_ 1055 RefuelEvent 0;
BA_ "GenSigTimeoutTime_EVCU2" SG_ 1055 RefuelEvent 0;
BA_ "GenSigTimeoutTime_GNMM" SG_ 1055 RefuelEvent 0;
BA_ "GenSigTimeoutTime_HCP" SG_ 1055 RefuelEvent 0;
BA_ "GenSigTimeoutTime_IPC" SG_ 1055 RefuelEvent 0;
BA_ "GenSigTimeoutTime_RFHM" SG_ 1055 RefuelEvent 0;
BA_ "GenSigTimeoutTime_SGW" SG_ 1055 RefuelEvent 0;
BA_ "GenSigTimeoutTime_TCM" SG_ 1055 RefuelEvent 0;
BA_ "GenSigTimeoutTime_AGSM" SG_ 1055 RefuelIndication 0;
BA_ "GenSigTimeoutTime_BCM" SG_ 1055 RefuelIndication 0;
BA_ "GenSigTimeoutTime_BSM" SG_ 1055 RefuelIndication 0;
BA_ "GenSigTimeoutTime_CADM" SG_ 1055 RefuelIndication 0;
BA_ "GenSigTimeoutTime_DMSM" SG_ 1055 RefuelIndication 0;
BA_ "GenSigTimeoutTime_DTCM" SG_ 1055 RefuelIndication 0;
BA_ "GenSigTimeoutTime_ECM" SG_ 1055 RefuelIndication 0;
BA_ "GenSigTimeoutTime_EVCU2" SG_ 1055 RefuelIndication 0;
BA_ "GenSigTimeoutTime_GNMM" SG_ 1055 RefuelIndication 0;
BA_ "GenSigTimeoutTime_HCP" SG_ 1055 RefuelIndication 0;
BA_ "GenSigTimeoutTime_RFHM" SG_ 1055 RefuelIndication 0;
BA_ "GenSigTimeoutTime_SGW" SG_ 1055 RefuelIndication 0;
BA_ "GenSigTimeoutTime_TCM" SG_ 1055 RefuelIndication 0;
BA_ "GenSigStartValue" SG_ 1055 RevOilLifeRst 65535;
BA_ "GenSigTimeoutTime_AGSM" SG_ 1055 RevOilLifeRst 0;
BA_ "GenSigTimeoutTime_BSM" SG_ 1055 RevOilLifeRst 0;
BA_ "GenSigTimeoutTime_CADM" SG_ 1055 RevOilLifeRst 0;
BA_ "GenSigTimeoutTime_DMSM" SG_ 1055 RevOilLifeRst 0;
BA_ "GenSigTimeoutTime_DTCM" SG_ 1055 RevOilLifeRst 0;
BA_ "GenSigTimeoutTime_ECM" SG_ 1055 RevOilLifeRst 0;
BA_ "GenSigTimeoutTime_EVCU2" SG_ 1055 RevOilLifeRst 0;
BA_ "GenSigTimeoutTime_GNMM" SG_ 1055 RevOilLifeRst 0;
BA_ "GenSigTimeoutTime_HCP" SG_ 1055 RevOilLifeRst 0;
BA_ "GenSigTimeoutTime_IPC" SG_ 1055 RevOilLifeRst 0;
BA_ "GenSigTimeoutTime_RFHM" SG_ 1055 RevOilLifeRst 0;
BA_ "GenSigTimeoutTime_SGW" SG_ 1055 RevOilLifeRst 0;
BA_ "GenSigTimeoutTime_TCM" SG_ 1055 RevOilLifeRst 0;
BA_ "GenSigTimeoutTime_AGSM" SG_ 1055 SYSTEM_STATUS 0;
BA_ "GenSigTimeoutTime_BCM" SG_ 1055 SYSTEM_STATUS 0;
BA_ "GenSigTimeoutTime_BSM" SG_ 1055 SYSTEM_STATUS 0;
BA_ "GenSigTimeoutTime_CADM" SG_ 1055 SYSTEM_STATUS 0;
BA_ "GenSigTimeoutTime_DMSM" SG_ 1055 SYSTEM_STATUS 0;
BA_ "GenSigTimeoutTime_DTCM" SG_ 1055 SYSTEM_STATUS 0;
BA_ "GenSigTimeoutTime_ECM" SG_ 1055 SYSTEM_STATUS 0;
BA_ "GenSigTimeoutTime_EVCU2" SG_ 1055 SYSTEM_STATUS 0;
BA_ "GenSigTimeoutTime_GNMM" SG_ 1055 SYSTEM_STATUS 0;
BA_ "GenSigTimeoutTime_HCP" SG_ 1055 SYSTEM_STATUS 0;
BA_ "GenSigTimeoutTime_IPC" SG_ 1055 SYSTEM_STATUS 0;
BA_ "GenSigTimeoutTime_RFHM" SG_ 1055 SYSTEM_STATUS 0;
BA_ "GenSigTimeoutTime_TCM" SG_ 1055 SYSTEM_STATUS 0;
BA_ "GenSigTimeoutTime_AGSM" SG_ 271 AccPos 0;
BA_ "GenSigTimeoutTime_BCM" SG_ 271 AccPos 0;
BA_ "GenSigTimeoutTime_BSM" SG_ 271 AccPos 0;
BA_ "GenSigTimeoutTime_CADM" SG_ 271 AccPos 0;
BA_ "GenSigTimeoutTime_DMSM" SG_ 271 AccPos 0;
BA_ "GenSigTimeoutTime_DTCM" SG_ 271 AccPos 0;
BA_ "GenSigTimeoutTime_ECM" SG_ 271 AccPos 0;
BA_ "GenSigTimeoutTime_EVCU2" SG_ 271 AccPos 0;
BA_ "GenSigTimeoutTime_GNMM" SG_ 271 AccPos 0;
BA_ "GenSigTimeoutTime_IPC" SG_ 271 AccPos 0;
BA_ "GenSigTimeoutTime_RFHM" SG_ 271 AccPos 0;
BA_ "GenSigTimeoutTime_SGW" SG_ 271 AccPos 0;
BA_ "GenSigTimeoutTime_TCM" SG_ 271 AccPos 0;
BA_ "GenSigTimeoutTime_AGSM" SG_ 271 AccPosV 0;
BA_ "GenSigTimeoutTime_BCM" SG_ 271 AccPosV 0;
BA_ "GenSigTimeoutTime_BSM" SG_ 271 AccPosV 0;
BA_ "GenSigTimeoutTime_CADM" SG_ 271 AccPosV 0;
BA_ "GenSigTimeoutTime_DMSM" SG_ 271 AccPosV 0;
BA_ "GenSigTimeoutTime_DTCM" SG_ 271 AccPosV 0;
BA_ "GenSigTimeoutTime_ECM" SG_ 271 AccPosV 0;
BA_ "GenSigTimeoutTime_EVCU2" SG_ 271 AccPosV 0;
BA_ "GenSigTimeoutTime_GNMM" SG_ 271 AccPosV 0;
BA_ "GenSigTimeoutTime_IPC" SG_ 271 AccPosV 0;
BA_ "GenSigTimeoutTime_RFHM" SG_ 271 AccPosV 0;
BA_ "GenSigTimeoutTime_SGW" SG_ 271 AccPosV 0;
BA_ "GenSigTimeoutTime_TCM" SG_ 271 AccPosV 0;
BA_ "GenSigTimeoutTime_AGSM" SG_ 271 Cam_Exh_1_Locked 0;
BA_ "GenSigTimeoutTime_BCM" SG_ 271 Cam_Exh_1_Locked 0;
BA_ "GenSigTimeoutTime_BSM" SG_ 271 Cam_Exh_1_Locked 0;
BA_ "GenSigTimeoutTime_CADM" SG_ 271 Cam_Exh_1_Locked 0;
BA_ "GenSigTimeoutTime_DMSM" SG_ 271 Cam_Exh_1_Locked 0;
BA_ "GenSigTimeoutTime_DTCM" SG_ 271 Cam_Exh_1_Locked 0;
BA_ "GenSigTimeoutTime_ECM" SG_ 271 Cam_Exh_1_Locked 0;
BA_ "GenSigTimeoutTime_EVCU2" SG_ 271 Cam_Exh_1_Locked 0;
BA_ "GenSigTimeoutTime_GNMM" SG_ 271 Cam_Exh_1_Locked 0;
BA_ "GenSigTimeoutTime_HCP" SG_ 271 Cam_Exh_1_Locked 0;
BA_ "GenSigTimeoutTime_IPC" SG_ 271 Cam_Exh_1_Locked 0;
BA_ "GenSigTimeoutTime_RFHM" SG_ 271 Cam_Exh_1_Locked 0;
BA_ "GenSigTimeoutTime_SGW" SG_ 271 Cam_Exh_1_Locked 0;
BA_ "GenSigTimeoutTime_TCM" SG_ 271 Cam_Exh_1_Locked 0;
BA_ "GenSigTimeoutTime_AGSM" SG_ 271 Cam_Exh_2_Locked 0;
BA_ "GenSigTimeoutTime_BCM" SG_ 271 Cam_Exh_2_Locked 0;
BA_ "GenSigTimeoutTime_BSM" SG_ 271 Cam_Exh_2_Locked 0;
BA_ "GenSigTimeoutTime_CADM" SG_ 271 Cam_Exh_2_Locked 0;
BA_ "GenSigTimeoutTime_DMSM" SG_ 271 Cam_Exh_2_Locked 0;
BA_ "GenSigTimeoutTime_DTCM" SG_ 271 Cam_Exh_2_Locked 0;
BA_ "GenSigTimeoutTime_ECM" SG_ 271 Cam_Exh_2_Locked 0;
BA_ "GenSigTimeoutTime_EVCU2" SG_ 271 Cam_Exh_2_Locked 0;
BA_ "GenSigTimeoutTime_GNMM" SG_ 271 Cam_Exh_2_Locked 0;
BA_ "GenSigTimeoutTime_HCP" SG_ 271 Cam_Exh_2_Locked 0;
BA_ "GenSigTimeoutTime_IPC" SG_ 271 Cam_Exh_2_Locked 0;
BA_ "GenSigTimeoutTime_RFHM" SG_ 271 Cam_Exh_2_Locked 0;
BA_ "GenSigTimeoutTime_SGW" SG_ 271 Cam_Exh_2_Locked 0;
BA_ "GenSigTimeoutTime_TCM" SG_ 271 Cam_Exh_2_Locked 0;
BA_ "GenSigTimeoutTime_AGSM" SG_ 271 Cam_Int_1_Locked 0;
BA_ "GenSigTimeoutTime_BCM" SG_ 271 Cam_Int_1_Locked 0;
BA_ "GenSigTimeoutTime_BSM" SG_ 271 Cam_Int_1_Locked 0;
BA_ "GenSigTimeoutTime_CADM" SG_ 271 Cam_Int_1_Locked 0;
BA_ "GenSigTimeoutTime_DMSM" SG_ 271 Cam_Int_1_Locked 0;
BA_ "GenSigTimeoutTime_DTCM" SG_ 271 Cam_Int_1_Locked 0;
BA_ "GenSigTimeoutTime_ECM" SG_ 271 Cam_Int_1_Locked 0;
BA_ "GenSigTimeoutTime_EVCU2" SG_ 271 Cam_Int_1_Locked 0;
BA_ "GenSigTimeoutTime_GNMM" SG_ 271 Cam_Int_1_Locked 0;
BA_ "GenSigTimeoutTime_HCP" SG_ 271 Cam_Int_1_Locked 0;
BA_ "GenSigTimeoutTime_IPC" SG_ 271 Cam_Int_1_Locked 0;
BA_ "GenSigTimeoutTime_RFHM" SG_ 271 Cam_Int_1_Locked 0;
BA_ "GenSigTimeoutTime_SGW" SG_ 271 Cam_Int_1_Locked 0;
BA_ "GenSigTimeoutTime_TCM" SG_ 271 Cam_Int_1_Locked 0;
BA_ "GenSigTimeoutTime_AGSM" SG_ 271 Cam_Int_2_Locked 0;
BA_ "GenSigTimeoutTime_BCM" SG_ 271 Cam_Int_2_Locked 0;
BA_ "GenSigTimeoutTime_BSM" SG_ 271 Cam_Int_2_Locked 0;
BA_ "GenSigTimeoutTime_CADM" SG_ 271 Cam_Int_2_Locked 0;
BA_ "GenSigTimeoutTime_DMSM" SG_ 271 Cam_Int_2_Locked 0;
BA_ "GenSigTimeoutTime_DTCM" SG_ 271 Cam_Int_2_Locked 0;
BA_ "GenSigTimeoutTime_ECM" SG_ 271 Cam_Int_2_Locked 0;
BA_ "GenSigTimeoutTime_EVCU2" SG_ 271 Cam_Int_2_Locked 0;
BA_ "GenSigTimeoutTime_GNMM" SG_ 271 Cam_Int_2_Locked 0;
BA_ "GenSigTimeoutTime_HCP" SG_ 271 Cam_Int_2_Locked 0;
BA_ "GenSigTimeoutTime_IPC" SG_ 271 Cam_Int_2_Locked 0;
BA_ "GenSigTimeoutTime_RFHM" SG_ 271 Cam_Int_2_Locked 0;
BA_ "GenSigTimeoutTime_SGW" SG_ 271 Cam_Int_2_Locked 0;
BA_ "GenSigTimeoutTime_TCM" SG_ 271 Cam_Int_2_Locked 0;
BA_ "GenSigStartValue" SG_ 271 CmndFlyWheelTorqPotential 938;
BA_ "GenSigTimeoutTime_AGSM" SG_ 271 CmndFlyWheelTorqPotential 0;
BA_ "GenSigTimeoutTime_BCM" SG_ 271 CmndFlyWheelTorqPotential 0;
BA_ "GenSigTimeoutTime_BSM" SG_ 271 CmndFlyWheelTorqPotential 0;
BA_ "GenSigTimeoutTime_CADM" SG_ 271 CmndFlyWheelTorqPotential 0;
BA_ "GenSigTimeoutTime_DMSM" SG_ 271 CmndFlyWheelTorqPotential 0;
BA_ "GenSigTimeoutTime_DTCM" SG_ 271 CmndFlyWheelTorqPotential 0;
BA_ "GenSigTimeoutTime_ECM" SG_ 271 CmndFlyWheelTorqPotential 0;
BA_ "GenSigTimeoutTime_EVCU2" SG_ 271 CmndFlyWheelTorqPotential 0;
BA_ "GenSigTimeoutTime_GNMM" SG_ 271 CmndFlyWheelTorqPotential 0;
BA_ "GenSigTimeoutTime_IPC" SG_ 271 CmndFlyWheelTorqPotential 0;
BA_ "GenSigTimeoutTime_RFHM" SG_ 271 CmndFlyWheelTorqPotential 0;
BA_ "GenSigTimeoutTime_SGW" SG_ 271 CmndFlyWheelTorqPotential 0;
BA_ "GenSigTimeoutTime_TCM" SG_ 271 CmndFlyWheelTorqPotential 0;
BA_ "GenSigStartValue" SG_ 271 CmndFlyWheelTorqPrdtd 938;
BA_ "GenSigTimeoutTime_AGSM" SG_ 271 CmndFlyWheelTorqPrdtd 0;
BA_ "GenSigTimeoutTime_BCM" SG_ 271 CmndFlyWheelTorqPrdtd 0;
BA_ "GenSigTimeoutTime_BSM" SG_ 271 CmndFlyWheelTorqPrdtd 0;
BA_ "GenSigTimeoutTime_CADM" SG_ 271 CmndFlyWheelTorqPrdtd 0;
BA_ "GenSigTimeoutTime_DMSM" SG_ 271 CmndFlyWheelTorqPrdtd 0;
BA_ "GenSigTimeoutTime_DTCM" SG_ 271 CmndFlyWheelTorqPrdtd 0;
BA_ "GenSigTimeoutTime_ECM" SG_ 271 CmndFlyWheelTorqPrdtd 0;
BA_ "GenSigTimeoutTime_EVCU2" SG_ 271 CmndFlyWheelTorqPrdtd 0;
BA_ "GenSigTimeoutTime_GNMM" SG_ 271 CmndFlyWheelTorqPrdtd 0;
BA_ "GenSigTimeoutTime_IPC" SG_ 271 CmndFlyWheelTorqPrdtd 0;
BA_ "GenSigTimeoutTime_RFHM" SG_ 271 CmndFlyWheelTorqPrdtd 0;
BA_ "GenSigTimeoutTime_SGW" SG_ 271 CmndFlyWheelTorqPrdtd 0;
BA_ "GenSigTimeoutTime_TCM" SG_ 271 CmndFlyWheelTorqPrdtd 0;
BA_ "GenSigTimeoutTime_AGSM" SG_ 271 CmndFlyWheelTorqRespTyp 0;
BA_ "GenSigTimeoutTime_BCM" SG_ 271 CmndFlyWheelTorqRespTyp 0;
BA_ "GenSigTimeoutTime_BSM" SG_ 271 CmndFlyWheelTorqRespTyp 0;
BA_ "GenSigTimeoutTime_CADM" SG_ 271 CmndFlyWheelTorqRespTyp 0;
BA_ "GenSigTimeoutTime_DMSM" SG_ 271 CmndFlyWheelTorqRespTyp 0;
BA_ "GenSigTimeoutTime_DTCM" SG_ 271 CmndFlyWheelTorqRespTyp 0;
BA_ "GenSigTimeoutTime_ECM" SG_ 271 CmndFlyWheelTorqRespTyp 0;
BA_ "GenSigTimeoutTime_EVCU2" SG_ 271 CmndFlyWheelTorqRespTyp 0;
BA_ "GenSigTimeoutTime_GNMM" SG_ 271 CmndFlyWheelTorqRespTyp 0;
BA_ "GenSigTimeoutTime_IPC" SG_ 271 CmndFlyWheelTorqRespTyp 0;
BA_ "GenSigTimeoutTime_RFHM" SG_ 271 CmndFlyWheelTorqRespTyp 0;
BA_ "GenSigTimeoutTime_SGW" SG_ 271 CmndFlyWheelTorqRespTyp 0;
BA_ "GenSigTimeoutTime_TCM" SG_ 271 CmndFlyWheelTorqRespTyp 0;
BA_ "GenSigTimeoutTime_AGSM" SG_ 271 Crank_Locked 0;
BA_ "GenSigTimeoutTime_BCM" SG_ 271 Crank_Locked 0;
BA_ "GenSigTimeoutTime_BSM" SG_ 271 Crank_Locked 0;
BA_ "GenSigTimeoutTime_CADM" SG_ 271 Crank_Locked 0;
BA_ "GenSigTimeoutTime_DMSM" SG_ 271 Crank_Locked 0;
BA_ "GenSigTimeoutTime_DTCM" SG_ 271 Crank_Locked 0;
BA_ "GenSigTimeoutTime_ECM" SG_ 271 Crank_Locked 0;
BA_ "GenSigTimeoutTime_EVCU2" SG_ 271 Crank_Locked 0;
BA_ "GenSigTimeoutTime_GNMM" SG_ 271 Crank_Locked 0;
BA_ "GenSigTimeoutTime_HCP" SG_ 271 Crank_Locked 0;
BA_ "GenSigTimeoutTime_IPC" SG_ 271 Crank_Locked 0;
BA_ "GenSigTimeoutTime_RFHM" SG_ 271 Crank_Locked 0;
BA_ "GenSigTimeoutTime_SGW" SG_ 271 Crank_Locked 0;
BA_ "GenSigTimeoutTime_TCM" SG_ 271 Crank_Locked 0;
BA_ "GenSigTimeoutTime_AGSM" SG_ 271 Crank_Maturing_Fault 0;
BA_ "GenSigTimeoutTime_BCM" SG_ 271 Crank_Maturing_Fault 0;
BA_ "GenSigTimeoutTime_BSM" SG_ 271 Crank_Maturing_Fault 0;
BA_ "GenSigTimeoutTime_CADM" SG_ 271 Crank_Maturing_Fault 0;
BA_ "GenSigTimeoutTime_DMSM" SG_ 271 Crank_Maturing_Fault 0;
BA_ "GenSigTimeoutTime_DTCM" SG_ 271 Crank_Maturing_Fault 0;
BA_ "GenSigTimeoutTime_ECM" SG_ 271 Crank_Maturing_Fault 0;
BA_ "GenSigTimeoutTime_EVCU2" SG_ 271 Crank_Maturing_Fault 0;
BA_ "GenSigTimeoutTime_GNMM" SG_ 271 Crank_Maturing_Fault 0;
BA_ "GenSigTimeoutTime_HCP" SG_ 271 Crank_Maturing_Fault 0;
BA_ "GenSigTimeoutTime_IPC" SG_ 271 Crank_Maturing_Fault 0;
BA_ "GenSigTimeoutTime_RFHM" SG_ 271 Crank_Maturing_Fault 0;
BA_ "GenSigTimeoutTime_SGW" SG_ 271 Crank_Maturing_Fault 0;
BA_ "GenSigTimeoutTime_TCM" SG_ 271 Crank_Maturing_Fault 0;
BA_ "GenSigTimeoutTime_AGSM" SG_ 271 CRC_ENGINE_HYBD_FD_1 0;
BA_ "GenSigTimeoutTime_BCM" SG_ 271 CRC_ENGINE_HYBD_FD_1 0;
BA_ "GenSigTimeoutTime_BSM" SG_ 271 CRC_ENGINE_HYBD_FD_1 0;
BA_ "GenSigTimeoutTime_CADM" SG_ 271 CRC_ENGINE_HYBD_FD_1 0;
BA_ "GenSigTimeoutTime_DMSM" SG_ 271 CRC_ENGINE_HYBD_FD_1 0;
BA_ "GenSigTimeoutTime_DTCM" SG_ 271 CRC_ENGINE_HYBD_FD_1 0;
BA_ "GenSigTimeoutTime_ECM" SG_ 271 CRC_ENGINE_HYBD_FD_1 0;
BA_ "GenSigTimeoutTime_EVCU2" SG_ 271 CRC_ENGINE_HYBD_FD_1 0;
BA_ "GenSigTimeoutTime_GNMM" SG_ 271 CRC_ENGINE_HYBD_FD_1 0;
BA_ "GenSigTimeoutTime_IPC" SG_ 271 CRC_ENGINE_HYBD_FD_1 0;
BA_ "GenSigTimeoutTime_RFHM" SG_ 271 CRC_ENGINE_HYBD_FD_1 0;
BA_ "GenSigTimeoutTime_SGW" SG_ 271 CRC_ENGINE_HYBD_FD_1 0;
BA_ "GenSigTimeoutTime_AGSM" SG_ 271 CylOff 0;
BA_ "GenSigTimeoutTime_BCM" SG_ 271 CylOff 0;
BA_ "GenSigTimeoutTime_BSM" SG_ 271 CylOff 0;
BA_ "GenSigTimeoutTime_CADM" SG_ 271 CylOff 0;
BA_ "GenSigTimeoutTime_DMSM" SG_ 271 CylOff 0;
BA_ "GenSigTimeoutTime_DTCM" SG_ 271 CylOff 0;
BA_ "GenSigTimeoutTime_ECM" SG_ 271 CylOff 0;
BA_ "GenSigTimeoutTime_GNMM" SG_ 271 CylOff 0;
BA_ "GenSigTimeoutTime_IPC" SG_ 271 CylOff 0;
BA_ "GenSigTimeoutTime_RFHM" SG_ 271 CylOff 0;
BA_ "GenSigTimeoutTime_SGW" SG_ 271 CylOff 0;
BA_ "GenSigTimeoutTime_TCM" SG_ 271 CylOff 0;
BA_ "GenSigStartValue" SG_ 271 DrvrIntndedFlyWheelTorq 938;
BA_ "GenSigTimeoutTime_AGSM" SG_ 271 DrvrIntndedFlyWheelTorq 0;
BA_ "GenSigTimeoutTime_BCM" SG_ 271 DrvrIntndedFlyWheelTorq 0;
BA_ "GenSigTimeoutTime_BSM" SG_ 271 DrvrIntndedFlyWheelTorq 0;
BA_ "GenSigTimeoutTime_CADM" SG_ 271 DrvrIntndedFlyWheelTorq 0;
BA_ "GenSigTimeoutTime_DMSM" SG_ 271 DrvrIntndedFlyWheelTorq 0;
BA_ "GenSigTimeoutTime_DTCM" SG_ 271 DrvrIntndedFlyWheelTorq 0;
BA_ "GenSigTimeoutTime_ECM" SG_ 271 DrvrIntndedFlyWheelTorq 0;
BA_ "GenSigTimeoutTime_EVCU2" SG_ 271 DrvrIntndedFlyWheelTorq 0;
BA_ "GenSigTimeoutTime_GNMM" SG_ 271 DrvrIntndedFlyWheelTorq 0;
BA_ "GenSigTimeoutTime_IPC" SG_ 271 DrvrIntndedFlyWheelTorq 0;
BA_ "GenSigTimeoutTime_RFHM" SG_ 271 DrvrIntndedFlyWheelTorq 0;
BA_ "GenSigTimeoutTime_SGW" SG_ 271 DrvrIntndedFlyWheelTorq 0;
BA_ "GenSigTimeoutTime_TCM" SG_ 271 DrvrIntndedFlyWheelTorq 0;
BA_ "GenSigStartValue" SG_ 271 DrvrIntndedFlyWheelTorqRaw 938;
BA_ "GenSigTimeoutTime_AGSM" SG_ 271 DrvrIntndedFlyWheelTorqRaw 0;
BA_ "GenSigTimeoutTime_BCM" SG_ 271 DrvrIntndedFlyWheelTorqRaw 0;
BA_ "GenSigTimeoutTime_BSM" SG_ 271 DrvrIntndedFlyWheelTorqRaw 0;
BA_ "GenSigTimeoutTime_CADM" SG_ 271 DrvrIntndedFlyWheelTorqRaw 0;
BA_ "GenSigTimeoutTime_DMSM" SG_ 271 DrvrIntndedFlyWheelTorqRaw 0;
BA_ "GenSigTimeoutTime_DTCM" SG_ 271 DrvrIntndedFlyWheelTorqRaw 0;
BA_ "GenSigTimeoutTime_ECM" SG_ 271 DrvrIntndedFlyWheelTorqRaw 0;
BA_ "GenSigTimeoutTime_EVCU2" SG_ 271 DrvrIntndedFlyWheelTorqRaw 0;
BA_ "GenSigTimeoutTime_GNMM" SG_ 271 DrvrIntndedFlyWheelTorqRaw 0;
BA_ "GenSigTimeoutTime_IPC" SG_ 271 DrvrIntndedFlyWheelTorqRaw 0;
BA_ "GenSigTimeoutTime_RFHM" SG_ 271 DrvrIntndedFlyWheelTorqRaw 0;
BA_ "GenSigTimeoutTime_SGW" SG_ 271 DrvrIntndedFlyWheelTorqRaw 0;
BA_ "GenSigTimeoutTime_TCM" SG_ 271 DrvrIntndedFlyWheelTorqRaw 0;
BA_ "GenSigTimeoutTime_AGSM" SG_ 271 DrvrIntndedFlyWheelTorqRawV 0;
BA_ "GenSigTimeoutTime_BCM" SG_ 271 DrvrIntndedFlyWheelTorqRawV 0;
BA_ "GenSigTimeoutTime_BSM" SG_ 271 DrvrIntndedFlyWheelTorqRawV 0;
BA_ "GenSigTimeoutTime_CADM" SG_ 271 DrvrIntndedFlyWheelTorqRawV 0;
BA_ "GenSigTimeoutTime_DMSM" SG_ 271 DrvrIntndedFlyWheelTorqRawV 0;
BA_ "GenSigTimeoutTime_DTCM" SG_ 271 DrvrIntndedFlyWheelTorqRawV 0;
BA_ "GenSigTimeoutTime_ECM" SG_ 271 DrvrIntndedFlyWheelTorqRawV 0;
BA_ "GenSigTimeoutTime_EVCU2" SG_ 271 DrvrIntndedFlyWheelTorqRawV 0;
BA_ "GenSigTimeoutTime_GNMM" SG_ 271 DrvrIntndedFlyWheelTorqRawV 0;
BA_ "GenSigTimeoutTime_IPC" SG_ 271 DrvrIntndedFlyWheelTorqRawV 0;
BA_ "GenSigTimeoutTime_RFHM" SG_ 271 DrvrIntndedFlyWheelTorqRawV 0;
BA_ "GenSigTimeoutTime_SGW" SG_ 271 DrvrIntndedFlyWheelTorqRawV 0;
BA_ "GenSigTimeoutTime_TCM" SG_ 271 DrvrIntndedFlyWheelTorqRawV 0;
BA_ "GenSigTimeoutTime_AGSM" SG_ 271 DrvrIntndedFlyWheelTorqV 0;
BA_ "GenSigTimeoutTime_BCM" SG_ 271 DrvrIntndedFlyWheelTorqV 0;
BA_ "GenSigTimeoutTime_BSM" SG_ 271 DrvrIntndedFlyWheelTorqV 0;
BA_ "GenSigTimeoutTime_CADM" SG_ 271 DrvrIntndedFlyWheelTorqV 0;
BA_ "GenSigTimeoutTime_DMSM" SG_ 271 DrvrIntndedFlyWheelTorqV 0;
BA_ "GenSigTimeoutTime_DTCM" SG_ 271 DrvrIntndedFlyWheelTorqV 0;
BA_ "GenSigTimeoutTime_ECM" SG_ 271 DrvrIntndedFlyWheelTorqV 0;
BA_ "GenSigTimeoutTime_EVCU2" SG_ 271 DrvrIntndedFlyWheelTorqV 0;
BA_ "GenSigTimeoutTime_GNMM" SG_ 271 DrvrIntndedFlyWheelTorqV 0;
BA_ "GenSigTimeoutTime_IPC" SG_ 271 DrvrIntndedFlyWheelTorqV 0;
BA_ "GenSigTimeoutTime_RFHM" SG_ 271 DrvrIntndedFlyWheelTorqV 0;
BA_ "GenSigTimeoutTime_SGW" SG_ 271 DrvrIntndedFlyWheelTorqV 0;
BA_ "GenSigTimeoutTime_TCM" SG_ 271 DrvrIntndedFlyWheelTorqV 0;
BA_ "GenSigTimeoutTime_AGSM" SG_ 271 ECM_Crank_Phase 0;
BA_ "GenSigTimeoutTime_BCM" SG_ 271 ECM_Crank_Phase 0;
BA_ "GenSigTimeoutTime_BSM" SG_ 271 ECM_Crank_Phase 0;
BA_ "GenSigTimeoutTime_CADM" SG_ 271 ECM_Crank_Phase 0;
BA_ "GenSigTimeoutTime_DMSM" SG_ 271 ECM_Crank_Phase 0;
BA_ "GenSigTimeoutTime_DTCM" SG_ 271 ECM_Crank_Phase 0;
BA_ "GenSigTimeoutTime_ECM" SG_ 271 ECM_Crank_Phase 0;
BA_ "GenSigTimeoutTime_EVCU2" SG_ 271 ECM_Crank_Phase 0;
BA_ "GenSigTimeoutTime_GNMM" SG_ 271 ECM_Crank_Phase 0;
BA_ "GenSigTimeoutTime_IPC" SG_ 271 ECM_Crank_Phase 0;
BA_ "GenSigTimeoutTime_RFHM" SG_ 271 ECM_Crank_Phase 0;
BA_ "GenSigTimeoutTime_SGW" SG_ 271 ECM_Crank_Phase 0;
BA_ "GenSigTimeoutTime_TCM" SG_ 271 ECM_Crank_Phase 0;
BA_ "GenSigTimeoutTime_AGSM" SG_ 271 ECM_VTD_Freeze 0;
BA_ "GenSigTimeoutTime_BCM" SG_ 271 ECM_VTD_Freeze 0;
BA_ "GenSigTimeoutTime_BSM" SG_ 271 ECM_VTD_Freeze 0;
BA_ "GenSigTimeoutTime_CADM" SG_ 271 ECM_VTD_Freeze 0;
BA_ "GenSigTimeoutTime_DMSM" SG_ 271 ECM_VTD_Freeze 0;
BA_ "GenSigTimeoutTime_DTCM" SG_ 271 ECM_VTD_Freeze 0;
BA_ "GenSigTimeoutTime_ECM" SG_ 271 ECM_VTD_Freeze 0;
BA_ "GenSigTimeoutTime_GNMM" SG_ 271 ECM_VTD_Freeze 0;
BA_ "GenSigTimeoutTime_HCP" SG_ 271 ECM_VTD_Freeze 0;
BA_ "GenSigTimeoutTime_IPC" SG_ 271 ECM_VTD_Freeze 0;
BA_ "GenSigTimeoutTime_RFHM" SG_ 271 ECM_VTD_Freeze 0;
BA_ "GenSigTimeoutTime_SGW" SG_ 271 ECM_VTD_Freeze 0;
BA_ "GenSigTimeoutTime_TCM" SG_ 271 ECM_VTD_Freeze 0;
BA_ "GenSigTimeoutTime_AGSM" SG_ 271 ECMReq_Remedial_Stop 0;
BA_ "GenSigTimeoutTime_BCM" SG_ 271 ECMReq_Remedial_Stop 0;
BA_ "GenSigTimeoutTime_BSM" SG_ 271 ECMReq_Remedial_Stop 0;
BA_ "GenSigTimeoutTime_CADM" SG_ 271 ECMReq_Remedial_Stop 0;
BA_ "GenSigTimeoutTime_DMSM" SG_ 271 ECMReq_Remedial_Stop 0;
BA_ "GenSigTimeoutTime_DTCM" SG_ 271 ECMReq_Remedial_Stop 0;
BA_ "GenSigTimeoutTime_ECM" SG_ 271 ECMReq_Remedial_Stop 0;
BA_ "GenSigTimeoutTime_GNMM" SG_ 271 ECMReq_Remedial_Stop 0;
BA_ "GenSigTimeoutTime_HCP" SG_ 271 ECMReq_Remedial_Stop 0;
BA_ "GenSigTimeoutTime_IPC" SG_ 271 ECMReq_Remedial_Stop 0;
BA_ "GenSigTimeoutTime_RFHM" SG_ 271 ECMReq_Remedial_Stop 0;
BA_ "GenSigTimeoutTime_SGW" SG_ 271 ECMReq_Remedial_Stop 0;
BA_ "GenSigTimeoutTime_TCM" SG_ 271 ECMReq_Remedial_Stop 0;
BA_ "GenSigTimeoutTime_AGSM" SG_ 271 ECU_A2D_Failure 0;
BA_ "GenSigTimeoutTime_BCM" SG_ 271 ECU_A2D_Failure 0;
BA_ "GenSigTimeoutTime_BSM" SG_ 271 ECU_A2D_Failure 0;
BA_ "GenSigTimeoutTime_CADM" SG_ 271 ECU_A2D_Failure 0;
BA_ "GenSigTimeoutTime_DMSM" SG_ 271 ECU_A2D_Failure 0;
BA_ "GenSigTimeoutTime_DTCM" SG_ 271 ECU_A2D_Failure 0;
BA_ "GenSigTimeoutTime_ECM" SG_ 271 ECU_A2D_Failure 0;
BA_ "GenSigTimeoutTime_EVCU2" SG_ 271 ECU_A2D_Failure 0;
BA_ "GenSigTimeoutTime_GNMM" SG_ 271 ECU_A2D_Failure 0;
BA_ "GenSigTimeoutTime_IPC" SG_ 271 ECU_A2D_Failure 0;
BA_ "GenSigTimeoutTime_RFHM" SG_ 271 ECU_A2D_Failure 0;
BA_ "GenSigTimeoutTime_SGW" SG_ 271 ECU_A2D_Failure 0;
BA_ "GenSigTimeoutTime_TCM" SG_ 271 ECU_A2D_Failure 0;
BA_ "GenSigStartValue" SG_ 271 EngActStdyStTorq 938;
BA_ "GenSigTimeoutTime_AGSM" SG_ 271 EngActStdyStTorq 0;
BA_ "GenSigTimeoutTime_BCM" SG_ 271 EngActStdyStTorq 0;
BA_ "GenSigTimeoutTime_BSM" SG_ 271 EngActStdyStTorq 0;
BA_ "GenSigTimeoutTime_CADM" SG_ 271 EngActStdyStTorq 0;
BA_ "GenSigTimeoutTime_DMSM" SG_ 271 EngActStdyStTorq 0;
BA_ "GenSigTimeoutTime_DTCM" SG_ 271 EngActStdyStTorq 0;
BA_ "GenSigTimeoutTime_ECM" SG_ 271 EngActStdyStTorq 0;
BA_ "GenSigTimeoutTime_EVCU2" SG_ 271 EngActStdyStTorq 0;
BA_ "GenSigTimeoutTime_GNMM" SG_ 271 EngActStdyStTorq 0;
BA_ "GenSigTimeoutTime_IPC" SG_ 271 EngActStdyStTorq 0;
BA_ "GenSigTimeoutTime_RFHM" SG_ 271 EngActStdyStTorq 0;
BA_ "GenSigTimeoutTime_SGW" SG_ 271 EngActStdyStTorq 0;
BA_ "GenSigTimeoutTime_TCM" SG_ 271 EngActStdyStTorq 0;
BA_ "GenSigTimeoutTime_AGSM" SG_ 271 EngActStdyStTorqV 0;
BA_ "GenSigTimeoutTime_BCM" SG_ 271 EngActStdyStTorqV 0;
BA_ "GenSigTimeoutTime_BSM" SG_ 271 EngActStdyStTorqV 0;
BA_ "GenSigTimeoutTime_CADM" SG_ 271 EngActStdyStTorqV 0;
BA_ "GenSigTimeoutTime_DMSM" SG_ 271 EngActStdyStTorqV 0;
BA_ "GenSigTimeoutTime_DTCM" SG_ 271 EngActStdyStTorqV 0;
BA_ "GenSigTimeoutTime_ECM" SG_ 271 EngActStdyStTorqV 0;
BA_ "GenSigTimeoutTime_EVCU2" SG_ 271 EngActStdyStTorqV 0;
BA_ "GenSigTimeoutTime_GNMM" SG_ 271 EngActStdyStTorqV 0;
BA_ "GenSigTimeoutTime_IPC" SG_ 271 EngActStdyStTorqV 0;
BA_ "GenSigTimeoutTime_RFHM" SG_ 271 EngActStdyStTorqV 0;
BA_ "GenSigTimeoutTime_SGW" SG_ 271 EngActStdyStTorqV 0;
BA_ "GenSigTimeoutTime_TCM" SG_ 271 EngActStdyStTorqV 0;
BA_ "GenSigTimeoutTime_AGSM" SG_ 271 EngActuatorsStat 0;
BA_ "GenSigTimeoutTime_BCM" SG_ 271 EngActuatorsStat 0;
BA_ "GenSigTimeoutTime_BSM" SG_ 271 EngActuatorsStat 0;
BA_ "GenSigTimeoutTime_CADM" SG_ 271 EngActuatorsStat 0;
BA_ "GenSigTimeoutTime_DMSM" SG_ 271 EngActuatorsStat 0;
BA_ "GenSigTimeoutTime_DTCM" SG_ 271 EngActuatorsStat 0;
BA_ "GenSigTimeoutTime_ECM" SG_ 271 EngActuatorsStat 0;
BA_ "GenSigTimeoutTime_EVCU2" SG_ 271 EngActuatorsStat 0;
BA_ "GenSigTimeoutTime_GNMM" SG_ 271 EngActuatorsStat 0;
BA_ "GenSigTimeoutTime_IPC" SG_ 271 EngActuatorsStat 0;
BA_ "GenSigTimeoutTime_RFHM" SG_ 271 EngActuatorsStat 0;
BA_ "GenSigTimeoutTime_SGW" SG_ 271 EngActuatorsStat 0;
BA_ "GenSigTimeoutTime_TCM" SG_ 271 EngActuatorsStat 0;
BA_ "GenSigStartValue" SG_ 271 EngAirFlwStdyStTorq 938;
BA_ "GenSigTimeoutTime_AGSM" SG_ 271 EngAirFlwStdyStTorq 0;
BA_ "GenSigTimeoutTime_BCM" SG_ 271 EngAirFlwStdyStTorq 0;
BA_ "GenSigTimeoutTime_BSM" SG_ 271 EngAirFlwStdyStTorq 0;
BA_ "GenSigTimeoutTime_CADM" SG_ 271 EngAirFlwStdyStTorq 0;
BA_ "GenSigTimeoutTime_DMSM" SG_ 271 EngAirFlwStdyStTorq 0;
BA_ "GenSigTimeoutTime_DTCM" SG_ 271 EngAirFlwStdyStTorq 0;
BA_ "GenSigTimeoutTime_ECM" SG_ 271 EngAirFlwStdyStTorq 0;
BA_ "GenSigTimeoutTime_EVCU2" SG_ 271 EngAirFlwStdyStTorq 0;
BA_ "GenSigTimeoutTime_GNMM" SG_ 271 EngAirFlwStdyStTorq 0;
BA_ "GenSigTimeoutTime_IPC" SG_ 271 EngAirFlwStdyStTorq 0;
BA_ "GenSigTimeoutTime_RFHM" SG_ 271 EngAirFlwStdyStTorq 0;
BA_ "GenSigTimeoutTime_SGW" SG_ 271 EngAirFlwStdyStTorq 0;
BA_ "GenSigTimeoutTime_TCM" SG_ 271 EngAirFlwStdyStTorq 0;
BA_ "GenSigTimeoutTime_AGSM" SG_ 271 EngAirFlwStdyStTorqV 0;
BA_ "GenSigTimeoutTime_BCM" SG_ 271 EngAirFlwStdyStTorqV 0;
BA_ "GenSigTimeoutTime_BSM" SG_ 271 EngAirFlwStdyStTorqV 0;
BA_ "GenSigTimeoutTime_CADM" SG_ 271 EngAirFlwStdyStTorqV 0;
BA_ "GenSigTimeoutTime_DMSM" SG_ 271 EngAirFlwStdyStTorqV 0;
BA_ "GenSigTimeoutTime_DTCM" SG_ 271 EngAirFlwStdyStTorqV 0;
BA_ "GenSigTimeoutTime_ECM" SG_ 271 EngAirFlwStdyStTorqV 0;
BA_ "GenSigTimeoutTime_EVCU2" SG_ 271 EngAirFlwStdyStTorqV 0;
BA_ "GenSigTimeoutTime_GNMM" SG_ 271 EngAirFlwStdyStTorqV 0;
BA_ "GenSigTimeoutTime_IPC" SG_ 271 EngAirFlwStdyStTorqV 0;
BA_ "GenSigTimeoutTime_RFHM" SG_ 271 EngAirFlwStdyStTorqV 0;
BA_ "GenSigTimeoutTime_SGW" SG_ 271 EngAirFlwStdyStTorqV 0;
BA_ "GenSigTimeoutTime_TCM" SG_ 271 EngAirFlwStdyStTorqV 0;
BA_ "GenSigTimeoutTime_AGSM" SG_ 271 EngCmbstnCmnd 0;
BA_ "GenSigTimeoutTime_BCM" SG_ 271 EngCmbstnCmnd 0;
BA_ "GenSigTimeoutTime_BSM" SG_ 271 EngCmbstnCmnd 0;
BA_ "GenSigTimeoutTime_CADM" SG_ 271 EngCmbstnCmnd 0;
BA_ "GenSigTimeoutTime_DMSM" SG_ 271 EngCmbstnCmnd 0;
BA_ "GenSigTimeoutTime_DTCM" SG_ 271 EngCmbstnCmnd 0;
BA_ "GenSigTimeoutTime_ECM" SG_ 271 EngCmbstnCmnd 0;
BA_ "GenSigTimeoutTime_GNMM" SG_ 271 EngCmbstnCmnd 0;
BA_ "GenSigTimeoutTime_IPC" SG_ 271 EngCmbstnCmnd 0;
BA_ "GenSigTimeoutTime_RFHM" SG_ 271 EngCmbstnCmnd 0;
BA_ "GenSigTimeoutTime_SGW" SG_ 271 EngCmbstnCmnd 0;
BA_ "GenSigTimeoutTime_TCM" SG_ 271 EngCmbstnCmnd 0;
BA_ "GenSigTimeoutTime_AGSM" SG_ 271 EngCylDeactEnCondMet 0;
BA_ "GenSigTimeoutTime_BCM" SG_ 271 EngCylDeactEnCondMet 0;
BA_ "GenSigTimeoutTime_BSM" SG_ 271 EngCylDeactEnCondMet 0;
BA_ "GenSigTimeoutTime_CADM" SG_ 271 EngCylDeactEnCondMet 0;
BA_ "GenSigTimeoutTime_DMSM" SG_ 271 EngCylDeactEnCondMet 0;
BA_ "GenSigTimeoutTime_DTCM" SG_ 271 EngCylDeactEnCondMet 0;
BA_ "GenSigTimeoutTime_ECM" SG_ 271 EngCylDeactEnCondMet 0;
BA_ "GenSigTimeoutTime_EVCU2" SG_ 271 EngCylDeactEnCondMet 0;
BA_ "GenSigTimeoutTime_GNMM" SG_ 271 EngCylDeactEnCondMet 0;
BA_ "GenSigTimeoutTime_IPC" SG_ 271 EngCylDeactEnCondMet 0;
BA_ "GenSigTimeoutTime_RFHM" SG_ 271 EngCylDeactEnCondMet 0;
BA_ "GenSigTimeoutTime_SGW" SG_ 271 EngCylDeactEnCondMet 0;
BA_ "GenSigTimeoutTime_TCM" SG_ 271 EngCylDeactEnCondMet 0;
BA_ "GenSigTimeoutTime_AGSM" SG_ 271 EngCylDeactMd 0;
BA_ "GenSigTimeoutTime_BCM" SG_ 271 EngCylDeactMd 0;
BA_ "GenSigTimeoutTime_BSM" SG_ 271 EngCylDeactMd 0;
BA_ "GenSigTimeoutTime_CADM" SG_ 271 EngCylDeactMd 0;
BA_ "GenSigTimeoutTime_DMSM" SG_ 271 EngCylDeactMd 0;
BA_ "GenSigTimeoutTime_DTCM" SG_ 271 EngCylDeactMd 0;
BA_ "GenSigTimeoutTime_ECM" SG_ 271 EngCylDeactMd 0;
BA_ "GenSigTimeoutTime_EVCU2" SG_ 271 EngCylDeactMd 0;
BA_ "GenSigTimeoutTime_GNMM" SG_ 271 EngCylDeactMd 0;
BA_ "GenSigTimeoutTime_IPC" SG_ 271 EngCylDeactMd 0;
BA_ "GenSigTimeoutTime_RFHM" SG_ 271 EngCylDeactMd 0;
BA_ "GenSigTimeoutTime_SGW" SG_ 271 EngCylDeactMd 0;
BA_ "GenSigTimeoutTime_TCM" SG_ 271 EngCylDeactMd 0;
BA_ "GenSigTimeoutTime_AGSM" SG_ 271 EngDFCO_Allw 0;
BA_ "GenSigTimeoutTime_BCM" SG_ 271 EngDFCO_Allw 0;
BA_ "GenSigTimeoutTime_BSM" SG_ 271 EngDFCO_Allw 0;
BA_ "GenSigTimeoutTime_CADM" SG_ 271 EngDFCO_Allw 0;
BA_ "GenSigTimeoutTime_DMSM" SG_ 271 EngDFCO_Allw 0;
BA_ "GenSigTimeoutTime_DTCM" SG_ 271 EngDFCO_Allw 0;
BA_ "GenSigTimeoutTime_ECM" SG_ 271 EngDFCO_Allw 0;
BA_ "GenSigTimeoutTime_GNMM" SG_ 271 EngDFCO_Allw 0;
BA_ "GenSigTimeoutTime_IPC" SG_ 271 EngDFCO_Allw 0;
BA_ "GenSigTimeoutTime_RFHM" SG_ 271 EngDFCO_Allw 0;
BA_ "GenSigTimeoutTime_SGW" SG_ 271 EngDFCO_Allw 0;
BA_ "GenSigTimeoutTime_TCM" SG_ 271 EngDFCO_Allw 0;
BA_ "GenSigTimeoutTime_AGSM" SG_ 271 EngDFCO_Req 0;
BA_ "GenSigTimeoutTime_BCM" SG_ 271 EngDFCO_Req 0;
BA_ "GenSigTimeoutTime_BSM" SG_ 271 EngDFCO_Req 0;
BA_ "GenSigTimeoutTime_CADM" SG_ 271 EngDFCO_Req 0;
BA_ "GenSigTimeoutTime_DMSM" SG_ 271 EngDFCO_Req 0;
BA_ "GenSigTimeoutTime_DTCM" SG_ 271 EngDFCO_Req 0;
BA_ "GenSigTimeoutTime_ECM" SG_ 271 EngDFCO_Req 0;
BA_ "GenSigTimeoutTime_GNMM" SG_ 271 EngDFCO_Req 0;
BA_ "GenSigTimeoutTime_IPC" SG_ 271 EngDFCO_Req 0;
BA_ "GenSigTimeoutTime_RFHM" SG_ 271 EngDFCO_Req 0;
BA_ "GenSigTimeoutTime_SGW" SG_ 271 EngDFCO_Req 0;
BA_ "GenSigTimeoutTime_TCM" SG_ 271 EngDFCO_Req 0;
BA_ "GenSigTimeoutTime_AGSM" SG_ 271 EngDFCO_St 0;
BA_ "GenSigTimeoutTime_BCM" SG_ 271 EngDFCO_St 0;
BA_ "GenSigTimeoutTime_BSM" SG_ 271 EngDFCO_St 0;
BA_ "GenSigTimeoutTime_CADM" SG_ 271 EngDFCO_St 0;
BA_ "GenSigTimeoutTime_DMSM" SG_ 271 EngDFCO_St 0;
BA_ "GenSigTimeoutTime_DTCM" SG_ 271 EngDFCO_St 0;
BA_ "GenSigTimeoutTime_ECM" SG_ 271 EngDFCO_St 0;
BA_ "GenSigTimeoutTime_GNMM" SG_ 271 EngDFCO_St 0;
BA_ "GenSigTimeoutTime_IPC" SG_ 271 EngDFCO_St 0;
BA_ "GenSigTimeoutTime_RFHM" SG_ 271 EngDFCO_St 0;
BA_ "GenSigTimeoutTime_SGW" SG_ 271 EngDFCO_St 0;
BA_ "GenSigTimeoutTime_TCM" SG_ 271 EngDFCO_St 0;
BA_ "GenSigTimeoutTime_AGSM" SG_ 271 Engine_Sync_720 0;
BA_ "GenSigTimeoutTime_BCM" SG_ 271 Engine_Sync_720 0;
BA_ "GenSigTimeoutTime_BSM" SG_ 271 Engine_Sync_720 0;
BA_ "GenSigTimeoutTime_CADM" SG_ 271 Engine_Sync_720 0;
BA_ "GenSigTimeoutTime_DMSM" SG_ 271 Engine_Sync_720 0;
BA_ "GenSigTimeoutTime_DTCM" SG_ 271 Engine_Sync_720 0;
BA_ "GenSigTimeoutTime_ECM" SG_ 271 Engine_Sync_720 0;
BA_ "GenSigTimeoutTime_EVCU2" SG_ 271 Engine_Sync_720 0;
BA_ "GenSigTimeoutTime_GNMM" SG_ 271 Engine_Sync_720 0;
BA_ "GenSigTimeoutTime_HCP" SG_ 271 Engine_Sync_720 0;
BA_ "GenSigTimeoutTime_IPC" SG_ 271 Engine_Sync_720 0;
BA_ "GenSigTimeoutTime_RFHM" SG_ 271 Engine_Sync_720 0;
BA_ "GenSigTimeoutTime_SGW" SG_ 271 Engine_Sync_720 0;
BA_ "GenSigTimeoutTime_TCM" SG_ 271 Engine_Sync_720 0;
BA_ "GenSigTimeoutTime_AGSM" SG_ 271 EngOffRecom 0;
BA_ "GenSigTimeoutTime_BCM" SG_ 271 EngOffRecom 0;
BA_ "GenSigTimeoutTime_BSM" SG_ 271 EngOffRecom 0;
BA_ "GenSigTimeoutTime_CADM" SG_ 271 EngOffRecom 0;
BA_ "GenSigTimeoutTime_DMSM" SG_ 271 EngOffRecom 0;
BA_ "GenSigTimeoutTime_DTCM" SG_ 271 EngOffRecom 0;
BA_ "GenSigTimeoutTime_ECM" SG_ 271 EngOffRecom 0;
BA_ "GenSigTimeoutTime_GNMM" SG_ 271 EngOffRecom 0;
BA_ "GenSigTimeoutTime_IPC" SG_ 271 EngOffRecom 0;
BA_ "GenSigTimeoutTime_RFHM" SG_ 271 EngOffRecom 0;
BA_ "GenSigTimeoutTime_SGW" SG_ 271 EngOffRecom 0;
BA_ "GenSigTimeoutTime_TCM" SG_ 271 EngOffRecom 0;
BA_ "GenSigTimeoutTime_AGSM" SG_ 271 EngRqStTyp 0;
BA_ "GenSigTimeoutTime_BCM" SG_ 271 EngRqStTyp 0;
BA_ "GenSigTimeoutTime_BSM" SG_ 271 EngRqStTyp 0;
BA_ "GenSigTimeoutTime_CADM" SG_ 271 EngRqStTyp 0;
BA_ "GenSigTimeoutTime_DMSM" SG_ 271 EngRqStTyp 0;
BA_ "GenSigTimeoutTime_DTCM" SG_ 271 EngRqStTyp 0;
BA_ "GenSigTimeoutTime_ECM" SG_ 271 EngRqStTyp 0;
BA_ "GenSigTimeoutTime_EVCU2" SG_ 271 EngRqStTyp 0;
BA_ "GenSigTimeoutTime_GNMM" SG_ 271 EngRqStTyp 0;
BA_ "GenSigTimeoutTime_IPC" SG_ 271 EngRqStTyp 0;
BA_ "GenSigTimeoutTime_RFHM" SG_ 271 EngRqStTyp 0;
BA_ "GenSigTimeoutTime_SGW" SG_ 271 EngRqStTyp 0;
BA_ "GenSigTimeoutTime_TCM" SG_ 271 EngRqStTyp 0;
BA_ "GenSigTimeoutTime_AGSM" SG_ 271 EngRunCrnkAct 0;
BA_ "GenSigTimeoutTime_BCM" SG_ 271 EngRunCrnkAct 0;
BA_ "GenSigTimeoutTime_BSM" SG_ 271 EngRunCrnkAct 0;
BA_ "GenSigTimeoutTime_CADM" SG_ 271 EngRunCrnkAct 0;
BA_ "GenSigTimeoutTime_DMSM" SG_ 271 EngRunCrnkAct 0;
BA_ "GenSigTimeoutTime_DTCM" SG_ 271 EngRunCrnkAct 0;
BA_ "GenSigTimeoutTime_ECM" SG_ 271 EngRunCrnkAct 0;
BA_ "GenSigTimeoutTime_EVCU2" SG_ 271 EngRunCrnkAct 0;
BA_ "GenSigTimeoutTime_GNMM" SG_ 271 EngRunCrnkAct 0;
BA_ "GenSigTimeoutTime_IPC" SG_ 271 EngRunCrnkAct 0;
BA_ "GenSigTimeoutTime_RFHM" SG_ 271 EngRunCrnkAct 0;
BA_ "GenSigTimeoutTime_SGW" SG_ 271 EngRunCrnkAct 0;
BA_ "GenSigTimeoutTime_TCM" SG_ 271 EngRunCrnkAct 0;
BA_ "GenSigTimeoutTime_AGSM" SG_ 271 EngSysFld 0;
BA_ "GenSigTimeoutTime_BCM" SG_ 271 EngSysFld 0;
BA_ "GenSigTimeoutTime_BSM" SG_ 271 EngSysFld 0;
BA_ "GenSigTimeoutTime_CADM" SG_ 271 EngSysFld 0;
BA_ "GenSigTimeoutTime_DMSM" SG_ 271 EngSysFld 0;
BA_ "GenSigTimeoutTime_DTCM" SG_ 271 EngSysFld 0;
BA_ "GenSigTimeoutTime_ECM" SG_ 271 EngSysFld 0;
BA_ "GenSigTimeoutTime_EVCU2" SG_ 271 EngSysFld 0;
BA_ "GenSigTimeoutTime_GNMM" SG_ 271 EngSysFld 0;
BA_ "GenSigTimeoutTime_IPC" SG_ 271 EngSysFld 0;
BA_ "GenSigTimeoutTime_RFHM" SG_ 271 EngSysFld 0;
BA_ "GenSigTimeoutTime_SGW" SG_ 271 EngSysFld 0;
BA_ "GenSigTimeoutTime_TCM" SG_ 271 EngSysFld 0;
BA_ "GenSigTimeoutTime_AGSM" SG_ 271 EngTrqReserveReq 0;
BA_ "GenSigTimeoutTime_BCM" SG_ 271 EngTrqReserveReq 0;
BA_ "GenSigTimeoutTime_BSM" SG_ 271 EngTrqReserveReq 0;
BA_ "GenSigTimeoutTime_CADM" SG_ 271 EngTrqReserveReq 0;
BA_ "GenSigTimeoutTime_DMSM" SG_ 271 EngTrqReserveReq 0;
BA_ "GenSigTimeoutTime_DTCM" SG_ 271 EngTrqReserveReq 0;
BA_ "GenSigTimeoutTime_ECM" SG_ 271 EngTrqReserveReq 0;
BA_ "GenSigTimeoutTime_EVCU2" SG_ 271 EngTrqReserveReq 0;
BA_ "GenSigTimeoutTime_GNMM" SG_ 271 EngTrqReserveReq 0;
BA_ "GenSigTimeoutTime_IPC" SG_ 271 EngTrqReserveReq 0;
BA_ "GenSigTimeoutTime_RFHM" SG_ 271 EngTrqReserveReq 0;
BA_ "GenSigTimeoutTime_SGW" SG_ 271 EngTrqReserveReq 0;
BA_ "GenSigTimeoutTime_TCM" SG_ 271 EngTrqReserveReq 0;
BA_ "GenSigStartValue" SG_ 271 ESS_Engine_State_EE 15;
BA_ "GenSigTimeoutTime_AGSM" SG_ 271 ESS_Engine_State_EE 0;
BA_ "GenSigTimeoutTime_BCM" SG_ 271 ESS_Engine_State_EE 0;
BA_ "GenSigTimeoutTime_BSM" SG_ 271 ESS_Engine_State_EE 0;
BA_ "GenSigTimeoutTime_CADM" SG_ 271 ESS_Engine_State_EE 0;
BA_ "GenSigTimeoutTime_DMSM" SG_ 271 ESS_Engine_State_EE 0;
BA_ "GenSigTimeoutTime_DTCM" SG_ 271 ESS_Engine_State_EE 0;
BA_ "GenSigTimeoutTime_ECM" SG_ 271 ESS_Engine_State_EE 0;
BA_ "GenSigTimeoutTime_GNMM" SG_ 271 ESS_Engine_State_EE 0;
BA_ "GenSigTimeoutTime_IPC" SG_ 271 ESS_Engine_State_EE 0;
BA_ "GenSigTimeoutTime_RFHM" SG_ 271 ESS_Engine_State_EE 0;
BA_ "GenSigTimeoutTime_SGW" SG_ 271 ESS_Engine_State_EE 0;
BA_ "GenSigTimeoutTime_TCM" SG_ 271 ESS_Engine_State_EE 0;
BA_ "GenSigTimeoutTime_AGSM" SG_ 271 ETRQ_Mode 0;
BA_ "GenSigTimeoutTime_BCM" SG_ 271 ETRQ_Mode 0;
BA_ "GenSigTimeoutTime_BSM" SG_ 271 ETRQ_Mode 0;
BA_ "GenSigTimeoutTime_CADM" SG_ 271 ETRQ_Mode 0;
BA_ "GenSigTimeoutTime_DMSM" SG_ 271 ETRQ_Mode 0;
BA_ "GenSigTimeoutTime_DTCM" SG_ 271 ETRQ_Mode 0;
BA_ "GenSigTimeoutTime_ECM" SG_ 271 ETRQ_Mode 0;
BA_ "GenSigTimeoutTime_EVCU2" SG_ 271 ETRQ_Mode 0;
BA_ "GenSigTimeoutTime_GNMM" SG_ 271 ETRQ_Mode 0;
BA_ "GenSigTimeoutTime_IPC" SG_ 271 ETRQ_Mode 0;
BA_ "GenSigTimeoutTime_RFHM" SG_ 271 ETRQ_Mode 0;
BA_ "GenSigTimeoutTime_SGW" SG_ 271 ETRQ_Mode 0;
BA_ "GenSigTimeoutTime_TCM" SG_ 271 ETRQ_Mode 0;
BA_ "GenSigTimeoutTime_AGSM" SG_ 271 Feedback_HCP 0;
BA_ "GenSigTimeoutTime_BCM" SG_ 271 Feedback_HCP 0;
BA_ "GenSigTimeoutTime_BSM" SG_ 271 Feedback_HCP 0;
BA_ "GenSigTimeoutTime_CADM" SG_ 271 Feedback_HCP 0;
BA_ "GenSigTimeoutTime_DMSM" SG_ 271 Feedback_HCP 0;
BA_ "GenSigTimeoutTime_DTCM" SG_ 271 Feedback_HCP 0;
BA_ "GenSigTimeoutTime_ECM" SG_ 271 Feedback_HCP 0;
BA_ "GenSigTimeoutTime_EVCU2" SG_ 271 Feedback_HCP 0;
BA_ "GenSigTimeoutTime_GNMM" SG_ 271 Feedback_HCP 0;
BA_ "GenSigTimeoutTime_IPC" SG_ 271 Feedback_HCP 0;
BA_ "GenSigTimeoutTime_RFHM" SG_ 271 Feedback_HCP 0;
BA_ "GenSigTimeoutTime_SGW" SG_ 271 Feedback_HCP 0;
BA_ "GenSigTimeoutTime_TCM" SG_ 271 Feedback_HCP 0;
BA_ "GenSigTimeoutTime_AGSM" SG_ 271 HybActEngTorqRespTyp 0;
BA_ "GenSigTimeoutTime_BCM" SG_ 271 HybActEngTorqRespTyp 0;
BA_ "GenSigTimeoutTime_BSM" SG_ 271 HybActEngTorqRespTyp 0;
BA_ "GenSigTimeoutTime_CADM" SG_ 271 HybActEngTorqRespTyp 0;
BA_ "GenSigTimeoutTime_DMSM" SG_ 271 HybActEngTorqRespTyp 0;
BA_ "GenSigTimeoutTime_DTCM" SG_ 271 HybActEngTorqRespTyp 0;
BA_ "GenSigTimeoutTime_ECM" SG_ 271 HybActEngTorqRespTyp 0;
BA_ "GenSigTimeoutTime_EVCU2" SG_ 271 HybActEngTorqRespTyp 0;
BA_ "GenSigTimeoutTime_GNMM" SG_ 271 HybActEngTorqRespTyp 0;
BA_ "GenSigTimeoutTime_IPC" SG_ 271 HybActEngTorqRespTyp 0;
BA_ "GenSigTimeoutTime_RFHM" SG_ 271 HybActEngTorqRespTyp 0;
BA_ "GenSigTimeoutTime_SGW" SG_ 271 HybActEngTorqRespTyp 0;
BA_ "GenSigTimeoutTime_TCM" SG_ 271 HybActEngTorqRespTyp 0;
BA_ "GenSigStartValue" SG_ 271 MaxOffEngTorqCap 938;
BA_ "GenSigTimeoutTime_AGSM" SG_ 271 MaxOffEngTorqCap 0;
BA_ "GenSigTimeoutTime_BCM" SG_ 271 MaxOffEngTorqCap 0;
BA_ "GenSigTimeoutTime_BSM" SG_ 271 MaxOffEngTorqCap 0;
BA_ "GenSigTimeoutTime_CADM" SG_ 271 MaxOffEngTorqCap 0;
BA_ "GenSigTimeoutTime_DMSM" SG_ 271 MaxOffEngTorqCap 0;
BA_ "GenSigTimeoutTime_DTCM" SG_ 271 MaxOffEngTorqCap 0;
BA_ "GenSigTimeoutTime_ECM" SG_ 271 MaxOffEngTorqCap 0;
BA_ "GenSigTimeoutTime_EVCU2" SG_ 271 MaxOffEngTorqCap 0;
BA_ "GenSigTimeoutTime_GNMM" SG_ 271 MaxOffEngTorqCap 0;
BA_ "GenSigTimeoutTime_IPC" SG_ 271 MaxOffEngTorqCap 0;
BA_ "GenSigTimeoutTime_RFHM" SG_ 271 MaxOffEngTorqCap 0;
BA_ "GenSigTimeoutTime_SGW" SG_ 271 MaxOffEngTorqCap 0;
BA_ "GenSigTimeoutTime_TCM" SG_ 271 MaxOffEngTorqCap 0;
BA_ "GenSigStartValue" SG_ 271 MaxPrdtdEngTorqCap 938;
BA_ "GenSigTimeoutTime_AGSM" SG_ 271 MaxPrdtdEngTorqCap 0;
BA_ "GenSigTimeoutTime_BCM" SG_ 271 MaxPrdtdEngTorqCap 0;
BA_ "GenSigTimeoutTime_BSM" SG_ 271 MaxPrdtdEngTorqCap 0;
BA_ "GenSigTimeoutTime_CADM" SG_ 271 MaxPrdtdEngTorqCap 0;
BA_ "GenSigTimeoutTime_DMSM" SG_ 271 MaxPrdtdEngTorqCap 0;
BA_ "GenSigTimeoutTime_DTCM" SG_ 271 MaxPrdtdEngTorqCap 0;
BA_ "GenSigTimeoutTime_ECM" SG_ 271 MaxPrdtdEngTorqCap 0;
BA_ "GenSigTimeoutTime_EVCU2" SG_ 271 MaxPrdtdEngTorqCap 0;
BA_ "GenSigTimeoutTime_GNMM" SG_ 271 MaxPrdtdEngTorqCap 0;
BA_ "GenSigTimeoutTime_IPC" SG_ 271 MaxPrdtdEngTorqCap 0;
BA_ "GenSigTimeoutTime_RFHM" SG_ 271 MaxPrdtdEngTorqCap 0;
BA_ "GenSigTimeoutTime_SGW" SG_ 271 MaxPrdtdEngTorqCap 0;
BA_ "GenSigTimeoutTime_TCM" SG_ 271 MaxPrdtdEngTorqCap 0;
BA_ "GenSigTimeoutTime_AGSM" SG_ 271 MaxPrdtdEngTorqCapV 0;
BA_ "GenSigTimeoutTime_BCM" SG_ 271 MaxPrdtdEngTorqCapV 0;
BA_ "GenSigTimeoutTime_BSM" SG_ 271 MaxPrdtdEngTorqCapV 0;
BA_ "GenSigTimeoutTime_CADM" SG_ 271 MaxPrdtdEngTorqCapV 0;
BA_ "GenSigTimeoutTime_DMSM" SG_ 271 MaxPrdtdEngTorqCapV 0;
BA_ "GenSigTimeoutTime_DTCM" SG_ 271 MaxPrdtdEngTorqCapV 0;
BA_ "GenSigTimeoutTime_ECM" SG_ 271 MaxPrdtdEngTorqCapV 0;
BA_ "GenSigTimeoutTime_EVCU2" SG_ 271 MaxPrdtdEngTorqCapV 0;
BA_ "GenSigTimeoutTime_GNMM" SG_ 271 MaxPrdtdEngTorqCapV 0;
BA_ "GenSigTimeoutTime_IPC" SG_ 271 MaxPrdtdEngTorqCapV 0;
BA_ "GenSigTimeoutTime_RFHM" SG_ 271 MaxPrdtdEngTorqCapV 0;
BA_ "GenSigTimeoutTime_SGW" SG_ 271 MaxPrdtdEngTorqCapV 0;
BA_ "GenSigTimeoutTime_TCM" SG_ 271 MaxPrdtdEngTorqCapV 0;
BA_ "GenSigTimeoutTime_AGSM" SG_ 271 MessageCounter_ENGINE_HYBD_FD_1 0;
BA_ "GenSigTimeoutTime_BCM" SG_ 271 MessageCounter_ENGINE_HYBD_FD_1 0;
BA_ "GenSigTimeoutTime_BSM" SG_ 271 MessageCounter_ENGINE_HYBD_FD_1 0;
BA_ "GenSigTimeoutTime_CADM" SG_ 271 MessageCounter_ENGINE_HYBD_FD_1 0;
BA_ "GenSigTimeoutTime_DMSM" SG_ 271 MessageCounter_ENGINE_HYBD_FD_1 0;
BA_ "GenSigTimeoutTime_DTCM" SG_ 271 MessageCounter_ENGINE_HYBD_FD_1 0;
BA_ "GenSigTimeoutTime_ECM" SG_ 271 MessageCounter_ENGINE_HYBD_FD_1 0;
BA_ "GenSigTimeoutTime_EVCU2" SG_ 271 MessageCounter_ENGINE_HYBD_FD_1 0;
BA_ "GenSigTimeoutTime_GNMM" SG_ 271 MessageCounter_ENGINE_HYBD_FD_1 0;
BA_ "GenSigTimeoutTime_IPC" SG_ 271 MessageCounter_ENGINE_HYBD_FD_1 0;
BA_ "GenSigTimeoutTime_RFHM" SG_ 271 MessageCounter_ENGINE_HYBD_FD_1 0;
BA_ "GenSigTimeoutTime_SGW" SG_ 271 MessageCounter_ENGINE_HYBD_FD_1 0;
BA_ "GenSigStartValue" SG_ 271 MinAirFlowMinSparkTorqCap 938;
BA_ "GenSigTimeoutTime_AGSM" SG_ 271 MinAirFlowMinSparkTorqCap 0;
BA_ "GenSigTimeoutTime_BCM" SG_ 271 MinAirFlowMinSparkTorqCap 0;
BA_ "GenSigTimeoutTime_BSM" SG_ 271 MinAirFlowMinSparkTorqCap 0;
BA_ "GenSigTimeoutTime_CADM" SG_ 271 MinAirFlowMinSparkTorqCap 0;
BA_ "GenSigTimeoutTime_DMSM" SG_ 271 MinAirFlowMinSparkTorqCap 0;
BA_ "GenSigTimeoutTime_DTCM" SG_ 271 MinAirFlowMinSparkTorqCap 0;
BA_ "GenSigTimeoutTime_ECM" SG_ 271 MinAirFlowMinSparkTorqCap 0;
BA_ "GenSigTimeoutTime_EVCU2" SG_ 271 MinAirFlowMinSparkTorqCap 0;
BA_ "GenSigTimeoutTime_GNMM" SG_ 271 MinAirFlowMinSparkTorqCap 0;
BA_ "GenSigTimeoutTime_IPC" SG_ 271 MinAirFlowMinSparkTorqCap 0;
BA_ "GenSigTimeoutTime_RFHM" SG_ 271 MinAirFlowMinSparkTorqCap 0;
BA_ "GenSigTimeoutTime_SGW" SG_ 271 MinAirFlowMinSparkTorqCap 0;
BA_ "GenSigTimeoutTime_TCM" SG_ 271 MinAirFlowMinSparkTorqCap 0;
BA_ "GenSigTimeoutTime_AGSM" SG_ 271 MinAirFlowMinSparkTorqCapV 0;
BA_ "GenSigTimeoutTime_BCM" SG_ 271 MinAirFlowMinSparkTorqCapV 0;
BA_ "GenSigTimeoutTime_BSM" SG_ 271 MinAirFlowMinSparkTorqCapV 0;
BA_ "GenSigTimeoutTime_CADM" SG_ 271 MinAirFlowMinSparkTorqCapV 0;
BA_ "GenSigTimeoutTime_DMSM" SG_ 271 MinAirFlowMinSparkTorqCapV 0;
BA_ "GenSigTimeoutTime_DTCM" SG_ 271 MinAirFlowMinSparkTorqCapV 0;
BA_ "GenSigTimeoutTime_ECM" SG_ 271 MinAirFlowMinSparkTorqCapV 0;
BA_ "GenSigTimeoutTime_EVCU2" SG_ 271 MinAirFlowMinSparkTorqCapV 0;
BA_ "GenSigTimeoutTime_GNMM" SG_ 271 MinAirFlowMinSparkTorqCapV 0;
BA_ "GenSigTimeoutTime_IPC" SG_ 271 MinAirFlowMinSparkTorqCapV 0;
BA_ "GenSigTimeoutTime_RFHM" SG_ 271 MinAirFlowMinSparkTorqCapV 0;
BA_ "GenSigTimeoutTime_SGW" SG_ 271 MinAirFlowMinSparkTorqCapV 0;
BA_ "GenSigTimeoutTime_TCM" SG_ 271 MinAirFlowMinSparkTorqCapV 0;
BA_ "GenSigStartValue" SG_ 271 MinEngTorqCap 938;
BA_ "GenSigTimeoutTime_AGSM" SG_ 271 MinEngTorqCap 0;
BA_ "GenSigTimeoutTime_BCM" SG_ 271 MinEngTorqCap 0;
BA_ "GenSigTimeoutTime_BSM" SG_ 271 MinEngTorqCap 0;
BA_ "GenSigTimeoutTime_CADM" SG_ 271 MinEngTorqCap 0;
BA_ "GenSigTimeoutTime_DMSM" SG_ 271 MinEngTorqCap 0;
BA_ "GenSigTimeoutTime_DTCM" SG_ 271 MinEngTorqCap 0;
BA_ "GenSigTimeoutTime_ECM" SG_ 271 MinEngTorqCap 0;
BA_ "GenSigTimeoutTime_EVCU2" SG_ 271 MinEngTorqCap 0;
BA_ "GenSigTimeoutTime_GNMM" SG_ 271 MinEngTorqCap 0;
BA_ "GenSigTimeoutTime_IPC" SG_ 271 MinEngTorqCap 0;
BA_ "GenSigTimeoutTime_RFHM" SG_ 271 MinEngTorqCap 0;
BA_ "GenSigTimeoutTime_SGW" SG_ 271 MinEngTorqCap 0;
BA_ "GenSigTimeoutTime_TCM" SG_ 271 MinEngTorqCap 0;
BA_ "GenSigTimeoutTime_AGSM" SG_ 271 MinEngTorqCapV 0;
BA_ "GenSigTimeoutTime_BCM" SG_ 271 MinEngTorqCapV 0;
BA_ "GenSigTimeoutTime_BSM" SG_ 271 MinEngTorqCapV 0;
BA_ "GenSigTimeoutTime_CADM" SG_ 271 MinEngTorqCapV 0;
BA_ "GenSigTimeoutTime_DMSM" SG_ 271 MinEngTorqCapV 0;
BA_ "GenSigTimeoutTime_DTCM" SG_ 271 MinEngTorqCapV 0;
BA_ "GenSigTimeoutTime_ECM" SG_ 271 MinEngTorqCapV 0;
BA_ "GenSigTimeoutTime_EVCU2" SG_ 271 MinEngTorqCapV 0;
BA_ "GenSigTimeoutTime_GNMM" SG_ 271 MinEngTorqCapV 0;
BA_ "GenSigTimeoutTime_IPC" SG_ 271 MinEngTorqCapV 0;
BA_ "GenSigTimeoutTime_RFHM" SG_ 271 MinEngTorqCapV 0;
BA_ "GenSigTimeoutTime_SGW" SG_ 271 MinEngTorqCapV 0;
BA_ "GenSigTimeoutTime_TCM" SG_ 271 MinEngTorqCapV 0;
BA_ "GenSigStartValue" SG_ 271 MinImmedEngTorqCap 938;
BA_ "GenSigTimeoutTime_AGSM" SG_ 271 MinImmedEngTorqCap 0;
BA_ "GenSigTimeoutTime_BCM" SG_ 271 MinImmedEngTorqCap 0;
BA_ "GenSigTimeoutTime_BSM" SG_ 271 MinImmedEngTorqCap 0;
BA_ "GenSigTimeoutTime_CADM" SG_ 271 MinImmedEngTorqCap 0;
BA_ "GenSigTimeoutTime_DMSM" SG_ 271 MinImmedEngTorqCap 0;
BA_ "GenSigTimeoutTime_DTCM" SG_ 271 MinImmedEngTorqCap 0;
BA_ "GenSigTimeoutTime_ECM" SG_ 271 MinImmedEngTorqCap 0;
BA_ "GenSigTimeoutTime_EVCU2" SG_ 271 MinImmedEngTorqCap 0;
BA_ "GenSigTimeoutTime_GNMM" SG_ 271 MinImmedEngTorqCap 0;
BA_ "GenSigTimeoutTime_IPC" SG_ 271 MinImmedEngTorqCap 0;
BA_ "GenSigTimeoutTime_RFHM" SG_ 271 MinImmedEngTorqCap 0;
BA_ "GenSigTimeoutTime_SGW" SG_ 271 MinImmedEngTorqCap 0;
BA_ "GenSigTimeoutTime_TCM" SG_ 271 MinImmedEngTorqCap 0;
BA_ "GenSigTimeoutTime_AGSM" SG_ 271 MinImmedEngTorqCapV 0;
BA_ "GenSigTimeoutTime_BCM" SG_ 271 MinImmedEngTorqCapV 0;
BA_ "GenSigTimeoutTime_BSM" SG_ 271 MinImmedEngTorqCapV 0;
BA_ "GenSigTimeoutTime_CADM" SG_ 271 MinImmedEngTorqCapV 0;
BA_ "GenSigTimeoutTime_DMSM" SG_ 271 MinImmedEngTorqCapV 0;
BA_ "GenSigTimeoutTime_DTCM" SG_ 271 MinImmedEngTorqCapV 0;
BA_ "GenSigTimeoutTime_ECM" SG_ 271 MinImmedEngTorqCapV 0;
BA_ "GenSigTimeoutTime_EVCU2" SG_ 271 MinImmedEngTorqCapV 0;
BA_ "GenSigTimeoutTime_GNMM" SG_ 271 MinImmedEngTorqCapV 0;
BA_ "GenSigTimeoutTime_IPC" SG_ 271 MinImmedEngTorqCapV 0;
BA_ "GenSigTimeoutTime_RFHM" SG_ 271 MinImmedEngTorqCapV 0;
BA_ "GenSigTimeoutTime_SGW" SG_ 271 MinImmedEngTorqCapV 0;
BA_ "GenSigTimeoutTime_TCM" SG_ 271 MinImmedEngTorqCapV 0;
BA_ "GenSigStartValue" SG_ 271 MinPrdtdEngRunTorqCap 938;
BA_ "GenSigTimeoutTime_AGSM" SG_ 271 MinPrdtdEngRunTorqCap 0;
BA_ "GenSigTimeoutTime_BCM" SG_ 271 MinPrdtdEngRunTorqCap 0;
BA_ "GenSigTimeoutTime_BSM" SG_ 271 MinPrdtdEngRunTorqCap 0;
BA_ "GenSigTimeoutTime_CADM" SG_ 271 MinPrdtdEngRunTorqCap 0;
BA_ "GenSigTimeoutTime_DMSM" SG_ 271 MinPrdtdEngRunTorqCap 0;
BA_ "GenSigTimeoutTime_DTCM" SG_ 271 MinPrdtdEngRunTorqCap 0;
BA_ "GenSigTimeoutTime_ECM" SG_ 271 MinPrdtdEngRunTorqCap 0;
BA_ "GenSigTimeoutTime_EVCU2" SG_ 271 MinPrdtdEngRunTorqCap 0;
BA_ "GenSigTimeoutTime_GNMM" SG_ 271 MinPrdtdEngRunTorqCap 0;
BA_ "GenSigTimeoutTime_IPC" SG_ 271 MinPrdtdEngRunTorqCap 0;
BA_ "GenSigTimeoutTime_RFHM" SG_ 271 MinPrdtdEngRunTorqCap 0;
BA_ "GenSigTimeoutTime_SGW" SG_ 271 MinPrdtdEngRunTorqCap 0;
BA_ "GenSigTimeoutTime_TCM" SG_ 271 MinPrdtdEngRunTorqCap 0;
BA_ "GenSigTimeoutTime_AGSM" SG_ 271 MinPrdtdEngRunTorqCapV 0;
BA_ "GenSigTimeoutTime_BCM" SG_ 271 MinPrdtdEngRunTorqCapV 0;
BA_ "GenSigTimeoutTime_BSM" SG_ 271 MinPrdtdEngRunTorqCapV 0;
BA_ "GenSigTimeoutTime_CADM" SG_ 271 MinPrdtdEngRunTorqCapV 0;
BA_ "GenSigTimeoutTime_DMSM" SG_ 271 MinPrdtdEngRunTorqCapV 0;
BA_ "GenSigTimeoutTime_DTCM" SG_ 271 MinPrdtdEngRunTorqCapV 0;
BA_ "GenSigTimeoutTime_ECM" SG_ 271 MinPrdtdEngRunTorqCapV 0;
BA_ "GenSigTimeoutTime_EVCU2" SG_ 271 MinPrdtdEngRunTorqCapV 0;
BA_ "GenSigTimeoutTime_GNMM" SG_ 271 MinPrdtdEngRunTorqCapV 0;
BA_ "GenSigTimeoutTime_IPC" SG_ 271 MinPrdtdEngRunTorqCapV 0;
BA_ "GenSigTimeoutTime_RFHM" SG_ 271 MinPrdtdEngRunTorqCapV 0;
BA_ "GenSigTimeoutTime_SGW" SG_ 271 MinPrdtdEngRunTorqCapV 0;
BA_ "GenSigTimeoutTime_TCM" SG_ 271 MinPrdtdEngRunTorqCapV 0;
BA_ "GenSigTimeoutTime_AGSM" SG_ 271 PT_BrakePdlPosn 0;
BA_ "GenSigTimeoutTime_BCM" SG_ 271 PT_BrakePdlPosn 0;
BA_ "GenSigTimeoutTime_BSM" SG_ 271 PT_BrakePdlPosn 0;
BA_ "GenSigTimeoutTime_CADM" SG_ 271 PT_BrakePdlPosn 0;
BA_ "GenSigTimeoutTime_DMSM" SG_ 271 PT_BrakePdlPosn 0;
BA_ "GenSigTimeoutTime_DTCM" SG_ 271 PT_BrakePdlPosn 0;
BA_ "GenSigTimeoutTime_ECM" SG_ 271 PT_BrakePdlPosn 0;
BA_ "GenSigTimeoutTime_EVCU2" SG_ 271 PT_BrakePdlPosn 0;
BA_ "GenSigTimeoutTime_GNMM" SG_ 271 PT_BrakePdlPosn 0;
BA_ "GenSigTimeoutTime_IPC" SG_ 271 PT_BrakePdlPosn 0;
BA_ "GenSigTimeoutTime_RFHM" SG_ 271 PT_BrakePdlPosn 0;
BA_ "GenSigTimeoutTime_SGW" SG_ 271 PT_BrakePdlPosn 0;
BA_ "GenSigTimeoutTime_TCM" SG_ 271 PT_BrakePdlPosn 0;
BA_ "GenSigTimeoutTime_AGSM" SG_ 271 PT_BrkPedDscrtInpStat 0;
BA_ "GenSigTimeoutTime_BCM" SG_ 271 PT_BrkPedDscrtInpStat 0;
BA_ "GenSigTimeoutTime_BSM" SG_ 271 PT_BrkPedDscrtInpStat 0;
BA_ "GenSigTimeoutTime_CADM" SG_ 271 PT_BrkPedDscrtInpStat 0;
BA_ "GenSigTimeoutTime_DMSM" SG_ 271 PT_BrkPedDscrtInpStat 0;
BA_ "GenSigTimeoutTime_DTCM" SG_ 271 PT_BrkPedDscrtInpStat 0;
BA_ "GenSigTimeoutTime_ECM" SG_ 271 PT_BrkPedDscrtInpStat 0;
BA_ "GenSigTimeoutTime_EVCU2" SG_ 271 PT_BrkPedDscrtInpStat 0;
BA_ "GenSigTimeoutTime_GNMM" SG_ 271 PT_BrkPedDscrtInpStat 0;
BA_ "GenSigTimeoutTime_IPC" SG_ 271 PT_BrkPedDscrtInpStat 0;
BA_ "GenSigTimeoutTime_RFHM" SG_ 271 PT_BrkPedDscrtInpStat 0;
BA_ "GenSigTimeoutTime_SGW" SG_ 271 PT_BrkPedDscrtInpStat 0;
BA_ "GenSigTimeoutTime_TCM" SG_ 271 PT_BrkPedDscrtInpStat 0;
BA_ "GenSigTimeoutTime_AGSM" SG_ 271 PT_BrkPedDscrtInpStatV 0;
BA_ "GenSigTimeoutTime_BCM" SG_ 271 PT_BrkPedDscrtInpStatV 0;
BA_ "GenSigTimeoutTime_BSM" SG_ 271 PT_BrkPedDscrtInpStatV 0;
BA_ "GenSigTimeoutTime_CADM" SG_ 271 PT_BrkPedDscrtInpStatV 0;
BA_ "GenSigTimeoutTime_DMSM" SG_ 271 PT_BrkPedDscrtInpStatV 0;
BA_ "GenSigTimeoutTime_DTCM" SG_ 271 PT_BrkPedDscrtInpStatV 0;
BA_ "GenSigTimeoutTime_ECM" SG_ 271 PT_BrkPedDscrtInpStatV 0;
BA_ "GenSigTimeoutTime_EVCU2" SG_ 271 PT_BrkPedDscrtInpStatV 0;
BA_ "GenSigTimeoutTime_GNMM" SG_ 271 PT_BrkPedDscrtInpStatV 0;
BA_ "GenSigTimeoutTime_IPC" SG_ 271 PT_BrkPedDscrtInpStatV 0;
BA_ "GenSigTimeoutTime_RFHM" SG_ 271 PT_BrkPedDscrtInpStatV 0;
BA_ "GenSigTimeoutTime_SGW" SG_ 271 PT_BrkPedDscrtInpStatV 0;
BA_ "GenSigTimeoutTime_TCM" SG_ 271 PT_BrkPedDscrtInpStatV 0;
BA_ "GenSigTimeoutTime_AGSM" SG_ 271 PT_CrnkAct 0;
BA_ "GenSigTimeoutTime_BCM" SG_ 271 PT_CrnkAct 0;
BA_ "GenSigTimeoutTime_BSM" SG_ 271 PT_CrnkAct 0;
BA_ "GenSigTimeoutTime_CADM" SG_ 271 PT_CrnkAct 0;
BA_ "GenSigTimeoutTime_DMSM" SG_ 271 PT_CrnkAct 0;
BA_ "GenSigTimeoutTime_DTCM" SG_ 271 PT_CrnkAct 0;
BA_ "GenSigTimeoutTime_ECM" SG_ 271 PT_CrnkAct 0;
BA_ "GenSigTimeoutTime_EVCU2" SG_ 271 PT_CrnkAct 0;
BA_ "GenSigTimeoutTime_GNMM" SG_ 271 PT_CrnkAct 0;
BA_ "GenSigTimeoutTime_IPC" SG_ 271 PT_CrnkAct 0;
BA_ "GenSigTimeoutTime_RFHM" SG_ 271 PT_CrnkAct 0;
BA_ "GenSigTimeoutTime_SGW" SG_ 271 PT_CrnkAct 0;
BA_ "GenSigTimeoutTime_TCM" SG_ 271 PT_CrnkAct 0;
BA_ "GenSigTimeoutTime_AGSM" SG_ 271 PTCrnkAbrted 0;
BA_ "GenSigTimeoutTime_BCM" SG_ 271 PTCrnkAbrted 0;
BA_ "GenSigTimeoutTime_BSM" SG_ 271 PTCrnkAbrted 0;
BA_ "GenSigTimeoutTime_CADM" SG_ 271 PTCrnkAbrted 0;
BA_ "GenSigTimeoutTime_DMSM" SG_ 271 PTCrnkAbrted 0;
BA_ "GenSigTimeoutTime_DTCM" SG_ 271 PTCrnkAbrted 0;
BA_ "GenSigTimeoutTime_ECM" SG_ 271 PTCrnkAbrted 0;
BA_ "GenSigTimeoutTime_EVCU2" SG_ 271 PTCrnkAbrted 0;
BA_ "GenSigTimeoutTime_GNMM" SG_ 271 PTCrnkAbrted 0;
BA_ "GenSigTimeoutTime_IPC" SG_ 271 PTCrnkAbrted 0;
BA_ "GenSigTimeoutTime_RFHM" SG_ 271 PTCrnkAbrted 0;
BA_ "GenSigTimeoutTime_SGW" SG_ 271 PTCrnkAbrted 0;
BA_ "GenSigTimeoutTime_TCM" SG_ 271 PTCrnkAbrted 0;
BA_ "GenSigStartValue" SG_ 271 Sum_FW_ID_Fst 1;
BA_ "GenSigTimeoutTime_AGSM" SG_ 271 Sum_FW_ID_Fst 0;
BA_ "GenSigTimeoutTime_BCM" SG_ 271 Sum_FW_ID_Fst 0;
BA_ "GenSigTimeoutTime_BSM" SG_ 271 Sum_FW_ID_Fst 0;
BA_ "GenSigTimeoutTime_CADM" SG_ 271 Sum_FW_ID_Fst 0;
BA_ "GenSigTimeoutTime_DMSM" SG_ 271 Sum_FW_ID_Fst 0;
BA_ "GenSigTimeoutTime_DTCM" SG_ 271 Sum_FW_ID_Fst 0;
BA_ "GenSigTimeoutTime_ECM" SG_ 271 Sum_FW_ID_Fst 0;
BA_ "GenSigTimeoutTime_EVCU2" SG_ 271 Sum_FW_ID_Fst 0;
BA_ "GenSigTimeoutTime_GNMM" SG_ 271 Sum_FW_ID_Fst 0;
BA_ "GenSigTimeoutTime_IPC" SG_ 271 Sum_FW_ID_Fst 0;
BA_ "GenSigTimeoutTime_RFHM" SG_ 271 Sum_FW_ID_Fst 0;
BA_ "GenSigTimeoutTime_SGW" SG_ 271 Sum_FW_ID_Fst 0;
BA_ "GenSigTimeoutTime_TCM" SG_ 271 Sum_FW_ID_Fst 0;
BA_ "GenSigStartValue" SG_ 271 Sum_FW_ID_Slw 1;
BA_ "GenSigTimeoutTime_AGSM" SG_ 271 Sum_FW_ID_Slw 0;
BA_ "GenSigTimeoutTime_BCM" SG_ 271 Sum_FW_ID_Slw 0;
BA_ "GenSigTimeoutTime_BSM" SG_ 271 Sum_FW_ID_Slw 0;
BA_ "GenSigTimeoutTime_CADM" SG_ 271 Sum_FW_ID_Slw 0;
BA_ "GenSigTimeoutTime_DMSM" SG_ 271 Sum_FW_ID_Slw 0;
BA_ "GenSigTimeoutTime_DTCM" SG_ 271 Sum_FW_ID_Slw 0;
BA_ "GenSigTimeoutTime_ECM" SG_ 271 Sum_FW_ID_Slw 0;
BA_ "GenSigTimeoutTime_EVCU2" SG_ 271 Sum_FW_ID_Slw 0;
BA_ "GenSigTimeoutTime_GNMM" SG_ 271 Sum_FW_ID_Slw 0;
BA_ "GenSigTimeoutTime_IPC" SG_ 271 Sum_FW_ID_Slw 0;
BA_ "GenSigTimeoutTime_RFHM" SG_ 271 Sum_FW_ID_Slw 0;
BA_ "GenSigTimeoutTime_SGW" SG_ 271 Sum_FW_ID_Slw 0;
BA_ "GenSigTimeoutTime_TCM" SG_ 271 Sum_FW_ID_Slw 0;
BA_ "GenSigStartValue" SG_ 271 T_max_FW 938;
BA_ "GenSigTimeoutTime_AGSM" SG_ 271 T_max_FW 0;
BA_ "GenSigTimeoutTime_BCM" SG_ 271 T_max_FW 0;
BA_ "GenSigTimeoutTime_BSM" SG_ 271 T_max_FW 0;
BA_ "GenSigTimeoutTime_CADM" SG_ 271 T_max_FW 0;
BA_ "GenSigTimeoutTime_DMSM" SG_ 271 T_max_FW 0;
BA_ "GenSigTimeoutTime_DTCM" SG_ 271 T_max_FW 0;
BA_ "GenSigTimeoutTime_ECM" SG_ 271 T_max_FW 0;
BA_ "GenSigTimeoutTime_EVCU2" SG_ 271 T_max_FW 0;
BA_ "GenSigTimeoutTime_GNMM" SG_ 271 T_max_FW 0;
BA_ "GenSigTimeoutTime_IPC" SG_ 271 T_max_FW 0;
BA_ "GenSigTimeoutTime_RFHM" SG_ 271 T_max_FW 0;
BA_ "GenSigTimeoutTime_SGW" SG_ 271 T_max_FW 0;
BA_ "GenSigTimeoutTime_TCM" SG_ 271 T_max_FW 0;
BA_ "GenSigStartValue" SG_ 271 T_min_FW 938;
BA_ "GenSigTimeoutTime_AGSM" SG_ 271 T_min_FW 0;
BA_ "GenSigTimeoutTime_BCM" SG_ 271 T_min_FW 0;
BA_ "GenSigTimeoutTime_BSM" SG_ 271 T_min_FW 0;
BA_ "GenSigTimeoutTime_CADM" SG_ 271 T_min_FW 0;
BA_ "GenSigTimeoutTime_DMSM" SG_ 271 T_min_FW 0;
BA_ "GenSigTimeoutTime_DTCM" SG_ 271 T_min_FW 0;
BA_ "GenSigTimeoutTime_ECM" SG_ 271 T_min_FW 0;
BA_ "GenSigTimeoutTime_EVCU2" SG_ 271 T_min_FW 0;
BA_ "GenSigTimeoutTime_GNMM" SG_ 271 T_min_FW 0;
BA_ "GenSigTimeoutTime_IPC" SG_ 271 T_min_FW 0;
BA_ "GenSigTimeoutTime_RFHM" SG_ 271 T_min_FW 0;
BA_ "GenSigTimeoutTime_SGW" SG_ 271 T_min_FW 0;
BA_ "GenSigTimeoutTime_TCM" SG_ 271 T_min_FW 0;
BA_ "GenSigTimeoutTime_AGSM" SG_ 271 TLC_LRN_Rq 0;
BA_ "GenSigTimeoutTime_BCM" SG_ 271 TLC_LRN_Rq 0;
BA_ "GenSigTimeoutTime_BSM" SG_ 271 TLC_LRN_Rq 0;
BA_ "GenSigTimeoutTime_CADM" SG_ 271 TLC_LRN_Rq 0;
BA_ "GenSigTimeoutTime_DMSM" SG_ 271 TLC_LRN_Rq 0;
BA_ "GenSigTimeoutTime_DTCM" SG_ 271 TLC_LRN_Rq 0;
BA_ "GenSigTimeoutTime_ECM" SG_ 271 TLC_LRN_Rq 0;
BA_ "GenSigTimeoutTime_GNMM" SG_ 271 TLC_LRN_Rq 0;
BA_ "GenSigTimeoutTime_IPC" SG_ 271 TLC_LRN_Rq 0;
BA_ "GenSigTimeoutTime_RFHM" SG_ 271 TLC_LRN_Rq 0;
BA_ "GenSigTimeoutTime_SGW" SG_ 271 TLC_LRN_Rq 0;
BA_ "GenSigTimeoutTime_TCM" SG_ 271 TLC_LRN_Rq 0;
BA_ "GenSigTimeoutTime_AGSM" SG_ 1035 AGSposn 0;
BA_ "GenSigTimeoutTime_BCM" SG_ 1035 AGSposn 0;
BA_ "GenSigTimeoutTime_BSM" SG_ 1035 AGSposn 0;
BA_ "GenSigTimeoutTime_CADM" SG_ 1035 AGSposn 0;
BA_ "GenSigTimeoutTime_DMSM" SG_ 1035 AGSposn 0;
BA_ "GenSigTimeoutTime_DTCM" SG_ 1035 AGSposn 0;
BA_ "GenSigTimeoutTime_ECM" SG_ 1035 AGSposn 0;
BA_ "GenSigTimeoutTime_EVCU2" SG_ 1035 AGSposn 0;
BA_ "GenSigTimeoutTime_GNMM" SG_ 1035 AGSposn 0;
BA_ "GenSigTimeoutTime_IPC" SG_ 1035 AGSposn 0;
BA_ "GenSigTimeoutTime_RFHM" SG_ 1035 AGSposn 0;
BA_ "GenSigTimeoutTime_SGW" SG_ 1035 AGSposn 0;
BA_ "GenSigTimeoutTime_TCM" SG_ 1035 AGSposn 0;
BA_ "GenSigTimeoutTime_AGSM" SG_ 1035 CRC_ENGINE_HYBD_FD_3 0;
BA_ "GenSigTimeoutTime_BCM" SG_ 1035 CRC_ENGINE_HYBD_FD_3 0;
BA_ "GenSigTimeoutTime_CADM" SG_ 1035 CRC_ENGINE_HYBD_FD_3 0;
BA_ "GenSigTimeoutTime_DMSM" SG_ 1035 CRC_ENGINE_HYBD_FD_3 0;
BA_ "GenSigTimeoutTime_DTCM" SG_ 1035 CRC_ENGINE_HYBD_FD_3 0;
BA_ "GenSigTimeoutTime_ECM" SG_ 1035 CRC_ENGINE_HYBD_FD_3 0;
BA_ "GenSigTimeoutTime_GNMM" SG_ 1035 CRC_ENGINE_HYBD_FD_3 0;
BA_ "GenSigTimeoutTime_IPC" SG_ 1035 CRC_ENGINE_HYBD_FD_3 0;
BA_ "GenSigTimeoutTime_RFHM" SG_ 1035 CRC_ENGINE_HYBD_FD_3 0;
BA_ "GenSigTimeoutTime_SGW" SG_ 1035 CRC_ENGINE_HYBD_FD_3 0;
BA_ "GenSigTimeoutTime_TCM" SG_ 1035 CRC_ENGINE_HYBD_FD_3 0;
BA_ "GenSigTimeoutTime_AGSM" SG_ 1035 ECM_AirflowRequest 0;
BA_ "GenSigTimeoutTime_BCM" SG_ 1035 ECM_AirflowRequest 0;
BA_ "GenSigTimeoutTime_BSM" SG_ 1035 ECM_AirflowRequest 0;
BA_ "GenSigTimeoutTime_CADM" SG_ 1035 ECM_AirflowRequest 0;
BA_ "GenSigTimeoutTime_DMSM" SG_ 1035 ECM_AirflowRequest 0;
BA_ "GenSigTimeoutTime_DTCM" SG_ 1035 ECM_AirflowRequest 0;
BA_ "GenSigTimeoutTime_ECM" SG_ 1035 ECM_AirflowRequest 0;
BA_ "GenSigTimeoutTime_GNMM" SG_ 1035 ECM_AirflowRequest 0;
BA_ "GenSigTimeoutTime_HCP" SG_ 1035 ECM_AirflowRequest 0;
BA_ "GenSigTimeoutTime_IPC" SG_ 1035 ECM_AirflowRequest 0;
BA_ "GenSigTimeoutTime_RFHM" SG_ 1035 ECM_AirflowRequest 0;
BA_ "GenSigTimeoutTime_SGW" SG_ 1035 ECM_AirflowRequest 0;
BA_ "GenSigTimeoutTime_TCM" SG_ 1035 ECM_AirflowRequest 0;
BA_ "GenSigTimeoutTime_AGSM" SG_ 1035 ECM_WorkSite_Invtr_Sts 0;
BA_ "GenSigTimeoutTime_BCM" SG_ 1035 ECM_WorkSite_Invtr_Sts 0;
BA_ "GenSigTimeoutTime_BSM" SG_ 1035 ECM_WorkSite_Invtr_Sts 0;
BA_ "GenSigTimeoutTime_CADM" SG_ 1035 ECM_WorkSite_Invtr_Sts 0;
BA_ "GenSigTimeoutTime_DMSM" SG_ 1035 ECM_WorkSite_Invtr_Sts 0;
BA_ "GenSigTimeoutTime_DTCM" SG_ 1035 ECM_WorkSite_Invtr_Sts 0;
BA_ "GenSigTimeoutTime_ECM" SG_ 1035 ECM_WorkSite_Invtr_Sts 0;
BA_ "GenSigTimeoutTime_EVCU2" SG_ 1035 ECM_WorkSite_Invtr_Sts 0;
BA_ "GenSigTimeoutTime_GNMM" SG_ 1035 ECM_WorkSite_Invtr_Sts 0;
BA_ "GenSigTimeoutTime_IPC" SG_ 1035 ECM_WorkSite_Invtr_Sts 0;
BA_ "GenSigTimeoutTime_RFHM" SG_ 1035 ECM_WorkSite_Invtr_Sts 0;
BA_ "GenSigTimeoutTime_SGW" SG_ 1035 ECM_WorkSite_Invtr_Sts 0;
BA_ "GenSigTimeoutTime_TCM" SG_ 1035 ECM_WorkSite_Invtr_Sts 0;
BA_ "GenSigStartValue" SG_ 1035 EngCltTmp 255;
BA_ "GenSigTimeoutTime_AGSM" SG_ 1035 EngCltTmp 0;
BA_ "GenSigTimeoutTime_BCM" SG_ 1035 EngCltTmp 0;
BA_ "GenSigTimeoutTime_BSM" SG_ 1035 EngCltTmp 0;
BA_ "GenSigTimeoutTime_CADM" SG_ 1035 EngCltTmp 0;
BA_ "GenSigTimeoutTime_DMSM" SG_ 1035 EngCltTmp 0;
BA_ "GenSigTimeoutTime_DTCM" SG_ 1035 EngCltTmp 0;
BA_ "GenSigTimeoutTime_ECM" SG_ 1035 EngCltTmp 0;
BA_ "GenSigTimeoutTime_GNMM" SG_ 1035 EngCltTmp 0;
BA_ "GenSigTimeoutTime_IPC" SG_ 1035 EngCltTmp 0;
BA_ "GenSigTimeoutTime_RFHM" SG_ 1035 EngCltTmp 0;
BA_ "GenSigTimeoutTime_SGW" SG_ 1035 EngCltTmp 0;
BA_ "GenSigTimeoutTime_TCM" SG_ 1035 EngCltTmp 0;
BA_ "GenSigTimeoutTime_AGSM" SG_ 1035 EngCltTmpV 0;
BA_ "GenSigTimeoutTime_BCM" SG_ 1035 EngCltTmpV 0;
BA_ "GenSigTimeoutTime_BSM" SG_ 1035 EngCltTmpV 0;
BA_ "GenSigTimeoutTime_CADM" SG_ 1035 EngCltTmpV 0;
BA_ "GenSigTimeoutTime_DMSM" SG_ 1035 EngCltTmpV 0;
BA_ "GenSigTimeoutTime_DTCM" SG_ 1035 EngCltTmpV 0;
BA_ "GenSigTimeoutTime_ECM" SG_ 1035 EngCltTmpV 0;
BA_ "GenSigTimeoutTime_GNMM" SG_ 1035 EngCltTmpV 0;
BA_ "GenSigTimeoutTime_IPC" SG_ 1035 EngCltTmpV 0;
BA_ "GenSigTimeoutTime_RFHM" SG_ 1035 EngCltTmpV 0;
BA_ "GenSigTimeoutTime_SGW" SG_ 1035 EngCltTmpV 0;
BA_ "GenSigTimeoutTime_TCM" SG_ 1035 EngCltTmpV 0;
BA_ "GenSigTimeoutTime_AGSM" SG_ 1035 EngHalfCylSpdMaxLim 0;
BA_ "GenSigTimeoutTime_BCM" SG_ 1035 EngHalfCylSpdMaxLim 0;
BA_ "GenSigTimeoutTime_BSM" SG_ 1035 EngHalfCylSpdMaxLim 0;
BA_ "GenSigTimeoutTime_CADM" SG_ 1035 EngHalfCylSpdMaxLim 0;
BA_ "GenSigTimeoutTime_DMSM" SG_ 1035 EngHalfCylSpdMaxLim 0;
BA_ "GenSigTimeoutTime_DTCM" SG_ 1035 EngHalfCylSpdMaxLim 0;
BA_ "GenSigTimeoutTime_ECM" SG_ 1035 EngHalfCylSpdMaxLim 0;
BA_ "GenSigTimeoutTime_EVCU2" SG_ 1035 EngHalfCylSpdMaxLim 0;
BA_ "GenSigTimeoutTime_GNMM" SG_ 1035 EngHalfCylSpdMaxLim 0;
BA_ "GenSigTimeoutTime_IPC" SG_ 1035 EngHalfCylSpdMaxLim 0;
BA_ "GenSigTimeoutTime_RFHM" SG_ 1035 EngHalfCylSpdMaxLim 0;
BA_ "GenSigTimeoutTime_SGW" SG_ 1035 EngHalfCylSpdMaxLim 0;
BA_ "GenSigTimeoutTime_TCM" SG_ 1035 EngHalfCylSpdMaxLim 0;
BA_ "GenSigTimeoutTime_AGSM" SG_ 1035 EngHalfCylSpdMinLim 0;
BA_ "GenSigTimeoutTime_BCM" SG_ 1035 EngHalfCylSpdMinLim 0;
BA_ "GenSigTimeoutTime_BSM" SG_ 1035 EngHalfCylSpdMinLim 0;
BA_ "GenSigTimeoutTime_CADM" SG_ 1035 EngHalfCylSpdMinLim 0;
BA_ "GenSigTimeoutTime_DMSM" SG_ 1035 EngHalfCylSpdMinLim 0;
BA_ "GenSigTimeoutTime_DTCM" SG_ 1035 EngHalfCylSpdMinLim 0;
BA_ "GenSigTimeoutTime_ECM" SG_ 1035 EngHalfCylSpdMinLim 0;
BA_ "GenSigTimeoutTime_EVCU2" SG_ 1035 EngHalfCylSpdMinLim 0;
BA_ "GenSigTimeoutTime_GNMM" SG_ 1035 EngHalfCylSpdMinLim 0;
BA_ "GenSigTimeoutTime_IPC" SG_ 1035 EngHalfCylSpdMinLim 0;
BA_ "GenSigTimeoutTime_RFHM" SG_ 1035 EngHalfCylSpdMinLim 0;
BA_ "GenSigTimeoutTime_SGW" SG_ 1035 EngHalfCylSpdMinLim 0;
BA_ "GenSigTimeoutTime_TCM" SG_ 1035 EngHalfCylSpdMinLim 0;
BA_ "GenSigTimeoutTime_AGSM" SG_ 1035 EngOutofFuel 0;
BA_ "GenSigTimeoutTime_BCM" SG_ 1035 EngOutofFuel 0;
BA_ "GenSigTimeoutTime_BSM" SG_ 1035 EngOutofFuel 0;
BA_ "GenSigTimeoutTime_CADM" SG_ 1035 EngOutofFuel 0;
BA_ "GenSigTimeoutTime_DMSM" SG_ 1035 EngOutofFuel 0;
BA_ "GenSigTimeoutTime_DTCM" SG_ 1035 EngOutofFuel 0;
BA_ "GenSigTimeoutTime_ECM" SG_ 1035 EngOutofFuel 0;
BA_ "GenSigTimeoutTime_GNMM" SG_ 1035 EngOutofFuel 0;
BA_ "GenSigTimeoutTime_IPC" SG_ 1035 EngOutofFuel 0;
BA_ "GenSigTimeoutTime_RFHM" SG_ 1035 EngOutofFuel 0;
BA_ "GenSigTimeoutTime_SGW" SG_ 1035 EngOutofFuel 0;
BA_ "GenSigTimeoutTime_TCM" SG_ 1035 EngOutofFuel 0;
BA_ "GenSigTimeoutTime_AGSM" SG_ 1035 EngSpd 0;
BA_ "GenSigTimeoutTime_BCM" SG_ 1035 EngSpd 0;
BA_ "GenSigTimeoutTime_BSM" SG_ 1035 EngSpd 0;
BA_ "GenSigTimeoutTime_CADM" SG_ 1035 EngSpd 0;
BA_ "GenSigTimeoutTime_DMSM" SG_ 1035 EngSpd 0;
BA_ "GenSigTimeoutTime_DTCM" SG_ 1035 EngSpd 0;
BA_ "GenSigTimeoutTime_ECM" SG_ 1035 EngSpd 0;
BA_ "GenSigTimeoutTime_EVCU2" SG_ 1035 EngSpd 0;
BA_ "GenSigTimeoutTime_GNMM" SG_ 1035 EngSpd 0;
BA_ "GenSigTimeoutTime_IPC" SG_ 1035 EngSpd 0;
BA_ "GenSigTimeoutTime_RFHM" SG_ 1035 EngSpd 0;
BA_ "GenSigTimeoutTime_SGW" SG_ 1035 EngSpd 0;
BA_ "GenSigTimeoutTime_TCM" SG_ 1035 EngSpd 0;
BA_ "GenSigTimeoutTime_AGSM" SG_ 1035 EngSpdStat 0;
BA_ "GenSigTimeoutTime_BCM" SG_ 1035 EngSpdStat 0;
BA_ "GenSigTimeoutTime_BSM" SG_ 1035 EngSpdStat 0;
BA_ "GenSigTimeoutTime_CADM" SG_ 1035 EngSpdStat 0;
BA_ "GenSigTimeoutTime_DMSM" SG_ 1035 EngSpdStat 0;
BA_ "GenSigTimeoutTime_DTCM" SG_ 1035 EngSpdStat 0;
BA_ "GenSigTimeoutTime_ECM" SG_ 1035 EngSpdStat 0;
BA_ "GenSigTimeoutTime_EVCU2" SG_ 1035 EngSpdStat 0;
BA_ "GenSigTimeoutTime_GNMM" SG_ 1035 EngSpdStat 0;
BA_ "GenSigTimeoutTime_IPC" SG_ 1035 EngSpdStat 0;
BA_ "GenSigTimeoutTime_RFHM" SG_ 1035 EngSpdStat 0;
BA_ "GenSigTimeoutTime_SGW" SG_ 1035 EngSpdStat 0;
BA_ "GenSigTimeoutTime_TCM" SG_ 1035 EngSpdStat 0;
BA_ "GenSigTimeoutTime_AGSM" SG_ 1035 LTR_PumpSpeedAct 0;
BA_ "GenSigTimeoutTime_BCM" SG_ 1035 LTR_PumpSpeedAct 0;
BA_ "GenSigTimeoutTime_BSM" SG_ 1035 LTR_PumpSpeedAct 0;
BA_ "GenSigTimeoutTime_CADM" SG_ 1035 LTR_PumpSpeedAct 0;
BA_ "GenSigTimeoutTime_DMSM" SG_ 1035 LTR_PumpSpeedAct 0;
BA_ "GenSigTimeoutTime_DTCM" SG_ 1035 LTR_PumpSpeedAct 0;
BA_ "GenSigTimeoutTime_ECM" SG_ 1035 LTR_PumpSpeedAct 0;
BA_ "GenSigTimeoutTime_EVCU2" SG_ 1035 LTR_PumpSpeedAct 0;
BA_ "GenSigTimeoutTime_GNMM" SG_ 1035 LTR_PumpSpeedAct 0;
BA_ "GenSigTimeoutTime_IPC" SG_ 1035 LTR_PumpSpeedAct 0;
BA_ "GenSigTimeoutTime_RFHM" SG_ 1035 LTR_PumpSpeedAct 0;
BA_ "GenSigTimeoutTime_TCM" SG_ 1035 LTR_PumpSpeedAct 0;
BA_ "GenSigTimeoutTime_AGSM" SG_ 1035 MaxEngSpdCap 0;
BA_ "GenSigTimeoutTime_BCM" SG_ 1035 MaxEngSpdCap 0;
BA_ "GenSigTimeoutTime_BSM" SG_ 1035 MaxEngSpdCap 0;
BA_ "GenSigTimeoutTime_CADM" SG_ 1035 MaxEngSpdCap 0;
BA_ "GenSigTimeoutTime_DMSM" SG_ 1035 MaxEngSpdCap 0;
BA_ "GenSigTimeoutTime_DTCM" SG_ 1035 MaxEngSpdCap 0;
BA_ "GenSigTimeoutTime_ECM" SG_ 1035 MaxEngSpdCap 0;
BA_ "GenSigTimeoutTime_EVCU2" SG_ 1035 MaxEngSpdCap 0;
BA_ "GenSigTimeoutTime_GNMM" SG_ 1035 MaxEngSpdCap 0;
BA_ "GenSigTimeoutTime_IPC" SG_ 1035 MaxEngSpdCap 0;
BA_ "GenSigTimeoutTime_RFHM" SG_ 1035 MaxEngSpdCap 0;
BA_ "GenSigTimeoutTime_SGW" SG_ 1035 MaxEngSpdCap 0;
BA_ "GenSigTimeoutTime_TCM" SG_ 1035 MaxEngSpdCap 0;
BA_ "GenSigTimeoutTime_AGSM" SG_ 1035 MessageCounter_ENGINE_HYBD_FD_3 0;
BA_ "GenSigTimeoutTime_BCM" SG_ 1035 MessageCounter_ENGINE_HYBD_FD_3 0;
BA_ "GenSigTimeoutTime_CADM" SG_ 1035 MessageCounter_ENGINE_HYBD_FD_3 0;
BA_ "GenSigTimeoutTime_DMSM" SG_ 1035 MessageCounter_ENGINE_HYBD_FD_3 0;
BA_ "GenSigTimeoutTime_DTCM" SG_ 1035 MessageCounter_ENGINE_HYBD_FD_3 0;
BA_ "GenSigTimeoutTime_ECM" SG_ 1035 MessageCounter_ENGINE_HYBD_FD_3 0;
BA_ "GenSigTimeoutTime_GNMM" SG_ 1035 MessageCounter_ENGINE_HYBD_FD_3 0;
BA_ "GenSigTimeoutTime_IPC" SG_ 1035 MessageCounter_ENGINE_HYBD_FD_3 0;
BA_ "GenSigTimeoutTime_RFHM" SG_ 1035 MessageCounter_ENGINE_HYBD_FD_3 0;
BA_ "GenSigTimeoutTime_SGW" SG_ 1035 MessageCounter_ENGINE_HYBD_FD_3 0;
BA_ "GenSigTimeoutTime_TCM" SG_ 1035 MessageCounter_ENGINE_HYBD_FD_3 0;
BA_ "GenSigTimeoutTime_AGSM" SG_ 1035 MinEngSpdCap 0;
BA_ "GenSigTimeoutTime_BCM" SG_ 1035 MinEngSpdCap 0;
BA_ "GenSigTimeoutTime_BSM" SG_ 1035 MinEngSpdCap 0;
BA_ "GenSigTimeoutTime_CADM" SG_ 1035 MinEngSpdCap 0;
BA_ "GenSigTimeoutTime_DMSM" SG_ 1035 MinEngSpdCap 0;
BA_ "GenSigTimeoutTime_DTCM" SG_ 1035 MinEngSpdCap 0;
BA_ "GenSigTimeoutTime_ECM" SG_ 1035 MinEngSpdCap 0;
BA_ "GenSigTimeoutTime_EVCU2" SG_ 1035 MinEngSpdCap 0;
BA_ "GenSigTimeoutTime_GNMM" SG_ 1035 MinEngSpdCap 0;
BA_ "GenSigTimeoutTime_IPC" SG_ 1035 MinEngSpdCap 0;
BA_ "GenSigTimeoutTime_RFHM" SG_ 1035 MinEngSpdCap 0;
BA_ "GenSigTimeoutTime_SGW" SG_ 1035 MinEngSpdCap 0;
BA_ "GenSigTimeoutTime_TCM" SG_ 1035 MinEngSpdCap 0;
BA_ "GenSigTimeoutTime_AGSM" SG_ 1035 RadFanReq 0;
BA_ "GenSigTimeoutTime_BCM" SG_ 1035 RadFanReq 0;
BA_ "GenSigTimeoutTime_BSM" SG_ 1035 RadFanReq 0;
BA_ "GenSigTimeoutTime_CADM" SG_ 1035 RadFanReq 0;
BA_ "GenSigTimeoutTime_DMSM" SG_ 1035 RadFanReq 0;
BA_ "GenSigTimeoutTime_DTCM" SG_ 1035 RadFanReq 0;
BA_ "GenSigTimeoutTime_ECM" SG_ 1035 RadFanReq 0;
BA_ "GenSigTimeoutTime_EVCU2" SG_ 1035 RadFanReq 0;
BA_ "GenSigTimeoutTime_GNMM" SG_ 1035 RadFanReq 0;
BA_ "GenSigTimeoutTime_IPC" SG_ 1035 RadFanReq 0;
BA_ "GenSigTimeoutTime_RFHM" SG_ 1035 RadFanReq 0;
BA_ "GenSigTimeoutTime_SGW" SG_ 1035 RadFanReq 0;
BA_ "GenSigTimeoutTime_TCM" SG_ 1035 RadFanReq 0;
BA_ "GenSigTimeoutTime_AGSM" SG_ 1035 ServiceHybSys 0;
BA_ "GenSigTimeoutTime_BCM" SG_ 1035 ServiceHybSys 0;
BA_ "GenSigTimeoutTime_BSM" SG_ 1035 ServiceHybSys 0;
BA_ "GenSigTimeoutTime_CADM" SG_ 1035 ServiceHybSys 0;
BA_ "GenSigTimeoutTime_DMSM" SG_ 1035 ServiceHybSys 0;
BA_ "GenSigTimeoutTime_DTCM" SG_ 1035 ServiceHybSys 0;
BA_ "GenSigTimeoutTime_ECM" SG_ 1035 ServiceHybSys 0;
BA_ "GenSigTimeoutTime_EVCU2" SG_ 1035 ServiceHybSys 0;
BA_ "GenSigTimeoutTime_GNMM" SG_ 1035 ServiceHybSys 0;
BA_ "GenSigTimeoutTime_IPC" SG_ 1035 ServiceHybSys 0;
BA_ "GenSigTimeoutTime_RFHM" SG_ 1035 ServiceHybSys 0;
BA_ "GenSigTimeoutTime_SGW" SG_ 1035 ServiceHybSys 0;
BA_ "GenSigTimeoutTime_TCM" SG_ 1035 ServiceHybSys 0;
BA_ "GenSigTimeoutTime_AGSM" SG_ 1328 CatHtgStateActive 0;
BA_ "GenSigTimeoutTime_BCM" SG_ 1328 CatHtgStateActive 0;
BA_ "GenSigTimeoutTime_BSM" SG_ 1328 CatHtgStateActive 0;
BA_ "GenSigTimeoutTime_CADM" SG_ 1328 CatHtgStateActive 0;
BA_ "GenSigTimeoutTime_DMSM" SG_ 1328 CatHtgStateActive 0;
BA_ "GenSigTimeoutTime_DTCM" SG_ 1328 CatHtgStateActive 0;
BA_ "GenSigTimeoutTime_ECM" SG_ 1328 CatHtgStateActive 0;
BA_ "GenSigTimeoutTime_GNMM" SG_ 1328 CatHtgStateActive 0;
BA_ "GenSigTimeoutTime_IPC" SG_ 1328 CatHtgStateActive 0;
BA_ "GenSigTimeoutTime_RFHM" SG_ 1328 CatHtgStateActive 0;
BA_ "GenSigTimeoutTime_SGW" SG_ 1328 CatHtgStateActive 0;
BA_ "GenSigTimeoutTime_TCM" SG_ 1328 CatHtgStateActive 0;
BA_ "GenSigTimeoutTime_AGSM" SG_ 1328 CatTempMaint 0;
BA_ "GenSigTimeoutTime_BCM" SG_ 1328 CatTempMaint 0;
BA_ "GenSigTimeoutTime_BSM" SG_ 1328 CatTempMaint 0;
BA_ "GenSigTimeoutTime_CADM" SG_ 1328 CatTempMaint 0;
BA_ "GenSigTimeoutTime_DMSM" SG_ 1328 CatTempMaint 0;
BA_ "GenSigTimeoutTime_DTCM" SG_ 1328 CatTempMaint 0;
BA_ "GenSigTimeoutTime_ECM" SG_ 1328 CatTempMaint 0;
BA_ "GenSigTimeoutTime_GNMM" SG_ 1328 CatTempMaint 0;
BA_ "GenSigTimeoutTime_HCP" SG_ 1328 CatTempMaint 0;
BA_ "GenSigTimeoutTime_IPC" SG_ 1328 CatTempMaint 0;
BA_ "GenSigTimeoutTime_RFHM" SG_ 1328 CatTempMaint 0;
BA_ "GenSigTimeoutTime_SGW" SG_ 1328 CatTempMaint 0;
BA_ "GenSigTimeoutTime_TCM" SG_ 1328 CatTempMaint 0;
BA_ "GenSigTimeoutTime_AGSM" SG_ 1328 CRC_ENGINE_HYBD_FD_4 0;
BA_ "GenSigTimeoutTime_BCM" SG_ 1328 CRC_ENGINE_HYBD_FD_4 0;
BA_ "GenSigTimeoutTime_BSM" SG_ 1328 CRC_ENGINE_HYBD_FD_4 0;
BA_ "GenSigTimeoutTime_CADM" SG_ 1328 CRC_ENGINE_HYBD_FD_4 0;
BA_ "GenSigTimeoutTime_DMSM" SG_ 1328 CRC_ENGINE_HYBD_FD_4 0;
BA_ "GenSigTimeoutTime_DTCM" SG_ 1328 CRC_ENGINE_HYBD_FD_4 0;
BA_ "GenSigTimeoutTime_ECM" SG_ 1328 CRC_ENGINE_HYBD_FD_4 0;
BA_ "GenSigTimeoutTime_EVCU2" SG_ 1328 CRC_ENGINE_HYBD_FD_4 0;
BA_ "GenSigTimeoutTime_GNMM" SG_ 1328 CRC_ENGINE_HYBD_FD_4 0;
BA_ "GenSigTimeoutTime_IPC" SG_ 1328 CRC_ENGINE_HYBD_FD_4 0;
BA_ "GenSigTimeoutTime_RFHM" SG_ 1328 CRC_ENGINE_HYBD_FD_4 0;
BA_ "GenSigTimeoutTime_SGW" SG_ 1328 CRC_ENGINE_HYBD_FD_4 0;
BA_ "GenSigTimeoutTime_TCM" SG_ 1328 CRC_ENGINE_HYBD_FD_4 0;
BA_ "GenSigTimeoutTime_AGSM" SG_ 1328 EngTorqACCCapability 0;
BA_ "GenSigTimeoutTime_BCM" SG_ 1328 EngTorqACCCapability 0;
BA_ "GenSigTimeoutTime_BSM" SG_ 1328 EngTorqACCCapability 0;
BA_ "GenSigTimeoutTime_CADM" SG_ 1328 EngTorqACCCapability 0;
BA_ "GenSigTimeoutTime_DMSM" SG_ 1328 EngTorqACCCapability 0;
BA_ "GenSigTimeoutTime_DTCM" SG_ 1328 EngTorqACCCapability 0;
BA_ "GenSigTimeoutTime_ECM" SG_ 1328 EngTorqACCCapability 0;
BA_ "GenSigTimeoutTime_EVCU2" SG_ 1328 EngTorqACCCapability 0;
BA_ "GenSigTimeoutTime_GNMM" SG_ 1328 EngTorqACCCapability 0;
BA_ "GenSigTimeoutTime_IPC" SG_ 1328 EngTorqACCCapability 0;
BA_ "GenSigTimeoutTime_RFHM" SG_ 1328 EngTorqACCCapability 0;
BA_ "GenSigTimeoutTime_SGW" SG_ 1328 EngTorqACCCapability 0;
BA_ "GenSigTimeoutTime_TCM" SG_ 1328 EngTorqACCCapability 0;
BA_ "GenSigTimeoutTime_AGSM" SG_ 1328 EngTorqCapbltyEngOpMd 0;
BA_ "GenSigTimeoutTime_BCM" SG_ 1328 EngTorqCapbltyEngOpMd 0;
BA_ "GenSigTimeoutTime_BSM" SG_ 1328 EngTorqCapbltyEngOpMd 0;
BA_ "GenSigTimeoutTime_CADM" SG_ 1328 EngTorqCapbltyEngOpMd 0;
BA_ "GenSigTimeoutTime_DMSM" SG_ 1328 EngTorqCapbltyEngOpMd 0;
BA_ "GenSigTimeoutTime_DTCM" SG_ 1328 EngTorqCapbltyEngOpMd 0;
BA_ "GenSigTimeoutTime_ECM" SG_ 1328 EngTorqCapbltyEngOpMd 0;
BA_ "GenSigTimeoutTime_EVCU2" SG_ 1328 EngTorqCapbltyEngOpMd 0;
BA_ "GenSigTimeoutTime_GNMM" SG_ 1328 EngTorqCapbltyEngOpMd 0;
BA_ "GenSigTimeoutTime_IPC" SG_ 1328 EngTorqCapbltyEngOpMd 0;
BA_ "GenSigTimeoutTime_RFHM" SG_ 1328 EngTorqCapbltyEngOpMd 0;
BA_ "GenSigTimeoutTime_SGW" SG_ 1328 EngTorqCapbltyEngOpMd 0;
BA_ "GenSigTimeoutTime_TCM" SG_ 1328 EngTorqCapbltyEngOpMd 0;
BA_ "GenSigTimeoutTime_AGSM" SG_ 1328 EngTorqCapbltyFrmCntr 0;
BA_ "GenSigTimeoutTime_BCM" SG_ 1328 EngTorqCapbltyFrmCntr 0;
BA_ "GenSigTimeoutTime_BSM" SG_ 1328 EngTorqCapbltyFrmCntr 0;
BA_ "GenSigTimeoutTime_CADM" SG_ 1328 EngTorqCapbltyFrmCntr 0;
BA_ "GenSigTimeoutTime_DMSM" SG_ 1328 EngTorqCapbltyFrmCntr 0;
BA_ "GenSigTimeoutTime_DTCM" SG_ 1328 EngTorqCapbltyFrmCntr 0;
BA_ "GenSigTimeoutTime_ECM" SG_ 1328 EngTorqCapbltyFrmCntr 0;
BA_ "GenSigTimeoutTime_EVCU2" SG_ 1328 EngTorqCapbltyFrmCntr 0;
BA_ "GenSigTimeoutTime_GNMM" SG_ 1328 EngTorqCapbltyFrmCntr 0;
BA_ "GenSigTimeoutTime_IPC" SG_ 1328 EngTorqCapbltyFrmCntr 0;
BA_ "GenSigTimeoutTime_RFHM" SG_ 1328 EngTorqCapbltyFrmCntr 0;
BA_ "GenSigTimeoutTime_SGW" SG_ 1328 EngTorqCapbltyFrmCntr 0;
BA_ "GenSigTimeoutTime_TCM" SG_ 1328 EngTorqCapbltyFrmCntr 0;
BA_ "GenSigTimeoutTime_AGSM" SG_ 1328 EngTorqCapbltyMaxOffTorq 0;
BA_ "GenSigTimeoutTime_BCM" SG_ 1328 EngTorqCapbltyMaxOffTorq 0;
BA_ "GenSigTimeoutTime_BSM" SG_ 1328 EngTorqCapbltyMaxOffTorq 0;
BA_ "GenSigTimeoutTime_CADM" SG_ 1328 EngTorqCapbltyMaxOffTorq 0;
BA_ "GenSigTimeoutTime_DMSM" SG_ 1328 EngTorqCapbltyMaxOffTorq 0;
BA_ "GenSigTimeoutTime_DTCM" SG_ 1328 EngTorqCapbltyMaxOffTorq 0;
BA_ "GenSigTimeoutTime_ECM" SG_ 1328 EngTorqCapbltyMaxOffTorq 0;
BA_ "GenSigTimeoutTime_EVCU2" SG_ 1328 EngTorqCapbltyMaxOffTorq 0;
BA_ "GenSigTimeoutTime_GNMM" SG_ 1328 EngTorqCapbltyMaxOffTorq 0;
BA_ "GenSigTimeoutTime_IPC" SG_ 1328 EngTorqCapbltyMaxOffTorq 0;
BA_ "GenSigTimeoutTime_RFHM" SG_ 1328 EngTorqCapbltyMaxOffTorq 0;
BA_ "GenSigTimeoutTime_SGW" SG_ 1328 EngTorqCapbltyMaxOffTorq 0;
BA_ "GenSigTimeoutTime_TCM" SG_ 1328 EngTorqCapbltyMaxOffTorq 0;
BA_ "GenSigStartValue" SG_ 1328 EngTorqCapbltyMaxTorq 938;
BA_ "GenSigTimeoutTime_AGSM" SG_ 1328 EngTorqCapbltyMaxTorq 0;
BA_ "GenSigTimeoutTime_BCM" SG_ 1328 EngTorqCapbltyMaxTorq 0;
BA_ "GenSigTimeoutTime_BSM" SG_ 1328 EngTorqCapbltyMaxTorq 0;
BA_ "GenSigTimeoutTime_CADM" SG_ 1328 EngTorqCapbltyMaxTorq 0;
BA_ "GenSigTimeoutTime_DMSM" SG_ 1328 EngTorqCapbltyMaxTorq 0;
BA_ "GenSigTimeoutTime_DTCM" SG_ 1328 EngTorqCapbltyMaxTorq 0;
BA_ "GenSigTimeoutTime_ECM" SG_ 1328 EngTorqCapbltyMaxTorq 0;
BA_ "GenSigTimeoutTime_EVCU2" SG_ 1328 EngTorqCapbltyMaxTorq 0;
BA_ "GenSigTimeoutTime_GNMM" SG_ 1328 EngTorqCapbltyMaxTorq 0;
BA_ "GenSigTimeoutTime_IPC" SG_ 1328 EngTorqCapbltyMaxTorq 0;
BA_ "GenSigTimeoutTime_RFHM" SG_ 1328 EngTorqCapbltyMaxTorq 0;
BA_ "GenSigTimeoutTime_SGW" SG_ 1328 EngTorqCapbltyMaxTorq 0;
BA_ "GenSigTimeoutTime_TCM" SG_ 1328 EngTorqCapbltyMaxTorq 0;
BA_ "GenSigStartValue" SG_ 1328 EngTorqCapbltyMinRunTorq 938;
BA_ "GenSigTimeoutTime_AGSM" SG_ 1328 EngTorqCapbltyMinRunTorq 0;
BA_ "GenSigTimeoutTime_BCM" SG_ 1328 EngTorqCapbltyMinRunTorq 0;
BA_ "GenSigTimeoutTime_BSM" SG_ 1328 EngTorqCapbltyMinRunTorq 0;
BA_ "GenSigTimeoutTime_CADM" SG_ 1328 EngTorqCapbltyMinRunTorq 0;
BA_ "GenSigTimeoutTime_DMSM" SG_ 1328 EngTorqCapbltyMinRunTorq 0;
BA_ "GenSigTimeoutTime_DTCM" SG_ 1328 EngTorqCapbltyMinRunTorq 0;
BA_ "GenSigTimeoutTime_ECM" SG_ 1328 EngTorqCapbltyMinRunTorq 0;
BA_ "GenSigTimeoutTime_EVCU2" SG_ 1328 EngTorqCapbltyMinRunTorq 0;
BA_ "GenSigTimeoutTime_GNMM" SG_ 1328 EngTorqCapbltyMinRunTorq 0;
BA_ "GenSigTimeoutTime_IPC" SG_ 1328 EngTorqCapbltyMinRunTorq 0;
BA_ "GenSigTimeoutTime_RFHM" SG_ 1328 EngTorqCapbltyMinRunTorq 0;
BA_ "GenSigTimeoutTime_SGW" SG_ 1328 EngTorqCapbltyMinRunTorq 0;
BA_ "GenSigTimeoutTime_TCM" SG_ 1328 EngTorqCapbltyMinRunTorq 0;
BA_ "GenSigStartValue" SG_ 1328 EngTorqCapbltyMinTorq 938;
BA_ "GenSigTimeoutTime_AGSM" SG_ 1328 EngTorqCapbltyMinTorq 0;
BA_ "GenSigTimeoutTime_BCM" SG_ 1328 EngTorqCapbltyMinTorq 0;
BA_ "GenSigTimeoutTime_BSM" SG_ 1328 EngTorqCapbltyMinTorq 0;
BA_ "GenSigTimeoutTime_CADM" SG_ 1328 EngTorqCapbltyMinTorq 0;
BA_ "GenSigTimeoutTime_DMSM" SG_ 1328 EngTorqCapbltyMinTorq 0;
BA_ "GenSigTimeoutTime_DTCM" SG_ 1328 EngTorqCapbltyMinTorq 0;
BA_ "GenSigTimeoutTime_ECM" SG_ 1328 EngTorqCapbltyMinTorq 0;
BA_ "GenSigTimeoutTime_EVCU2" SG_ 1328 EngTorqCapbltyMinTorq 0;
BA_ "GenSigTimeoutTime_GNMM" SG_ 1328 EngTorqCapbltyMinTorq 0;
BA_ "GenSigTimeoutTime_IPC" SG_ 1328 EngTorqCapbltyMinTorq 0;
BA_ "GenSigTimeoutTime_RFHM" SG_ 1328 EngTorqCapbltyMinTorq 0;
BA_ "GenSigTimeoutTime_SGW" SG_ 1328 EngTorqCapbltyMinTorq 0;
BA_ "GenSigTimeoutTime_TCM" SG_ 1328 EngTorqCapbltyMinTorq 0;
BA_ "GenSigTimeoutTime_AGSM" SG_ 1328 EngTorqCapbltyRefEngSpd 0;
BA_ "GenSigTimeoutTime_BCM" SG_ 1328 EngTorqCapbltyRefEngSpd 0;
BA_ "GenSigTimeoutTime_BSM" SG_ 1328 EngTorqCapbltyRefEngSpd 0;
BA_ "GenSigTimeoutTime_CADM" SG_ 1328 EngTorqCapbltyRefEngSpd 0;
BA_ "GenSigTimeoutTime_DMSM" SG_ 1328 EngTorqCapbltyRefEngSpd 0;
BA_ "GenSigTimeoutTime_DTCM" SG_ 1328 EngTorqCapbltyRefEngSpd 0;
BA_ "GenSigTimeoutTime_ECM" SG_ 1328 EngTorqCapbltyRefEngSpd 0;
BA_ "GenSigTimeoutTime_EVCU2" SG_ 1328 EngTorqCapbltyRefEngSpd 0;
BA_ "GenSigTimeoutTime_GNMM" SG_ 1328 EngTorqCapbltyRefEngSpd 0;
BA_ "GenSigTimeoutTime_IPC" SG_ 1328 EngTorqCapbltyRefEngSpd 0;
BA_ "GenSigTimeoutTime_RFHM" SG_ 1328 EngTorqCapbltyRefEngSpd 0;
BA_ "GenSigTimeoutTime_SGW" SG_ 1328 EngTorqCapbltyRefEngSpd 0;
BA_ "GenSigTimeoutTime_TCM" SG_ 1328 EngTorqCapbltyRefEngSpd 0;
BA_ "GenSigTimeoutTime_AGSM" SG_ 1328 MessageCounter_ENGINE_HYBD_FD_4 0;
BA_ "GenSigTimeoutTime_BCM" SG_ 1328 MessageCounter_ENGINE_HYBD_FD_4 0;
BA_ "GenSigTimeoutTime_BSM" SG_ 1328 MessageCounter_ENGINE_HYBD_FD_4 0;
BA_ "GenSigTimeoutTime_CADM" SG_ 1328 MessageCounter_ENGINE_HYBD_FD_4 0;
BA_ "GenSigTimeoutTime_DMSM" SG_ 1328 MessageCounter_ENGINE_HYBD_FD_4 0;
BA_ "GenSigTimeoutTime_DTCM" SG_ 1328 MessageCounter_ENGINE_HYBD_FD_4 0;
BA_ "GenSigTimeoutTime_ECM" SG_ 1328 MessageCounter_ENGINE_HYBD_FD_4 0;
BA_ "GenSigTimeoutTime_EVCU2" SG_ 1328 MessageCounter_ENGINE_HYBD_FD_4 0;
BA_ "GenSigTimeoutTime_GNMM" SG_ 1328 MessageCounter_ENGINE_HYBD_FD_4 0;
BA_ "GenSigTimeoutTime_IPC" SG_ 1328 MessageCounter_ENGINE_HYBD_FD_4 0;
BA_ "GenSigTimeoutTime_RFHM" SG_ 1328 MessageCounter_ENGINE_HYBD_FD_4 0;
BA_ "GenSigTimeoutTime_SGW" SG_ 1328 MessageCounter_ENGINE_HYBD_FD_4 0;
BA_ "GenSigTimeoutTime_TCM" SG_ 1328 MessageCounter_ENGINE_HYBD_FD_4 0;
BA_ "GenSigTimeoutTime_AGSM" SG_ 264 CRC_EPS1 0;
BA_ "GenSigTimeoutTime_BCM" SG_ 264 CRC_EPS1 0;
BA_ "GenSigTimeoutTime_CADM" SG_ 264 CRC_EPS1 0;
BA_ "GenSigTimeoutTime_GNMM" SG_ 264 CRC_EPS1 0;
BA_ "GenSigTimeoutTime_HCP" SG_ 264 CRC_EPS1 0;
BA_ "GenSigTimeoutTime_IPC" SG_ 264 CRC_EPS1 0;
BA_ "GenSigTimeoutTime_RFHM" SG_ 264 CRC_EPS1 0;
BA_ "GenSigTimeoutTime_SGW" SG_ 264 CRC_EPS1 0;
BA_ "GenSigTimeoutTime_AGSM" SG_ 264 ElectricSteeringFailSts 0;
BA_ "GenSigTimeoutTime_BCM" SG_ 264 ElectricSteeringFailSts 0;
BA_ "GenSigTimeoutTime_BSM" SG_ 264 ElectricSteeringFailSts 0;
BA_ "GenSigTimeoutTime_CADM" SG_ 264 ElectricSteeringFailSts 0;
BA_ "GenSigTimeoutTime_DMSM" SG_ 264 ElectricSteeringFailSts 0;
BA_ "GenSigTimeoutTime_ECM" SG_ 264 ElectricSteeringFailSts 0;
BA_ "GenSigTimeoutTime_GNMM" SG_ 264 ElectricSteeringFailSts 0;
BA_ "GenSigTimeoutTime_HCP" SG_ 264 ElectricSteeringFailSts 0;
BA_ "GenSigTimeoutTime_IPC" SG_ 264 ElectricSteeringFailSts 0;
BA_ "GenSigTimeoutTime_RFHM" SG_ 264 ElectricSteeringFailSts 0;
BA_ "GenSigTimeoutTime_SGW" SG_ 264 ElectricSteeringFailSts 0;
BA_ "GenSigTimeoutTime_TCM" SG_ 264 ElectricSteeringFailSts 0;
BA_ "GenSigTimeoutTime_AGSM" SG_ 264 EngineFanRequestActivation 0;
BA_ "GenSigTimeoutTime_BCM" SG_ 264 EngineFanRequestActivation 0;
BA_ "GenSigTimeoutTime_BSM" SG_ 264 EngineFanRequestActivation 0;
BA_ "GenSigTimeoutTime_CADM" SG_ 264 EngineFanRequestActivation 0;
BA_ "GenSigTimeoutTime_DMSM" SG_ 264 EngineFanRequestActivation 0;
BA_ "GenSigTimeoutTime_DTCM" SG_ 264 EngineFanRequestActivation 0;
BA_ "GenSigTimeoutTime_EVCU2" SG_ 264 EngineFanRequestActivation 0;
BA_ "GenSigTimeoutTime_GNMM" SG_ 264 EngineFanRequestActivation 0;
BA_ "GenSigTimeoutTime_HCP" SG_ 264 EngineFanRequestActivation 0;
BA_ "GenSigTimeoutTime_IPC" SG_ 264 EngineFanRequestActivation 0;
BA_ "GenSigTimeoutTime_RFHM" SG_ 264 EngineFanRequestActivation 0;
BA_ "GenSigTimeoutTime_SGW" SG_ 264 EngineFanRequestActivation 0;
BA_ "GenSigTimeoutTime_TCM" SG_ 264 EngineFanRequestActivation 0;
BA_ "GenSigTimeoutTime_AGSM" SG_ 264 LwsAngle 0;
BA_ "GenSigTimeoutTime_BCM" SG_ 264 LwsAngle 0;
BA_ "GenSigTimeoutTime_CADM" SG_ 264 LwsAngle 0;
BA_ "GenSigTimeoutTime_GNMM" SG_ 264 LwsAngle 0;
BA_ "GenSigTimeoutTime_HCP" SG_ 264 LwsAngle 0;
BA_ "GenSigTimeoutTime_RFHM" SG_ 264 LwsAngle 0;
BA_ "GenSigTimeoutTime_AGSM" SG_ 264 LwsAngleType 0;
BA_ "GenSigTimeoutTime_BCM" SG_ 264 LwsAngleType 0;
BA_ "GenSigTimeoutTime_CADM" SG_ 264 LwsAngleType 0;
BA_ "GenSigTimeoutTime_DMSM" SG_ 264 LwsAngleType 0;
BA_ "GenSigTimeoutTime_DTCM" SG_ 264 LwsAngleType 0;
BA_ "GenSigTimeoutTime_ECM" SG_ 264 LwsAngleType 0;
BA_ "GenSigTimeoutTime_EVCU2" SG_ 264 LwsAngleType 0;
BA_ "GenSigTimeoutTime_GNMM" SG_ 264 LwsAngleType 0;
BA_ "GenSigTimeoutTime_HCP" SG_ 264 LwsAngleType 0;
BA_ "GenSigTimeoutTime_RFHM" SG_ 264 LwsAngleType 0;
BA_ "GenSigTimeoutTime_SGW" SG_ 264 LwsAngleType 0;
BA_ "GenSigTimeoutTime_TCM" SG_ 264 LwsAngleType 0;
BA_ "GenSigTimeoutTime_AGSM" SG_ 264 LwsCalibration 0;
BA_ "GenSigTimeoutTime_BCM" SG_ 264 LwsCalibration 0;
BA_ "GenSigTimeoutTime_CADM" SG_ 264 LwsCalibration 0;
BA_ "GenSigTimeoutTime_DMSM" SG_ 264 LwsCalibration 0;
BA_ "GenSigTimeoutTime_DTCM" SG_ 264 LwsCalibration 0;
BA_ "GenSigTimeoutTime_ECM" SG_ 264 LwsCalibration 0;
BA_ "GenSigTimeoutTime_EVCU2" SG_ 264 LwsCalibration 0;
BA_ "GenSigTimeoutTime_GNMM" SG_ 264 LwsCalibration 0;
BA_ "GenSigTimeoutTime_HCP" SG_ 264 LwsCalibration 0;
BA_ "GenSigTimeoutTime_RFHM" SG_ 264 LwsCalibration 0;
BA_ "GenSigTimeoutTime_SGW" SG_ 264 LwsCalibration 0;
BA_ "GenSigTimeoutTime_TCM" SG_ 264 LwsCalibration 0;
BA_ "GenSigTimeoutTime_AGSM" SG_ 264 LwsSpeed 0;
BA_ "GenSigTimeoutTime_BCM" SG_ 264 LwsSpeed 0;
BA_ "GenSigTimeoutTime_BSM" SG_ 264 LwsSpeed 0;
BA_ "GenSigTimeoutTime_CADM" SG_ 264 LwsSpeed 0;
BA_ "GenSigTimeoutTime_DMSM" SG_ 264 LwsSpeed 0;
BA_ "GenSigTimeoutTime_DTCM" SG_ 264 LwsSpeed 0;
BA_ "GenSigTimeoutTime_GNMM" SG_ 264 LwsSpeed 0;
BA_ "GenSigTimeoutTime_HCP" SG_ 264 LwsSpeed 0;
BA_ "GenSigTimeoutTime_RFHM" SG_ 264 LwsSpeed 0;
BA_ "GenSigTimeoutTime_SGW" SG_ 264 LwsSpeed 0;
BA_ "GenSigTimeoutTime_TCM" SG_ 264 LwsSpeed 0;
BA_ "GenSigTimeoutTime_AGSM" SG_ 264 MessageCounter_EPS1 0;
BA_ "GenSigTimeoutTime_BCM" SG_ 264 MessageCounter_EPS1 0;
BA_ "GenSigTimeoutTime_CADM" SG_ 264 MessageCounter_EPS1 0;
BA_ "GenSigTimeoutTime_GNMM" SG_ 264 MessageCounter_EPS1 0;
BA_ "GenSigTimeoutTime_HCP" SG_ 264 MessageCounter_EPS1 0;
BA_ "GenSigTimeoutTime_IPC" SG_ 264 MessageCounter_EPS1 0;
BA_ "GenSigTimeoutTime_RFHM" SG_ 264 MessageCounter_EPS1 0;
BA_ "GenSigTimeoutTime_SGW" SG_ 264 MessageCounter_EPS1 0;
BA_ "GenSigTimeoutTime_AGSM" SG_ 1056 CRC_EPS2 0;
BA_ "GenSigTimeoutTime_BCM" SG_ 1056 CRC_EPS2 0;
BA_ "GenSigTimeoutTime_BSM" SG_ 1056 CRC_EPS2 0;
BA_ "GenSigTimeoutTime_CADM" SG_ 1056 CRC_EPS2 0;
BA_ "GenSigTimeoutTime_DMSM" SG_ 1056 CRC_EPS2 0;
BA_ "GenSigTimeoutTime_DTCM" SG_ 1056 CRC_EPS2 0;
BA_ "GenSigTimeoutTime_ECM" SG_ 1056 CRC_EPS2 0;
BA_ "GenSigTimeoutTime_EVCU2" SG_ 1056 CRC_EPS2 0;
BA_ "GenSigTimeoutTime_GNMM" SG_ 1056 CRC_EPS2 0;
BA_ "GenSigTimeoutTime_HCP" SG_ 1056 CRC_EPS2 0;
BA_ "GenSigTimeoutTime_RFHM" SG_ 1056 CRC_EPS2 0;
BA_ "GenSigTimeoutTime_SGW" SG_ 1056 CRC_EPS2 0;
BA_ "GenSigTimeoutTime_TCM" SG_ 1056 CRC_EPS2 0;
BA_ "GenSigTimeoutTime_AGSM" SG_ 1056 EPS_Warn_Disp_Rq 0;
BA_ "GenSigTimeoutTime_BCM" SG_ 1056 EPS_Warn_Disp_Rq 0;
BA_ "GenSigTimeoutTime_BSM" SG_ 1056 EPS_Warn_Disp_Rq 0;
BA_ "GenSigTimeoutTime_CADM" SG_ 1056 EPS_Warn_Disp_Rq 0;
BA_ "GenSigTimeoutTime_DMSM" SG_ 1056 EPS_Warn_Disp_Rq 0;
BA_ "GenSigTimeoutTime_DTCM" SG_ 1056 EPS_Warn_Disp_Rq 0;
BA_ "GenSigTimeoutTime_EVCU2" SG_ 1056 EPS_Warn_Disp_Rq 0;
BA_ "GenSigTimeoutTime_GNMM" SG_ 1056 EPS_Warn_Disp_Rq 0;
BA_ "GenSigTimeoutTime_HCP" SG_ 1056 EPS_Warn_Disp_Rq 0;
BA_ "GenSigTimeoutTime_RFHM" SG_ 1056 EPS_Warn_Disp_Rq 0;
BA_ "GenSigTimeoutTime_TCM" SG_ 1056 EPS_Warn_Disp_Rq 0;
BA_ "GenSigTimeoutTime_AGSM" SG_ 1056 MessageCounter_EPS2 0;
BA_ "GenSigTimeoutTime_BCM" SG_ 1056 MessageCounter_EPS2 0;
BA_ "GenSigTimeoutTime_BSM" SG_ 1056 MessageCounter_EPS2 0;
BA_ "GenSigTimeoutTime_CADM" SG_ 1056 MessageCounter_EPS2 0;
BA_ "GenSigTimeoutTime_DMSM" SG_ 1056 MessageCounter_EPS2 0;
BA_ "GenSigTimeoutTime_DTCM" SG_ 1056 MessageCounter_EPS2 0;
BA_ "GenSigTimeoutTime_ECM" SG_ 1056 MessageCounter_EPS2 0;
BA_ "GenSigTimeoutTime_EVCU2" SG_ 1056 MessageCounter_EPS2 0;
BA_ "GenSigTimeoutTime_GNMM" SG_ 1056 MessageCounter_EPS2 0;
BA_ "GenSigTimeoutTime_HCP" SG_ 1056 MessageCounter_EPS2 0;
BA_ "GenSigTimeoutTime_RFHM" SG_ 1056 MessageCounter_EPS2 0;
BA_ "GenSigTimeoutTime_SGW" SG_ 1056 MessageCounter_EPS2 0;
BA_ "GenSigTimeoutTime_TCM" SG_ 1056 MessageCounter_EPS2 0;
BA_ "GenSigSendType" SG_ 1460 CADM_Big_ECU_Package 3;
BA_ "GenSigTimeoutTime_AGSM" SG_ 1460 CADM_Big_ECU_Package 0;
BA_ "GenSigTimeoutTime_BCM" SG_ 1460 CADM_Big_ECU_Package 0;
BA_ "GenSigTimeoutTime_BSM" SG_ 1460 CADM_Big_ECU_Package 0;
BA_ "GenSigTimeoutTime_DMSM" SG_ 1460 CADM_Big_ECU_Package 0;
BA_ "GenSigTimeoutTime_DTCM" SG_ 1460 CADM_Big_ECU_Package 0;
BA_ "GenSigTimeoutTime_ECM" SG_ 1460 CADM_Big_ECU_Package 0;
BA_ "GenSigTimeoutTime_EVCU2" SG_ 1460 CADM_Big_ECU_Package 0;
BA_ "GenSigTimeoutTime_GNMM" SG_ 1460 CADM_Big_ECU_Package 0;
BA_ "GenSigTimeoutTime_HCP" SG_ 1460 CADM_Big_ECU_Package 0;
BA_ "GenSigTimeoutTime_IPC" SG_ 1460 CADM_Big_ECU_Package 0;
BA_ "GenSigTimeoutTime_RFHM" SG_ 1460 CADM_Big_ECU_Package 0;
BA_ "GenSigTimeoutTime_SGW" SG_ 1460 CADM_Big_ECU_Package 0;
BA_ "GenSigTimeoutTime_TCM" SG_ 1460 CADM_Big_ECU_Package 0;
BA_ "GenSigSendType" SG_ 1460 FOTA_Install_Type 3;
BA_ "GenSigTimeoutTime_AGSM" SG_ 1460 FOTA_Install_Type 0;
BA_ "GenSigTimeoutTime_BCM" SG_ 1460 FOTA_Install_Type 0;
BA_ "GenSigTimeoutTime_BSM" SG_ 1460 FOTA_Install_Type 0;
BA_ "GenSigTimeoutTime_CADM" SG_ 1460 FOTA_Install_Type 0;
BA_ "GenSigTimeoutTime_DMSM" SG_ 1460 FOTA_Install_Type 0;
BA_ "GenSigTimeoutTime_DTCM" SG_ 1460 FOTA_Install_Type 0;
BA_ "GenSigTimeoutTime_GNMM" SG_ 1460 FOTA_Install_Type 0;
BA_ "GenSigTimeoutTime_HCP" SG_ 1460 FOTA_Install_Type 0;
BA_ "GenSigTimeoutTime_IPC" SG_ 1460 FOTA_Install_Type 0;
BA_ "GenSigTimeoutTime_RFHM" SG_ 1460 FOTA_Install_Type 0;
BA_ "GenSigTimeoutTime_SGW" SG_ 1460 FOTA_Install_Type 0;
BA_ "GenSigTimeoutTime_TCM" SG_ 1460 FOTA_Install_Type 0;
BA_ "GenSigSendType" SG_ 1460 FOTA_Installation_Status 3;
BA_ "GenSigTimeoutTime_AGSM" SG_ 1460 FOTA_Installation_Status 0;
BA_ "GenSigTimeoutTime_BCM" SG_ 1460 FOTA_Installation_Status 0;
BA_ "GenSigTimeoutTime_BSM" SG_ 1460 FOTA_Installation_Status 0;
BA_ "GenSigTimeoutTime_CADM" SG_ 1460 FOTA_Installation_Status 0;
BA_ "GenSigTimeoutTime_DMSM" SG_ 1460 FOTA_Installation_Status 0;
BA_ "GenSigTimeoutTime_DTCM" SG_ 1460 FOTA_Installation_Status 0;
BA_ "GenSigTimeoutTime_ECM" SG_ 1460 FOTA_Installation_Status 0;
BA_ "GenSigTimeoutTime_GNMM" SG_ 1460 FOTA_Installation_Status 0;
BA_ "GenSigTimeoutTime_HCP" SG_ 1460 FOTA_Installation_Status 0;
BA_ "GenSigTimeoutTime_IPC" SG_ 1460 FOTA_Installation_Status 0;
BA_ "GenSigTimeoutTime_SGW" SG_ 1460 FOTA_Installation_Status 0;
BA_ "GenSigTimeoutTime_TCM" SG_ 1460 FOTA_Installation_Status 0;
BA_ "GenSigStartValue" SG_ 1460 FOTA_Purge 1;
BA_ "GenSigSendType" SG_ 1460 FOTA_Purge 3;
BA_ "GenSigTimeoutTime_AGSM" SG_ 1460 FOTA_Purge 0;
BA_ "GenSigTimeoutTime_BCM" SG_ 1460 FOTA_Purge 0;
BA_ "GenSigTimeoutTime_BSM" SG_ 1460 FOTA_Purge 0;
BA_ "GenSigTimeoutTime_DMSM" SG_ 1460 FOTA_Purge 0;
BA_ "GenSigTimeoutTime_DTCM" SG_ 1460 FOTA_Purge 0;
BA_ "GenSigTimeoutTime_ECM" SG_ 1460 FOTA_Purge 0;
BA_ "GenSigTimeoutTime_EVCU2" SG_ 1460 FOTA_Purge 0;
BA_ "GenSigTimeoutTime_GNMM" SG_ 1460 FOTA_Purge 0;
BA_ "GenSigTimeoutTime_HCP" SG_ 1460 FOTA_Purge 0;
BA_ "GenSigTimeoutTime_IPC" SG_ 1460 FOTA_Purge 0;
BA_ "GenSigTimeoutTime_RFHM" SG_ 1460 FOTA_Purge 0;
BA_ "GenSigTimeoutTime_SGW" SG_ 1460 FOTA_Purge 0;
BA_ "GenSigTimeoutTime_TCM" SG_ 1460 FOTA_Purge 0;
BA_ "GenSigSendType" SG_ 1460 FOTA_Status 3;
BA_ "GenSigTimeoutTime_AGSM" SG_ 1460 FOTA_Status 0;
BA_ "GenSigTimeoutTime_DMSM" SG_ 1460 FOTA_Status 0;
BA_ "GenSigTimeoutTime_DTCM" SG_ 1460 FOTA_Status 0;
BA_ "GenSigTimeoutTime_EVCU2" SG_ 1460 FOTA_Status 0;
BA_ "GenSigTimeoutTime_GNMM" SG_ 1460 FOTA_Status 0;
BA_ "GenSigTimeoutTime_HCP" SG_ 1460 FOTA_Status 0;
BA_ "GenSigTimeoutTime_SGW" SG_ 1460 FOTA_Status 0;
BA_ "GenSigSendType" SG_ 1460 Safe_State 3;
BA_ "GenSigTimeoutTime_AGSM" SG_ 1460 Safe_State 0;
BA_ "GenSigTimeoutTime_BCM" SG_ 1460 Safe_State 0;
BA_ "GenSigTimeoutTime_BSM" SG_ 1460 Safe_State 0;
BA_ "GenSigTimeoutTime_DMSM" SG_ 1460 Safe_State 0;
BA_ "GenSigTimeoutTime_DTCM" SG_ 1460 Safe_State 0;
BA_ "GenSigTimeoutTime_ECM" SG_ 1460 Safe_State 0;
BA_ "GenSigTimeoutTime_EVCU2" SG_ 1460 Safe_State 0;
BA_ "GenSigTimeoutTime_GNMM" SG_ 1460 Safe_State 0;
BA_ "GenSigTimeoutTime_HCP" SG_ 1460 Safe_State 0;
BA_ "GenSigTimeoutTime_IPC" SG_ 1460 Safe_State 0;
BA_ "GenSigTimeoutTime_RFHM" SG_ 1460 Safe_State 0;
BA_ "GenSigTimeoutTime_SGW" SG_ 1460 Safe_State 0;
BA_ "GenSigTimeoutTime_TCM" SG_ 1460 Safe_State 0;
BA_ "GenSigSendType" SG_ 1460 WakeUpECM 3;
BA_ "GenSigTimeoutTime_AGSM" SG_ 1460 WakeUpECM 0;
BA_ "GenSigTimeoutTime_BSM" SG_ 1460 WakeUpECM 0;
BA_ "GenSigTimeoutTime_CADM" SG_ 1460 WakeUpECM 0;
BA_ "GenSigTimeoutTime_DMSM" SG_ 1460 WakeUpECM 0;
BA_ "GenSigTimeoutTime_DTCM" SG_ 1460 WakeUpECM 0;
BA_ "GenSigTimeoutTime_ECM" SG_ 1460 WakeUpECM 0;
BA_ "GenSigTimeoutTime_EVCU2" SG_ 1460 WakeUpECM 0;
BA_ "GenSigTimeoutTime_GNMM" SG_ 1460 WakeUpECM 0;
BA_ "GenSigTimeoutTime_HCP" SG_ 1460 WakeUpECM 0;
BA_ "GenSigTimeoutTime_IPC" SG_ 1460 WakeUpECM 0;
BA_ "GenSigTimeoutTime_RFHM" SG_ 1460 WakeUpECM 0;
BA_ "GenSigTimeoutTime_SGW" SG_ 1460 WakeUpECM 0;
BA_ "GenSigTimeoutTime_TCM" SG_ 1460 WakeUpECM 0;
VAL_ 518 AirFuelRatio 255 "SNA";
VAL_ 518 ECM_CODE_CLR_W 0 "Not Cleared" 1 "Cleared";
VAL_ 518 ECM_READINESS_RESET_W 0 "Not Set" 1 "Set";
VAL_ 518 EngineReadyForESS_W 0 "Not_Active" 1 "Active";
VAL_ 518 EngTrqMaxCorrFctr_W 255 "SNA";
VAL_ 518 GrMax_Rq_ECM_W 0 "Passive" 1 "G1" 2 "G2" 3 "G3" 4 "G4" 5 "G5" 6 "G6" 7 "G7" 8 "G8" 9 "G9";
VAL_ 518 GrMin_Rq_ECM_W 0 "Passive" 1 "G1" 2 "G2" 3 "G3" 4 "G4" 5 "G5" 6 "G6" 7 "G7" 8 "G8" 9 "G9";
VAL_ 518 IntkAirTempIntrClr 255 "SNA";
VAL_ 518 LTR_CoolantTemp 255 "SNA";
VAL_ 518 PdlPosActual 255 "SNA";
VAL_ 518 RPMOverRev_W 0 "FALSE" 1 "TRUE";
VAL_ 751 DrvAway_Alert 0 "FALSE" 1 "TRUE";
VAL_ 751 DrvAway_Indications 0 "No_Indication" 1 "DrvAway_Shft_Corr" 2 "DrvAway_Auto_Stop";
VAL_ 751 DrvAway_Inhibit 0 "FALSE" 1 "TRUE";
VAL_ 751 ECM_FOTA_Conflict 0 "False" 1 "True";
VAL_ 751 ECM_MSG_RQ 0 "NONE" 1 "SCREEN_1" 2 "SCREEN_2" 3 "SCREEN_3" 4 "SCREEN_4" 5 "SCREEN_5" 6 "SCREEN_6" 7 "SCREEN_7" 8 "SCREEN_8" 9 "SCREEN_9" 10 "SCREEN_10" 11 "SCREEN_11" 12 "SCREEN_12" 13 "SCREEN_13" 14 "SCREEN_14" 15 "SCREEN_15" 16 "SCREEN_16" 17 "SCREEN_17" 18 "SCREEN_18" 19 "SCREEN_19" 20 "SCREEN_20" 21 "SCREEN_21" 22 "SCREEN_22" 23 "SCREEN_23" 24 "SCREEN_24" 25 "SCREEN_25" 26 "SCREEN_26" 27 "SCREEN_27" 28 "SCREEN_28" 29 "SCREEN_29" 30 "SCREEN_30" 31 "SNA";
VAL_ 751 EngineWaterTemp 255 "SNA";
VAL_ 751 FuelConsumption_GAG 65535 "SNA";
VAL_ 751 GearShiftIndication 0 "No_Gearshift_Suggestion_by_ECM" 1 "Downshift_Suggestion_by_ECM" 2 "Upshift_Suggestion_by_ECM" 3 "Strategy_Not_Available_ECM_Fail";
VAL_ 751 HP_MODE_STS 0 "NONE" 1 "VALET" 2 "BLACK" 3 "RED" 7 "SNA";
VAL_ 751 LeakCheckTimerValue 511 "SNA";
VAL_ 751 LeakTestRequest 0 "No_Request" 1 "Leak_Test_Requested";
VAL_ 751 LeakTestSts 0 "NONE" 1 "PEND" 2 "COMPLETE" 3 "DELAY";
VAL_ 751 SAMInfo 0 "OFF" 1 "Engine_OFF" 2 "Cranking_management" 3 "ColdEngineManagement" 4 "Eassist_Ready" 5 "Steady_State" 6 "Regenerative_Braking_BSG" 7 "Quick_Charge" 8 "Auto_Shut_OFF" 9 "Shut_OFF" 10 "SAM_recovery" 11 "Battery_Regeneration" 12 "STOP_START" 13 "E_Assist" 14 "NEUTRAL" 15 "SNA";
VAL_ 751 Selector_SystemFailSts 0 "Fail_Not_Present" 1 "Fail_Present";
VAL_ 751 StarterProtectionTime 255 "SNA";
VAL_ 751 StartProtectionInhibit 0 "Default" 2 "Crank_Inhibit" 3 "SNA";
VAL_ 751 StartRelayBCMFeedbackFault 0 "False" 1 "True";
VAL_ 751 StartRelayECMFeedbackFault 0 "False" 1 "True";
VAL_ 751 Terrain_HMI_Rq_ECM 0 "No_Request" 1 "SCREEN_1" 2 "SCREEN_2" 3 "SCREEN_3" 4 "SCREEN_4" 5 "SCREEN_5" 6 "SCREEN_6" 7 "SCREEN_7" 8 "SCREEN_8" 9 "SCREEN_9" 10 "SCREEN_10" 11 "SCREEN_11" 12 "SCREEN_12" 13 "SCREEN_13" 14 "SCREEN_14" 15 "SCREEN_15" 16 "SCREEN_16" 17 "SCREEN_17" 18 "SCREEN_18" 19 "SCREEN_19" 20 "SCREEN_20" 21 "SCREEN_21" 22 "SCREEN_22" 23 "SCREEN_23" 24 "SCREEN_24" 25 "SCREEN_25" 26 "SCREEN_26" 27 "SCREEN_27" 28 "SCREEN_28" 29 "SCREEN_29" 30 "SCREEN_30" 31 "SNA";
VAL_ 751 TerrainModeDesiredStat 0 "Auto" 1 "Auto_Fault" 2 "Rock" 3 "Track" 4 "Snow" 5 "Offroad" 6 "Eco" 7 "Corsa" 8 "Sport" 9 "Mud_Sand" 10 "Mud" 11 "Sand" 12 "Valet" 13 "Custom" 14 "Tow" 15 "DRAG" 16 "BAJA" 31 "SNA";
VAL_ 751 TerrainModeInterfaceButton_ECM 0 "Not_Activated" 1 "Activated" 5 "Short_to_Ground_Fault" 6 "Open_Short_to_Power_Fault" 7 "SNA";
VAL_ 751 TerrainModeStat_ECM 0 "Auto" 1 "Auto_Fault" 2 "Rock" 3 "Track" 4 "Snow" 5 "Offroad" 6 "Eco" 7 "Corsa" 8 "Sport" 9 "Mud_Sand" 10 "Mud" 11 "Sand" 12 "Valet" 13 "Custom" 14 "Tow" 15 "DRAG" 16 "BAJA" 31 "SNA";
VAL_ 751 Trns_DrvMd_CfgSts_ECM 0 "NP" 1 "STREET" 2 "VALET" 3 "SPORT" 4 "S_PLUS" 5 "TRACK" 6 "ECO" 7 "SNOW" 8 "ROCK " 9 "TOW" 10 "DRAG" 11 "MUD" 12 "SAND" 13 "BAJA" 14 "OFFROAD" 31 "SNA";
VAL_ 751 Trns_DrvMdReq_ECM 0 "NP" 1 "STREET" 2 "VALET" 3 "SPORT" 4 "S_PLUS" 5 "TRACK" 6 "ECO" 7 "SNOW" 8 "ROCK " 9 "TOW" 10 "DRAG" 11 "MUD" 12 "SAND" 13 "BAJA" 14 "OFFROAD" 15 "LAUNCH" 16 "LINELOCK" 31 "SNA";
VAL_ 1448 CompressorSts 0 "Not_Used" 1 "Not_inserted_by_NCM" 2 "Not_insrtd_by_driver_or_security" 3 "Inserted";
VAL_ 1448 ECM_THA_Resp 0 "Off" 1 "Active" 3 "SNA";
VAL_ 1448 ECM_WARN_BTO 0 "Not_Active" 1 "Active";
VAL_ 1448 ECM_WARN_BTO_1 0 "Not_Active" 1 "Active";
VAL_ 1448 EMSFailSts 0 "Fail_Not_Present" 1 "Fail_Flash_Light_Indication" 2 "Fail_Fix_Light_Indication" 3 "Flash_For_Service";
VAL_ 1448 EngineOperatingMode 0 "Normal" 1 "DPF Regeneration LO" 2 "DPF Regeneration HI" 3 "NSC DeNOx Regeneration" 4 "NSC DeSOx Regeneration" 5 "SCR Heat-up strategy";
VAL_ 1448 ETCFailSts 0 "Fail_Not_Present" 1 "Fail_Flash_Light_Indication" 2 "Fail_Fix_Light_Indication" 3 "Flash_For_Service";
VAL_ 1448 ExhaustTemperature 255 "SNA";
VAL_ 1448 FuelMM_Sts 0 "INACTIVE" 1 "ACTIVE" 2 "DISABLED";
VAL_ 1448 HoursOilLifeRst 4095 "SNA";
VAL_ 1448 KNK_MG_TRIGGER 0 "LSPI_NO_MESSAGE" 1 "LSPI_LEVEL_1" 2 "LSPI_LEVEL_2" 3 "LSPI_LEVEL_3";
VAL_ 1448 MntncSts 0 "NONE" 1 "SOON" 2 "NOW" 3 "SNA";
VAL_ 1448 OilLifeSts 0 "Normal_Oil_Properties" 1 "Oil_Life_Reset" 2 "Change_Oil_Required" 3 "Not_used";
VAL_ 1448 OilPressureSts 0 "Normal_Pressure" 1 "Low_Pressure";
VAL_ 1448 PerfShftRq_HUD 0 "DISABLE_MUTE" 1 "PRE_SHIFT 1" 2 "PRE_SHIFT 2" 3 "SHIFT NOW";
VAL_ 1448 SpStDispstat 0 "NONE" 3 "ACTIVE" 1 "PCR_OPENS" 4 "D_OR_SB" 5 "NR_DRV_NOT_DET" 6 "DR_INHIB" 7 "TX_INHIB" 8 "KEY" 9 "BATT" 10 "SYSFLT" 11 "NR" 12 "READY" 13 "OFF" 14 "HOOD" 15 "PEDAL" 16 "BATT_CHG" 17 "TM" 18 "T4WD_L" 20 "INCLINE" 21 "AMB_TEMP" 23 "SB" 24 "DR_AJAR" 25 "CABIN" 26 "MAX_HVAC" 27 "FT_DEFROST" 29 "ST_WHEEL" 30 "Eng_Temp_Hi" 31 "Eng_Temp_Lo" 32 "Prk_Brk_Inhib" 33 "Park_Inhib" 34 "Hood_Inhib" 35 "DPF_Regen" 38 "BATT_HIGH" 63 "SNA";
VAL_ 1448 SpStIndRq 0 "Not_Active" 1 "Active";
VAL_ 1448 SpStSwStat 0 "OFF" 1 "CONT" 2 "BLINK" 3 "SNA";
VAL_ 1055 AM_ECM_Prsnt 0 "DEFAULT" 2 "AM_ECM_PRESENT" 3 "SNA";
VAL_ 1055 GF_Charge 65535 "SNA";
VAL_ 1055 LTR_TARGET_TEMP 254 "Failure" 255 "SNA";
VAL_ 1055 MAP_4_BAR 511 "SNA";
VAL_ 1055 MdsAct 0 "Not Active" 1 "Active";
VAL_ 1055 MdsActforANC 0 "Not Active" 1 "Active";
VAL_ 1055 OIL_PRESS 255 "SNA";
VAL_ 1055 PSI_EnableSts 0 "Not_Enabled" 1 "Enabled";
VAL_ 1055 PSI_Gr1_RPM 31 "SNA";
VAL_ 1055 PSI_Gr2_RPM 31 "SNA";
VAL_ 1055 PSI_Gr3_RPM 31 "SNA";
VAL_ 1055 PSI_Gr4_RPM 31 "SNA";
VAL_ 1055 PSI_Gr5_RPM 31 "SNA";
VAL_ 1055 RACE_CLDWN_DEAC_TIME 1023 "SNA";
VAL_ 1055 RefuelEvent 0 "NONE" 1 "PEND" 2 "TRUE" 3 "COMP" 4 "FAULT";
VAL_ 1055 RefuelIndication 0 "NONE" 1 "WAIT" 2 "PARK" 3 "OK" 4 "DOOR" 5 "BLOCKAGE" 6 "SERVICE";
VAL_ 1055 RevOilLifeRst 65535 "SNA";
VAL_ 271 AccPosV 0 "False" 1 "True";
VAL_ 271 Cam_Exh_1_Locked 0 "CAM_UNLOCKED" 1 "CAM_LOCKED";
VAL_ 271 Cam_Exh_2_Locked 0 "CAM_UNLOCKED" 1 "CAM_LOCKED";
VAL_ 271 Cam_Int_1_Locked 0 "CAM_UNLOCKED" 1 "CAM_LOCKED";
VAL_ 271 Cam_Int_2_Locked 0 "CAM_UNLOCKED" 1 "CAM_LOCKED";
VAL_ 271 CmndFlyWheelTorqPotential 4095 "SNA";
VAL_ 271 CmndFlyWheelTorqPrdtd 4095 "SNA";
VAL_ 271 CmndFlyWheelTorqRespTyp 0 "Inactive" 1 "PL" 2 "MR";
VAL_ 271 Crank_Locked 0 "NOT_LOCKED" 1 "CRANK_LOCKED";
VAL_ 271 Crank_Maturing_Fault 0 "False" 1 "True";
VAL_ 271 DrvrIntndedFlyWheelTorq 4095 "SNA";
VAL_ 271 DrvrIntndedFlyWheelTorqRaw 4095 "SNA";
VAL_ 271 DrvrIntndedFlyWheelTorqRawV 0 "Vaild" 1 "Not_Vaild";
VAL_ 271 DrvrIntndedFlyWheelTorqV 0 "Vaild" 1 "Not_Vaild";
VAL_ 271 ECM_Crank_Phase 0 "Not_Initialized" 1 "Quadrant_1" 2 "Quadrant_2" 3 "Quadrant_3" 4 "Quadrant_4" 7 "SNA";
VAL_ 271 ECM_VTD_Freeze 0 "No_reset" 1 "Lifetime_and_Recent_Clear" 2 "Recent_Clear" 3 "Freeze";
VAL_ 271 ECMReq_Remedial_Stop 0 "DEFAULT" 1 "Remedial_Stp_Req" 2 "Remedial_Stp_Req_w_Limp" 3 "SNA";
VAL_ 271 EngActStdyStTorq 4095 "SNA";
VAL_ 271 EngActStdyStTorqV 0 "Valid" 1 "Not_Valid";
VAL_ 271 EngActuatorsStat 0 "ACPP" 1 "SCPP" 2 "ACPA";
VAL_ 271 EngAirFlwStdyStTorq 4095 "SNA";
VAL_ 271 EngAirFlwStdyStTorqV 0 "Valid" 1 "Not_Valid";
VAL_ 271 EngCylDeactMd 0 "CYL_ACT" 1 "DAP" 2 "HTCA" 3 "RAP";
VAL_ 271 Engine_Sync_720 0 "NOT_SYNCED" 1 "SYNC_720_ACHIEVED";
VAL_ 271 EngRqStTyp 0 "N_RQ" 1 "KS_NORM" 2 "KS_LP" 3 "KS_LPB" 4 "KS_GEN" 5 "AS_SM" 6 "AS_NORM" 7 "AS_AGG" 8 "AS_GEN" 9 "CT" 15 "SNA";
VAL_ 271 EngTrqReserveReq 255 "SNA";
VAL_ 271 ESS_Engine_State_EE 1 "ENS_STOPPED" 2 "ENS_RQ_ST" 3 "ENS_RUN" 4 "ENS_STOP_PEND" 5 "ENS_ST_PRTCT" 6 "ENS_ST_INH" 7 "ENS_DSBL" 8 "ENS_IHB_LATCH" 9 "ENS_ST" 10 "KEY_START" 11 "CHANGED_MIND" 12 "KEY_TORQUE_START" 13 "ENS_DISARM_RUN" 15 "SNA";
VAL_ 271 ETRQ_Mode 7 "SNA";
VAL_ 271 HybActEngTorqRespTyp 0 "Inactive" 1 "Pleasability_Limited" 2 "Maximum_Range";
VAL_ 271 MaxOffEngTorqCap 4095 "SNA";
VAL_ 271 MaxPrdtdEngTorqCap 4095 "SNA";
VAL_ 271 MaxPrdtdEngTorqCapV 0 "Valid" 1 "Not_Valid";
VAL_ 271 MinAirFlowMinSparkTorqCap 4095 "SNA";
VAL_ 271 MinEngTorqCap 4095 "SNA";
VAL_ 271 MinEngTorqCapV 0 "Valid" 1 "Not_Valid";
VAL_ 271 MinImmedEngTorqCap 4095 "SNA";
VAL_ 271 MinImmedEngTorqCapV 0 "Valid" 1 "Not_Valid";
VAL_ 271 MinPrdtdEngRunTorqCap 4095 "SNA";
VAL_ 271 MinPrdtdEngRunTorqCapV 0 "Valid" 1 "Not_Valid";
VAL_ 271 PT_BrakePdlPosn 255 "SNA";
VAL_ 271 PT_BrkPedDscrtInpStatV 0 "Valid" 1 "Not_Valid";
VAL_ 271 Sum_FW_ID_Fst 31 "SNA";
VAL_ 271 Sum_FW_ID_Slw 31 "SNA";
VAL_ 271 T_max_FW 4095 "SNA";
VAL_ 271 T_min_FW 4095 "SNA";
VAL_ 1035 AGSposn 127 "SNA";
VAL_ 1035 ECM_AirflowRequest 127 "SNA";
VAL_ 1035 ECM_WorkSite_Invtr_Sts 0 "NOT_ACTIVE" 1 "ACTIVE" 3 "SNA";
VAL_ 1035 EngCltTmp 255 "SNA";
VAL_ 1035 EngCltTmpV 0 "False" 1 "True";
VAL_ 1035 EngHalfCylSpdMaxLim 8191 "SNA";
VAL_ 1035 EngHalfCylSpdMinLim 8191 "SNA";
VAL_ 1035 EngSpdStat 0 "NOR_OPR" 1 "DEG_OPR" 3 "SNA";
VAL_ 1035 LTR_PumpSpeedAct 127 "SNA";
VAL_ 1035 RadFanReq 127 "SNA";
VAL_ 1328 CatTempMaint 0 "Not_Active" 1 "Active";
VAL_ 1328 EngTorqACCCapability 255 "SNA";
VAL_ 1328 EngTorqCapbltyMaxOffTorq 4095 "SNA";
VAL_ 1328 EngTorqCapbltyMaxTorq 4095 "SNA";
VAL_ 1328 EngTorqCapbltyMinRunTorq 4095 "SNA";
VAL_ 1328 EngTorqCapbltyMinTorq 4095 "SNA";
VAL_ 264 ElectricSteeringFailSts 0 "Fail_Not_Present" 1 "Fail_Present";
VAL_ 264 EngineFanRequestActivation 0 "False" 1 "True";
VAL_ 264 LwsAngle 65535 "SNA";
VAL_ 264 LwsAngleType 0 "Absolute" 1 "Relative" 3 "SNA";
VAL_ 264 LwsCalibration 0 "Not_calibrated" 1 "Calibrated";
VAL_ 264 LwsSpeed 4095 "SNA";
VAL_ 1056 EPS_Warn_Disp_Rq 0 "EPS function active OK" 1 "Warning - Service power steering ERR" 2 "Warning - Power steering-over temp ERR2" 3 "Service Required - High Priority SERV_HI" 7 "SNA";
VAL_ 1460 CADM_Big_ECU_Package 0 "No Package" 1 "Package Available";
VAL_ 1460 FOTA_Install_Type 0 "No FOTA" 1 "FOTA Now" 2 "FOTA Schedule" 3 "FOTA Cancelled";
VAL_ 1460 FOTA_Installation_Status 0 "Default" 1 "Installation_Started" 2 "Installation_Complete" 3 "Reserved";
VAL_ 1460 FOTA_Purge 0 "Do_Not_Purge" 1 "Purge";
VAL_ 1460 FOTA_Status 0 "No FOTA Event" 1 "Downloading Package from Backend" 2 "Passing Images to Big Target ECUs" 3 "Waiting for HMI Acceptance" 4 "Installing FOTA Updated" 5 "Successful FOTA Update" 6 "FOTA Failure Rollback Successful" 7 "FOTA Failure Complete" 8 "Build Vehicle Library" 9 "Check Campaign Availability" 10 "Check Download Conditions" 11 "Validate Vehicle Package" 12 "Double Check Manifest" 13 "Initiate Authenticated Diagnostic session" 14 "Ready_State" 15 "Rollback";
VAL_ 1460 Safe_State 0 "Not Safe State" 1 "Safe State";
VAL_ 1460 WakeUpECM 0 "Not_Active" 1 "Active";
