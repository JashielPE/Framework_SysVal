VERSION ""

NS_ :

BS_:

BU_: AGSM BCM BSM CADM DMSM DTCM ECM EVCU2 GNMM HCP IPC RFHM SGW TCM
BO_ 1058 OBD_CONTENT_FRAME: 32 ECM
 SG_ AccelPdlPosn_OBD : 111|8@0+ (0.3922,0) [0|100] "%" BSM,SGW,TCM
 SG_ BarPrsAbs : 39|8@0+ (0.5,0) [0|127.5] "kPa" EVCU2,HCP
 SG_ BarPrsAbsV : 92|1@0+ (1,0) [0|0] "-" EVCU2,HCP
 SG_ CARB_PERM : 119|1@0+ (1,0) [0|1] "-" BSM,EVCU2,HCP,TCM
 SG_ CarbWarmUp : 93|1@0+ (1,0) [0|1] "-" BSM,EVCU2,HCP,TCM
 SG_ CldStrtDenominator : 116|1@0+ (1,0) [0|1] "-" EVCU2
 SG_ CRC_OBDCONTENTFRAME : 191|8@0+ (1,0) [0|255] "-" BSM,EVCU2,HCP,TCM
 SG_ EngineOFFTime : 89|10@0+ (1,0) [0|1022] "min" EVCU2,TCM
 SG_ EngIntAirTmp : 23|8@0+ (1,-40) [-40|214] "°C" EVCU2,HCP
 SG_ EngIntAirTmpV : 4|1@0+ (1,0) [0|0] "-" EVCU2,HCP
 SG_ EngOffTmPT : 3|12@0+ (0.5,0) [0.5|2047.5] "min" EVCU2,HCP
 SG_ EngOffTmPTV : 5|1@0+ (1,0) [0|0] "-" EVCU2,HCP
 SG_ EstCatCnvTmp : 47|8@0+ (5,0) [0|1270] "°C" EVCU2,HCP
 SG_ GenDenominator : 95|1@0+ (1,0) [0|1] "-" EVCU2,TCM
 SG_ IgnCntrTrue : 118|1@0+ (1,0) [0|1] "-" EVCU2,TCM
 SG_ Inp_CSD_Fail : 115|1@0+ (1,0) [0|1] "-" EVCU2
 SG_ Inp_ICC_Fail : 117|1@0+ (1,0) [0|1] "-" EVCU2,TCM
 SG_ InputsGDFail : 94|1@0+ (1,0) [0|1] "-" EVCU2,TCM
 SG_ LgsDiagCldStrtCndFltPr : 56|1@0+ (1,0) [0|0] "-" EVCU2,HCP
 SG_ LgsDiagCldStrtCndMet : 57|1@0+ (1,0) [0|0] "-" EVCU2,HCP
 SG_ LgsDiagStndCondFltPrs : 58|1@0+ (1,0) [0|0] "-" EVCU2
 SG_ LgsDiagStndCondMet : 59|1@0+ (1,0) [0|0] "-" EVCU2
 SG_ LoadOBD : 87|8@0+ (0.3922,0) [0|100] "%" BSM,EVCU2,SGW,TCM
 SG_ MessageCounter_OBDCONTENTFRAME : 179|4@0+ (1,0) [0|15] "-" BSM,EVCU2,HCP,TCM
 SG_ OAT_PT_Est : 55|8@0+ (1,-64) [-64|191] "°C" EVCU2,HCP
 SG_ OAT_PT_EstV : 60|1@0+ (1,0) [0|0] "-" EVCU2,HCP
 SG_ PSActiveTimer_OBD : 151|32@0+ (0.1,0) [0|429496729.5] "sec" EVCU2

BO_ 611 ORC_FD_1: 32 BCM
 SG_ AirBagFailSts : 137|2@0+ (1,0) [0|3] "-" IPC
 SG_ CRC_ORC1 : 191|8@0+ (1,0) [0|255] "-" EVCU2,HCP,IPC
 SG_ MessageCounter_ORC1 : 179|4@0+ (1,0) [0|15] "-" EVCU2,HCP,IPC
 SG_ SBR1RowDriverSeatConfigSts : 92|1@0+ (1,0) [0|1] "-" IPC
 SG_ SBR1RowDriverSeatSts : 94|2@0+ (1,0) [0|2] "-" EVCU2,IPC,SGW
 SG_ SBR1RowPsngrSeatConfigSts : 95|1@0+ (1,0) [0|1] "-" IPC
 SG_ SBR1RowPsngrSeatSts : 98|3@0+ (1,0) [0|6] "-" IPC,SGW

BO_ 1954 ORC_FD_2: 32 BCM
 SG_ CRC_ORC2 : 191|8@0+ (1,0) [0|255] "-" BSM,ECM,TCM
 SG_ DrvSbltUnFltr_1 : 119|8@0+ (0.1,0) [0|25.5] "mA" BSM,ECM,TCM
 SG_ MessageCounter_ORC2 : 179|4@0+ (1,0) [0|15] "-" BSM,ECM,TCM
 SG_ SBR1RowPsngrSeatPPDSts : 127|2@0+ (1,0) [0|3] "-" IPC

BO_ 274 ORC_FD_3: 32 BCM
 SG_ CRC_ORC3 : 191|8@0+ (1,0) [0|255] "-" DTCM,ECM,EVCU2,HCP,TCM
 SG_ LatAcceleration : 147|12@0+ (0.02,-40.96) [-40.96|40.92] "m/s^2" DTCM,ECM,EVCU2,TCM
 SG_ LatAccelerationFailSts : 182|1@0+ (1,0) [0|1] "-" DTCM,ECM,EVCU2
 SG_ LongAcceleration : 131|12@0+ (0.02,-40.96) [-40.96|40.92] "m/s^2" DTCM,ECM,EVCU2,HCP,TCM
 SG_ LongAccelerationFailSts : 183|1@0+ (1,0) [0|1] "-" DTCM,ECM,EVCU2
 SG_ MessageCounter_ORC3 : 179|4@0+ (1,0) [0|15] "-" DTCM,ECM,EVCU2,HCP,TCM
 SG_ YawRate : 163|12@0+ (0.08,-163.84) [-163.84|163.68] "deg/s" DTCM,EVCU2
 SG_ YawRateFailSts : 181|1@0+ (1,0) [0|1] "-" DTCM,EVCU2

BO_ 2654339094 PDC_INFO_FD_AGSM: 32 AGSM
 SG_ CurrentCanNMState_FD03_AGSM : 15|4@0+ (1,0) [0|15] "" SGW
 SG_ CurrentCanNMState_FD16_AGSM : 99|4@0+ (1,0) [0|15] "" SGW
 SG_ CurrentFailSts_FD03_AGSM : 6|1@0+ (1,0) [0|1] "" BCM,SGW
 SG_ CurrentFailSts_FD16_AGSM : 181|1@0+ (1,0) [0|1] "" SGW
 SG_ DES_FD03_AGSM : 4|2@0+ (1,0) [0|3] "" SGW
 SG_ DES_FD16_AGSM : 183|2@0+ (1,0) [0|3] "" SGW
 SG_ EOL_FD03_AGSM : 7|1@0+ (1,0) [0|1] "-" BCM,SGW
 SG_ EOL_FD16_AGSM : 2|1@0+ (1,0) [0|1] "-" SGW
 SG_ GenericFailSts_FD03_AGSM : 5|1@0+ (1,0) [0|1] "" BCM,SGW
 SG_ GenericFailSts_FD16_AGSM : 180|1@0+ (1,0) [0|1] "" SGW
 SG_ PreviousCanNMState_FD03_AGSM : 11|4@0+ (1,0) [0|15] "" SGW
 SG_ PreviousCanNMState_FD16_AGSM : 103|4@0+ (1,0) [0|15] "" SGW
 SG_ StayActiveSource_FD03_AGSM : 31|64@0+ (1,0) [0|0] "" SGW
 SG_ StayActiveSource_FD16_AGSM : 111|64@0+ (1,0) [0|0] "" SGW
 SG_ WakeupSource_FD03_AGSM : 23|8@0+ (1,0) [0|255] "" SGW
 SG_ WakeupSource_FD16_AGSM : 95|8@0+ (1,0) [0|255] "" SGW

BO_ 2654339072 PDC_INFO_FD_BCM: 48 BCM
 SG_ CurrentCanNMState_FD01_BCM : 15|4@0+ (1,0) [0|15] "" Vector__XXX
 SG_ CurrentCanNMState_FD02_BCM : 103|4@0+ (1,0) [0|15] "" Vector__XXX
 SG_ CurrentCanNMState_FD03_BCM : 191|4@0+ (1,0) [0|15] "" Vector__XXX
 SG_ CurrentCanNMState_FD04_BCM : 279|4@0+ (1,0) [0|15] "" Vector__XXX
 SG_ CurrentFailSts_FD01_BCM : 6|1@0+ (1,0) [0|1] "" Vector__XXX
 SG_ CurrentFailSts_FD02_BCM : 94|1@0+ (1,0) [0|1] "" Vector__XXX
 SG_ CurrentFailSts_FD03_BCM : 182|1@0+ (1,0) [0|1] "" Vector__XXX
 SG_ CurrentFailSts_FD04_BCM : 270|1@0+ (1,0) [0|1] "" Vector__XXX
 SG_ DES_FD01_BCM : 4|2@0+ (1,0) [0|3] "" Vector__XXX
 SG_ DES_FD02_BCM : 92|2@0+ (1,0) [0|3] "" Vector__XXX
 SG_ DES_FD03_BCM : 180|2@0+ (1,0) [0|3] "" Vector__XXX
 SG_ DES_FD04_BCM : 268|2@0+ (1,0) [0|3] "" Vector__XXX
 SG_ EOL_FD01_BCM : 7|1@0+ (1,0) [0|1] "-" Vector__XXX
 SG_ EOL_FD02_BCM : 95|1@0+ (1,0) [0|1] "-" Vector__XXX
 SG_ EOL_FD03_BCM : 183|1@0+ (1,0) [0|1] "-" Vector__XXX
 SG_ EOL_FD04_BCM : 271|1@0+ (1,0) [0|1] "-" Vector__XXX
 SG_ GenericFailSts_FD01_BCM : 5|1@0+ (1,0) [0|1] "" Vector__XXX
 SG_ GenericFailSts_FD02_BCM : 93|1@0+ (1,0) [0|1] "" Vector__XXX
 SG_ GenericFailSts_FD03_BCM : 181|1@0+ (1,0) [0|1] "" Vector__XXX
 SG_ GenericFailSts_FD04_BCM : 269|1@0+ (1,0) [0|1] "" Vector__XXX
 SG_ PreviousCanNMState_FD01_BCM : 11|4@0+ (1,0) [0|15] "" Vector__XXX
 SG_ PreviousCanNMState_FD02_BCM : 99|4@0+ (1,0) [0|15] "" Vector__XXX
 SG_ PreviousCanNMState_FD03_BCM : 187|4@0+ (1,0) [0|15] "" Vector__XXX
 SG_ PreviousCanNMState_FD04_BCM : 275|4@0+ (1,0) [0|15] "" Vector__XXX
 SG_ StayActiveSource_FD01_BCM : 31|64@0+ (1,0) [0|18446744073709551615] "" Vector__XXX
 SG_ StayActiveSource_FD02_BCM : 119|64@0+ (1,0) [0|18446744073709551615] "" Vector__XXX
 SG_ StayActiveSource_FD03_BCM : 207|64@0+ (1,0) [0|18446744073709551615] "" Vector__XXX
 SG_ StayActiveSource_FD04_BCM : 295|64@0+ (1,0) [0|18446744073709551615] "" Vector__XXX
 SG_ WakeupSource_FD01_BCM : 23|8@0+ (1,0) [0|255] "" Vector__XXX
 SG_ WakeupSource_FD02_BCM : 111|8@0+ (1,0) [0|255] "" Vector__XXX
 SG_ WakeupSource_FD03_BCM : 199|8@0+ (1,0) [0|255] "" Vector__XXX
 SG_ WakeupSource_FD04_BCM : 287|8@0+ (1,0) [0|255] "" Vector__XXX

BO_ 2654339142 PDC_INFO_FD_BPCM: 32 EVCU2
 SG_ CurrentCanNMState_FD05_BPCM : 95|4@0+ (1,0) [0|15] "" Vector__XXX
 SG_ CurrentCanNMState_FD11_BPCM : 15|4@0+ (1,0) [0|15] "" Vector__XXX
 SG_ CurrentFailSts_FD05_BPCM : 6|1@0+ (1,0) [0|1] "" Vector__XXX
 SG_ CurrentFailSts_FD11_BPCM : 2|1@0+ (1,0) [0|1] "" BCM
 SG_ DES_FD05_BPCM : 91|2@0+ (1,0) [0|3] "" Vector__XXX
 SG_ DES_FD11_BPCM : 4|2@0+ (1,0) [0|3] "" Vector__XXX
 SG_ EOL_FD05_BPCM : 1|1@0+ (1,0) [0|1] "-" Vector__XXX
 SG_ EOL_FD11_BPCM : 7|1@0+ (1,0) [0|1] "-" BCM
 SG_ GenericFailSts_FD05_BPCM : 89|1@0+ (1,0) [0|1] "" Vector__XXX
 SG_ GenericFailSts_FD11_BPCM : 5|1@0+ (1,0) [0|1] "" BCM
 SG_ PreviousCanNMState_FD05_BPCM : 103|4@0+ (1,0) [0|15] "" Vector__XXX
 SG_ PreviousCanNMState_FD11_BPCM : 11|4@0+ (1,0) [0|15] "" Vector__XXX
 SG_ StayActiveSource_FD05_BPCM : 99|64@0+ (1,0) [0|0] "" Vector__XXX
 SG_ StayActiveSource_FD11_BPCM : 31|64@0+ (1,0) [0|0] "" Vector__XXX
 SG_ WakeupSource_FD05_BPCM : 175|8@0+ (1,0) [0|255] "" Vector__XXX
 SG_ WakeupSource_FD11_BPCM : 23|8@0+ (1,0) [0|255] "" Vector__XXX

BO_ 2654339078 PDC_INFO_FD_BSM: 12 BSM
 SG_ CurrentCanNMState_FD03_BSM : 15|4@0+ (1,0) [0|15] "" SGW
 SG_ CurrentFailSts_FD03_BSM : 6|1@0+ (1,0) [0|1] "" BCM,SGW
 SG_ DES_FD03_BSM : 4|2@0+ (1,0) [0|1] "" SGW
 SG_ EOL_FD03_BSM : 7|1@0+ (1,0) [0|1] "-" BCM,SGW
 SG_ GenericFailSts_FD03_BSM : 5|1@0+ (1,0) [0|1] "" BCM,SGW
 SG_ PreviousCanNMState_FD03_BSM : 11|4@0+ (1,0) [0|15] "" SGW
 SG_ StayActiveSource_FD03_BSM : 31|64@0+ (1,0) [0|18446744073709551615] "" SGW
 SG_ WakeupSource_FD03_BSM : 23|8@0+ (1,0) [0|255] "" SGW

BO_ 2654339213 PDC_INFO_FD_CADM: 12 CADM
 SG_ CurrentCanNMState_FD03_CADM : 15|4@0+ (1,0) [0|15] "" SGW
 SG_ CurrentFailSts_FD03_CADM : 6|1@0+ (1,0) [0|1] "" BCM,SGW
 SG_ DES_FD03_CADM : 4|2@0+ (1,0) [0|3] "" SGW
 SG_ EOL_FD03_CADM : 7|1@0+ (1,0) [0|1] "-" BCM,SGW
 SG_ GenericFailSts_FD03_CADM : 5|1@0+ (1,0) [0|1] "" BCM,SGW
 SG_ PreviousCanNMState_FD03_CADM : 11|4@0+ (1,0) [0|15] "" SGW
 SG_ StayActiveSource_FD03_CADM : 31|64@0+ (1,0) [0|18446744073709600000] "" SGW
 SG_ WakeupSource_FD03_CADM : 23|8@0+ (1,0) [0|255] "" SGW

BO_ 2654339225 PDC_INFO_FD_DMSM: 12 DMSM
 SG_ CurrentCanNMState_FD03_DMSM : 15|4@0+ (1,0) [0|15] "" SGW
 SG_ CurrentFailSts_FD03_DMSM : 6|1@0+ (1,0) [0|1] "" BCM,SGW
 SG_ DES_FD03_DMSM : 4|2@0+ (1,0) [0|3] "" SGW
 SG_ EOL_FD03_DMSM : 7|1@0+ (1,0) [0|1] "-" BCM,SGW
 SG_ GenericFailSts_FD03_DMSM : 5|1@0+ (1,0) [0|1] "" BCM,SGW
 SG_ PreviousCanNMState_FD03_DMSM : 11|4@0+ (1,0) [0|15] "" SGW
 SG_ StayActiveSource_FD03_DMSM : 31|64@0+ (1,0) [0|18446744073709600000] "" SGW
 SG_ WakeupSource_FD03_DMSM : 23|8@0+ (1,0) [0|255] "" SGW

BO_ 2654339139 PDC_INFO_FD_DTCM: 12 DTCM
 SG_ CurrentCanNMState_FD03_DTCM : 15|4@0+ (1,0) [0|15] "" SGW
 SG_ CurrentFailSts_FD03_DTCM : 6|1@0+ (1,0) [0|1] "" BCM,SGW
 SG_ DES_FD03_DTCM : 4|2@0+ (1,0) [0|3] "" SGW
 SG_ EOL_FD03_DTCM : 7|1@0+ (1,0) [0|1] "-" BCM,SGW
 SG_ GenericFailSts_FD03_DTCM : 5|1@0+ (1,0) [0|1] "" BCM,SGW
 SG_ PreviousCanNMState_FD03_DTCM : 11|4@0+ (1,0) [0|15] "" SGW
 SG_ StayActiveSource_FD03_DTCM : 31|64@0+ (1,0) [0|18446744073709600000] "" SGW
 SG_ WakeupSource_FD03_DTCM : 23|8@0+ (1,0) [0|255] "" SGW

BO_TX_BU_ 2654339142 : EVCU2,HCP;
CM_ SG_ 1058 AccelPdlPosn_OBD "Pedal value for OBD (ISO 15031-5.4 PID 49)";
CM_ SG_ 1058 BarPrsAbs "Barometric pressure absolute";
CM_ SG_ 1058 BarPrsAbsV "Barometric Pressure Absolute Validity; Invalid = [1]";
CM_ SG_ 1058 CARB_PERM "Fault code for diagnostics.";
CM_ SG_ 1058 CarbWarmUp "CARB warmup criteria true.  The engine controller will set this bit when the engine coolant temp achieves the CARB warm-up criteria.";
CM_ SG_ 1058 CldStrtDenominator "Cold start denominator conditions are met [1]";
CM_ SG_ 1058 CRC_OBDCONTENTFRAME "CRC according to SAE J1850 standard at each frame transmission.";
CM_ SG_ 1058 EngineOFFTime "The number of minutes the engine was off.";
CM_ SG_ 1058 EngIntAirTmp "Engine Intake Air Temperature";
CM_ SG_ 1058 EngIntAirTmpV "Engine Intake Air Temperature Validity; Invalid = [1]";
CM_ SG_ 1058 EngOffTmPT "Engine off time powertrain";
CM_ SG_ 1058 EngOffTmPTV "Engine off time powertrain validity (1=invalid)";
CM_ SG_ 1058 EstCatCnvTmp "Estimated catalytic converter temperature";
CM_ SG_ 1058 GenDenominator "General denominator conditions are met.  The engine controller will set this bit when the conditions for setting the General Denominator are met for rate based diagnostics.";
CM_ SG_ 1058 IgnCntrTrue "Ignition cycle counter is true [1]";
CM_ SG_ 1058 Inp_CSD_Fail "Inputs to the cold start denominator are in a pend or MIL fault.";
CM_ SG_ 1058 Inp_ICC_Fail "Inputs to the Ign Cycle Cntr are in a Pend or MIL cond.";
CM_ SG_ 1058 InputsGDFail "General Denominator Requirements Achieved Validity. The engine controller sets this bit when any of the inputs to the General Denominator are in a pending or MIL fault.";
CM_ SG_ 1058 LgsDiagCldStrtCndFltPr "Legislated diagnostics cold start conditions fault present; true = [1]";
CM_ SG_ 1058 LgsDiagCldStrtCndMet "Legislated diagnostics cold start conditions met; true = [1]";
CM_ SG_ 1058 LgsDiagStndCondFltPrs "Legislated diagnostics standard conditions fault present";
CM_ SG_ 1058 LgsDiagStndCondMet "Legislated diagnostics standard conditions met";
CM_ SG_ 1058 LoadOBD "Engine calculated load value in percentage of load.";
CM_ SG_ 1058 MessageCounter_OBDCONTENTFRAME "This signal is a counter used for safety checks strategies. This counter is incremented of 1 (one) unit at each frame transmission.";
CM_ SG_ 1058 OAT_PT_Est "Outside air temperature powertrain estimated";
CM_ SG_ 1058 OAT_PT_EstV "Outside air temperature powertrain estimated validity; Invalid = [1]";
CM_ SG_ 1058 PSActiveTimer_OBD "Propulsion system active timer";
CM_ SG_ 611 AirBagFailSts "This signal is used to require the activation/deactivation of airbag warning light";
CM_ SG_ 611 CRC_ORC1 "CRC according to SAE J1850 standard at each frame transmission.";
CM_ SG_ 611 MessageCounter_ORC1 "This signal is a counter used for safety checks strategies. This counter is incremented of 1 (one) unit at each frame transmission.";
CM_ SG_ 611 SBR1RowDriverSeatConfigSts "Signal used to show if the first row driver seatbelt is under check";
CM_ SG_ 611 SBR1RowDriverSeatSts "First row driver seatbelt switch status";
CM_ SG_ 611 SBR1RowPsngrSeatConfigSts "Signal used to show if the first row passenger seatbelt is under check";
CM_ SG_ 611 SBR1RowPsngrSeatSts "First row passenger seat status";
CM_ SG_ 1954 CRC_ORC2 "CRC according to SAE J1850 standard at each frame transmission.";
CM_ SG_ 1954 DrvSbltUnFltr_1 "Driver seatbelt fault status - unfiltered";
CM_ SG_ 1954 MessageCounter_ORC2 "This signal is a counter used for safety checks strategies. This counter is incremented of 1 (one) unit at each frame transmission.";
CM_ SG_ 1954 SBR1RowPsngrSeatPPDSts "Passenger Occupant Detection Sensor Status";
CM_ SG_ 274 CRC_ORC3 "CRC according to SAE J1850 standard at each frame transmission.";
CM_ SG_ 274 LatAcceleration "This signal indicates the Lateral Acceleration Value";
CM_ SG_ 274 LatAccelerationFailSts "This signal indicates the status of Lateral Acceleration Signal";
CM_ SG_ 274 LongAcceleration "This signal indicates the Longitudinal Acceleration Value";
CM_ SG_ 274 LongAccelerationFailSts "This signal indicates the status of Longitudinal acceleration signal";
CM_ SG_ 274 MessageCounter_ORC3 "This signal is a counter used for safety checks strategies. This counter is incremented of 1 (one) unit at each frame transmission.";
CM_ SG_ 274 YawRate "This signal indicates the Yaw Rate Value";
CM_ SG_ 274 YawRateFailSts "This signal indicates the Status of Yaw Rate Signal";
CM_ SG_ 2654339094 CurrentCanNMState_FD03_AGSM "Indicates that CanNM state the ECU is currently executing";
CM_ SG_ 2654339094 CurrentCanNMState_FD16_AGSM "Indicates that CanNM state the ECU is currently executing";
CM_ SG_ 2654339094 CurrentFailSts_FD03_AGSM "Indicates the presence/absence of at least one DTC with DTCStatus = present in the System Memory";
CM_ SG_ 2654339094 CurrentFailSts_FD16_AGSM "Indicates the presence/absence of at least one DTC with DTCStatus = present in the System Memory";
CM_ SG_ 2654339094 DES_FD03_AGSM "Indicates whether the ECU?s CAN cell is in either ErrorActive, or ErrorPassive state OR has just now recovered from a BusOff condition";
CM_ SG_ 2654339094 DES_FD16_AGSM "Indicates whether the ECU?s CAN cell is in either ErrorActive, or ErrorPassive state OR has just now recovered from a BusOff condition";
CM_ SG_ 2654339094 EOL_FD03_AGSM "Indicates if the ECU requires configuration data at the assembly plant End Of Line";
CM_ SG_ 2654339094 EOL_FD16_AGSM "Indicates if the ECU requires configuration data at the assembly plant End Of Line";
CM_ SG_ 2654339094 GenericFailSts_FD03_AGSM "Indicates the presence/absent of at least one DTC in the System Memory";
CM_ SG_ 2654339094 GenericFailSts_FD16_AGSM "Indicates the presence/absent of at least one DTC in the System Memory";
CM_ SG_ 2654339094 PreviousCanNMState_FD03_AGSM "Indicates the last CanNM state that the ECU existed in";
CM_ SG_ 2654339094 PreviousCanNMState_FD16_AGSM "Indicates the last CanNM state that the ECU existed in";
CM_ SG_ 2654339094 StayActiveSource_FD03_AGSM "Indicates the source that requests the ECU to stay active";
CM_ SG_ 2654339094 StayActiveSource_FD16_AGSM "Indicates the source that requests the ECU to stay active";
CM_ SG_ 2654339094 WakeupSource_FD03_AGSM "Indicates the reason the ECU was most recently awakened";
CM_ SG_ 2654339094 WakeupSource_FD16_AGSM "Indicates the reason the ECU was most recently awakened";
CM_ SG_ 2654339072 CurrentCanNMState_FD01_BCM "Indicates that CanNM state the ECU is currently executing";
CM_ SG_ 2654339072 CurrentCanNMState_FD02_BCM "Indicates that CanNM state the ECU is currently executing";
CM_ SG_ 2654339072 CurrentCanNMState_FD03_BCM "Indicates that CanNM state the ECU is currently executing";
CM_ SG_ 2654339072 CurrentCanNMState_FD04_BCM "Indicates that CanNM state the ECU is currently executing";
CM_ SG_ 2654339072 CurrentFailSts_FD01_BCM "Indicates the presence/absence of at least one DTC with DTCStatus = present in the System Memory";
CM_ SG_ 2654339072 CurrentFailSts_FD02_BCM "Indicates the presence/absence of at least one DTC with DTCStatus = present in the System Memory";
CM_ SG_ 2654339072 CurrentFailSts_FD03_BCM "Indicates the presence/absence of at least one DTC with DTCStatus = present in the System Memory";
CM_ SG_ 2654339072 CurrentFailSts_FD04_BCM "Indicates the presence/absence of at least one DTC with DTCStatus = present in the System Memory";
CM_ SG_ 2654339072 DES_FD01_BCM "Indicates whether the ECU?s CAN cell is in either ErrorActive, or ErrorPassive state OR has just now recovered from a BusOff condition";
CM_ SG_ 2654339072 DES_FD02_BCM "Indicates whether the ECU?s CAN cell is in either ErrorActive, or ErrorPassive state OR has just now recovered from a BusOff condition";
CM_ SG_ 2654339072 DES_FD03_BCM "Indicates whether the ECU?s CAN cell is in either ErrorActive, or ErrorPassive state OR has just now recovered from a BusOff condition";
CM_ SG_ 2654339072 DES_FD04_BCM "Indicates whether the ECU?s CAN cell is in either ErrorActive, or ErrorPassive state OR has just now recovered from a BusOff condition";
CM_ SG_ 2654339072 EOL_FD01_BCM "Indicates if the ECU requires configuration data at the assembly plant End Of Line";
CM_ SG_ 2654339072 EOL_FD02_BCM "Indicates if the ECU requires configuration data at the assembly plant End Of Line";
CM_ SG_ 2654339072 EOL_FD03_BCM "Indicates if the ECU requires configuration data at the assembly plant End Of Line";
CM_ SG_ 2654339072 EOL_FD04_BCM "Indicates if the ECU requires configuration data at the assembly plant End Of Line";
CM_ SG_ 2654339072 GenericFailSts_FD01_BCM "Indicates the presence/absent of at least one DTC in the System Memory";
CM_ SG_ 2654339072 GenericFailSts_FD02_BCM "Indicates the presence/absent of at least one DTC in the System Memory";
CM_ SG_ 2654339072 GenericFailSts_FD03_BCM "Indicates the presence/absent of at least one DTC in the System Memory";
CM_ SG_ 2654339072 GenericFailSts_FD04_BCM "Indicates the presence/absent of at least one DTC in the System Memory";
CM_ SG_ 2654339072 PreviousCanNMState_FD01_BCM "Indicates the last CanNM state that the ECU existed in";
CM_ SG_ 2654339072 PreviousCanNMState_FD02_BCM "Indicates the last CanNM state that the ECU existed in";
CM_ SG_ 2654339072 PreviousCanNMState_FD03_BCM "Indicates the last CanNM state that the ECU existed in";
CM_ SG_ 2654339072 PreviousCanNMState_FD04_BCM "Indicates the last CanNM state that the ECU existed in";
CM_ SG_ 2654339072 StayActiveSource_FD01_BCM "Indicates the source that requests the ECU to stay active";
CM_ SG_ 2654339072 StayActiveSource_FD02_BCM "Indicates the source that requests the ECU to stay active";
CM_ SG_ 2654339072 StayActiveSource_FD03_BCM "Indicates the source that requests the ECU to stay active";
CM_ SG_ 2654339072 StayActiveSource_FD04_BCM "Indicates the source that requests the ECU to stay active";
CM_ SG_ 2654339072 WakeupSource_FD01_BCM "Indicates the reason the ECU was most recently awakened";
CM_ SG_ 2654339072 WakeupSource_FD02_BCM "Indicates the reason the ECU was most recently awakened";
CM_ SG_ 2654339072 WakeupSource_FD03_BCM "Indicates the reason the ECU was most recently awakened";
CM_ SG_ 2654339072 WakeupSource_FD04_BCM "Indicates the reason the ECU was most recently awakened";
CM_ SG_ 2654339142 CurrentCanNMState_FD05_BPCM "Indicates that CanNM state the ECU is currently executing";
CM_ SG_ 2654339142 CurrentCanNMState_FD11_BPCM "Indicates that CanNM state the ECU is currently executing";
CM_ SG_ 2654339142 CurrentFailSts_FD05_BPCM "Indicates the presence/absence of at least one DTC with DTCStatus = present in the System Memory";
CM_ SG_ 2654339142 CurrentFailSts_FD11_BPCM "Indicates the presence/absence of at least one DTC with DTCStatus = present in the System Memory";
CM_ SG_ 2654339142 DES_FD05_BPCM "Indicates whether the ECU?s CAN cell is in either ErrorActive, or ErrorPassive state OR has just now recovered from a BusOff condition";
CM_ SG_ 2654339142 DES_FD11_BPCM "Indicates whether the ECU?s CAN cell is in either ErrorActive, or ErrorPassive state OR has just now recovered from a BusOff condition";
CM_ SG_ 2654339142 EOL_FD05_BPCM "Indicates if the ECU requires configuration data at the assembly plant End Of Line";
CM_ SG_ 2654339142 EOL_FD11_BPCM "Indicates if the ECU requires configuration data at the assembly plant End Of Line";
CM_ SG_ 2654339142 GenericFailSts_FD05_BPCM "Indicates the presence/absent of at least one DTC in the System Memory";
CM_ SG_ 2654339142 GenericFailSts_FD11_BPCM "Indicates the presence/absent of at least one DTC in the System Memory";
CM_ SG_ 2654339142 PreviousCanNMState_FD05_BPCM "Indicates the last CanNM state that the ECU existed in";
CM_ SG_ 2654339142 PreviousCanNMState_FD11_BPCM "Indicates the last CanNM state that the ECU existed in";
CM_ SG_ 2654339142 StayActiveSource_FD05_BPCM "Indicates the source that requests the ECU to stay active";
CM_ SG_ 2654339142 StayActiveSource_FD11_BPCM "Indicates the source that requests the ECU to stay active";
CM_ SG_ 2654339142 WakeupSource_FD05_BPCM "Indicates the reason the ECU was most recently awakened";
CM_ SG_ 2654339142 WakeupSource_FD11_BPCM "Indicates the reason the ECU was most recently awakened";
CM_ SG_ 2654339078 CurrentCanNMState_FD03_BSM "Indicates that CanNM state the ECU is currently executing";
CM_ SG_ 2654339078 CurrentFailSts_FD03_BSM "Indicates the presence/absence of at least one DTC with DTCStatus = present in the System Memory";
CM_ SG_ 2654339078 DES_FD03_BSM "Indicates whether the ECU?s CAN cell is in either ErrorActive, or ErrorPassive state OR has just now recovered from a BusOff condition";
CM_ SG_ 2654339078 EOL_FD03_BSM "Indicates if the ECU requires configuration data at the assembly plant End Of Line";
CM_ SG_ 2654339078 GenericFailSts_FD03_BSM "Indicates the presence/absent of at least one DTC in the System Memory";
CM_ SG_ 2654339078 PreviousCanNMState_FD03_BSM "Indicates the last CanNM state that the ECU existed in";
CM_ SG_ 2654339078 StayActiveSource_FD03_BSM "Indicates the source that requests the ECU to stay active";
CM_ SG_ 2654339078 WakeupSource_FD03_BSM "Indicates the reason the ECU was most recently awakened";
CM_ SG_ 2654339213 CurrentCanNMState_FD03_CADM "Indicates that CanNM state the ECU is currently executing";
CM_ SG_ 2654339213 CurrentFailSts_FD03_CADM "Indicates the presence/absence of at least one DTC with DTCStatus = present in the System Memory";
CM_ SG_ 2654339213 DES_FD03_CADM "Indicates whether the ECU?s CAN cell is in either ErrorActive, or ErrorPassive state OR has just now recovered from a BusOff condition";
CM_ SG_ 2654339213 EOL_FD03_CADM "Indicates if the ECU requires configuration data at the assembly plant End Of Line";
CM_ SG_ 2654339213 GenericFailSts_FD03_CADM "Indicates the presence/absent of at least one DTC in the System Memory";
CM_ SG_ 2654339213 PreviousCanNMState_FD03_CADM "Indicates the last CanNM state that the ECU existed in";
CM_ SG_ 2654339213 StayActiveSource_FD03_CADM "Indicates the source that requests the ECU to stay active";
CM_ SG_ 2654339213 WakeupSource_FD03_CADM "Indicates the reason the ECU was most recently awakened";
CM_ SG_ 2654339225 CurrentCanNMState_FD03_DMSM "Indicates that CanNM state the ECU is currently executing";
CM_ SG_ 2654339225 CurrentFailSts_FD03_DMSM "Indicates the presence/absence of at least one DTC with DTCStatus = present in the System Memory";
CM_ SG_ 2654339225 DES_FD03_DMSM "Indicates whether the ECU?s CAN cell is in either ErrorActive, or ErrorPassive state OR has just now recovered from a BusOff condition";
CM_ SG_ 2654339225 EOL_FD03_DMSM "Indicates if the ECU requires configuration data at the assembly plant End Of Line";
CM_ SG_ 2654339225 GenericFailSts_FD03_DMSM "Indicates the presence/absent of at least one DTC in the System Memory";
CM_ SG_ 2654339225 PreviousCanNMState_FD03_DMSM "Indicates the last CanNM state that the ECU existed in";
CM_ SG_ 2654339225 StayActiveSource_FD03_DMSM "Indicates the source that requests the ECU to stay active";
CM_ SG_ 2654339225 WakeupSource_FD03_DMSM "Indicates the reason the ECU was most recently awakened";
CM_ SG_ 2654339139 CurrentCanNMState_FD03_DTCM "Indicates that CanNM state the ECU is currently executing";
CM_ SG_ 2654339139 CurrentFailSts_FD03_DTCM "Indicates the presence/absence of at least one DTC with DTCStatus = present in the System Memory";
CM_ SG_ 2654339139 DES_FD03_DTCM "Indicates whether the ECU?s CAN cell is in either ErrorActive, or ErrorPassive state OR has just now recovered from a BusOff condition";
CM_ SG_ 2654339139 EOL_FD03_DTCM "Indicates if the ECU requires configuration data at the assembly plant End Of Line";
CM_ SG_ 2654339139 GenericFailSts_FD03_DTCM "Indicates the presence/absent of at least one DTC in the System Memory";
CM_ SG_ 2654339139 PreviousCanNMState_FD03_DTCM "Indicates the last CanNM state that the ECU existed in";
CM_ SG_ 2654339139 StayActiveSource_FD03_DTCM "Indicates the source that requests the ECU to stay active";
CM_ SG_ 2654339139 WakeupSource_FD03_DTCM "Indicates the reason the ECU was most recently awakened";

BA_DEF_ SG_ "GenSigStartValue" INT 0 2147483647;
BA_DEF_ SG_ "GenSigInactiveValue" INT 0 2147483647;
BA_DEF_ SG_ "GenSigSendType" ENUM "NotUsed","OnWrite","OnWriteWithRepetition","OnChange","OnChangeWithRepetition","IfActive","IfActiveWithRepetition","NoSigSendType";
BA_DEF_ SG_ "SystemSignalLongSymbol" STRING ;
BA_DEF_ SG_ "GenSigTimeoutTime_AGSM" INT 0 65535;
BA_DEF_ SG_ "GenSigTimeoutTime_BCM" INT 0 65535;
BA_DEF_ SG_ "GenSigTimeoutTime_BSM" INT 0 65535;
BA_DEF_ SG_ "GenSigTimeoutTime_CADM" INT 0 65535;
BA_DEF_ SG_ "GenSigTimeoutTime_DMSM" INT 0 65535;
BA_DEF_ SG_ "GenSigTimeoutTime_DTCM" INT 0 65535;
BA_DEF_ SG_ "GenSigTimeoutTime_ECM" INT 0 65535;
BA_DEF_ SG_ "GenSigTimeoutTime_EVCU2" INT 0 65535;
BA_DEF_ SG_ "GenSigTimeoutTime_GNMM" INT 0 65535;
BA_DEF_ SG_ "GenSigTimeoutTime_HCP" INT 0 65535;
BA_DEF_ SG_ "GenSigTimeoutTime_IPC" INT 0 65535;
BA_DEF_ SG_ "GenSigTimeoutTime_RFHM" INT 0 65535;
BA_DEF_ SG_ "GenSigTimeoutTime_SGW" INT 0 65535;
BA_DEF_ SG_ "GenSigTimeoutTime_TCM" INT 0 65535;
BA_DEF_ BO_ "DiagRequest" ENUM "No","Yes";
BA_DEF_ BO_ "Type" ENUM "P","C","PE","COC","PE_Cntrl","E","E_Cntrl","OC","S","BAF","DC","EM","MM","ISO-TP","-";
BA_DEF_ BO_ "DiagResponse" ENUM "No","Yes";
BA_DEF_ BO_ "NmMessage" ENUM "No","Yes";
BA_DEF_ BO_ "GenMsgSendType" ENUM "Cyclic","NotUsed","NotUsed","NotUsed","NotUsed","NotUsed","NotUsed","NotUsed","NoMsgSendType";
BA_DEF_ BO_ "GenMsgNrOfRepetition" INT 0 255;
BA_DEF_ BO_ "GenMsgILSupport" ENUM "No","Yes";
BA_DEF_ BO_ "GenMsgStartDelayTime" INT 0 65535;
BA_DEF_ BO_ "GenMsgCycleTimeFast" INT 0 65535;
BA_DEF_ BO_ "GenMsgCycleTime" INT 0 65535;
BA_DEF_ BO_ "GenMsgDelayTime" INT 0 65535;
BA_DEF_ BO_ "NmAsrMessage" ENUM "No","Yes";
BA_DEF_ BO_ "DiagState" ENUM "No","Yes";
BA_DEF_ BO_ "DiagConnection" HEX 0 65535;
BA_DEF_ BO_ "VFrameFormat" ENUM "StandardCAN","ExtendedCAN","reserved","reserved","reserved","reserved","reserved","reserved","reserved","reserved","reserved","reserved","reserved","reserved","StandardCAN_FD","ExtendedCAN_FD";
BA_DEF_ BO_ "CANFD_BRS" ENUM "0","1";
BA_DEF_DEF_ "DiagRequest" "No";
BA_DEF_DEF_ "Type" "-";
BA_DEF_DEF_ "DiagResponse" "No";
BA_DEF_DEF_ "NmMessage" "No";
BA_DEF_DEF_ "GenMsgSendType" "NoMsgSendType";
BA_DEF_DEF_ "GenMsgNrOfRepetition" 0;
BA_DEF_DEF_ "GenMsgILSupport" "No";
BA_DEF_DEF_ "GenMsgStartDelayTime" 0;
BA_DEF_DEF_ "GenMsgCycleTimeFast" 0;
BA_DEF_DEF_ "GenMsgCycleTime" 0;
BA_DEF_DEF_ "GenMsgDelayTime" 0;
BA_DEF_DEF_ "NmAsrMessage" "No";
BA_DEF_DEF_ "DiagState" "No";
BA_DEF_DEF_ "DiagConnection" 0;
BA_DEF_DEF_ "VFrameFormat" "StandardCAN_FD";
BA_DEF_DEF_ "CANFD_BRS" "0";
BA_DEF_DEF_ "GenSigStartValue" 0;
BA_DEF_DEF_ "GenSigInactiveValue" 0;
BA_DEF_DEF_ "GenSigSendType" "NoSigSendType";
BA_DEF_DEF_ "SystemSignalLongSymbol" "";
BA_DEF_DEF_ "GenSigTimeoutTime_AGSM" 2500;
BA_DEF_DEF_ "GenSigTimeoutTime_BCM" 2500;
BA_DEF_DEF_ "GenSigTimeoutTime_BSM" 2500;
BA_DEF_DEF_ "GenSigTimeoutTime_CADM" 2500;
BA_DEF_DEF_ "GenSigTimeoutTime_DMSM" 2500;
BA_DEF_DEF_ "GenSigTimeoutTime_DTCM" 2500;
BA_DEF_DEF_ "GenSigTimeoutTime_ECM" 2500;
BA_DEF_DEF_ "GenSigTimeoutTime_EVCU2" 2500;
BA_DEF_DEF_ "GenSigTimeoutTime_GNMM" 2500;
BA_DEF_DEF_ "GenSigTimeoutTime_HCP" 2500;
BA_DEF_DEF_ "GenSigTimeoutTime_IPC" 2500;
BA_DEF_DEF_ "GenSigTimeoutTime_RFHM" 2500;
BA_DEF_DEF_ "GenSigTimeoutTime_SGW" 2500;
BA_DEF_DEF_ "GenSigTimeoutTime_TCM" 2500;
BA_ "Type" BO_ 1058 1;
BA_ "GenMsgSendType" BO_ 1058 0;
BA_ "GenMsgILSupport" BO_ 1058 1;
BA_ "GenMsgCycleTime" BO_ 1058 100;
BA_ "CANFD_BRS" BO_ 1058 1;
BA_ "Type" BO_ 611 3;
BA_ "GenMsgSendType" BO_ 611 0;
BA_ "GenMsgILSupport" BO_ 611 1;
BA_ "GenMsgStartDelayTime" BO_ 611 75;
BA_ "GenMsgCycleTime" BO_ 611 100;
BA_ "GenMsgDelayTime" BO_ 611 20;
BA_ "CANFD_BRS" BO_ 611 1;
BA_ "Type" BO_ 1954 3;
BA_ "GenMsgSendType" BO_ 1954 0;
BA_ "GenMsgILSupport" BO_ 1954 1;
BA_ "GenMsgStartDelayTime" BO_ 1954 425;
BA_ "GenMsgCycleTime" BO_ 1954 1000;
BA_ "CANFD_BRS" BO_ 1954 1;
BA_ "Type" BO_ 274 1;
BA_ "GenMsgSendType" BO_ 274 0;
BA_ "GenMsgILSupport" BO_ 274 1;
BA_ "GenMsgStartDelayTime" BO_ 274 5;
BA_ "GenMsgCycleTime" BO_ 274 10;
BA_ "CANFD_BRS" BO_ 274 1;
BA_ "Type" BO_ 2654339094 1;
BA_ "GenMsgSendType" BO_ 2654339094 0;
BA_ "GenMsgILSupport" BO_ 2654339094 1;
BA_ "GenMsgCycleTime" BO_ 2654339094 1000;
BA_ "VFrameFormat" BO_ 2654339094 15;
BA_ "CANFD_BRS" BO_ 2654339094 1;
BA_ "Type" BO_ 2654339072 1;
BA_ "GenMsgSendType" BO_ 2654339072 0;
BA_ "GenMsgILSupport" BO_ 2654339072 1;
BA_ "GenMsgStartDelayTime" BO_ 2654339072 440;
BA_ "GenMsgCycleTime" BO_ 2654339072 1000;
BA_ "VFrameFormat" BO_ 2654339072 15;
BA_ "CANFD_BRS" BO_ 2654339072 1;
BA_ "Type" BO_ 2654339142 1;
BA_ "GenMsgSendType" BO_ 2654339142 0;
BA_ "GenMsgILSupport" BO_ 2654339142 1;
BA_ "GenMsgCycleTime" BO_ 2654339142 1000;
BA_ "VFrameFormat" BO_ 2654339142 15;
BA_ "CANFD_BRS" BO_ 2654339142 1;
BA_ "Type" BO_ 2654339078 1;
BA_ "GenMsgSendType" BO_ 2654339078 0;
BA_ "GenMsgILSupport" BO_ 2654339078 1;
BA_ "GenMsgCycleTime" BO_ 2654339078 1000;
BA_ "VFrameFormat" BO_ 2654339078 15;
BA_ "CANFD_BRS" BO_ 2654339078 1;
BA_ "Type" BO_ 2654339213 1;
BA_ "GenMsgSendType" BO_ 2654339213 0;
BA_ "GenMsgILSupport" BO_ 2654339213 1;
BA_ "GenMsgCycleTime" BO_ 2654339213 1000;
BA_ "VFrameFormat" BO_ 2654339213 15;
BA_ "CANFD_BRS" BO_ 2654339213 1;
BA_ "Type" BO_ 2654339225 1;
BA_ "GenMsgSendType" BO_ 2654339225 0;
BA_ "GenMsgILSupport" BO_ 2654339225 1;
BA_ "GenMsgCycleTime" BO_ 2654339225 1000;
BA_ "VFrameFormat" BO_ 2654339225 15;
BA_ "CANFD_BRS" BO_ 2654339225 1;
BA_ "Type" BO_ 2654339139 1;
BA_ "GenMsgSendType" BO_ 2654339139 0;
BA_ "GenMsgILSupport" BO_ 2654339139 1;
BA_ "GenMsgCycleTime" BO_ 2654339139 1000;
BA_ "VFrameFormat" BO_ 2654339139 15;
BA_ "CANFD_BRS" BO_ 2654339139 1;
BA_ "GenSigTimeoutTime_AGSM" SG_ 1058 AccelPdlPosn_OBD 0;
BA_ "GenSigTimeoutTime_BCM" SG_ 1058 AccelPdlPosn_OBD 0;
BA_ "GenSigTimeoutTime_CADM" SG_ 1058 AccelPdlPosn_OBD 0;
BA_ "GenSigTimeoutTime_DMSM" SG_ 1058 AccelPdlPosn_OBD 0;
BA_ "GenSigTimeoutTime_DTCM" SG_ 1058 AccelPdlPosn_OBD 0;
BA_ "GenSigTimeoutTime_ECM" SG_ 1058 AccelPdlPosn_OBD 0;
BA_ "GenSigTimeoutTime_EVCU2" SG_ 1058 AccelPdlPosn_OBD 0;
BA_ "GenSigTimeoutTime_GNMM" SG_ 1058 AccelPdlPosn_OBD 0;
BA_ "GenSigTimeoutTime_HCP" SG_ 1058 AccelPdlPosn_OBD 0;
BA_ "GenSigTimeoutTime_IPC" SG_ 1058 AccelPdlPosn_OBD 0;
BA_ "GenSigTimeoutTime_RFHM" SG_ 1058 AccelPdlPosn_OBD 0;
BA_ "GenSigTimeoutTime_AGSM" SG_ 1058 BarPrsAbs 0;
BA_ "GenSigTimeoutTime_BCM" SG_ 1058 BarPrsAbs 0;
BA_ "GenSigTimeoutTime_BSM" SG_ 1058 BarPrsAbs 0;
BA_ "GenSigTimeoutTime_CADM" SG_ 1058 BarPrsAbs 0;
BA_ "GenSigTimeoutTime_DMSM" SG_ 1058 BarPrsAbs 0;
BA_ "GenSigTimeoutTime_DTCM" SG_ 1058 BarPrsAbs 0;
BA_ "GenSigTimeoutTime_ECM" SG_ 1058 BarPrsAbs 0;
BA_ "GenSigTimeoutTime_GNMM" SG_ 1058 BarPrsAbs 0;
BA_ "GenSigTimeoutTime_IPC" SG_ 1058 BarPrsAbs 0;
BA_ "GenSigTimeoutTime_RFHM" SG_ 1058 BarPrsAbs 0;
BA_ "GenSigTimeoutTime_SGW" SG_ 1058 BarPrsAbs 0;
BA_ "GenSigTimeoutTime_TCM" SG_ 1058 BarPrsAbs 0;
BA_ "GenSigTimeoutTime_AGSM" SG_ 1058 BarPrsAbsV 0;
BA_ "GenSigTimeoutTime_BCM" SG_ 1058 BarPrsAbsV 0;
BA_ "GenSigTimeoutTime_BSM" SG_ 1058 BarPrsAbsV 0;
BA_ "GenSigTimeoutTime_CADM" SG_ 1058 BarPrsAbsV 0;
BA_ "GenSigTimeoutTime_DMSM" SG_ 1058 BarPrsAbsV 0;
BA_ "GenSigTimeoutTime_DTCM" SG_ 1058 BarPrsAbsV 0;
BA_ "GenSigTimeoutTime_ECM" SG_ 1058 BarPrsAbsV 0;
BA_ "GenSigTimeoutTime_GNMM" SG_ 1058 BarPrsAbsV 0;
BA_ "GenSigTimeoutTime_IPC" SG_ 1058 BarPrsAbsV 0;
BA_ "GenSigTimeoutTime_RFHM" SG_ 1058 BarPrsAbsV 0;
BA_ "GenSigTimeoutTime_SGW" SG_ 1058 BarPrsAbsV 0;
BA_ "GenSigTimeoutTime_TCM" SG_ 1058 BarPrsAbsV 0;
BA_ "GenSigTimeoutTime_AGSM" SG_ 1058 CARB_PERM 0;
BA_ "GenSigTimeoutTime_BCM" SG_ 1058 CARB_PERM 0;
BA_ "GenSigTimeoutTime_CADM" SG_ 1058 CARB_PERM 0;
BA_ "GenSigTimeoutTime_DMSM" SG_ 1058 CARB_PERM 0;
BA_ "GenSigTimeoutTime_DTCM" SG_ 1058 CARB_PERM 0;
BA_ "GenSigTimeoutTime_ECM" SG_ 1058 CARB_PERM 0;
BA_ "GenSigTimeoutTime_GNMM" SG_ 1058 CARB_PERM 0;
BA_ "GenSigTimeoutTime_IPC" SG_ 1058 CARB_PERM 0;
BA_ "GenSigTimeoutTime_RFHM" SG_ 1058 CARB_PERM 0;
BA_ "GenSigTimeoutTime_SGW" SG_ 1058 CARB_PERM 0;
BA_ "GenSigTimeoutTime_AGSM" SG_ 1058 CarbWarmUp 0;
BA_ "GenSigTimeoutTime_BCM" SG_ 1058 CarbWarmUp 0;
BA_ "GenSigTimeoutTime_CADM" SG_ 1058 CarbWarmUp 0;
BA_ "GenSigTimeoutTime_DMSM" SG_ 1058 CarbWarmUp 0;
BA_ "GenSigTimeoutTime_DTCM" SG_ 1058 CarbWarmUp 0;
BA_ "GenSigTimeoutTime_ECM" SG_ 1058 CarbWarmUp 0;
BA_ "GenSigTimeoutTime_GNMM" SG_ 1058 CarbWarmUp 0;
BA_ "GenSigTimeoutTime_IPC" SG_ 1058 CarbWarmUp 0;
BA_ "GenSigTimeoutTime_RFHM" SG_ 1058 CarbWarmUp 0;
BA_ "GenSigTimeoutTime_SGW" SG_ 1058 CarbWarmUp 0;
BA_ "GenSigTimeoutTime_AGSM" SG_ 1058 CldStrtDenominator 0;
BA_ "GenSigTimeoutTime_BCM" SG_ 1058 CldStrtDenominator 0;
BA_ "GenSigTimeoutTime_BSM" SG_ 1058 CldStrtDenominator 0;
BA_ "GenSigTimeoutTime_CADM" SG_ 1058 CldStrtDenominator 0;
BA_ "GenSigTimeoutTime_DMSM" SG_ 1058 CldStrtDenominator 0;
BA_ "GenSigTimeoutTime_DTCM" SG_ 1058 CldStrtDenominator 0;
BA_ "GenSigTimeoutTime_ECM" SG_ 1058 CldStrtDenominator 0;
BA_ "GenSigTimeoutTime_GNMM" SG_ 1058 CldStrtDenominator 0;
BA_ "GenSigTimeoutTime_HCP" SG_ 1058 CldStrtDenominator 0;
BA_ "GenSigTimeoutTime_IPC" SG_ 1058 CldStrtDenominator 0;
BA_ "GenSigTimeoutTime_RFHM" SG_ 1058 CldStrtDenominator 0;
BA_ "GenSigTimeoutTime_SGW" SG_ 1058 CldStrtDenominator 0;
BA_ "GenSigTimeoutTime_TCM" SG_ 1058 CldStrtDenominator 0;
BA_ "GenSigTimeoutTime_AGSM" SG_ 1058 CRC_OBDCONTENTFRAME 0;
BA_ "GenSigTimeoutTime_BCM" SG_ 1058 CRC_OBDCONTENTFRAME 0;
BA_ "GenSigTimeoutTime_CADM" SG_ 1058 CRC_OBDCONTENTFRAME 0;
BA_ "GenSigTimeoutTime_DMSM" SG_ 1058 CRC_OBDCONTENTFRAME 0;
BA_ "GenSigTimeoutTime_DTCM" SG_ 1058 CRC_OBDCONTENTFRAME 0;
BA_ "GenSigTimeoutTime_ECM" SG_ 1058 CRC_OBDCONTENTFRAME 0;
BA_ "GenSigTimeoutTime_GNMM" SG_ 1058 CRC_OBDCONTENTFRAME 0;
BA_ "GenSigTimeoutTime_IPC" SG_ 1058 CRC_OBDCONTENTFRAME 0;
BA_ "GenSigTimeoutTime_RFHM" SG_ 1058 CRC_OBDCONTENTFRAME 0;
BA_ "GenSigTimeoutTime_SGW" SG_ 1058 CRC_OBDCONTENTFRAME 0;
BA_ "GenSigStartValue" SG_ 1058 EngineOFFTime 1023;
BA_ "GenSigTimeoutTime_AGSM" SG_ 1058 EngineOFFTime 0;
BA_ "GenSigTimeoutTime_BCM" SG_ 1058 EngineOFFTime 0;
BA_ "GenSigTimeoutTime_BSM" SG_ 1058 EngineOFFTime 0;
BA_ "GenSigTimeoutTime_CADM" SG_ 1058 EngineOFFTime 0;
BA_ "GenSigTimeoutTime_DMSM" SG_ 1058 EngineOFFTime 0;
BA_ "GenSigTimeoutTime_DTCM" SG_ 1058 EngineOFFTime 0;
BA_ "GenSigTimeoutTime_ECM" SG_ 1058 EngineOFFTime 0;
BA_ "GenSigTimeoutTime_GNMM" SG_ 1058 EngineOFFTime 0;
BA_ "GenSigTimeoutTime_HCP" SG_ 1058 EngineOFFTime 0;
BA_ "GenSigTimeoutTime_IPC" SG_ 1058 EngineOFFTime 0;
BA_ "GenSigTimeoutTime_RFHM" SG_ 1058 EngineOFFTime 0;
BA_ "GenSigTimeoutTime_SGW" SG_ 1058 EngineOFFTime 0;
BA_ "GenSigTimeoutTime_AGSM" SG_ 1058 EngIntAirTmp 0;
BA_ "GenSigTimeoutTime_BCM" SG_ 1058 EngIntAirTmp 0;
BA_ "GenSigTimeoutTime_BSM" SG_ 1058 EngIntAirTmp 0;
BA_ "GenSigTimeoutTime_CADM" SG_ 1058 EngIntAirTmp 0;
BA_ "GenSigTimeoutTime_DMSM" SG_ 1058 EngIntAirTmp 0;
BA_ "GenSigTimeoutTime_DTCM" SG_ 1058 EngIntAirTmp 0;
BA_ "GenSigTimeoutTime_ECM" SG_ 1058 EngIntAirTmp 0;
BA_ "GenSigTimeoutTime_GNMM" SG_ 1058 EngIntAirTmp 0;
BA_ "GenSigTimeoutTime_IPC" SG_ 1058 EngIntAirTmp 0;
BA_ "GenSigTimeoutTime_RFHM" SG_ 1058 EngIntAirTmp 0;
BA_ "GenSigTimeoutTime_SGW" SG_ 1058 EngIntAirTmp 0;
BA_ "GenSigTimeoutTime_TCM" SG_ 1058 EngIntAirTmp 0;
BA_ "GenSigTimeoutTime_AGSM" SG_ 1058 EngIntAirTmpV 0;
BA_ "GenSigTimeoutTime_BCM" SG_ 1058 EngIntAirTmpV 0;
BA_ "GenSigTimeoutTime_BSM" SG_ 1058 EngIntAirTmpV 0;
BA_ "GenSigTimeoutTime_CADM" SG_ 1058 EngIntAirTmpV 0;
BA_ "GenSigTimeoutTime_DMSM" SG_ 1058 EngIntAirTmpV 0;
BA_ "GenSigTimeoutTime_DTCM" SG_ 1058 EngIntAirTmpV 0;
BA_ "GenSigTimeoutTime_ECM" SG_ 1058 EngIntAirTmpV 0;
BA_ "GenSigTimeoutTime_GNMM" SG_ 1058 EngIntAirTmpV 0;
BA_ "GenSigTimeoutTime_IPC" SG_ 1058 EngIntAirTmpV 0;
BA_ "GenSigTimeoutTime_RFHM" SG_ 1058 EngIntAirTmpV 0;
BA_ "GenSigTimeoutTime_SGW" SG_ 1058 EngIntAirTmpV 0;
BA_ "GenSigTimeoutTime_TCM" SG_ 1058 EngIntAirTmpV 0;
BA_ "GenSigTimeoutTime_AGSM" SG_ 1058 EngOffTmPT 0;
BA_ "GenSigTimeoutTime_BCM" SG_ 1058 EngOffTmPT 0;
BA_ "GenSigTimeoutTime_BSM" SG_ 1058 EngOffTmPT 0;
BA_ "GenSigTimeoutTime_CADM" SG_ 1058 EngOffTmPT 0;
BA_ "GenSigTimeoutTime_DMSM" SG_ 1058 EngOffTmPT 0;
BA_ "GenSigTimeoutTime_DTCM" SG_ 1058 EngOffTmPT 0;
BA_ "GenSigTimeoutTime_ECM" SG_ 1058 EngOffTmPT 0;
BA_ "GenSigTimeoutTime_GNMM" SG_ 1058 EngOffTmPT 0;
BA_ "GenSigTimeoutTime_IPC" SG_ 1058 EngOffTmPT 0;
BA_ "GenSigTimeoutTime_RFHM" SG_ 1058 EngOffTmPT 0;
BA_ "GenSigTimeoutTime_SGW" SG_ 1058 EngOffTmPT 0;
BA_ "GenSigTimeoutTime_TCM" SG_ 1058 EngOffTmPT 0;
BA_ "GenSigStartValue" SG_ 1058 EngOffTmPTV 1;
BA_ "GenSigTimeoutTime_AGSM" SG_ 1058 EngOffTmPTV 0;
BA_ "GenSigTimeoutTime_BCM" SG_ 1058 EngOffTmPTV 0;
BA_ "GenSigTimeoutTime_BSM" SG_ 1058 EngOffTmPTV 0;
BA_ "GenSigTimeoutTime_CADM" SG_ 1058 EngOffTmPTV 0;
BA_ "GenSigTimeoutTime_DMSM" SG_ 1058 EngOffTmPTV 0;
BA_ "GenSigTimeoutTime_DTCM" SG_ 1058 EngOffTmPTV 0;
BA_ "GenSigTimeoutTime_ECM" SG_ 1058 EngOffTmPTV 0;
BA_ "GenSigTimeoutTime_GNMM" SG_ 1058 EngOffTmPTV 0;
BA_ "GenSigTimeoutTime_IPC" SG_ 1058 EngOffTmPTV 0;
BA_ "GenSigTimeoutTime_RFHM" SG_ 1058 EngOffTmPTV 0;
BA_ "GenSigTimeoutTime_SGW" SG_ 1058 EngOffTmPTV 0;
BA_ "GenSigTimeoutTime_TCM" SG_ 1058 EngOffTmPTV 0;
BA_ "GenSigTimeoutTime_AGSM" SG_ 1058 EstCatCnvTmp 0;
BA_ "GenSigTimeoutTime_BCM" SG_ 1058 EstCatCnvTmp 0;
BA_ "GenSigTimeoutTime_BSM" SG_ 1058 EstCatCnvTmp 0;
BA_ "GenSigTimeoutTime_CADM" SG_ 1058 EstCatCnvTmp 0;
BA_ "GenSigTimeoutTime_DMSM" SG_ 1058 EstCatCnvTmp 0;
BA_ "GenSigTimeoutTime_DTCM" SG_ 1058 EstCatCnvTmp 0;
BA_ "GenSigTimeoutTime_ECM" SG_ 1058 EstCatCnvTmp 0;
BA_ "GenSigTimeoutTime_GNMM" SG_ 1058 EstCatCnvTmp 0;
BA_ "GenSigTimeoutTime_IPC" SG_ 1058 EstCatCnvTmp 0;
BA_ "GenSigTimeoutTime_RFHM" SG_ 1058 EstCatCnvTmp 0;
BA_ "GenSigTimeoutTime_SGW" SG_ 1058 EstCatCnvTmp 0;
BA_ "GenSigTimeoutTime_TCM" SG_ 1058 EstCatCnvTmp 0;
BA_ "GenSigTimeoutTime_AGSM" SG_ 1058 GenDenominator 0;
BA_ "GenSigTimeoutTime_BCM" SG_ 1058 GenDenominator 0;
BA_ "GenSigTimeoutTime_BSM" SG_ 1058 GenDenominator 0;
BA_ "GenSigTimeoutTime_CADM" SG_ 1058 GenDenominator 0;
BA_ "GenSigTimeoutTime_DMSM" SG_ 1058 GenDenominator 0;
BA_ "GenSigTimeoutTime_DTCM" SG_ 1058 GenDenominator 0;
BA_ "GenSigTimeoutTime_ECM" SG_ 1058 GenDenominator 0;
BA_ "GenSigTimeoutTime_GNMM" SG_ 1058 GenDenominator 0;
BA_ "GenSigTimeoutTime_HCP" SG_ 1058 GenDenominator 0;
BA_ "GenSigTimeoutTime_IPC" SG_ 1058 GenDenominator 0;
BA_ "GenSigTimeoutTime_RFHM" SG_ 1058 GenDenominator 0;
BA_ "GenSigTimeoutTime_SGW" SG_ 1058 GenDenominator 0;
BA_ "GenSigTimeoutTime_AGSM" SG_ 1058 IgnCntrTrue 0;
BA_ "GenSigTimeoutTime_BCM" SG_ 1058 IgnCntrTrue 0;
BA_ "GenSigTimeoutTime_BSM" SG_ 1058 IgnCntrTrue 0;
BA_ "GenSigTimeoutTime_CADM" SG_ 1058 IgnCntrTrue 0;
BA_ "GenSigTimeoutTime_DMSM" SG_ 1058 IgnCntrTrue 0;
BA_ "GenSigTimeoutTime_DTCM" SG_ 1058 IgnCntrTrue 0;
BA_ "GenSigTimeoutTime_ECM" SG_ 1058 IgnCntrTrue 0;
BA_ "GenSigTimeoutTime_GNMM" SG_ 1058 IgnCntrTrue 0;
BA_ "GenSigTimeoutTime_HCP" SG_ 1058 IgnCntrTrue 0;
BA_ "GenSigTimeoutTime_IPC" SG_ 1058 IgnCntrTrue 0;
BA_ "GenSigTimeoutTime_RFHM" SG_ 1058 IgnCntrTrue 0;
BA_ "GenSigTimeoutTime_SGW" SG_ 1058 IgnCntrTrue 0;
BA_ "GenSigTimeoutTime_AGSM" SG_ 1058 Inp_CSD_Fail 0;
BA_ "GenSigTimeoutTime_BCM" SG_ 1058 Inp_CSD_Fail 0;
BA_ "GenSigTimeoutTime_BSM" SG_ 1058 Inp_CSD_Fail 0;
BA_ "GenSigTimeoutTime_CADM" SG_ 1058 Inp_CSD_Fail 0;
BA_ "GenSigTimeoutTime_DMSM" SG_ 1058 Inp_CSD_Fail 0;
BA_ "GenSigTimeoutTime_DTCM" SG_ 1058 Inp_CSD_Fail 0;
BA_ "GenSigTimeoutTime_ECM" SG_ 1058 Inp_CSD_Fail 0;
BA_ "GenSigTimeoutTime_GNMM" SG_ 1058 Inp_CSD_Fail 0;
BA_ "GenSigTimeoutTime_HCP" SG_ 1058 Inp_CSD_Fail 0;
BA_ "GenSigTimeoutTime_IPC" SG_ 1058 Inp_CSD_Fail 0;
BA_ "GenSigTimeoutTime_RFHM" SG_ 1058 Inp_CSD_Fail 0;
BA_ "GenSigTimeoutTime_SGW" SG_ 1058 Inp_CSD_Fail 0;
BA_ "GenSigTimeoutTime_TCM" SG_ 1058 Inp_CSD_Fail 0;
BA_ "GenSigTimeoutTime_AGSM" SG_ 1058 Inp_ICC_Fail 0;
BA_ "GenSigTimeoutTime_BCM" SG_ 1058 Inp_ICC_Fail 0;
BA_ "GenSigTimeoutTime_BSM" SG_ 1058 Inp_ICC_Fail 0;
BA_ "GenSigTimeoutTime_CADM" SG_ 1058 Inp_ICC_Fail 0;
BA_ "GenSigTimeoutTime_DMSM" SG_ 1058 Inp_ICC_Fail 0;
BA_ "GenSigTimeoutTime_DTCM" SG_ 1058 Inp_ICC_Fail 0;
BA_ "GenSigTimeoutTime_ECM" SG_ 1058 Inp_ICC_Fail 0;
BA_ "GenSigTimeoutTime_GNMM" SG_ 1058 Inp_ICC_Fail 0;
BA_ "GenSigTimeoutTime_HCP" SG_ 1058 Inp_ICC_Fail 0;
BA_ "GenSigTimeoutTime_IPC" SG_ 1058 Inp_ICC_Fail 0;
BA_ "GenSigTimeoutTime_RFHM" SG_ 1058 Inp_ICC_Fail 0;
BA_ "GenSigTimeoutTime_SGW" SG_ 1058 Inp_ICC_Fail 0;
BA_ "GenSigTimeoutTime_AGSM" SG_ 1058 InputsGDFail 0;
BA_ "GenSigTimeoutTime_BCM" SG_ 1058 InputsGDFail 0;
BA_ "GenSigTimeoutTime_BSM" SG_ 1058 InputsGDFail 0;
BA_ "GenSigTimeoutTime_CADM" SG_ 1058 InputsGDFail 0;
BA_ "GenSigTimeoutTime_DMSM" SG_ 1058 InputsGDFail 0;
BA_ "GenSigTimeoutTime_DTCM" SG_ 1058 InputsGDFail 0;
BA_ "GenSigTimeoutTime_ECM" SG_ 1058 InputsGDFail 0;
BA_ "GenSigTimeoutTime_GNMM" SG_ 1058 InputsGDFail 0;
BA_ "GenSigTimeoutTime_HCP" SG_ 1058 InputsGDFail 0;
BA_ "GenSigTimeoutTime_IPC" SG_ 1058 InputsGDFail 0;
BA_ "GenSigTimeoutTime_RFHM" SG_ 1058 InputsGDFail 0;
BA_ "GenSigTimeoutTime_SGW" SG_ 1058 InputsGDFail 0;
BA_ "GenSigTimeoutTime_AGSM" SG_ 1058 LgsDiagCldStrtCndFltPr 0;
BA_ "GenSigTimeoutTime_BCM" SG_ 1058 LgsDiagCldStrtCndFltPr 0;
BA_ "GenSigTimeoutTime_BSM" SG_ 1058 LgsDiagCldStrtCndFltPr 0;
BA_ "GenSigTimeoutTime_CADM" SG_ 1058 LgsDiagCldStrtCndFltPr 0;
BA_ "GenSigTimeoutTime_DMSM" SG_ 1058 LgsDiagCldStrtCndFltPr 0;
BA_ "GenSigTimeoutTime_DTCM" SG_ 1058 LgsDiagCldStrtCndFltPr 0;
BA_ "GenSigTimeoutTime_ECM" SG_ 1058 LgsDiagCldStrtCndFltPr 0;
BA_ "GenSigTimeoutTime_GNMM" SG_ 1058 LgsDiagCldStrtCndFltPr 0;
BA_ "GenSigTimeoutTime_IPC" SG_ 1058 LgsDiagCldStrtCndFltPr 0;
BA_ "GenSigTimeoutTime_RFHM" SG_ 1058 LgsDiagCldStrtCndFltPr 0;
BA_ "GenSigTimeoutTime_SGW" SG_ 1058 LgsDiagCldStrtCndFltPr 0;
BA_ "GenSigTimeoutTime_TCM" SG_ 1058 LgsDiagCldStrtCndFltPr 0;
BA_ "GenSigTimeoutTime_AGSM" SG_ 1058 LgsDiagCldStrtCndMet 0;
BA_ "GenSigTimeoutTime_BCM" SG_ 1058 LgsDiagCldStrtCndMet 0;
BA_ "GenSigTimeoutTime_BSM" SG_ 1058 LgsDiagCldStrtCndMet 0;
BA_ "GenSigTimeoutTime_CADM" SG_ 1058 LgsDiagCldStrtCndMet 0;
BA_ "GenSigTimeoutTime_DMSM" SG_ 1058 LgsDiagCldStrtCndMet 0;
BA_ "GenSigTimeoutTime_DTCM" SG_ 1058 LgsDiagCldStrtCndMet 0;
BA_ "GenSigTimeoutTime_ECM" SG_ 1058 LgsDiagCldStrtCndMet 0;
BA_ "GenSigTimeoutTime_GNMM" SG_ 1058 LgsDiagCldStrtCndMet 0;
BA_ "GenSigTimeoutTime_IPC" SG_ 1058 LgsDiagCldStrtCndMet 0;
BA_ "GenSigTimeoutTime_RFHM" SG_ 1058 LgsDiagCldStrtCndMet 0;
BA_ "GenSigTimeoutTime_SGW" SG_ 1058 LgsDiagCldStrtCndMet 0;
BA_ "GenSigTimeoutTime_TCM" SG_ 1058 LgsDiagCldStrtCndMet 0;
BA_ "GenSigTimeoutTime_AGSM" SG_ 1058 LgsDiagStndCondFltPrs 0;
BA_ "GenSigTimeoutTime_BCM" SG_ 1058 LgsDiagStndCondFltPrs 0;
BA_ "GenSigTimeoutTime_BSM" SG_ 1058 LgsDiagStndCondFltPrs 0;
BA_ "GenSigTimeoutTime_CADM" SG_ 1058 LgsDiagStndCondFltPrs 0;
BA_ "GenSigTimeoutTime_DMSM" SG_ 1058 LgsDiagStndCondFltPrs 0;
BA_ "GenSigTimeoutTime_DTCM" SG_ 1058 LgsDiagStndCondFltPrs 0;
BA_ "GenSigTimeoutTime_ECM" SG_ 1058 LgsDiagStndCondFltPrs 0;
BA_ "GenSigTimeoutTime_GNMM" SG_ 1058 LgsDiagStndCondFltPrs 0;
BA_ "GenSigTimeoutTime_HCP" SG_ 1058 LgsDiagStndCondFltPrs 0;
BA_ "GenSigTimeoutTime_IPC" SG_ 1058 LgsDiagStndCondFltPrs 0;
BA_ "GenSigTimeoutTime_RFHM" SG_ 1058 LgsDiagStndCondFltPrs 0;
BA_ "GenSigTimeoutTime_SGW" SG_ 1058 LgsDiagStndCondFltPrs 0;
BA_ "GenSigTimeoutTime_TCM" SG_ 1058 LgsDiagStndCondFltPrs 0;
BA_ "GenSigTimeoutTime_AGSM" SG_ 1058 LgsDiagStndCondMet 0;
BA_ "GenSigTimeoutTime_BCM" SG_ 1058 LgsDiagStndCondMet 0;
BA_ "GenSigTimeoutTime_BSM" SG_ 1058 LgsDiagStndCondMet 0;
BA_ "GenSigTimeoutTime_CADM" SG_ 1058 LgsDiagStndCondMet 0;
BA_ "GenSigTimeoutTime_DMSM" SG_ 1058 LgsDiagStndCondMet 0;
BA_ "GenSigTimeoutTime_DTCM" SG_ 1058 LgsDiagStndCondMet 0;
BA_ "GenSigTimeoutTime_ECM" SG_ 1058 LgsDiagStndCondMet 0;
BA_ "GenSigTimeoutTime_GNMM" SG_ 1058 LgsDiagStndCondMet 0;
BA_ "GenSigTimeoutTime_HCP" SG_ 1058 LgsDiagStndCondMet 0;
BA_ "GenSigTimeoutTime_IPC" SG_ 1058 LgsDiagStndCondMet 0;
BA_ "GenSigTimeoutTime_RFHM" SG_ 1058 LgsDiagStndCondMet 0;
BA_ "GenSigTimeoutTime_SGW" SG_ 1058 LgsDiagStndCondMet 0;
BA_ "GenSigTimeoutTime_TCM" SG_ 1058 LgsDiagStndCondMet 0;
BA_ "GenSigTimeoutTime_AGSM" SG_ 1058 LoadOBD 0;
BA_ "GenSigTimeoutTime_BCM" SG_ 1058 LoadOBD 0;
BA_ "GenSigTimeoutTime_CADM" SG_ 1058 LoadOBD 0;
BA_ "GenSigTimeoutTime_DMSM" SG_ 1058 LoadOBD 0;
BA_ "GenSigTimeoutTime_DTCM" SG_ 1058 LoadOBD 0;
BA_ "GenSigTimeoutTime_ECM" SG_ 1058 LoadOBD 0;
BA_ "GenSigTimeoutTime_GNMM" SG_ 1058 LoadOBD 0;
BA_ "GenSigTimeoutTime_HCP" SG_ 1058 LoadOBD 0;
BA_ "GenSigTimeoutTime_IPC" SG_ 1058 LoadOBD 0;
BA_ "GenSigTimeoutTime_RFHM" SG_ 1058 LoadOBD 0;
BA_ "GenSigTimeoutTime_AGSM" SG_ 1058 MessageCounter_OBDCONTENTFRAME 0;
BA_ "GenSigTimeoutTime_BCM" SG_ 1058 MessageCounter_OBDCONTENTFRAME 0;
BA_ "GenSigTimeoutTime_CADM" SG_ 1058 MessageCounter_OBDCONTENTFRAME 0;
BA_ "GenSigTimeoutTime_DMSM" SG_ 1058 MessageCounter_OBDCONTENTFRAME 0;
BA_ "GenSigTimeoutTime_DTCM" SG_ 1058 MessageCounter_OBDCONTENTFRAME 0;
BA_ "GenSigTimeoutTime_ECM" SG_ 1058 MessageCounter_OBDCONTENTFRAME 0;
BA_ "GenSigTimeoutTime_GNMM" SG_ 1058 MessageCounter_OBDCONTENTFRAME 0;
BA_ "GenSigTimeoutTime_IPC" SG_ 1058 MessageCounter_OBDCONTENTFRAME 0;
BA_ "GenSigTimeoutTime_RFHM" SG_ 1058 MessageCounter_OBDCONTENTFRAME 0;
BA_ "GenSigTimeoutTime_SGW" SG_ 1058 MessageCounter_OBDCONTENTFRAME 0;
BA_ "GenSigTimeoutTime_AGSM" SG_ 1058 OAT_PT_Est 0;
BA_ "GenSigTimeoutTime_BCM" SG_ 1058 OAT_PT_Est 0;
BA_ "GenSigTimeoutTime_BSM" SG_ 1058 OAT_PT_Est 0;
BA_ "GenSigTimeoutTime_CADM" SG_ 1058 OAT_PT_Est 0;
BA_ "GenSigTimeoutTime_DMSM" SG_ 1058 OAT_PT_Est 0;
BA_ "GenSigTimeoutTime_DTCM" SG_ 1058 OAT_PT_Est 0;
BA_ "GenSigTimeoutTime_ECM" SG_ 1058 OAT_PT_Est 0;
BA_ "GenSigTimeoutTime_GNMM" SG_ 1058 OAT_PT_Est 0;
BA_ "GenSigTimeoutTime_IPC" SG_ 1058 OAT_PT_Est 0;
BA_ "GenSigTimeoutTime_RFHM" SG_ 1058 OAT_PT_Est 0;
BA_ "GenSigTimeoutTime_SGW" SG_ 1058 OAT_PT_Est 0;
BA_ "GenSigTimeoutTime_TCM" SG_ 1058 OAT_PT_Est 0;
BA_ "GenSigTimeoutTime_AGSM" SG_ 1058 OAT_PT_EstV 0;
BA_ "GenSigTimeoutTime_BCM" SG_ 1058 OAT_PT_EstV 0;
BA_ "GenSigTimeoutTime_BSM" SG_ 1058 OAT_PT_EstV 0;
BA_ "GenSigTimeoutTime_CADM" SG_ 1058 OAT_PT_EstV 0;
BA_ "GenSigTimeoutTime_DMSM" SG_ 1058 OAT_PT_EstV 0;
BA_ "GenSigTimeoutTime_DTCM" SG_ 1058 OAT_PT_EstV 0;
BA_ "GenSigTimeoutTime_ECM" SG_ 1058 OAT_PT_EstV 0;
BA_ "GenSigTimeoutTime_GNMM" SG_ 1058 OAT_PT_EstV 0;
BA_ "GenSigTimeoutTime_IPC" SG_ 1058 OAT_PT_EstV 0;
BA_ "GenSigTimeoutTime_RFHM" SG_ 1058 OAT_PT_EstV 0;
BA_ "GenSigTimeoutTime_SGW" SG_ 1058 OAT_PT_EstV 0;
BA_ "GenSigTimeoutTime_TCM" SG_ 1058 OAT_PT_EstV 0;
BA_ "GenSigTimeoutTime_AGSM" SG_ 1058 PSActiveTimer_OBD 0;
BA_ "GenSigTimeoutTime_BCM" SG_ 1058 PSActiveTimer_OBD 0;
BA_ "GenSigTimeoutTime_BSM" SG_ 1058 PSActiveTimer_OBD 0;
BA_ "GenSigTimeoutTime_CADM" SG_ 1058 PSActiveTimer_OBD 0;
BA_ "GenSigTimeoutTime_DMSM" SG_ 1058 PSActiveTimer_OBD 0;
BA_ "GenSigTimeoutTime_DTCM" SG_ 1058 PSActiveTimer_OBD 0;
BA_ "GenSigTimeoutTime_ECM" SG_ 1058 PSActiveTimer_OBD 0;
BA_ "GenSigTimeoutTime_GNMM" SG_ 1058 PSActiveTimer_OBD 0;
BA_ "GenSigTimeoutTime_HCP" SG_ 1058 PSActiveTimer_OBD 0;
BA_ "GenSigTimeoutTime_IPC" SG_ 1058 PSActiveTimer_OBD 0;
BA_ "GenSigTimeoutTime_RFHM" SG_ 1058 PSActiveTimer_OBD 0;
BA_ "GenSigTimeoutTime_SGW" SG_ 1058 PSActiveTimer_OBD 0;
BA_ "GenSigTimeoutTime_TCM" SG_ 1058 PSActiveTimer_OBD 0;
BA_ "GenSigStartValue" SG_ 611 AirBagFailSts 2;
BA_ "GenSigTimeoutTime_AGSM" SG_ 611 AirBagFailSts 0;
BA_ "GenSigTimeoutTime_BCM" SG_ 611 AirBagFailSts 0;
BA_ "GenSigTimeoutTime_BSM" SG_ 611 AirBagFailSts 0;
BA_ "GenSigTimeoutTime_CADM" SG_ 611 AirBagFailSts 0;
BA_ "GenSigTimeoutTime_DMSM" SG_ 611 AirBagFailSts 0;
BA_ "GenSigTimeoutTime_DTCM" SG_ 611 AirBagFailSts 0;
BA_ "GenSigTimeoutTime_ECM" SG_ 611 AirBagFailSts 0;
BA_ "GenSigTimeoutTime_EVCU2" SG_ 611 AirBagFailSts 0;
BA_ "GenSigTimeoutTime_GNMM" SG_ 611 AirBagFailSts 0;
BA_ "GenSigTimeoutTime_HCP" SG_ 611 AirBagFailSts 0;
BA_ "GenSigTimeoutTime_RFHM" SG_ 611 AirBagFailSts 0;
BA_ "GenSigTimeoutTime_SGW" SG_ 611 AirBagFailSts 0;
BA_ "GenSigTimeoutTime_TCM" SG_ 611 AirBagFailSts 0;
BA_ "GenSigTimeoutTime_AGSM" SG_ 611 CRC_ORC1 0;
BA_ "GenSigTimeoutTime_BCM" SG_ 611 CRC_ORC1 0;
BA_ "GenSigTimeoutTime_BSM" SG_ 611 CRC_ORC1 0;
BA_ "GenSigTimeoutTime_CADM" SG_ 611 CRC_ORC1 0;
BA_ "GenSigTimeoutTime_DMSM" SG_ 611 CRC_ORC1 0;
BA_ "GenSigTimeoutTime_DTCM" SG_ 611 CRC_ORC1 0;
BA_ "GenSigTimeoutTime_ECM" SG_ 611 CRC_ORC1 0;
BA_ "GenSigTimeoutTime_GNMM" SG_ 611 CRC_ORC1 0;
BA_ "GenSigTimeoutTime_RFHM" SG_ 611 CRC_ORC1 0;
BA_ "GenSigTimeoutTime_SGW" SG_ 611 CRC_ORC1 0;
BA_ "GenSigTimeoutTime_TCM" SG_ 611 CRC_ORC1 0;
BA_ "GenSigTimeoutTime_AGSM" SG_ 611 MessageCounter_ORC1 0;
BA_ "GenSigTimeoutTime_BCM" SG_ 611 MessageCounter_ORC1 0;
BA_ "GenSigTimeoutTime_BSM" SG_ 611 MessageCounter_ORC1 0;
BA_ "GenSigTimeoutTime_CADM" SG_ 611 MessageCounter_ORC1 0;
BA_ "GenSigTimeoutTime_DMSM" SG_ 611 MessageCounter_ORC1 0;
BA_ "GenSigTimeoutTime_DTCM" SG_ 611 MessageCounter_ORC1 0;
BA_ "GenSigTimeoutTime_ECM" SG_ 611 MessageCounter_ORC1 0;
BA_ "GenSigTimeoutTime_GNMM" SG_ 611 MessageCounter_ORC1 0;
BA_ "GenSigTimeoutTime_RFHM" SG_ 611 MessageCounter_ORC1 0;
BA_ "GenSigTimeoutTime_SGW" SG_ 611 MessageCounter_ORC1 0;
BA_ "GenSigTimeoutTime_TCM" SG_ 611 MessageCounter_ORC1 0;
BA_ "GenSigTimeoutTime_AGSM" SG_ 611 SBR1RowDriverSeatConfigSts 0;
BA_ "GenSigTimeoutTime_BCM" SG_ 611 SBR1RowDriverSeatConfigSts 0;
BA_ "GenSigTimeoutTime_BSM" SG_ 611 SBR1RowDriverSeatConfigSts 0;
BA_ "GenSigTimeoutTime_CADM" SG_ 611 SBR1RowDriverSeatConfigSts 0;
BA_ "GenSigTimeoutTime_DMSM" SG_ 611 SBR1RowDriverSeatConfigSts 0;
BA_ "GenSigTimeoutTime_DTCM" SG_ 611 SBR1RowDriverSeatConfigSts 0;
BA_ "GenSigTimeoutTime_ECM" SG_ 611 SBR1RowDriverSeatConfigSts 0;
BA_ "GenSigTimeoutTime_EVCU2" SG_ 611 SBR1RowDriverSeatConfigSts 0;
BA_ "GenSigTimeoutTime_GNMM" SG_ 611 SBR1RowDriverSeatConfigSts 0;
BA_ "GenSigTimeoutTime_HCP" SG_ 611 SBR1RowDriverSeatConfigSts 0;
BA_ "GenSigTimeoutTime_RFHM" SG_ 611 SBR1RowDriverSeatConfigSts 0;
BA_ "GenSigTimeoutTime_SGW" SG_ 611 SBR1RowDriverSeatConfigSts 0;
BA_ "GenSigTimeoutTime_TCM" SG_ 611 SBR1RowDriverSeatConfigSts 0;
BA_ "GenSigStartValue" SG_ 611 SBR1RowDriverSeatSts 3;
BA_ "GenSigSendType" SG_ 611 SBR1RowDriverSeatSts 3;
BA_ "GenSigTimeoutTime_AGSM" SG_ 611 SBR1RowDriverSeatSts 0;
BA_ "GenSigTimeoutTime_BCM" SG_ 611 SBR1RowDriverSeatSts 0;
BA_ "GenSigTimeoutTime_BSM" SG_ 611 SBR1RowDriverSeatSts 0;
BA_ "GenSigTimeoutTime_CADM" SG_ 611 SBR1RowDriverSeatSts 0;
BA_ "GenSigTimeoutTime_DMSM" SG_ 611 SBR1RowDriverSeatSts 0;
BA_ "GenSigTimeoutTime_DTCM" SG_ 611 SBR1RowDriverSeatSts 0;
BA_ "GenSigTimeoutTime_ECM" SG_ 611 SBR1RowDriverSeatSts 0;
BA_ "GenSigTimeoutTime_GNMM" SG_ 611 SBR1RowDriverSeatSts 0;
BA_ "GenSigTimeoutTime_HCP" SG_ 611 SBR1RowDriverSeatSts 0;
BA_ "GenSigTimeoutTime_RFHM" SG_ 611 SBR1RowDriverSeatSts 0;
BA_ "GenSigTimeoutTime_TCM" SG_ 611 SBR1RowDriverSeatSts 0;
BA_ "GenSigTimeoutTime_AGSM" SG_ 611 SBR1RowPsngrSeatConfigSts 0;
BA_ "GenSigTimeoutTime_BCM" SG_ 611 SBR1RowPsngrSeatConfigSts 0;
BA_ "GenSigTimeoutTime_BSM" SG_ 611 SBR1RowPsngrSeatConfigSts 0;
BA_ "GenSigTimeoutTime_CADM" SG_ 611 SBR1RowPsngrSeatConfigSts 0;
BA_ "GenSigTimeoutTime_DMSM" SG_ 611 SBR1RowPsngrSeatConfigSts 0;
BA_ "GenSigTimeoutTime_DTCM" SG_ 611 SBR1RowPsngrSeatConfigSts 0;
BA_ "GenSigTimeoutTime_ECM" SG_ 611 SBR1RowPsngrSeatConfigSts 0;
BA_ "GenSigTimeoutTime_EVCU2" SG_ 611 SBR1RowPsngrSeatConfigSts 0;
BA_ "GenSigTimeoutTime_GNMM" SG_ 611 SBR1RowPsngrSeatConfigSts 0;
BA_ "GenSigTimeoutTime_HCP" SG_ 611 SBR1RowPsngrSeatConfigSts 0;
BA_ "GenSigTimeoutTime_RFHM" SG_ 611 SBR1RowPsngrSeatConfigSts 0;
BA_ "GenSigTimeoutTime_SGW" SG_ 611 SBR1RowPsngrSeatConfigSts 0;
BA_ "GenSigTimeoutTime_TCM" SG_ 611 SBR1RowPsngrSeatConfigSts 0;
BA_ "GenSigStartValue" SG_ 611 SBR1RowPsngrSeatSts 7;
BA_ "GenSigSendType" SG_ 611 SBR1RowPsngrSeatSts 3;
BA_ "GenSigTimeoutTime_AGSM" SG_ 611 SBR1RowPsngrSeatSts 0;
BA_ "GenSigTimeoutTime_BCM" SG_ 611 SBR1RowPsngrSeatSts 0;
BA_ "GenSigTimeoutTime_BSM" SG_ 611 SBR1RowPsngrSeatSts 0;
BA_ "GenSigTimeoutTime_CADM" SG_ 611 SBR1RowPsngrSeatSts 0;
BA_ "GenSigTimeoutTime_DMSM" SG_ 611 SBR1RowPsngrSeatSts 0;
BA_ "GenSigTimeoutTime_DTCM" SG_ 611 SBR1RowPsngrSeatSts 0;
BA_ "GenSigTimeoutTime_ECM" SG_ 611 SBR1RowPsngrSeatSts 0;
BA_ "GenSigTimeoutTime_EVCU2" SG_ 611 SBR1RowPsngrSeatSts 0;
BA_ "GenSigTimeoutTime_GNMM" SG_ 611 SBR1RowPsngrSeatSts 0;
BA_ "GenSigTimeoutTime_HCP" SG_ 611 SBR1RowPsngrSeatSts 0;
BA_ "GenSigTimeoutTime_RFHM" SG_ 611 SBR1RowPsngrSeatSts 0;
BA_ "GenSigTimeoutTime_TCM" SG_ 611 SBR1RowPsngrSeatSts 0;
BA_ "GenSigTimeoutTime_AGSM" SG_ 1954 CRC_ORC2 0;
BA_ "GenSigTimeoutTime_BCM" SG_ 1954 CRC_ORC2 0;
BA_ "GenSigTimeoutTime_CADM" SG_ 1954 CRC_ORC2 0;
BA_ "GenSigTimeoutTime_DMSM" SG_ 1954 CRC_ORC2 0;
BA_ "GenSigTimeoutTime_DTCM" SG_ 1954 CRC_ORC2 0;
BA_ "GenSigTimeoutTime_EVCU2" SG_ 1954 CRC_ORC2 0;
BA_ "GenSigTimeoutTime_GNMM" SG_ 1954 CRC_ORC2 0;
BA_ "GenSigTimeoutTime_HCP" SG_ 1954 CRC_ORC2 0;
BA_ "GenSigTimeoutTime_IPC" SG_ 1954 CRC_ORC2 0;
BA_ "GenSigTimeoutTime_RFHM" SG_ 1954 CRC_ORC2 0;
BA_ "GenSigTimeoutTime_SGW" SG_ 1954 CRC_ORC2 0;
BA_ "GenSigTimeoutTime_AGSM" SG_ 1954 DrvSbltUnFltr_1 0;
BA_ "GenSigTimeoutTime_BCM" SG_ 1954 DrvSbltUnFltr_1 0;
BA_ "GenSigTimeoutTime_CADM" SG_ 1954 DrvSbltUnFltr_1 0;
BA_ "GenSigTimeoutTime_DMSM" SG_ 1954 DrvSbltUnFltr_1 0;
BA_ "GenSigTimeoutTime_DTCM" SG_ 1954 DrvSbltUnFltr_1 0;
BA_ "GenSigTimeoutTime_EVCU2" SG_ 1954 DrvSbltUnFltr_1 0;
BA_ "GenSigTimeoutTime_GNMM" SG_ 1954 DrvSbltUnFltr_1 0;
BA_ "GenSigTimeoutTime_HCP" SG_ 1954 DrvSbltUnFltr_1 0;
BA_ "GenSigTimeoutTime_IPC" SG_ 1954 DrvSbltUnFltr_1 0;
BA_ "GenSigTimeoutTime_RFHM" SG_ 1954 DrvSbltUnFltr_1 0;
BA_ "GenSigTimeoutTime_SGW" SG_ 1954 DrvSbltUnFltr_1 0;
BA_ "GenSigTimeoutTime_AGSM" SG_ 1954 MessageCounter_ORC2 0;
BA_ "GenSigTimeoutTime_BCM" SG_ 1954 MessageCounter_ORC2 0;
BA_ "GenSigTimeoutTime_CADM" SG_ 1954 MessageCounter_ORC2 0;
BA_ "GenSigTimeoutTime_DMSM" SG_ 1954 MessageCounter_ORC2 0;
BA_ "GenSigTimeoutTime_DTCM" SG_ 1954 MessageCounter_ORC2 0;
BA_ "GenSigTimeoutTime_EVCU2" SG_ 1954 MessageCounter_ORC2 0;
BA_ "GenSigTimeoutTime_GNMM" SG_ 1954 MessageCounter_ORC2 0;
BA_ "GenSigTimeoutTime_HCP" SG_ 1954 MessageCounter_ORC2 0;
BA_ "GenSigTimeoutTime_IPC" SG_ 1954 MessageCounter_ORC2 0;
BA_ "GenSigTimeoutTime_RFHM" SG_ 1954 MessageCounter_ORC2 0;
BA_ "GenSigTimeoutTime_SGW" SG_ 1954 MessageCounter_ORC2 0;
BA_ "GenSigStartValue" SG_ 1954 SBR1RowPsngrSeatPPDSts 3;
BA_ "GenSigSendType" SG_ 1954 SBR1RowPsngrSeatPPDSts 3;
BA_ "GenSigTimeoutTime_AGSM" SG_ 1954 SBR1RowPsngrSeatPPDSts 0;
BA_ "GenSigTimeoutTime_BCM" SG_ 1954 SBR1RowPsngrSeatPPDSts 0;
BA_ "GenSigTimeoutTime_BSM" SG_ 1954 SBR1RowPsngrSeatPPDSts 0;
BA_ "GenSigTimeoutTime_CADM" SG_ 1954 SBR1RowPsngrSeatPPDSts 0;
BA_ "GenSigTimeoutTime_DMSM" SG_ 1954 SBR1RowPsngrSeatPPDSts 0;
BA_ "GenSigTimeoutTime_DTCM" SG_ 1954 SBR1RowPsngrSeatPPDSts 0;
BA_ "GenSigTimeoutTime_ECM" SG_ 1954 SBR1RowPsngrSeatPPDSts 0;
BA_ "GenSigTimeoutTime_EVCU2" SG_ 1954 SBR1RowPsngrSeatPPDSts 0;
BA_ "GenSigTimeoutTime_GNMM" SG_ 1954 SBR1RowPsngrSeatPPDSts 0;
BA_ "GenSigTimeoutTime_HCP" SG_ 1954 SBR1RowPsngrSeatPPDSts 0;
BA_ "GenSigTimeoutTime_RFHM" SG_ 1954 SBR1RowPsngrSeatPPDSts 0;
BA_ "GenSigTimeoutTime_SGW" SG_ 1954 SBR1RowPsngrSeatPPDSts 0;
BA_ "GenSigTimeoutTime_TCM" SG_ 1954 SBR1RowPsngrSeatPPDSts 0;
BA_ "GenSigTimeoutTime_AGSM" SG_ 274 CRC_ORC3 0;
BA_ "GenSigTimeoutTime_BCM" SG_ 274 CRC_ORC3 0;
BA_ "GenSigTimeoutTime_BSM" SG_ 274 CRC_ORC3 0;
BA_ "GenSigTimeoutTime_CADM" SG_ 274 CRC_ORC3 0;
BA_ "GenSigTimeoutTime_DMSM" SG_ 274 CRC_ORC3 0;
BA_ "GenSigTimeoutTime_GNMM" SG_ 274 CRC_ORC3 0;
BA_ "GenSigTimeoutTime_IPC" SG_ 274 CRC_ORC3 0;
BA_ "GenSigTimeoutTime_RFHM" SG_ 274 CRC_ORC3 0;
BA_ "GenSigTimeoutTime_SGW" SG_ 274 CRC_ORC3 0;
BA_ "GenSigStartValue" SG_ 274 LatAcceleration 4095;
BA_ "GenSigTimeoutTime_AGSM" SG_ 274 LatAcceleration 0;
BA_ "GenSigTimeoutTime_BCM" SG_ 274 LatAcceleration 0;
BA_ "GenSigTimeoutTime_BSM" SG_ 274 LatAcceleration 0;
BA_ "GenSigTimeoutTime_CADM" SG_ 274 LatAcceleration 0;
BA_ "GenSigTimeoutTime_DMSM" SG_ 274 LatAcceleration 0;
BA_ "GenSigTimeoutTime_GNMM" SG_ 274 LatAcceleration 0;
BA_ "GenSigTimeoutTime_HCP" SG_ 274 LatAcceleration 0;
BA_ "GenSigTimeoutTime_IPC" SG_ 274 LatAcceleration 0;
BA_ "GenSigTimeoutTime_RFHM" SG_ 274 LatAcceleration 0;
BA_ "GenSigTimeoutTime_SGW" SG_ 274 LatAcceleration 0;
BA_ "GenSigTimeoutTime_AGSM" SG_ 274 LatAccelerationFailSts 0;
BA_ "GenSigTimeoutTime_BCM" SG_ 274 LatAccelerationFailSts 0;
BA_ "GenSigTimeoutTime_BSM" SG_ 274 LatAccelerationFailSts 0;
BA_ "GenSigTimeoutTime_CADM" SG_ 274 LatAccelerationFailSts 0;
BA_ "GenSigTimeoutTime_DMSM" SG_ 274 LatAccelerationFailSts 0;
BA_ "GenSigTimeoutTime_GNMM" SG_ 274 LatAccelerationFailSts 0;
BA_ "GenSigTimeoutTime_HCP" SG_ 274 LatAccelerationFailSts 0;
BA_ "GenSigTimeoutTime_IPC" SG_ 274 LatAccelerationFailSts 0;
BA_ "GenSigTimeoutTime_RFHM" SG_ 274 LatAccelerationFailSts 0;
BA_ "GenSigTimeoutTime_SGW" SG_ 274 LatAccelerationFailSts 0;
BA_ "GenSigTimeoutTime_TCM" SG_ 274 LatAccelerationFailSts 0;
BA_ "GenSigStartValue" SG_ 274 LongAcceleration 4095;
BA_ "GenSigTimeoutTime_AGSM" SG_ 274 LongAcceleration 0;
BA_ "GenSigTimeoutTime_BCM" SG_ 274 LongAcceleration 0;
BA_ "GenSigTimeoutTime_BSM" SG_ 274 LongAcceleration 0;
BA_ "GenSigTimeoutTime_CADM" SG_ 274 LongAcceleration 0;
BA_ "GenSigTimeoutTime_DMSM" SG_ 274 LongAcceleration 0;
BA_ "GenSigTimeoutTime_GNMM" SG_ 274 LongAcceleration 0;
BA_ "GenSigTimeoutTime_IPC" SG_ 274 LongAcceleration 0;
BA_ "GenSigTimeoutTime_RFHM" SG_ 274 LongAcceleration 0;
BA_ "GenSigTimeoutTime_SGW" SG_ 274 LongAcceleration 0;
BA_ "GenSigTimeoutTime_AGSM" SG_ 274 LongAccelerationFailSts 0;
BA_ "GenSigTimeoutTime_BCM" SG_ 274 LongAccelerationFailSts 0;
BA_ "GenSigTimeoutTime_BSM" SG_ 274 LongAccelerationFailSts 0;
BA_ "GenSigTimeoutTime_CADM" SG_ 274 LongAccelerationFailSts 0;
BA_ "GenSigTimeoutTime_DMSM" SG_ 274 LongAccelerationFailSts 0;
BA_ "GenSigTimeoutTime_GNMM" SG_ 274 LongAccelerationFailSts 0;
BA_ "GenSigTimeoutTime_HCP" SG_ 274 LongAccelerationFailSts 0;
BA_ "GenSigTimeoutTime_IPC" SG_ 274 LongAccelerationFailSts 0;
BA_ "GenSigTimeoutTime_RFHM" SG_ 274 LongAccelerationFailSts 0;
BA_ "GenSigTimeoutTime_SGW" SG_ 274 LongAccelerationFailSts 0;
BA_ "GenSigTimeoutTime_TCM" SG_ 274 LongAccelerationFailSts 0;
BA_ "GenSigTimeoutTime_AGSM" SG_ 274 MessageCounter_ORC3 0;
BA_ "GenSigTimeoutTime_BCM" SG_ 274 MessageCounter_ORC3 0;
BA_ "GenSigTimeoutTime_BSM" SG_ 274 MessageCounter_ORC3 0;
BA_ "GenSigTimeoutTime_CADM" SG_ 274 MessageCounter_ORC3 0;
BA_ "GenSigTimeoutTime_DMSM" SG_ 274 MessageCounter_ORC3 0;
BA_ "GenSigTimeoutTime_GNMM" SG_ 274 MessageCounter_ORC3 0;
BA_ "GenSigTimeoutTime_IPC" SG_ 274 MessageCounter_ORC3 0;
BA_ "GenSigTimeoutTime_RFHM" SG_ 274 MessageCounter_ORC3 0;
BA_ "GenSigTimeoutTime_SGW" SG_ 274 MessageCounter_ORC3 0;
BA_ "GenSigStartValue" SG_ 274 YawRate 4095;
BA_ "GenSigTimeoutTime_AGSM" SG_ 274 YawRate 0;
BA_ "GenSigTimeoutTime_BCM" SG_ 274 YawRate 0;
BA_ "GenSigTimeoutTime_BSM" SG_ 274 YawRate 0;
BA_ "GenSigTimeoutTime_CADM" SG_ 274 YawRate 0;
BA_ "GenSigTimeoutTime_DMSM" SG_ 274 YawRate 0;
BA_ "GenSigTimeoutTime_ECM" SG_ 274 YawRate 0;
BA_ "GenSigTimeoutTime_GNMM" SG_ 274 YawRate 0;
BA_ "GenSigTimeoutTime_HCP" SG_ 274 YawRate 0;
BA_ "GenSigTimeoutTime_IPC" SG_ 274 YawRate 0;
BA_ "GenSigTimeoutTime_RFHM" SG_ 274 YawRate 0;
BA_ "GenSigTimeoutTime_SGW" SG_ 274 YawRate 0;
BA_ "GenSigTimeoutTime_TCM" SG_ 274 YawRate 0;
BA_ "GenSigTimeoutTime_AGSM" SG_ 274 YawRateFailSts 0;
BA_ "GenSigTimeoutTime_BCM" SG_ 274 YawRateFailSts 0;
BA_ "GenSigTimeoutTime_BSM" SG_ 274 YawRateFailSts 0;
BA_ "GenSigTimeoutTime_CADM" SG_ 274 YawRateFailSts 0;
BA_ "GenSigTimeoutTime_DMSM" SG_ 274 YawRateFailSts 0;
BA_ "GenSigTimeoutTime_ECM" SG_ 274 YawRateFailSts 0;
BA_ "GenSigTimeoutTime_GNMM" SG_ 274 YawRateFailSts 0;
BA_ "GenSigTimeoutTime_HCP" SG_ 274 YawRateFailSts 0;
BA_ "GenSigTimeoutTime_IPC" SG_ 274 YawRateFailSts 0;
BA_ "GenSigTimeoutTime_RFHM" SG_ 274 YawRateFailSts 0;
BA_ "GenSigTimeoutTime_SGW" SG_ 274 YawRateFailSts 0;
BA_ "GenSigTimeoutTime_TCM" SG_ 274 YawRateFailSts 0;
BA_ "GenSigTimeoutTime_AGSM" SG_ 2654339094 CurrentCanNMState_FD03_AGSM 0;
BA_ "GenSigTimeoutTime_BCM" SG_ 2654339094 CurrentCanNMState_FD03_AGSM 0;
BA_ "GenSigTimeoutTime_BSM" SG_ 2654339094 CurrentCanNMState_FD03_AGSM 0;
BA_ "GenSigTimeoutTime_CADM" SG_ 2654339094 CurrentCanNMState_FD03_AGSM 0;
BA_ "GenSigTimeoutTime_DMSM" SG_ 2654339094 CurrentCanNMState_FD03_AGSM 0;
BA_ "GenSigTimeoutTime_DTCM" SG_ 2654339094 CurrentCanNMState_FD03_AGSM 0;
BA_ "GenSigTimeoutTime_ECM" SG_ 2654339094 CurrentCanNMState_FD03_AGSM 0;
BA_ "GenSigTimeoutTime_EVCU2" SG_ 2654339094 CurrentCanNMState_FD03_AGSM 0;
BA_ "GenSigTimeoutTime_GNMM" SG_ 2654339094 CurrentCanNMState_FD03_AGSM 0;
BA_ "GenSigTimeoutTime_HCP" SG_ 2654339094 CurrentCanNMState_FD03_AGSM 0;
BA_ "GenSigTimeoutTime_IPC" SG_ 2654339094 CurrentCanNMState_FD03_AGSM 0;
BA_ "GenSigTimeoutTime_RFHM" SG_ 2654339094 CurrentCanNMState_FD03_AGSM 0;
BA_ "GenSigTimeoutTime_TCM" SG_ 2654339094 CurrentCanNMState_FD03_AGSM 0;
BA_ "GenSigTimeoutTime_AGSM" SG_ 2654339094 CurrentCanNMState_FD16_AGSM 0;
BA_ "GenSigTimeoutTime_BCM" SG_ 2654339094 CurrentCanNMState_FD16_AGSM 0;
BA_ "GenSigTimeoutTime_BSM" SG_ 2654339094 CurrentCanNMState_FD16_AGSM 0;
BA_ "GenSigTimeoutTime_CADM" SG_ 2654339094 CurrentCanNMState_FD16_AGSM 0;
BA_ "GenSigTimeoutTime_DMSM" SG_ 2654339094 CurrentCanNMState_FD16_AGSM 0;
BA_ "GenSigTimeoutTime_DTCM" SG_ 2654339094 CurrentCanNMState_FD16_AGSM 0;
BA_ "GenSigTimeoutTime_ECM" SG_ 2654339094 CurrentCanNMState_FD16_AGSM 0;
BA_ "GenSigTimeoutTime_EVCU2" SG_ 2654339094 CurrentCanNMState_FD16_AGSM 0;
BA_ "GenSigTimeoutTime_GNMM" SG_ 2654339094 CurrentCanNMState_FD16_AGSM 0;
BA_ "GenSigTimeoutTime_HCP" SG_ 2654339094 CurrentCanNMState_FD16_AGSM 0;
BA_ "GenSigTimeoutTime_IPC" SG_ 2654339094 CurrentCanNMState_FD16_AGSM 0;
BA_ "GenSigTimeoutTime_RFHM" SG_ 2654339094 CurrentCanNMState_FD16_AGSM 0;
BA_ "GenSigTimeoutTime_TCM" SG_ 2654339094 CurrentCanNMState_FD16_AGSM 0;
BA_ "GenSigTimeoutTime_AGSM" SG_ 2654339094 CurrentFailSts_FD03_AGSM 0;
BA_ "GenSigTimeoutTime_BSM" SG_ 2654339094 CurrentFailSts_FD03_AGSM 0;
BA_ "GenSigTimeoutTime_CADM" SG_ 2654339094 CurrentFailSts_FD03_AGSM 0;
BA_ "GenSigTimeoutTime_DMSM" SG_ 2654339094 CurrentFailSts_FD03_AGSM 0;
BA_ "GenSigTimeoutTime_DTCM" SG_ 2654339094 CurrentFailSts_FD03_AGSM 0;
BA_ "GenSigTimeoutTime_ECM" SG_ 2654339094 CurrentFailSts_FD03_AGSM 0;
BA_ "GenSigTimeoutTime_EVCU2" SG_ 2654339094 CurrentFailSts_FD03_AGSM 0;
BA_ "GenSigTimeoutTime_GNMM" SG_ 2654339094 CurrentFailSts_FD03_AGSM 0;
BA_ "GenSigTimeoutTime_HCP" SG_ 2654339094 CurrentFailSts_FD03_AGSM 0;
BA_ "GenSigTimeoutTime_IPC" SG_ 2654339094 CurrentFailSts_FD03_AGSM 0;
BA_ "GenSigTimeoutTime_RFHM" SG_ 2654339094 CurrentFailSts_FD03_AGSM 0;
BA_ "GenSigTimeoutTime_TCM" SG_ 2654339094 CurrentFailSts_FD03_AGSM 0;
BA_ "GenSigTimeoutTime_AGSM" SG_ 2654339094 CurrentFailSts_FD16_AGSM 0;
BA_ "GenSigTimeoutTime_BCM" SG_ 2654339094 CurrentFailSts_FD16_AGSM 0;
BA_ "GenSigTimeoutTime_BSM" SG_ 2654339094 CurrentFailSts_FD16_AGSM 0;
BA_ "GenSigTimeoutTime_CADM" SG_ 2654339094 CurrentFailSts_FD16_AGSM 0;
BA_ "GenSigTimeoutTime_DMSM" SG_ 2654339094 CurrentFailSts_FD16_AGSM 0;
BA_ "GenSigTimeoutTime_DTCM" SG_ 2654339094 CurrentFailSts_FD16_AGSM 0;
BA_ "GenSigTimeoutTime_ECM" SG_ 2654339094 CurrentFailSts_FD16_AGSM 0;
BA_ "GenSigTimeoutTime_EVCU2" SG_ 2654339094 CurrentFailSts_FD16_AGSM 0;
BA_ "GenSigTimeoutTime_GNMM" SG_ 2654339094 CurrentFailSts_FD16_AGSM 0;
BA_ "GenSigTimeoutTime_HCP" SG_ 2654339094 CurrentFailSts_FD16_AGSM 0;
BA_ "GenSigTimeoutTime_IPC" SG_ 2654339094 CurrentFailSts_FD16_AGSM 0;
BA_ "GenSigTimeoutTime_RFHM" SG_ 2654339094 CurrentFailSts_FD16_AGSM 0;
BA_ "GenSigTimeoutTime_TCM" SG_ 2654339094 CurrentFailSts_FD16_AGSM 0;
BA_ "GenSigTimeoutTime_AGSM" SG_ 2654339094 DES_FD03_AGSM 0;
BA_ "GenSigTimeoutTime_BCM" SG_ 2654339094 DES_FD03_AGSM 0;
BA_ "GenSigTimeoutTime_BSM" SG_ 2654339094 DES_FD03_AGSM 0;
BA_ "GenSigTimeoutTime_CADM" SG_ 2654339094 DES_FD03_AGSM 0;
BA_ "GenSigTimeoutTime_DMSM" SG_ 2654339094 DES_FD03_AGSM 0;
BA_ "GenSigTimeoutTime_DTCM" SG_ 2654339094 DES_FD03_AGSM 0;
BA_ "GenSigTimeoutTime_ECM" SG_ 2654339094 DES_FD03_AGSM 0;
BA_ "GenSigTimeoutTime_EVCU2" SG_ 2654339094 DES_FD03_AGSM 0;
BA_ "GenSigTimeoutTime_GNMM" SG_ 2654339094 DES_FD03_AGSM 0;
BA_ "GenSigTimeoutTime_HCP" SG_ 2654339094 DES_FD03_AGSM 0;
BA_ "GenSigTimeoutTime_IPC" SG_ 2654339094 DES_FD03_AGSM 0;
BA_ "GenSigTimeoutTime_RFHM" SG_ 2654339094 DES_FD03_AGSM 0;
BA_ "GenSigTimeoutTime_TCM" SG_ 2654339094 DES_FD03_AGSM 0;
BA_ "GenSigTimeoutTime_AGSM" SG_ 2654339094 DES_FD16_AGSM 0;
BA_ "GenSigTimeoutTime_BCM" SG_ 2654339094 DES_FD16_AGSM 0;
BA_ "GenSigTimeoutTime_BSM" SG_ 2654339094 DES_FD16_AGSM 0;
BA_ "GenSigTimeoutTime_CADM" SG_ 2654339094 DES_FD16_AGSM 0;
BA_ "GenSigTimeoutTime_DMSM" SG_ 2654339094 DES_FD16_AGSM 0;
BA_ "GenSigTimeoutTime_DTCM" SG_ 2654339094 DES_FD16_AGSM 0;
BA_ "GenSigTimeoutTime_ECM" SG_ 2654339094 DES_FD16_AGSM 0;
BA_ "GenSigTimeoutTime_EVCU2" SG_ 2654339094 DES_FD16_AGSM 0;
BA_ "GenSigTimeoutTime_GNMM" SG_ 2654339094 DES_FD16_AGSM 0;
BA_ "GenSigTimeoutTime_HCP" SG_ 2654339094 DES_FD16_AGSM 0;
BA_ "GenSigTimeoutTime_IPC" SG_ 2654339094 DES_FD16_AGSM 0;
BA_ "GenSigTimeoutTime_RFHM" SG_ 2654339094 DES_FD16_AGSM 0;
BA_ "GenSigTimeoutTime_TCM" SG_ 2654339094 DES_FD16_AGSM 0;
BA_ "GenSigTimeoutTime_AGSM" SG_ 2654339094 EOL_FD03_AGSM 0;
BA_ "GenSigTimeoutTime_BSM" SG_ 2654339094 EOL_FD03_AGSM 0;
BA_ "GenSigTimeoutTime_CADM" SG_ 2654339094 EOL_FD03_AGSM 0;
BA_ "GenSigTimeoutTime_DMSM" SG_ 2654339094 EOL_FD03_AGSM 0;
BA_ "GenSigTimeoutTime_DTCM" SG_ 2654339094 EOL_FD03_AGSM 0;
BA_ "GenSigTimeoutTime_ECM" SG_ 2654339094 EOL_FD03_AGSM 0;
BA_ "GenSigTimeoutTime_EVCU2" SG_ 2654339094 EOL_FD03_AGSM 0;
BA_ "GenSigTimeoutTime_GNMM" SG_ 2654339094 EOL_FD03_AGSM 0;
BA_ "GenSigTimeoutTime_HCP" SG_ 2654339094 EOL_FD03_AGSM 0;
BA_ "GenSigTimeoutTime_IPC" SG_ 2654339094 EOL_FD03_AGSM 0;
BA_ "GenSigTimeoutTime_RFHM" SG_ 2654339094 EOL_FD03_AGSM 0;
BA_ "GenSigTimeoutTime_TCM" SG_ 2654339094 EOL_FD03_AGSM 0;
BA_ "GenSigTimeoutTime_AGSM" SG_ 2654339094 EOL_FD16_AGSM 0;
BA_ "GenSigTimeoutTime_BCM" SG_ 2654339094 EOL_FD16_AGSM 0;
BA_ "GenSigTimeoutTime_BSM" SG_ 2654339094 EOL_FD16_AGSM 0;
BA_ "GenSigTimeoutTime_CADM" SG_ 2654339094 EOL_FD16_AGSM 0;
BA_ "GenSigTimeoutTime_DMSM" SG_ 2654339094 EOL_FD16_AGSM 0;
BA_ "GenSigTimeoutTime_DTCM" SG_ 2654339094 EOL_FD16_AGSM 0;
BA_ "GenSigTimeoutTime_ECM" SG_ 2654339094 EOL_FD16_AGSM 0;
BA_ "GenSigTimeoutTime_EVCU2" SG_ 2654339094 EOL_FD16_AGSM 0;
BA_ "GenSigTimeoutTime_GNMM" SG_ 2654339094 EOL_FD16_AGSM 0;
BA_ "GenSigTimeoutTime_HCP" SG_ 2654339094 EOL_FD16_AGSM 0;
BA_ "GenSigTimeoutTime_IPC" SG_ 2654339094 EOL_FD16_AGSM 0;
BA_ "GenSigTimeoutTime_RFHM" SG_ 2654339094 EOL_FD16_AGSM 0;
BA_ "GenSigTimeoutTime_TCM" SG_ 2654339094 EOL_FD16_AGSM 0;
BA_ "GenSigTimeoutTime_AGSM" SG_ 2654339094 GenericFailSts_FD03_AGSM 0;
BA_ "GenSigTimeoutTime_BSM" SG_ 2654339094 GenericFailSts_FD03_AGSM 0;
BA_ "GenSigTimeoutTime_CADM" SG_ 2654339094 GenericFailSts_FD03_AGSM 0;
BA_ "GenSigTimeoutTime_DMSM" SG_ 2654339094 GenericFailSts_FD03_AGSM 0;
BA_ "GenSigTimeoutTime_DTCM" SG_ 2654339094 GenericFailSts_FD03_AGSM 0;
BA_ "GenSigTimeoutTime_ECM" SG_ 2654339094 GenericFailSts_FD03_AGSM 0;
BA_ "GenSigTimeoutTime_EVCU2" SG_ 2654339094 GenericFailSts_FD03_AGSM 0;
BA_ "GenSigTimeoutTime_GNMM" SG_ 2654339094 GenericFailSts_FD03_AGSM 0;
BA_ "GenSigTimeoutTime_HCP" SG_ 2654339094 GenericFailSts_FD03_AGSM 0;
BA_ "GenSigTimeoutTime_IPC" SG_ 2654339094 GenericFailSts_FD03_AGSM 0;
BA_ "GenSigTimeoutTime_RFHM" SG_ 2654339094 GenericFailSts_FD03_AGSM 0;
BA_ "GenSigTimeoutTime_TCM" SG_ 2654339094 GenericFailSts_FD03_AGSM 0;
BA_ "GenSigTimeoutTime_AGSM" SG_ 2654339094 GenericFailSts_FD16_AGSM 0;
BA_ "GenSigTimeoutTime_BCM" SG_ 2654339094 GenericFailSts_FD16_AGSM 0;
BA_ "GenSigTimeoutTime_BSM" SG_ 2654339094 GenericFailSts_FD16_AGSM 0;
BA_ "GenSigTimeoutTime_CADM" SG_ 2654339094 GenericFailSts_FD16_AGSM 0;
BA_ "GenSigTimeoutTime_DMSM" SG_ 2654339094 GenericFailSts_FD16_AGSM 0;
BA_ "GenSigTimeoutTime_DTCM" SG_ 2654339094 GenericFailSts_FD16_AGSM 0;
BA_ "GenSigTimeoutTime_ECM" SG_ 2654339094 GenericFailSts_FD16_AGSM 0;
BA_ "GenSigTimeoutTime_EVCU2" SG_ 2654339094 GenericFailSts_FD16_AGSM 0;
BA_ "GenSigTimeoutTime_GNMM" SG_ 2654339094 GenericFailSts_FD16_AGSM 0;
BA_ "GenSigTimeoutTime_HCP" SG_ 2654339094 GenericFailSts_FD16_AGSM 0;
BA_ "GenSigTimeoutTime_IPC" SG_ 2654339094 GenericFailSts_FD16_AGSM 0;
BA_ "GenSigTimeoutTime_RFHM" SG_ 2654339094 GenericFailSts_FD16_AGSM 0;
BA_ "GenSigTimeoutTime_TCM" SG_ 2654339094 GenericFailSts_FD16_AGSM 0;
BA_ "GenSigTimeoutTime_AGSM" SG_ 2654339094 PreviousCanNMState_FD03_AGSM 0;
BA_ "GenSigTimeoutTime_BCM" SG_ 2654339094 PreviousCanNMState_FD03_AGSM 0;
BA_ "GenSigTimeoutTime_BSM" SG_ 2654339094 PreviousCanNMState_FD03_AGSM 0;
BA_ "GenSigTimeoutTime_CADM" SG_ 2654339094 PreviousCanNMState_FD03_AGSM 0;
BA_ "GenSigTimeoutTime_DMSM" SG_ 2654339094 PreviousCanNMState_FD03_AGSM 0;
BA_ "GenSigTimeoutTime_DTCM" SG_ 2654339094 PreviousCanNMState_FD03_AGSM 0;
BA_ "GenSigTimeoutTime_ECM" SG_ 2654339094 PreviousCanNMState_FD03_AGSM 0;
BA_ "GenSigTimeoutTime_EVCU2" SG_ 2654339094 PreviousCanNMState_FD03_AGSM 0;
BA_ "GenSigTimeoutTime_GNMM" SG_ 2654339094 PreviousCanNMState_FD03_AGSM 0;
BA_ "GenSigTimeoutTime_HCP" SG_ 2654339094 PreviousCanNMState_FD03_AGSM 0;
BA_ "GenSigTimeoutTime_IPC" SG_ 2654339094 PreviousCanNMState_FD03_AGSM 0;
BA_ "GenSigTimeoutTime_RFHM" SG_ 2654339094 PreviousCanNMState_FD03_AGSM 0;
BA_ "GenSigTimeoutTime_TCM" SG_ 2654339094 PreviousCanNMState_FD03_AGSM 0;
BA_ "GenSigTimeoutTime_AGSM" SG_ 2654339094 PreviousCanNMState_FD16_AGSM 0;
BA_ "GenSigTimeoutTime_BCM" SG_ 2654339094 PreviousCanNMState_FD16_AGSM 0;
BA_ "GenSigTimeoutTime_BSM" SG_ 2654339094 PreviousCanNMState_FD16_AGSM 0;
BA_ "GenSigTimeoutTime_CADM" SG_ 2654339094 PreviousCanNMState_FD16_AGSM 0;
BA_ "GenSigTimeoutTime_DMSM" SG_ 2654339094 PreviousCanNMState_FD16_AGSM 0;
BA_ "GenSigTimeoutTime_DTCM" SG_ 2654339094 PreviousCanNMState_FD16_AGSM 0;
BA_ "GenSigTimeoutTime_ECM" SG_ 2654339094 PreviousCanNMState_FD16_AGSM 0;
BA_ "GenSigTimeoutTime_EVCU2" SG_ 2654339094 PreviousCanNMState_FD16_AGSM 0;
BA_ "GenSigTimeoutTime_GNMM" SG_ 2654339094 PreviousCanNMState_FD16_AGSM 0;
BA_ "GenSigTimeoutTime_HCP" SG_ 2654339094 PreviousCanNMState_FD16_AGSM 0;
BA_ "GenSigTimeoutTime_IPC" SG_ 2654339094 PreviousCanNMState_FD16_AGSM 0;
BA_ "GenSigTimeoutTime_RFHM" SG_ 2654339094 PreviousCanNMState_FD16_AGSM 0;
BA_ "GenSigTimeoutTime_TCM" SG_ 2654339094 PreviousCanNMState_FD16_AGSM 0;
BA_ "GenSigTimeoutTime_AGSM" SG_ 2654339094 StayActiveSource_FD03_AGSM 0;
BA_ "GenSigTimeoutTime_BCM" SG_ 2654339094 StayActiveSource_FD03_AGSM 0;
BA_ "GenSigTimeoutTime_BSM" SG_ 2654339094 StayActiveSource_FD03_AGSM 0;
BA_ "GenSigTimeoutTime_CADM" SG_ 2654339094 StayActiveSource_FD03_AGSM 0;
BA_ "GenSigTimeoutTime_DMSM" SG_ 2654339094 StayActiveSource_FD03_AGSM 0;
BA_ "GenSigTimeoutTime_DTCM" SG_ 2654339094 StayActiveSource_FD03_AGSM 0;
BA_ "GenSigTimeoutTime_ECM" SG_ 2654339094 StayActiveSource_FD03_AGSM 0;
BA_ "GenSigTimeoutTime_EVCU2" SG_ 2654339094 StayActiveSource_FD03_AGSM 0;
BA_ "GenSigTimeoutTime_GNMM" SG_ 2654339094 StayActiveSource_FD03_AGSM 0;
BA_ "GenSigTimeoutTime_HCP" SG_ 2654339094 StayActiveSource_FD03_AGSM 0;
BA_ "GenSigTimeoutTime_IPC" SG_ 2654339094 StayActiveSource_FD03_AGSM 0;
BA_ "GenSigTimeoutTime_RFHM" SG_ 2654339094 StayActiveSource_FD03_AGSM 0;
BA_ "GenSigTimeoutTime_TCM" SG_ 2654339094 StayActiveSource_FD03_AGSM 0;
BA_ "GenSigTimeoutTime_AGSM" SG_ 2654339094 StayActiveSource_FD16_AGSM 0;
BA_ "GenSigTimeoutTime_BCM" SG_ 2654339094 StayActiveSource_FD16_AGSM 0;
BA_ "GenSigTimeoutTime_BSM" SG_ 2654339094 StayActiveSource_FD16_AGSM 0;
BA_ "GenSigTimeoutTime_CADM" SG_ 2654339094 StayActiveSource_FD16_AGSM 0;
BA_ "GenSigTimeoutTime_DMSM" SG_ 2654339094 StayActiveSource_FD16_AGSM 0;
BA_ "GenSigTimeoutTime_DTCM" SG_ 2654339094 StayActiveSource_FD16_AGSM 0;
BA_ "GenSigTimeoutTime_ECM" SG_ 2654339094 StayActiveSource_FD16_AGSM 0;
BA_ "GenSigTimeoutTime_EVCU2" SG_ 2654339094 StayActiveSource_FD16_AGSM 0;
BA_ "GenSigTimeoutTime_GNMM" SG_ 2654339094 StayActiveSource_FD16_AGSM 0;
BA_ "GenSigTimeoutTime_HCP" SG_ 2654339094 StayActiveSource_FD16_AGSM 0;
BA_ "GenSigTimeoutTime_IPC" SG_ 2654339094 StayActiveSource_FD16_AGSM 0;
BA_ "GenSigTimeoutTime_RFHM" SG_ 2654339094 StayActiveSource_FD16_AGSM 0;
BA_ "GenSigTimeoutTime_TCM" SG_ 2654339094 StayActiveSource_FD16_AGSM 0;
BA_ "GenSigTimeoutTime_AGSM" SG_ 2654339094 WakeupSource_FD03_AGSM 0;
BA_ "GenSigTimeoutTime_BCM" SG_ 2654339094 WakeupSource_FD03_AGSM 0;
BA_ "GenSigTimeoutTime_BSM" SG_ 2654339094 WakeupSource_FD03_AGSM 0;
BA_ "GenSigTimeoutTime_CADM" SG_ 2654339094 WakeupSource_FD03_AGSM 0;
BA_ "GenSigTimeoutTime_DMSM" SG_ 2654339094 WakeupSource_FD03_AGSM 0;
BA_ "GenSigTimeoutTime_DTCM" SG_ 2654339094 WakeupSource_FD03_AGSM 0;
BA_ "GenSigTimeoutTime_ECM" SG_ 2654339094 WakeupSource_FD03_AGSM 0;
BA_ "GenSigTimeoutTime_EVCU2" SG_ 2654339094 WakeupSource_FD03_AGSM 0;
BA_ "GenSigTimeoutTime_GNMM" SG_ 2654339094 WakeupSource_FD03_AGSM 0;
BA_ "GenSigTimeoutTime_HCP" SG_ 2654339094 WakeupSource_FD03_AGSM 0;
BA_ "GenSigTimeoutTime_IPC" SG_ 2654339094 WakeupSource_FD03_AGSM 0;
BA_ "GenSigTimeoutTime_RFHM" SG_ 2654339094 WakeupSource_FD03_AGSM 0;
BA_ "GenSigTimeoutTime_TCM" SG_ 2654339094 WakeupSource_FD03_AGSM 0;
BA_ "GenSigTimeoutTime_AGSM" SG_ 2654339094 WakeupSource_FD16_AGSM 0;
BA_ "GenSigTimeoutTime_BCM" SG_ 2654339094 WakeupSource_FD16_AGSM 0;
BA_ "GenSigTimeoutTime_BSM" SG_ 2654339094 WakeupSource_FD16_AGSM 0;
BA_ "GenSigTimeoutTime_CADM" SG_ 2654339094 WakeupSource_FD16_AGSM 0;
BA_ "GenSigTimeoutTime_DMSM" SG_ 2654339094 WakeupSource_FD16_AGSM 0;
BA_ "GenSigTimeoutTime_DTCM" SG_ 2654339094 WakeupSource_FD16_AGSM 0;
BA_ "GenSigTimeoutTime_ECM" SG_ 2654339094 WakeupSource_FD16_AGSM 0;
BA_ "GenSigTimeoutTime_EVCU2" SG_ 2654339094 WakeupSource_FD16_AGSM 0;
BA_ "GenSigTimeoutTime_GNMM" SG_ 2654339094 WakeupSource_FD16_AGSM 0;
BA_ "GenSigTimeoutTime_HCP" SG_ 2654339094 WakeupSource_FD16_AGSM 0;
BA_ "GenSigTimeoutTime_IPC" SG_ 2654339094 WakeupSource_FD16_AGSM 0;
BA_ "GenSigTimeoutTime_RFHM" SG_ 2654339094 WakeupSource_FD16_AGSM 0;
BA_ "GenSigTimeoutTime_TCM" SG_ 2654339094 WakeupSource_FD16_AGSM 0;
BA_ "GenSigTimeoutTime_AGSM" SG_ 2654339072 CurrentCanNMState_FD01_BCM 0;
BA_ "GenSigTimeoutTime_BCM" SG_ 2654339072 CurrentCanNMState_FD01_BCM 0;
BA_ "GenSigTimeoutTime_BSM" SG_ 2654339072 CurrentCanNMState_FD01_BCM 0;
BA_ "GenSigTimeoutTime_CADM" SG_ 2654339072 CurrentCanNMState_FD01_BCM 0;
BA_ "GenSigTimeoutTime_DMSM" SG_ 2654339072 CurrentCanNMState_FD01_BCM 0;
BA_ "GenSigTimeoutTime_DTCM" SG_ 2654339072 CurrentCanNMState_FD01_BCM 0;
BA_ "GenSigTimeoutTime_ECM" SG_ 2654339072 CurrentCanNMState_FD01_BCM 0;
BA_ "GenSigTimeoutTime_EVCU2" SG_ 2654339072 CurrentCanNMState_FD01_BCM 0;
BA_ "GenSigTimeoutTime_GNMM" SG_ 2654339072 CurrentCanNMState_FD01_BCM 0;
BA_ "GenSigTimeoutTime_HCP" SG_ 2654339072 CurrentCanNMState_FD01_BCM 0;
BA_ "GenSigTimeoutTime_IPC" SG_ 2654339072 CurrentCanNMState_FD01_BCM 0;
BA_ "GenSigTimeoutTime_RFHM" SG_ 2654339072 CurrentCanNMState_FD01_BCM 0;
BA_ "GenSigTimeoutTime_SGW" SG_ 2654339072 CurrentCanNMState_FD01_BCM 0;
BA_ "GenSigTimeoutTime_TCM" SG_ 2654339072 CurrentCanNMState_FD01_BCM 0;
BA_ "GenSigTimeoutTime_AGSM" SG_ 2654339072 CurrentCanNMState_FD02_BCM 0;
BA_ "GenSigTimeoutTime_BCM" SG_ 2654339072 CurrentCanNMState_FD02_BCM 0;
BA_ "GenSigTimeoutTime_BSM" SG_ 2654339072 CurrentCanNMState_FD02_BCM 0;
BA_ "GenSigTimeoutTime_CADM" SG_ 2654339072 CurrentCanNMState_FD02_BCM 0;
BA_ "GenSigTimeoutTime_DMSM" SG_ 2654339072 CurrentCanNMState_FD02_BCM 0;
BA_ "GenSigTimeoutTime_DTCM" SG_ 2654339072 CurrentCanNMState_FD02_BCM 0;
BA_ "GenSigTimeoutTime_ECM" SG_ 2654339072 CurrentCanNMState_FD02_BCM 0;
BA_ "GenSigTimeoutTime_EVCU2" SG_ 2654339072 CurrentCanNMState_FD02_BCM 0;
BA_ "GenSigTimeoutTime_GNMM" SG_ 2654339072 CurrentCanNMState_FD02_BCM 0;
BA_ "GenSigTimeoutTime_HCP" SG_ 2654339072 CurrentCanNMState_FD02_BCM 0;
BA_ "GenSigTimeoutTime_IPC" SG_ 2654339072 CurrentCanNMState_FD02_BCM 0;
BA_ "GenSigTimeoutTime_RFHM" SG_ 2654339072 CurrentCanNMState_FD02_BCM 0;
BA_ "GenSigTimeoutTime_SGW" SG_ 2654339072 CurrentCanNMState_FD02_BCM 0;
BA_ "GenSigTimeoutTime_TCM" SG_ 2654339072 CurrentCanNMState_FD02_BCM 0;
BA_ "GenSigTimeoutTime_AGSM" SG_ 2654339072 CurrentCanNMState_FD03_BCM 0;
BA_ "GenSigTimeoutTime_BCM" SG_ 2654339072 CurrentCanNMState_FD03_BCM 0;
BA_ "GenSigTimeoutTime_BSM" SG_ 2654339072 CurrentCanNMState_FD03_BCM 0;
BA_ "GenSigTimeoutTime_CADM" SG_ 2654339072 CurrentCanNMState_FD03_BCM 0;
BA_ "GenSigTimeoutTime_DMSM" SG_ 2654339072 CurrentCanNMState_FD03_BCM 0;
BA_ "GenSigTimeoutTime_DTCM" SG_ 2654339072 CurrentCanNMState_FD03_BCM 0;
BA_ "GenSigTimeoutTime_ECM" SG_ 2654339072 CurrentCanNMState_FD03_BCM 0;
BA_ "GenSigTimeoutTime_EVCU2" SG_ 2654339072 CurrentCanNMState_FD03_BCM 0;
BA_ "GenSigTimeoutTime_GNMM" SG_ 2654339072 CurrentCanNMState_FD03_BCM 0;
BA_ "GenSigTimeoutTime_HCP" SG_ 2654339072 CurrentCanNMState_FD03_BCM 0;
BA_ "GenSigTimeoutTime_IPC" SG_ 2654339072 CurrentCanNMState_FD03_BCM 0;
BA_ "GenSigTimeoutTime_RFHM" SG_ 2654339072 CurrentCanNMState_FD03_BCM 0;
BA_ "GenSigTimeoutTime_SGW" SG_ 2654339072 CurrentCanNMState_FD03_BCM 0;
BA_ "GenSigTimeoutTime_TCM" SG_ 2654339072 CurrentCanNMState_FD03_BCM 0;
BA_ "GenSigTimeoutTime_AGSM" SG_ 2654339072 CurrentCanNMState_FD04_BCM 0;
BA_ "GenSigTimeoutTime_BCM" SG_ 2654339072 CurrentCanNMState_FD04_BCM 0;
BA_ "GenSigTimeoutTime_BSM" SG_ 2654339072 CurrentCanNMState_FD04_BCM 0;
BA_ "GenSigTimeoutTime_CADM" SG_ 2654339072 CurrentCanNMState_FD04_BCM 0;
BA_ "GenSigTimeoutTime_DMSM" SG_ 2654339072 CurrentCanNMState_FD04_BCM 0;
BA_ "GenSigTimeoutTime_DTCM" SG_ 2654339072 CurrentCanNMState_FD04_BCM 0;
BA_ "GenSigTimeoutTime_ECM" SG_ 2654339072 CurrentCanNMState_FD04_BCM 0;
BA_ "GenSigTimeoutTime_EVCU2" SG_ 2654339072 CurrentCanNMState_FD04_BCM 0;
BA_ "GenSigTimeoutTime_GNMM" SG_ 2654339072 CurrentCanNMState_FD04_BCM 0;
BA_ "GenSigTimeoutTime_HCP" SG_ 2654339072 CurrentCanNMState_FD04_BCM 0;
BA_ "GenSigTimeoutTime_IPC" SG_ 2654339072 CurrentCanNMState_FD04_BCM 0;
BA_ "GenSigTimeoutTime_RFHM" SG_ 2654339072 CurrentCanNMState_FD04_BCM 0;
BA_ "GenSigTimeoutTime_SGW" SG_ 2654339072 CurrentCanNMState_FD04_BCM 0;
BA_ "GenSigTimeoutTime_TCM" SG_ 2654339072 CurrentCanNMState_FD04_BCM 0;
BA_ "GenSigTimeoutTime_AGSM" SG_ 2654339072 CurrentFailSts_FD01_BCM 0;
BA_ "GenSigTimeoutTime_BCM" SG_ 2654339072 CurrentFailSts_FD01_BCM 0;
BA_ "GenSigTimeoutTime_BSM" SG_ 2654339072 CurrentFailSts_FD01_BCM 0;
BA_ "GenSigTimeoutTime_CADM" SG_ 2654339072 CurrentFailSts_FD01_BCM 0;
BA_ "GenSigTimeoutTime_DMSM" SG_ 2654339072 CurrentFailSts_FD01_BCM 0;
BA_ "GenSigTimeoutTime_DTCM" SG_ 2654339072 CurrentFailSts_FD01_BCM 0;
BA_ "GenSigTimeoutTime_ECM" SG_ 2654339072 CurrentFailSts_FD01_BCM 0;
BA_ "GenSigTimeoutTime_EVCU2" SG_ 2654339072 CurrentFailSts_FD01_BCM 0;
BA_ "GenSigTimeoutTime_GNMM" SG_ 2654339072 CurrentFailSts_FD01_BCM 0;
BA_ "GenSigTimeoutTime_HCP" SG_ 2654339072 CurrentFailSts_FD01_BCM 0;
BA_ "GenSigTimeoutTime_IPC" SG_ 2654339072 CurrentFailSts_FD01_BCM 0;
BA_ "GenSigTimeoutTime_RFHM" SG_ 2654339072 CurrentFailSts_FD01_BCM 0;
BA_ "GenSigTimeoutTime_SGW" SG_ 2654339072 CurrentFailSts_FD01_BCM 0;
BA_ "GenSigTimeoutTime_TCM" SG_ 2654339072 CurrentFailSts_FD01_BCM 0;
BA_ "GenSigTimeoutTime_AGSM" SG_ 2654339072 CurrentFailSts_FD02_BCM 0;
BA_ "GenSigTimeoutTime_BCM" SG_ 2654339072 CurrentFailSts_FD02_BCM 0;
BA_ "GenSigTimeoutTime_BSM" SG_ 2654339072 CurrentFailSts_FD02_BCM 0;
BA_ "GenSigTimeoutTime_CADM" SG_ 2654339072 CurrentFailSts_FD02_BCM 0;
BA_ "GenSigTimeoutTime_DMSM" SG_ 2654339072 CurrentFailSts_FD02_BCM 0;
BA_ "GenSigTimeoutTime_DTCM" SG_ 2654339072 CurrentFailSts_FD02_BCM 0;
BA_ "GenSigTimeoutTime_ECM" SG_ 2654339072 CurrentFailSts_FD02_BCM 0;
BA_ "GenSigTimeoutTime_EVCU2" SG_ 2654339072 CurrentFailSts_FD02_BCM 0;
BA_ "GenSigTimeoutTime_GNMM" SG_ 2654339072 CurrentFailSts_FD02_BCM 0;
BA_ "GenSigTimeoutTime_HCP" SG_ 2654339072 CurrentFailSts_FD02_BCM 0;
BA_ "GenSigTimeoutTime_IPC" SG_ 2654339072 CurrentFailSts_FD02_BCM 0;
BA_ "GenSigTimeoutTime_RFHM" SG_ 2654339072 CurrentFailSts_FD02_BCM 0;
BA_ "GenSigTimeoutTime_SGW" SG_ 2654339072 CurrentFailSts_FD02_BCM 0;
BA_ "GenSigTimeoutTime_TCM" SG_ 2654339072 CurrentFailSts_FD02_BCM 0;
BA_ "GenSigTimeoutTime_AGSM" SG_ 2654339072 CurrentFailSts_FD03_BCM 0;
BA_ "GenSigTimeoutTime_BCM" SG_ 2654339072 CurrentFailSts_FD03_BCM 0;
BA_ "GenSigTimeoutTime_BSM" SG_ 2654339072 CurrentFailSts_FD03_BCM 0;
BA_ "GenSigTimeoutTime_CADM" SG_ 2654339072 CurrentFailSts_FD03_BCM 0;
BA_ "GenSigTimeoutTime_DMSM" SG_ 2654339072 CurrentFailSts_FD03_BCM 0;
BA_ "GenSigTimeoutTime_DTCM" SG_ 2654339072 CurrentFailSts_FD03_BCM 0;
BA_ "GenSigTimeoutTime_ECM" SG_ 2654339072 CurrentFailSts_FD03_BCM 0;
BA_ "GenSigTimeoutTime_EVCU2" SG_ 2654339072 CurrentFailSts_FD03_BCM 0;
BA_ "GenSigTimeoutTime_GNMM" SG_ 2654339072 CurrentFailSts_FD03_BCM 0;
BA_ "GenSigTimeoutTime_HCP" SG_ 2654339072 CurrentFailSts_FD03_BCM 0;
BA_ "GenSigTimeoutTime_IPC" SG_ 2654339072 CurrentFailSts_FD03_BCM 0;
BA_ "GenSigTimeoutTime_RFHM" SG_ 2654339072 CurrentFailSts_FD03_BCM 0;
BA_ "GenSigTimeoutTime_SGW" SG_ 2654339072 CurrentFailSts_FD03_BCM 0;
BA_ "GenSigTimeoutTime_TCM" SG_ 2654339072 CurrentFailSts_FD03_BCM 0;
BA_ "GenSigTimeoutTime_AGSM" SG_ 2654339072 CurrentFailSts_FD04_BCM 0;
BA_ "GenSigTimeoutTime_BCM" SG_ 2654339072 CurrentFailSts_FD04_BCM 0;
BA_ "GenSigTimeoutTime_BSM" SG_ 2654339072 CurrentFailSts_FD04_BCM 0;
BA_ "GenSigTimeoutTime_CADM" SG_ 2654339072 CurrentFailSts_FD04_BCM 0;
BA_ "GenSigTimeoutTime_DMSM" SG_ 2654339072 CurrentFailSts_FD04_BCM 0;
BA_ "GenSigTimeoutTime_DTCM" SG_ 2654339072 CurrentFailSts_FD04_BCM 0;
BA_ "GenSigTimeoutTime_ECM" SG_ 2654339072 CurrentFailSts_FD04_BCM 0;
BA_ "GenSigTimeoutTime_EVCU2" SG_ 2654339072 CurrentFailSts_FD04_BCM 0;
BA_ "GenSigTimeoutTime_GNMM" SG_ 2654339072 CurrentFailSts_FD04_BCM 0;
BA_ "GenSigTimeoutTime_HCP" SG_ 2654339072 CurrentFailSts_FD04_BCM 0;
BA_ "GenSigTimeoutTime_IPC" SG_ 2654339072 CurrentFailSts_FD04_BCM 0;
BA_ "GenSigTimeoutTime_RFHM" SG_ 2654339072 CurrentFailSts_FD04_BCM 0;
BA_ "GenSigTimeoutTime_SGW" SG_ 2654339072 CurrentFailSts_FD04_BCM 0;
BA_ "GenSigTimeoutTime_TCM" SG_ 2654339072 CurrentFailSts_FD04_BCM 0;
BA_ "GenSigTimeoutTime_AGSM" SG_ 2654339072 DES_FD01_BCM 0;
BA_ "GenSigTimeoutTime_BCM" SG_ 2654339072 DES_FD01_BCM 0;
BA_ "GenSigTimeoutTime_BSM" SG_ 2654339072 DES_FD01_BCM 0;
BA_ "GenSigTimeoutTime_CADM" SG_ 2654339072 DES_FD01_BCM 0;
BA_ "GenSigTimeoutTime_DMSM" SG_ 2654339072 DES_FD01_BCM 0;
BA_ "GenSigTimeoutTime_DTCM" SG_ 2654339072 DES_FD01_BCM 0;
BA_ "GenSigTimeoutTime_ECM" SG_ 2654339072 DES_FD01_BCM 0;
BA_ "GenSigTimeoutTime_EVCU2" SG_ 2654339072 DES_FD01_BCM 0;
BA_ "GenSigTimeoutTime_GNMM" SG_ 2654339072 DES_FD01_BCM 0;
BA_ "GenSigTimeoutTime_HCP" SG_ 2654339072 DES_FD01_BCM 0;
BA_ "GenSigTimeoutTime_IPC" SG_ 2654339072 DES_FD01_BCM 0;
BA_ "GenSigTimeoutTime_RFHM" SG_ 2654339072 DES_FD01_BCM 0;
BA_ "GenSigTimeoutTime_SGW" SG_ 2654339072 DES_FD01_BCM 0;
BA_ "GenSigTimeoutTime_TCM" SG_ 2654339072 DES_FD01_BCM 0;
BA_ "GenSigTimeoutTime_AGSM" SG_ 2654339072 DES_FD02_BCM 0;
BA_ "GenSigTimeoutTime_BCM" SG_ 2654339072 DES_FD02_BCM 0;
BA_ "GenSigTimeoutTime_BSM" SG_ 2654339072 DES_FD02_BCM 0;
BA_ "GenSigTimeoutTime_CADM" SG_ 2654339072 DES_FD02_BCM 0;
BA_ "GenSigTimeoutTime_DMSM" SG_ 2654339072 DES_FD02_BCM 0;
BA_ "GenSigTimeoutTime_DTCM" SG_ 2654339072 DES_FD02_BCM 0;
BA_ "GenSigTimeoutTime_ECM" SG_ 2654339072 DES_FD02_BCM 0;
BA_ "GenSigTimeoutTime_EVCU2" SG_ 2654339072 DES_FD02_BCM 0;
BA_ "GenSigTimeoutTime_GNMM" SG_ 2654339072 DES_FD02_BCM 0;
BA_ "GenSigTimeoutTime_HCP" SG_ 2654339072 DES_FD02_BCM 0;
BA_ "GenSigTimeoutTime_IPC" SG_ 2654339072 DES_FD02_BCM 0;
BA_ "GenSigTimeoutTime_RFHM" SG_ 2654339072 DES_FD02_BCM 0;
BA_ "GenSigTimeoutTime_SGW" SG_ 2654339072 DES_FD02_BCM 0;
BA_ "GenSigTimeoutTime_TCM" SG_ 2654339072 DES_FD02_BCM 0;
BA_ "GenSigTimeoutTime_AGSM" SG_ 2654339072 DES_FD03_BCM 0;
BA_ "GenSigTimeoutTime_BCM" SG_ 2654339072 DES_FD03_BCM 0;
BA_ "GenSigTimeoutTime_BSM" SG_ 2654339072 DES_FD03_BCM 0;
BA_ "GenSigTimeoutTime_CADM" SG_ 2654339072 DES_FD03_BCM 0;
BA_ "GenSigTimeoutTime_DMSM" SG_ 2654339072 DES_FD03_BCM 0;
BA_ "GenSigTimeoutTime_DTCM" SG_ 2654339072 DES_FD03_BCM 0;
BA_ "GenSigTimeoutTime_ECM" SG_ 2654339072 DES_FD03_BCM 0;
BA_ "GenSigTimeoutTime_EVCU2" SG_ 2654339072 DES_FD03_BCM 0;
BA_ "GenSigTimeoutTime_GNMM" SG_ 2654339072 DES_FD03_BCM 0;
BA_ "GenSigTimeoutTime_HCP" SG_ 2654339072 DES_FD03_BCM 0;
BA_ "GenSigTimeoutTime_IPC" SG_ 2654339072 DES_FD03_BCM 0;
BA_ "GenSigTimeoutTime_RFHM" SG_ 2654339072 DES_FD03_BCM 0;
BA_ "GenSigTimeoutTime_SGW" SG_ 2654339072 DES_FD03_BCM 0;
BA_ "GenSigTimeoutTime_TCM" SG_ 2654339072 DES_FD03_BCM 0;
BA_ "GenSigTimeoutTime_AGSM" SG_ 2654339072 DES_FD04_BCM 0;
BA_ "GenSigTimeoutTime_BCM" SG_ 2654339072 DES_FD04_BCM 0;
BA_ "GenSigTimeoutTime_BSM" SG_ 2654339072 DES_FD04_BCM 0;
BA_ "GenSigTimeoutTime_CADM" SG_ 2654339072 DES_FD04_BCM 0;
BA_ "GenSigTimeoutTime_DMSM" SG_ 2654339072 DES_FD04_BCM 0;
BA_ "GenSigTimeoutTime_DTCM" SG_ 2654339072 DES_FD04_BCM 0;
BA_ "GenSigTimeoutTime_ECM" SG_ 2654339072 DES_FD04_BCM 0;
BA_ "GenSigTimeoutTime_EVCU2" SG_ 2654339072 DES_FD04_BCM 0;
BA_ "GenSigTimeoutTime_GNMM" SG_ 2654339072 DES_FD04_BCM 0;
BA_ "GenSigTimeoutTime_HCP" SG_ 2654339072 DES_FD04_BCM 0;
BA_ "GenSigTimeoutTime_IPC" SG_ 2654339072 DES_FD04_BCM 0;
BA_ "GenSigTimeoutTime_RFHM" SG_ 2654339072 DES_FD04_BCM 0;
BA_ "GenSigTimeoutTime_SGW" SG_ 2654339072 DES_FD04_BCM 0;
BA_ "GenSigTimeoutTime_TCM" SG_ 2654339072 DES_FD04_BCM 0;
BA_ "GenSigTimeoutTime_AGSM" SG_ 2654339072 EOL_FD01_BCM 0;
BA_ "GenSigTimeoutTime_BCM" SG_ 2654339072 EOL_FD01_BCM 0;
BA_ "GenSigTimeoutTime_BSM" SG_ 2654339072 EOL_FD01_BCM 0;
BA_ "GenSigTimeoutTime_CADM" SG_ 2654339072 EOL_FD01_BCM 0;
BA_ "GenSigTimeoutTime_DMSM" SG_ 2654339072 EOL_FD01_BCM 0;
BA_ "GenSigTimeoutTime_DTCM" SG_ 2654339072 EOL_FD01_BCM 0;
BA_ "GenSigTimeoutTime_ECM" SG_ 2654339072 EOL_FD01_BCM 0;
BA_ "GenSigTimeoutTime_EVCU2" SG_ 2654339072 EOL_FD01_BCM 0;
BA_ "GenSigTimeoutTime_GNMM" SG_ 2654339072 EOL_FD01_BCM 0;
BA_ "GenSigTimeoutTime_HCP" SG_ 2654339072 EOL_FD01_BCM 0;
BA_ "GenSigTimeoutTime_IPC" SG_ 2654339072 EOL_FD01_BCM 0;
BA_ "GenSigTimeoutTime_RFHM" SG_ 2654339072 EOL_FD01_BCM 0;
BA_ "GenSigTimeoutTime_SGW" SG_ 2654339072 EOL_FD01_BCM 0;
BA_ "GenSigTimeoutTime_TCM" SG_ 2654339072 EOL_FD01_BCM 0;
BA_ "GenSigTimeoutTime_AGSM" SG_ 2654339072 EOL_FD02_BCM 0;
BA_ "GenSigTimeoutTime_BCM" SG_ 2654339072 EOL_FD02_BCM 0;
BA_ "GenSigTimeoutTime_BSM" SG_ 2654339072 EOL_FD02_BCM 0;
BA_ "GenSigTimeoutTime_CADM" SG_ 2654339072 EOL_FD02_BCM 0;
BA_ "GenSigTimeoutTime_DMSM" SG_ 2654339072 EOL_FD02_BCM 0;
BA_ "GenSigTimeoutTime_DTCM" SG_ 2654339072 EOL_FD02_BCM 0;
BA_ "GenSigTimeoutTime_ECM" SG_ 2654339072 EOL_FD02_BCM 0;
BA_ "GenSigTimeoutTime_EVCU2" SG_ 2654339072 EOL_FD02_BCM 0;
BA_ "GenSigTimeoutTime_GNMM" SG_ 2654339072 EOL_FD02_BCM 0;
BA_ "GenSigTimeoutTime_HCP" SG_ 2654339072 EOL_FD02_BCM 0;
BA_ "GenSigTimeoutTime_IPC" SG_ 2654339072 EOL_FD02_BCM 0;
BA_ "GenSigTimeoutTime_RFHM" SG_ 2654339072 EOL_FD02_BCM 0;
BA_ "GenSigTimeoutTime_SGW" SG_ 2654339072 EOL_FD02_BCM 0;
BA_ "GenSigTimeoutTime_TCM" SG_ 2654339072 EOL_FD02_BCM 0;
BA_ "GenSigTimeoutTime_AGSM" SG_ 2654339072 EOL_FD03_BCM 0;
BA_ "GenSigTimeoutTime_BCM" SG_ 2654339072 EOL_FD03_BCM 0;
BA_ "GenSigTimeoutTime_BSM" SG_ 2654339072 EOL_FD03_BCM 0;
BA_ "GenSigTimeoutTime_CADM" SG_ 2654339072 EOL_FD03_BCM 0;
BA_ "GenSigTimeoutTime_DMSM" SG_ 2654339072 EOL_FD03_BCM 0;
BA_ "GenSigTimeoutTime_DTCM" SG_ 2654339072 EOL_FD03_BCM 0;
BA_ "GenSigTimeoutTime_ECM" SG_ 2654339072 EOL_FD03_BCM 0;
BA_ "GenSigTimeoutTime_EVCU2" SG_ 2654339072 EOL_FD03_BCM 0;
BA_ "GenSigTimeoutTime_GNMM" SG_ 2654339072 EOL_FD03_BCM 0;
BA_ "GenSigTimeoutTime_HCP" SG_ 2654339072 EOL_FD03_BCM 0;
BA_ "GenSigTimeoutTime_IPC" SG_ 2654339072 EOL_FD03_BCM 0;
BA_ "GenSigTimeoutTime_RFHM" SG_ 2654339072 EOL_FD03_BCM 0;
BA_ "GenSigTimeoutTime_SGW" SG_ 2654339072 EOL_FD03_BCM 0;
BA_ "GenSigTimeoutTime_TCM" SG_ 2654339072 EOL_FD03_BCM 0;
BA_ "GenSigTimeoutTime_AGSM" SG_ 2654339072 EOL_FD04_BCM 0;
BA_ "GenSigTimeoutTime_BCM" SG_ 2654339072 EOL_FD04_BCM 0;
BA_ "GenSigTimeoutTime_BSM" SG_ 2654339072 EOL_FD04_BCM 0;
BA_ "GenSigTimeoutTime_CADM" SG_ 2654339072 EOL_FD04_BCM 0;
BA_ "GenSigTimeoutTime_DMSM" SG_ 2654339072 EOL_FD04_BCM 0;
BA_ "GenSigTimeoutTime_DTCM" SG_ 2654339072 EOL_FD04_BCM 0;
BA_ "GenSigTimeoutTime_ECM" SG_ 2654339072 EOL_FD04_BCM 0;
BA_ "GenSigTimeoutTime_EVCU2" SG_ 2654339072 EOL_FD04_BCM 0;
BA_ "GenSigTimeoutTime_GNMM" SG_ 2654339072 EOL_FD04_BCM 0;
BA_ "GenSigTimeoutTime_HCP" SG_ 2654339072 EOL_FD04_BCM 0;
BA_ "GenSigTimeoutTime_IPC" SG_ 2654339072 EOL_FD04_BCM 0;
BA_ "GenSigTimeoutTime_RFHM" SG_ 2654339072 EOL_FD04_BCM 0;
BA_ "GenSigTimeoutTime_SGW" SG_ 2654339072 EOL_FD04_BCM 0;
BA_ "GenSigTimeoutTime_TCM" SG_ 2654339072 EOL_FD04_BCM 0;
BA_ "GenSigTimeoutTime_AGSM" SG_ 2654339072 GenericFailSts_FD01_BCM 0;
BA_ "GenSigTimeoutTime_BCM" SG_ 2654339072 GenericFailSts_FD01_BCM 0;
BA_ "GenSigTimeoutTime_BSM" SG_ 2654339072 GenericFailSts_FD01_BCM 0;
BA_ "GenSigTimeoutTime_CADM" SG_ 2654339072 GenericFailSts_FD01_BCM 0;
BA_ "GenSigTimeoutTime_DMSM" SG_ 2654339072 GenericFailSts_FD01_BCM 0;
BA_ "GenSigTimeoutTime_DTCM" SG_ 2654339072 GenericFailSts_FD01_BCM 0;
BA_ "GenSigTimeoutTime_ECM" SG_ 2654339072 GenericFailSts_FD01_BCM 0;
BA_ "GenSigTimeoutTime_EVCU2" SG_ 2654339072 GenericFailSts_FD01_BCM 0;
BA_ "GenSigTimeoutTime_GNMM" SG_ 2654339072 GenericFailSts_FD01_BCM 0;
BA_ "GenSigTimeoutTime_HCP" SG_ 2654339072 GenericFailSts_FD01_BCM 0;
BA_ "GenSigTimeoutTime_IPC" SG_ 2654339072 GenericFailSts_FD01_BCM 0;
BA_ "GenSigTimeoutTime_RFHM" SG_ 2654339072 GenericFailSts_FD01_BCM 0;
BA_ "GenSigTimeoutTime_SGW" SG_ 2654339072 GenericFailSts_FD01_BCM 0;
BA_ "GenSigTimeoutTime_TCM" SG_ 2654339072 GenericFailSts_FD01_BCM 0;
BA_ "GenSigTimeoutTime_AGSM" SG_ 2654339072 GenericFailSts_FD02_BCM 0;
BA_ "GenSigTimeoutTime_BCM" SG_ 2654339072 GenericFailSts_FD02_BCM 0;
BA_ "GenSigTimeoutTime_BSM" SG_ 2654339072 GenericFailSts_FD02_BCM 0;
BA_ "GenSigTimeoutTime_CADM" SG_ 2654339072 GenericFailSts_FD02_BCM 0;
BA_ "GenSigTimeoutTime_DMSM" SG_ 2654339072 GenericFailSts_FD02_BCM 0;
BA_ "GenSigTimeoutTime_DTCM" SG_ 2654339072 GenericFailSts_FD02_BCM 0;
BA_ "GenSigTimeoutTime_ECM" SG_ 2654339072 GenericFailSts_FD02_BCM 0;
BA_ "GenSigTimeoutTime_EVCU2" SG_ 2654339072 GenericFailSts_FD02_BCM 0;
BA_ "GenSigTimeoutTime_GNMM" SG_ 2654339072 GenericFailSts_FD02_BCM 0;
BA_ "GenSigTimeoutTime_HCP" SG_ 2654339072 GenericFailSts_FD02_BCM 0;
BA_ "GenSigTimeoutTime_IPC" SG_ 2654339072 GenericFailSts_FD02_BCM 0;
BA_ "GenSigTimeoutTime_RFHM" SG_ 2654339072 GenericFailSts_FD02_BCM 0;
BA_ "GenSigTimeoutTime_SGW" SG_ 2654339072 GenericFailSts_FD02_BCM 0;
BA_ "GenSigTimeoutTime_TCM" SG_ 2654339072 GenericFailSts_FD02_BCM 0;
BA_ "GenSigTimeoutTime_AGSM" SG_ 2654339072 GenericFailSts_FD03_BCM 0;
BA_ "GenSigTimeoutTime_BCM" SG_ 2654339072 GenericFailSts_FD03_BCM 0;
BA_ "GenSigTimeoutTime_BSM" SG_ 2654339072 GenericFailSts_FD03_BCM 0;
BA_ "GenSigTimeoutTime_CADM" SG_ 2654339072 GenericFailSts_FD03_BCM 0;
BA_ "GenSigTimeoutTime_DMSM" SG_ 2654339072 GenericFailSts_FD03_BCM 0;
BA_ "GenSigTimeoutTime_DTCM" SG_ 2654339072 GenericFailSts_FD03_BCM 0;
BA_ "GenSigTimeoutTime_ECM" SG_ 2654339072 GenericFailSts_FD03_BCM 0;
BA_ "GenSigTimeoutTime_EVCU2" SG_ 2654339072 GenericFailSts_FD03_BCM 0;
BA_ "GenSigTimeoutTime_GNMM" SG_ 2654339072 GenericFailSts_FD03_BCM 0;
BA_ "GenSigTimeoutTime_HCP" SG_ 2654339072 GenericFailSts_FD03_BCM 0;
BA_ "GenSigTimeoutTime_IPC" SG_ 2654339072 GenericFailSts_FD03_BCM 0;
BA_ "GenSigTimeoutTime_RFHM" SG_ 2654339072 GenericFailSts_FD03_BCM 0;
BA_ "GenSigTimeoutTime_SGW" SG_ 2654339072 GenericFailSts_FD03_BCM 0;
BA_ "GenSigTimeoutTime_TCM" SG_ 2654339072 GenericFailSts_FD03_BCM 0;
BA_ "GenSigTimeoutTime_AGSM" SG_ 2654339072 GenericFailSts_FD04_BCM 0;
BA_ "GenSigTimeoutTime_BCM" SG_ 2654339072 GenericFailSts_FD04_BCM 0;
BA_ "GenSigTimeoutTime_BSM" SG_ 2654339072 GenericFailSts_FD04_BCM 0;
BA_ "GenSigTimeoutTime_CADM" SG_ 2654339072 GenericFailSts_FD04_BCM 0;
BA_ "GenSigTimeoutTime_DMSM" SG_ 2654339072 GenericFailSts_FD04_BCM 0;
BA_ "GenSigTimeoutTime_DTCM" SG_ 2654339072 GenericFailSts_FD04_BCM 0;
BA_ "GenSigTimeoutTime_ECM" SG_ 2654339072 GenericFailSts_FD04_BCM 0;
BA_ "GenSigTimeoutTime_EVCU2" SG_ 2654339072 GenericFailSts_FD04_BCM 0;
BA_ "GenSigTimeoutTime_GNMM" SG_ 2654339072 GenericFailSts_FD04_BCM 0;
BA_ "GenSigTimeoutTime_HCP" SG_ 2654339072 GenericFailSts_FD04_BCM 0;
BA_ "GenSigTimeoutTime_IPC" SG_ 2654339072 GenericFailSts_FD04_BCM 0;
BA_ "GenSigTimeoutTime_RFHM" SG_ 2654339072 GenericFailSts_FD04_BCM 0;
BA_ "GenSigTimeoutTime_SGW" SG_ 2654339072 GenericFailSts_FD04_BCM 0;
BA_ "GenSigTimeoutTime_TCM" SG_ 2654339072 GenericFailSts_FD04_BCM 0;
BA_ "GenSigTimeoutTime_AGSM" SG_ 2654339072 PreviousCanNMState_FD01_BCM 0;
BA_ "GenSigTimeoutTime_BCM" SG_ 2654339072 PreviousCanNMState_FD01_BCM 0;
BA_ "GenSigTimeoutTime_BSM" SG_ 2654339072 PreviousCanNMState_FD01_BCM 0;
BA_ "GenSigTimeoutTime_CADM" SG_ 2654339072 PreviousCanNMState_FD01_BCM 0;
BA_ "GenSigTimeoutTime_DMSM" SG_ 2654339072 PreviousCanNMState_FD01_BCM 0;
BA_ "GenSigTimeoutTime_DTCM" SG_ 2654339072 PreviousCanNMState_FD01_BCM 0;
BA_ "GenSigTimeoutTime_ECM" SG_ 2654339072 PreviousCanNMState_FD01_BCM 0;
BA_ "GenSigTimeoutTime_EVCU2" SG_ 2654339072 PreviousCanNMState_FD01_BCM 0;
BA_ "GenSigTimeoutTime_GNMM" SG_ 2654339072 PreviousCanNMState_FD01_BCM 0;
BA_ "GenSigTimeoutTime_HCP" SG_ 2654339072 PreviousCanNMState_FD01_BCM 0;
BA_ "GenSigTimeoutTime_IPC" SG_ 2654339072 PreviousCanNMState_FD01_BCM 0;
BA_ "GenSigTimeoutTime_RFHM" SG_ 2654339072 PreviousCanNMState_FD01_BCM 0;
BA_ "GenSigTimeoutTime_SGW" SG_ 2654339072 PreviousCanNMState_FD01_BCM 0;
BA_ "GenSigTimeoutTime_TCM" SG_ 2654339072 PreviousCanNMState_FD01_BCM 0;
BA_ "GenSigTimeoutTime_AGSM" SG_ 2654339072 PreviousCanNMState_FD02_BCM 0;
BA_ "GenSigTimeoutTime_BCM" SG_ 2654339072 PreviousCanNMState_FD02_BCM 0;
BA_ "GenSigTimeoutTime_BSM" SG_ 2654339072 PreviousCanNMState_FD02_BCM 0;
BA_ "GenSigTimeoutTime_CADM" SG_ 2654339072 PreviousCanNMState_FD02_BCM 0;
BA_ "GenSigTimeoutTime_DMSM" SG_ 2654339072 PreviousCanNMState_FD02_BCM 0;
BA_ "GenSigTimeoutTime_DTCM" SG_ 2654339072 PreviousCanNMState_FD02_BCM 0;
BA_ "GenSigTimeoutTime_ECM" SG_ 2654339072 PreviousCanNMState_FD02_BCM 0;
BA_ "GenSigTimeoutTime_EVCU2" SG_ 2654339072 PreviousCanNMState_FD02_BCM 0;
BA_ "GenSigTimeoutTime_GNMM" SG_ 2654339072 PreviousCanNMState_FD02_BCM 0;
BA_ "GenSigTimeoutTime_HCP" SG_ 2654339072 PreviousCanNMState_FD02_BCM 0;
BA_ "GenSigTimeoutTime_IPC" SG_ 2654339072 PreviousCanNMState_FD02_BCM 0;
BA_ "GenSigTimeoutTime_RFHM" SG_ 2654339072 PreviousCanNMState_FD02_BCM 0;
BA_ "GenSigTimeoutTime_SGW" SG_ 2654339072 PreviousCanNMState_FD02_BCM 0;
BA_ "GenSigTimeoutTime_TCM" SG_ 2654339072 PreviousCanNMState_FD02_BCM 0;
BA_ "GenSigTimeoutTime_AGSM" SG_ 2654339072 PreviousCanNMState_FD03_BCM 0;
BA_ "GenSigTimeoutTime_BCM" SG_ 2654339072 PreviousCanNMState_FD03_BCM 0;
BA_ "GenSigTimeoutTime_BSM" SG_ 2654339072 PreviousCanNMState_FD03_BCM 0;
BA_ "GenSigTimeoutTime_CADM" SG_ 2654339072 PreviousCanNMState_FD03_BCM 0;
BA_ "GenSigTimeoutTime_DMSM" SG_ 2654339072 PreviousCanNMState_FD03_BCM 0;
BA_ "GenSigTimeoutTime_DTCM" SG_ 2654339072 PreviousCanNMState_FD03_BCM 0;
BA_ "GenSigTimeoutTime_ECM" SG_ 2654339072 PreviousCanNMState_FD03_BCM 0;
BA_ "GenSigTimeoutTime_EVCU2" SG_ 2654339072 PreviousCanNMState_FD03_BCM 0;
BA_ "GenSigTimeoutTime_GNMM" SG_ 2654339072 PreviousCanNMState_FD03_BCM 0;
BA_ "GenSigTimeoutTime_HCP" SG_ 2654339072 PreviousCanNMState_FD03_BCM 0;
BA_ "GenSigTimeoutTime_IPC" SG_ 2654339072 PreviousCanNMState_FD03_BCM 0;
BA_ "GenSigTimeoutTime_RFHM" SG_ 2654339072 PreviousCanNMState_FD03_BCM 0;
BA_ "GenSigTimeoutTime_SGW" SG_ 2654339072 PreviousCanNMState_FD03_BCM 0;
BA_ "GenSigTimeoutTime_TCM" SG_ 2654339072 PreviousCanNMState_FD03_BCM 0;
BA_ "GenSigTimeoutTime_AGSM" SG_ 2654339072 PreviousCanNMState_FD04_BCM 0;
BA_ "GenSigTimeoutTime_BCM" SG_ 2654339072 PreviousCanNMState_FD04_BCM 0;
BA_ "GenSigTimeoutTime_BSM" SG_ 2654339072 PreviousCanNMState_FD04_BCM 0;
BA_ "GenSigTimeoutTime_CADM" SG_ 2654339072 PreviousCanNMState_FD04_BCM 0;
BA_ "GenSigTimeoutTime_DMSM" SG_ 2654339072 PreviousCanNMState_FD04_BCM 0;
BA_ "GenSigTimeoutTime_DTCM" SG_ 2654339072 PreviousCanNMState_FD04_BCM 0;
BA_ "GenSigTimeoutTime_ECM" SG_ 2654339072 PreviousCanNMState_FD04_BCM 0;
BA_ "GenSigTimeoutTime_EVCU2" SG_ 2654339072 PreviousCanNMState_FD04_BCM 0;
BA_ "GenSigTimeoutTime_GNMM" SG_ 2654339072 PreviousCanNMState_FD04_BCM 0;
BA_ "GenSigTimeoutTime_HCP" SG_ 2654339072 PreviousCanNMState_FD04_BCM 0;
BA_ "GenSigTimeoutTime_IPC" SG_ 2654339072 PreviousCanNMState_FD04_BCM 0;
BA_ "GenSigTimeoutTime_RFHM" SG_ 2654339072 PreviousCanNMState_FD04_BCM 0;
BA_ "GenSigTimeoutTime_SGW" SG_ 2654339072 PreviousCanNMState_FD04_BCM 0;
BA_ "GenSigTimeoutTime_TCM" SG_ 2654339072 PreviousCanNMState_FD04_BCM 0;
BA_ "GenSigTimeoutTime_AGSM" SG_ 2654339072 StayActiveSource_FD01_BCM 0;
BA_ "GenSigTimeoutTime_BCM" SG_ 2654339072 StayActiveSource_FD01_BCM 0;
BA_ "GenSigTimeoutTime_BSM" SG_ 2654339072 StayActiveSource_FD01_BCM 0;
BA_ "GenSigTimeoutTime_CADM" SG_ 2654339072 StayActiveSource_FD01_BCM 0;
BA_ "GenSigTimeoutTime_DMSM" SG_ 2654339072 StayActiveSource_FD01_BCM 0;
BA_ "GenSigTimeoutTime_DTCM" SG_ 2654339072 StayActiveSource_FD01_BCM 0;
BA_ "GenSigTimeoutTime_ECM" SG_ 2654339072 StayActiveSource_FD01_BCM 0;
BA_ "GenSigTimeoutTime_EVCU2" SG_ 2654339072 StayActiveSource_FD01_BCM 0;
BA_ "GenSigTimeoutTime_GNMM" SG_ 2654339072 StayActiveSource_FD01_BCM 0;
BA_ "GenSigTimeoutTime_HCP" SG_ 2654339072 StayActiveSource_FD01_BCM 0;
BA_ "GenSigTimeoutTime_IPC" SG_ 2654339072 StayActiveSource_FD01_BCM 0;
BA_ "GenSigTimeoutTime_RFHM" SG_ 2654339072 StayActiveSource_FD01_BCM 0;
BA_ "GenSigTimeoutTime_SGW" SG_ 2654339072 StayActiveSource_FD01_BCM 0;
BA_ "GenSigTimeoutTime_TCM" SG_ 2654339072 StayActiveSource_FD01_BCM 0;
BA_ "GenSigTimeoutTime_AGSM" SG_ 2654339072 StayActiveSource_FD02_BCM 0;
BA_ "GenSigTimeoutTime_BCM" SG_ 2654339072 StayActiveSource_FD02_BCM 0;
BA_ "GenSigTimeoutTime_BSM" SG_ 2654339072 StayActiveSource_FD02_BCM 0;
BA_ "GenSigTimeoutTime_CADM" SG_ 2654339072 StayActiveSource_FD02_BCM 0;
BA_ "GenSigTimeoutTime_DMSM" SG_ 2654339072 StayActiveSource_FD02_BCM 0;
BA_ "GenSigTimeoutTime_DTCM" SG_ 2654339072 StayActiveSource_FD02_BCM 0;
BA_ "GenSigTimeoutTime_ECM" SG_ 2654339072 StayActiveSource_FD02_BCM 0;
BA_ "GenSigTimeoutTime_EVCU2" SG_ 2654339072 StayActiveSource_FD02_BCM 0;
BA_ "GenSigTimeoutTime_GNMM" SG_ 2654339072 StayActiveSource_FD02_BCM 0;
BA_ "GenSigTimeoutTime_HCP" SG_ 2654339072 StayActiveSource_FD02_BCM 0;
BA_ "GenSigTimeoutTime_IPC" SG_ 2654339072 StayActiveSource_FD02_BCM 0;
BA_ "GenSigTimeoutTime_RFHM" SG_ 2654339072 StayActiveSource_FD02_BCM 0;
BA_ "GenSigTimeoutTime_SGW" SG_ 2654339072 StayActiveSource_FD02_BCM 0;
BA_ "GenSigTimeoutTime_TCM" SG_ 2654339072 StayActiveSource_FD02_BCM 0;
BA_ "GenSigTimeoutTime_AGSM" SG_ 2654339072 StayActiveSource_FD03_BCM 0;
BA_ "GenSigTimeoutTime_BCM" SG_ 2654339072 StayActiveSource_FD03_BCM 0;
BA_ "GenSigTimeoutTime_BSM" SG_ 2654339072 StayActiveSource_FD03_BCM 0;
BA_ "GenSigTimeoutTime_CADM" SG_ 2654339072 StayActiveSource_FD03_BCM 0;
BA_ "GenSigTimeoutTime_DMSM" SG_ 2654339072 StayActiveSource_FD03_BCM 0;
BA_ "GenSigTimeoutTime_DTCM" SG_ 2654339072 StayActiveSource_FD03_BCM 0;
BA_ "GenSigTimeoutTime_ECM" SG_ 2654339072 StayActiveSource_FD03_BCM 0;
BA_ "GenSigTimeoutTime_EVCU2" SG_ 2654339072 StayActiveSource_FD03_BCM 0;
BA_ "GenSigTimeoutTime_GNMM" SG_ 2654339072 StayActiveSource_FD03_BCM 0;
BA_ "GenSigTimeoutTime_HCP" SG_ 2654339072 StayActiveSource_FD03_BCM 0;
BA_ "GenSigTimeoutTime_IPC" SG_ 2654339072 StayActiveSource_FD03_BCM 0;
BA_ "GenSigTimeoutTime_RFHM" SG_ 2654339072 StayActiveSource_FD03_BCM 0;
BA_ "GenSigTimeoutTime_SGW" SG_ 2654339072 StayActiveSource_FD03_BCM 0;
BA_ "GenSigTimeoutTime_TCM" SG_ 2654339072 StayActiveSource_FD03_BCM 0;
BA_ "GenSigTimeoutTime_AGSM" SG_ 2654339072 StayActiveSource_FD04_BCM 0;
BA_ "GenSigTimeoutTime_BCM" SG_ 2654339072 StayActiveSource_FD04_BCM 0;
BA_ "GenSigTimeoutTime_BSM" SG_ 2654339072 StayActiveSource_FD04_BCM 0;
BA_ "GenSigTimeoutTime_CADM" SG_ 2654339072 StayActiveSource_FD04_BCM 0;
BA_ "GenSigTimeoutTime_DMSM" SG_ 2654339072 StayActiveSource_FD04_BCM 0;
BA_ "GenSigTimeoutTime_DTCM" SG_ 2654339072 StayActiveSource_FD04_BCM 0;
BA_ "GenSigTimeoutTime_ECM" SG_ 2654339072 StayActiveSource_FD04_BCM 0;
BA_ "GenSigTimeoutTime_EVCU2" SG_ 2654339072 StayActiveSource_FD04_BCM 0;
BA_ "GenSigTimeoutTime_GNMM" SG_ 2654339072 StayActiveSource_FD04_BCM 0;
BA_ "GenSigTimeoutTime_HCP" SG_ 2654339072 StayActiveSource_FD04_BCM 0;
BA_ "GenSigTimeoutTime_IPC" SG_ 2654339072 StayActiveSource_FD04_BCM 0;
BA_ "GenSigTimeoutTime_RFHM" SG_ 2654339072 StayActiveSource_FD04_BCM 0;
BA_ "GenSigTimeoutTime_SGW" SG_ 2654339072 StayActiveSource_FD04_BCM 0;
BA_ "GenSigTimeoutTime_TCM" SG_ 2654339072 StayActiveSource_FD04_BCM 0;
BA_ "GenSigTimeoutTime_AGSM" SG_ 2654339072 WakeupSource_FD01_BCM 0;
BA_ "GenSigTimeoutTime_BCM" SG_ 2654339072 WakeupSource_FD01_BCM 0;
BA_ "GenSigTimeoutTime_BSM" SG_ 2654339072 WakeupSource_FD01_BCM 0;
BA_ "GenSigTimeoutTime_CADM" SG_ 2654339072 WakeupSource_FD01_BCM 0;
BA_ "GenSigTimeoutTime_DMSM" SG_ 2654339072 WakeupSource_FD01_BCM 0;
BA_ "GenSigTimeoutTime_DTCM" SG_ 2654339072 WakeupSource_FD01_BCM 0;
BA_ "GenSigTimeoutTime_ECM" SG_ 2654339072 WakeupSource_FD01_BCM 0;
BA_ "GenSigTimeoutTime_EVCU2" SG_ 2654339072 WakeupSource_FD01_BCM 0;
BA_ "GenSigTimeoutTime_GNMM" SG_ 2654339072 WakeupSource_FD01_BCM 0;
BA_ "GenSigTimeoutTime_HCP" SG_ 2654339072 WakeupSource_FD01_BCM 0;
BA_ "GenSigTimeoutTime_IPC" SG_ 2654339072 WakeupSource_FD01_BCM 0;
BA_ "GenSigTimeoutTime_RFHM" SG_ 2654339072 WakeupSource_FD01_BCM 0;
BA_ "GenSigTimeoutTime_SGW" SG_ 2654339072 WakeupSource_FD01_BCM 0;
BA_ "GenSigTimeoutTime_TCM" SG_ 2654339072 WakeupSource_FD01_BCM 0;
BA_ "GenSigTimeoutTime_AGSM" SG_ 2654339072 WakeupSource_FD02_BCM 0;
BA_ "GenSigTimeoutTime_BCM" SG_ 2654339072 WakeupSource_FD02_BCM 0;
BA_ "GenSigTimeoutTime_BSM" SG_ 2654339072 WakeupSource_FD02_BCM 0;
BA_ "GenSigTimeoutTime_CADM" SG_ 2654339072 WakeupSource_FD02_BCM 0;
BA_ "GenSigTimeoutTime_DMSM" SG_ 2654339072 WakeupSource_FD02_BCM 0;
BA_ "GenSigTimeoutTime_DTCM" SG_ 2654339072 WakeupSource_FD02_BCM 0;
BA_ "GenSigTimeoutTime_ECM" SG_ 2654339072 WakeupSource_FD02_BCM 0;
BA_ "GenSigTimeoutTime_EVCU2" SG_ 2654339072 WakeupSource_FD02_BCM 0;
BA_ "GenSigTimeoutTime_GNMM" SG_ 2654339072 WakeupSource_FD02_BCM 0;
BA_ "GenSigTimeoutTime_HCP" SG_ 2654339072 WakeupSource_FD02_BCM 0;
BA_ "GenSigTimeoutTime_IPC" SG_ 2654339072 WakeupSource_FD02_BCM 0;
BA_ "GenSigTimeoutTime_RFHM" SG_ 2654339072 WakeupSource_FD02_BCM 0;
BA_ "GenSigTimeoutTime_SGW" SG_ 2654339072 WakeupSource_FD02_BCM 0;
BA_ "GenSigTimeoutTime_TCM" SG_ 2654339072 WakeupSource_FD02_BCM 0;
BA_ "GenSigTimeoutTime_AGSM" SG_ 2654339072 WakeupSource_FD03_BCM 0;
BA_ "GenSigTimeoutTime_BCM" SG_ 2654339072 WakeupSource_FD03_BCM 0;
BA_ "GenSigTimeoutTime_BSM" SG_ 2654339072 WakeupSource_FD03_BCM 0;
BA_ "GenSigTimeoutTime_CADM" SG_ 2654339072 WakeupSource_FD03_BCM 0;
BA_ "GenSigTimeoutTime_DMSM" SG_ 2654339072 WakeupSource_FD03_BCM 0;
BA_ "GenSigTimeoutTime_DTCM" SG_ 2654339072 WakeupSource_FD03_BCM 0;
BA_ "GenSigTimeoutTime_ECM" SG_ 2654339072 WakeupSource_FD03_BCM 0;
BA_ "GenSigTimeoutTime_EVCU2" SG_ 2654339072 WakeupSource_FD03_BCM 0;
BA_ "GenSigTimeoutTime_GNMM" SG_ 2654339072 WakeupSource_FD03_BCM 0;
BA_ "GenSigTimeoutTime_HCP" SG_ 2654339072 WakeupSource_FD03_BCM 0;
BA_ "GenSigTimeoutTime_IPC" SG_ 2654339072 WakeupSource_FD03_BCM 0;
BA_ "GenSigTimeoutTime_RFHM" SG_ 2654339072 WakeupSource_FD03_BCM 0;
BA_ "GenSigTimeoutTime_SGW" SG_ 2654339072 WakeupSource_FD03_BCM 0;
BA_ "GenSigTimeoutTime_TCM" SG_ 2654339072 WakeupSource_FD03_BCM 0;
BA_ "GenSigTimeoutTime_AGSM" SG_ 2654339072 WakeupSource_FD04_BCM 0;
BA_ "GenSigTimeoutTime_BCM" SG_ 2654339072 WakeupSource_FD04_BCM 0;
BA_ "GenSigTimeoutTime_BSM" SG_ 2654339072 WakeupSource_FD04_BCM 0;
BA_ "GenSigTimeoutTime_CADM" SG_ 2654339072 WakeupSource_FD04_BCM 0;
BA_ "GenSigTimeoutTime_DMSM" SG_ 2654339072 WakeupSource_FD04_BCM 0;
BA_ "GenSigTimeoutTime_DTCM" SG_ 2654339072 WakeupSource_FD04_BCM 0;
BA_ "GenSigTimeoutTime_ECM" SG_ 2654339072 WakeupSource_FD04_BCM 0;
BA_ "GenSigTimeoutTime_EVCU2" SG_ 2654339072 WakeupSource_FD04_BCM 0;
BA_ "GenSigTimeoutTime_GNMM" SG_ 2654339072 WakeupSource_FD04_BCM 0;
BA_ "GenSigTimeoutTime_HCP" SG_ 2654339072 WakeupSource_FD04_BCM 0;
BA_ "GenSigTimeoutTime_IPC" SG_ 2654339072 WakeupSource_FD04_BCM 0;
BA_ "GenSigTimeoutTime_RFHM" SG_ 2654339072 WakeupSource_FD04_BCM 0;
BA_ "GenSigTimeoutTime_SGW" SG_ 2654339072 WakeupSource_FD04_BCM 0;
BA_ "GenSigTimeoutTime_TCM" SG_ 2654339072 WakeupSource_FD04_BCM 0;
BA_ "GenSigTimeoutTime_AGSM" SG_ 2654339142 CurrentCanNMState_FD05_BPCM 0;
BA_ "GenSigTimeoutTime_BCM" SG_ 2654339142 CurrentCanNMState_FD05_BPCM 0;
BA_ "GenSigTimeoutTime_BSM" SG_ 2654339142 CurrentCanNMState_FD05_BPCM 0;
BA_ "GenSigTimeoutTime_CADM" SG_ 2654339142 CurrentCanNMState_FD05_BPCM 0;
BA_ "GenSigTimeoutTime_DMSM" SG_ 2654339142 CurrentCanNMState_FD05_BPCM 0;
BA_ "GenSigTimeoutTime_DTCM" SG_ 2654339142 CurrentCanNMState_FD05_BPCM 0;
BA_ "GenSigTimeoutTime_ECM" SG_ 2654339142 CurrentCanNMState_FD05_BPCM 0;
BA_ "GenSigTimeoutTime_EVCU2" SG_ 2654339142 CurrentCanNMState_FD05_BPCM 0;
BA_ "GenSigTimeoutTime_GNMM" SG_ 2654339142 CurrentCanNMState_FD05_BPCM 0;
BA_ "GenSigTimeoutTime_HCP" SG_ 2654339142 CurrentCanNMState_FD05_BPCM 0;
BA_ "GenSigTimeoutTime_IPC" SG_ 2654339142 CurrentCanNMState_FD05_BPCM 0;
BA_ "GenSigTimeoutTime_RFHM" SG_ 2654339142 CurrentCanNMState_FD05_BPCM 0;
BA_ "GenSigTimeoutTime_SGW" SG_ 2654339142 CurrentCanNMState_FD05_BPCM 0;
BA_ "GenSigTimeoutTime_TCM" SG_ 2654339142 CurrentCanNMState_FD05_BPCM 0;
BA_ "GenSigTimeoutTime_AGSM" SG_ 2654339142 CurrentCanNMState_FD11_BPCM 0;
BA_ "GenSigTimeoutTime_BCM" SG_ 2654339142 CurrentCanNMState_FD11_BPCM 0;
BA_ "GenSigTimeoutTime_BSM" SG_ 2654339142 CurrentCanNMState_FD11_BPCM 0;
BA_ "GenSigTimeoutTime_CADM" SG_ 2654339142 CurrentCanNMState_FD11_BPCM 0;
BA_ "GenSigTimeoutTime_DMSM" SG_ 2654339142 CurrentCanNMState_FD11_BPCM 0;
BA_ "GenSigTimeoutTime_DTCM" SG_ 2654339142 CurrentCanNMState_FD11_BPCM 0;
BA_ "GenSigTimeoutTime_ECM" SG_ 2654339142 CurrentCanNMState_FD11_BPCM 0;
BA_ "GenSigTimeoutTime_EVCU2" SG_ 2654339142 CurrentCanNMState_FD11_BPCM 0;
BA_ "GenSigTimeoutTime_GNMM" SG_ 2654339142 CurrentCanNMState_FD11_BPCM 0;
BA_ "GenSigTimeoutTime_HCP" SG_ 2654339142 CurrentCanNMState_FD11_BPCM 0;
BA_ "GenSigTimeoutTime_IPC" SG_ 2654339142 CurrentCanNMState_FD11_BPCM 0;
BA_ "GenSigTimeoutTime_RFHM" SG_ 2654339142 CurrentCanNMState_FD11_BPCM 0;
BA_ "GenSigTimeoutTime_SGW" SG_ 2654339142 CurrentCanNMState_FD11_BPCM 0;
BA_ "GenSigTimeoutTime_TCM" SG_ 2654339142 CurrentCanNMState_FD11_BPCM 0;
BA_ "GenSigTimeoutTime_AGSM" SG_ 2654339142 CurrentFailSts_FD05_BPCM 0;
BA_ "GenSigTimeoutTime_BCM" SG_ 2654339142 CurrentFailSts_FD05_BPCM 0;
BA_ "GenSigTimeoutTime_BSM" SG_ 2654339142 CurrentFailSts_FD05_BPCM 0;
BA_ "GenSigTimeoutTime_CADM" SG_ 2654339142 CurrentFailSts_FD05_BPCM 0;
BA_ "GenSigTimeoutTime_DMSM" SG_ 2654339142 CurrentFailSts_FD05_BPCM 0;
BA_ "GenSigTimeoutTime_DTCM" SG_ 2654339142 CurrentFailSts_FD05_BPCM 0;
BA_ "GenSigTimeoutTime_ECM" SG_ 2654339142 CurrentFailSts_FD05_BPCM 0;
BA_ "GenSigTimeoutTime_EVCU2" SG_ 2654339142 CurrentFailSts_FD05_BPCM 0;
BA_ "GenSigTimeoutTime_GNMM" SG_ 2654339142 CurrentFailSts_FD05_BPCM 0;
BA_ "GenSigTimeoutTime_HCP" SG_ 2654339142 CurrentFailSts_FD05_BPCM 0;
BA_ "GenSigTimeoutTime_IPC" SG_ 2654339142 CurrentFailSts_FD05_BPCM 0;
BA_ "GenSigTimeoutTime_RFHM" SG_ 2654339142 CurrentFailSts_FD05_BPCM 0;
BA_ "GenSigTimeoutTime_SGW" SG_ 2654339142 CurrentFailSts_FD05_BPCM 0;
BA_ "GenSigTimeoutTime_TCM" SG_ 2654339142 CurrentFailSts_FD05_BPCM 0;
BA_ "GenSigTimeoutTime_AGSM" SG_ 2654339142 CurrentFailSts_FD11_BPCM 0;
BA_ "GenSigTimeoutTime_BSM" SG_ 2654339142 CurrentFailSts_FD11_BPCM 0;
BA_ "GenSigTimeoutTime_CADM" SG_ 2654339142 CurrentFailSts_FD11_BPCM 0;
BA_ "GenSigTimeoutTime_DMSM" SG_ 2654339142 CurrentFailSts_FD11_BPCM 0;
BA_ "GenSigTimeoutTime_DTCM" SG_ 2654339142 CurrentFailSts_FD11_BPCM 0;
BA_ "GenSigTimeoutTime_ECM" SG_ 2654339142 CurrentFailSts_FD11_BPCM 0;
BA_ "GenSigTimeoutTime_EVCU2" SG_ 2654339142 CurrentFailSts_FD11_BPCM 0;
BA_ "GenSigTimeoutTime_GNMM" SG_ 2654339142 CurrentFailSts_FD11_BPCM 0;
BA_ "GenSigTimeoutTime_HCP" SG_ 2654339142 CurrentFailSts_FD11_BPCM 0;
BA_ "GenSigTimeoutTime_IPC" SG_ 2654339142 CurrentFailSts_FD11_BPCM 0;
BA_ "GenSigTimeoutTime_RFHM" SG_ 2654339142 CurrentFailSts_FD11_BPCM 0;
BA_ "GenSigTimeoutTime_SGW" SG_ 2654339142 CurrentFailSts_FD11_BPCM 0;
BA_ "GenSigTimeoutTime_TCM" SG_ 2654339142 CurrentFailSts_FD11_BPCM 0;
BA_ "GenSigTimeoutTime_AGSM" SG_ 2654339142 DES_FD05_BPCM 0;
BA_ "GenSigTimeoutTime_BCM" SG_ 2654339142 DES_FD05_BPCM 0;
BA_ "GenSigTimeoutTime_BSM" SG_ 2654339142 DES_FD05_BPCM 0;
BA_ "GenSigTimeoutTime_CADM" SG_ 2654339142 DES_FD05_BPCM 0;
BA_ "GenSigTimeoutTime_DMSM" SG_ 2654339142 DES_FD05_BPCM 0;
BA_ "GenSigTimeoutTime_DTCM" SG_ 2654339142 DES_FD05_BPCM 0;
BA_ "GenSigTimeoutTime_ECM" SG_ 2654339142 DES_FD05_BPCM 0;
BA_ "GenSigTimeoutTime_EVCU2" SG_ 2654339142 DES_FD05_BPCM 0;
BA_ "GenSigTimeoutTime_GNMM" SG_ 2654339142 DES_FD05_BPCM 0;
BA_ "GenSigTimeoutTime_HCP" SG_ 2654339142 DES_FD05_BPCM 0;
BA_ "GenSigTimeoutTime_IPC" SG_ 2654339142 DES_FD05_BPCM 0;
BA_ "GenSigTimeoutTime_RFHM" SG_ 2654339142 DES_FD05_BPCM 0;
BA_ "GenSigTimeoutTime_SGW" SG_ 2654339142 DES_FD05_BPCM 0;
BA_ "GenSigTimeoutTime_TCM" SG_ 2654339142 DES_FD05_BPCM 0;
BA_ "GenSigTimeoutTime_AGSM" SG_ 2654339142 DES_FD11_BPCM 0;
BA_ "GenSigTimeoutTime_BCM" SG_ 2654339142 DES_FD11_BPCM 0;
BA_ "GenSigTimeoutTime_BSM" SG_ 2654339142 DES_FD11_BPCM 0;
BA_ "GenSigTimeoutTime_CADM" SG_ 2654339142 DES_FD11_BPCM 0;
BA_ "GenSigTimeoutTime_DMSM" SG_ 2654339142 DES_FD11_BPCM 0;
BA_ "GenSigTimeoutTime_DTCM" SG_ 2654339142 DES_FD11_BPCM 0;
BA_ "GenSigTimeoutTime_ECM" SG_ 2654339142 DES_FD11_BPCM 0;
BA_ "GenSigTimeoutTime_EVCU2" SG_ 2654339142 DES_FD11_BPCM 0;
BA_ "GenSigTimeoutTime_GNMM" SG_ 2654339142 DES_FD11_BPCM 0;
BA_ "GenSigTimeoutTime_HCP" SG_ 2654339142 DES_FD11_BPCM 0;
BA_ "GenSigTimeoutTime_IPC" SG_ 2654339142 DES_FD11_BPCM 0;
BA_ "GenSigTimeoutTime_RFHM" SG_ 2654339142 DES_FD11_BPCM 0;
BA_ "GenSigTimeoutTime_SGW" SG_ 2654339142 DES_FD11_BPCM 0;
BA_ "GenSigTimeoutTime_TCM" SG_ 2654339142 DES_FD11_BPCM 0;
BA_ "GenSigTimeoutTime_AGSM" SG_ 2654339142 EOL_FD05_BPCM 0;
BA_ "GenSigTimeoutTime_BCM" SG_ 2654339142 EOL_FD05_BPCM 0;
BA_ "GenSigTimeoutTime_BSM" SG_ 2654339142 EOL_FD05_BPCM 0;
BA_ "GenSigTimeoutTime_CADM" SG_ 2654339142 EOL_FD05_BPCM 0;
BA_ "GenSigTimeoutTime_DMSM" SG_ 2654339142 EOL_FD05_BPCM 0;
BA_ "GenSigTimeoutTime_DTCM" SG_ 2654339142 EOL_FD05_BPCM 0;
BA_ "GenSigTimeoutTime_ECM" SG_ 2654339142 EOL_FD05_BPCM 0;
BA_ "GenSigTimeoutTime_EVCU2" SG_ 2654339142 EOL_FD05_BPCM 0;
BA_ "GenSigTimeoutTime_GNMM" SG_ 2654339142 EOL_FD05_BPCM 0;
BA_ "GenSigTimeoutTime_HCP" SG_ 2654339142 EOL_FD05_BPCM 0;
BA_ "GenSigTimeoutTime_IPC" SG_ 2654339142 EOL_FD05_BPCM 0;
BA_ "GenSigTimeoutTime_RFHM" SG_ 2654339142 EOL_FD05_BPCM 0;
BA_ "GenSigTimeoutTime_SGW" SG_ 2654339142 EOL_FD05_BPCM 0;
BA_ "GenSigTimeoutTime_TCM" SG_ 2654339142 EOL_FD05_BPCM 0;
BA_ "GenSigTimeoutTime_AGSM" SG_ 2654339142 EOL_FD11_BPCM 0;
BA_ "GenSigTimeoutTime_BSM" SG_ 2654339142 EOL_FD11_BPCM 0;
BA_ "GenSigTimeoutTime_CADM" SG_ 2654339142 EOL_FD11_BPCM 0;
BA_ "GenSigTimeoutTime_DMSM" SG_ 2654339142 EOL_FD11_BPCM 0;
BA_ "GenSigTimeoutTime_DTCM" SG_ 2654339142 EOL_FD11_BPCM 0;
BA_ "GenSigTimeoutTime_ECM" SG_ 2654339142 EOL_FD11_BPCM 0;
BA_ "GenSigTimeoutTime_EVCU2" SG_ 2654339142 EOL_FD11_BPCM 0;
BA_ "GenSigTimeoutTime_GNMM" SG_ 2654339142 EOL_FD11_BPCM 0;
BA_ "GenSigTimeoutTime_HCP" SG_ 2654339142 EOL_FD11_BPCM 0;
BA_ "GenSigTimeoutTime_IPC" SG_ 2654339142 EOL_FD11_BPCM 0;
BA_ "GenSigTimeoutTime_RFHM" SG_ 2654339142 EOL_FD11_BPCM 0;
BA_ "GenSigTimeoutTime_SGW" SG_ 2654339142 EOL_FD11_BPCM 0;
BA_ "GenSigTimeoutTime_TCM" SG_ 2654339142 EOL_FD11_BPCM 0;
BA_ "GenSigTimeoutTime_AGSM" SG_ 2654339142 GenericFailSts_FD05_BPCM 0;
BA_ "GenSigTimeoutTime_BCM" SG_ 2654339142 GenericFailSts_FD05_BPCM 0;
BA_ "GenSigTimeoutTime_BSM" SG_ 2654339142 GenericFailSts_FD05_BPCM 0;
BA_ "GenSigTimeoutTime_CADM" SG_ 2654339142 GenericFailSts_FD05_BPCM 0;
BA_ "GenSigTimeoutTime_DMSM" SG_ 2654339142 GenericFailSts_FD05_BPCM 0;
BA_ "GenSigTimeoutTime_DTCM" SG_ 2654339142 GenericFailSts_FD05_BPCM 0;
BA_ "GenSigTimeoutTime_ECM" SG_ 2654339142 GenericFailSts_FD05_BPCM 0;
BA_ "GenSigTimeoutTime_EVCU2" SG_ 2654339142 GenericFailSts_FD05_BPCM 0;
BA_ "GenSigTimeoutTime_GNMM" SG_ 2654339142 GenericFailSts_FD05_BPCM 0;
BA_ "GenSigTimeoutTime_HCP" SG_ 2654339142 GenericFailSts_FD05_BPCM 0;
BA_ "GenSigTimeoutTime_IPC" SG_ 2654339142 GenericFailSts_FD05_BPCM 0;
BA_ "GenSigTimeoutTime_RFHM" SG_ 2654339142 GenericFailSts_FD05_BPCM 0;
BA_ "GenSigTimeoutTime_SGW" SG_ 2654339142 GenericFailSts_FD05_BPCM 0;
BA_ "GenSigTimeoutTime_TCM" SG_ 2654339142 GenericFailSts_FD05_BPCM 0;
BA_ "GenSigTimeoutTime_AGSM" SG_ 2654339142 GenericFailSts_FD11_BPCM 0;
BA_ "GenSigTimeoutTime_BSM" SG_ 2654339142 GenericFailSts_FD11_BPCM 0;
BA_ "GenSigTimeoutTime_CADM" SG_ 2654339142 GenericFailSts_FD11_BPCM 0;
BA_ "GenSigTimeoutTime_DMSM" SG_ 2654339142 GenericFailSts_FD11_BPCM 0;
BA_ "GenSigTimeoutTime_DTCM" SG_ 2654339142 GenericFailSts_FD11_BPCM 0;
BA_ "GenSigTimeoutTime_ECM" SG_ 2654339142 GenericFailSts_FD11_BPCM 0;
BA_ "GenSigTimeoutTime_EVCU2" SG_ 2654339142 GenericFailSts_FD11_BPCM 0;
BA_ "GenSigTimeoutTime_GNMM" SG_ 2654339142 GenericFailSts_FD11_BPCM 0;
BA_ "GenSigTimeoutTime_HCP" SG_ 2654339142 GenericFailSts_FD11_BPCM 0;
BA_ "GenSigTimeoutTime_IPC" SG_ 2654339142 GenericFailSts_FD11_BPCM 0;
BA_ "GenSigTimeoutTime_RFHM" SG_ 2654339142 GenericFailSts_FD11_BPCM 0;
BA_ "GenSigTimeoutTime_SGW" SG_ 2654339142 GenericFailSts_FD11_BPCM 0;
BA_ "GenSigTimeoutTime_TCM" SG_ 2654339142 GenericFailSts_FD11_BPCM 0;
BA_ "GenSigTimeoutTime_AGSM" SG_ 2654339142 PreviousCanNMState_FD05_BPCM 0;
BA_ "GenSigTimeoutTime_BCM" SG_ 2654339142 PreviousCanNMState_FD05_BPCM 0;
BA_ "GenSigTimeoutTime_BSM" SG_ 2654339142 PreviousCanNMState_FD05_BPCM 0;
BA_ "GenSigTimeoutTime_CADM" SG_ 2654339142 PreviousCanNMState_FD05_BPCM 0;
BA_ "GenSigTimeoutTime_DMSM" SG_ 2654339142 PreviousCanNMState_FD05_BPCM 0;
BA_ "GenSigTimeoutTime_DTCM" SG_ 2654339142 PreviousCanNMState_FD05_BPCM 0;
BA_ "GenSigTimeoutTime_ECM" SG_ 2654339142 PreviousCanNMState_FD05_BPCM 0;
BA_ "GenSigTimeoutTime_EVCU2" SG_ 2654339142 PreviousCanNMState_FD05_BPCM 0;
BA_ "GenSigTimeoutTime_GNMM" SG_ 2654339142 PreviousCanNMState_FD05_BPCM 0;
BA_ "GenSigTimeoutTime_HCP" SG_ 2654339142 PreviousCanNMState_FD05_BPCM 0;
BA_ "GenSigTimeoutTime_IPC" SG_ 2654339142 PreviousCanNMState_FD05_BPCM 0;
BA_ "GenSigTimeoutTime_RFHM" SG_ 2654339142 PreviousCanNMState_FD05_BPCM 0;
BA_ "GenSigTimeoutTime_SGW" SG_ 2654339142 PreviousCanNMState_FD05_BPCM 0;
BA_ "GenSigTimeoutTime_TCM" SG_ 2654339142 PreviousCanNMState_FD05_BPCM 0;
BA_ "GenSigTimeoutTime_AGSM" SG_ 2654339142 PreviousCanNMState_FD11_BPCM 0;
BA_ "GenSigTimeoutTime_BCM" SG_ 2654339142 PreviousCanNMState_FD11_BPCM 0;
BA_ "GenSigTimeoutTime_BSM" SG_ 2654339142 PreviousCanNMState_FD11_BPCM 0;
BA_ "GenSigTimeoutTime_CADM" SG_ 2654339142 PreviousCanNMState_FD11_BPCM 0;
BA_ "GenSigTimeoutTime_DMSM" SG_ 2654339142 PreviousCanNMState_FD11_BPCM 0;
BA_ "GenSigTimeoutTime_DTCM" SG_ 2654339142 PreviousCanNMState_FD11_BPCM 0;
BA_ "GenSigTimeoutTime_ECM" SG_ 2654339142 PreviousCanNMState_FD11_BPCM 0;
BA_ "GenSigTimeoutTime_EVCU2" SG_ 2654339142 PreviousCanNMState_FD11_BPCM 0;
BA_ "GenSigTimeoutTime_GNMM" SG_ 2654339142 PreviousCanNMState_FD11_BPCM 0;
BA_ "GenSigTimeoutTime_HCP" SG_ 2654339142 PreviousCanNMState_FD11_BPCM 0;
BA_ "GenSigTimeoutTime_IPC" SG_ 2654339142 PreviousCanNMState_FD11_BPCM 0;
BA_ "GenSigTimeoutTime_RFHM" SG_ 2654339142 PreviousCanNMState_FD11_BPCM 0;
BA_ "GenSigTimeoutTime_SGW" SG_ 2654339142 PreviousCanNMState_FD11_BPCM 0;
BA_ "GenSigTimeoutTime_TCM" SG_ 2654339142 PreviousCanNMState_FD11_BPCM 0;
BA_ "GenSigTimeoutTime_AGSM" SG_ 2654339142 StayActiveSource_FD05_BPCM 0;
BA_ "GenSigTimeoutTime_BCM" SG_ 2654339142 StayActiveSource_FD05_BPCM 0;
BA_ "GenSigTimeoutTime_BSM" SG_ 2654339142 StayActiveSource_FD05_BPCM 0;
BA_ "GenSigTimeoutTime_CADM" SG_ 2654339142 StayActiveSource_FD05_BPCM 0;
BA_ "GenSigTimeoutTime_DMSM" SG_ 2654339142 StayActiveSource_FD05_BPCM 0;
BA_ "GenSigTimeoutTime_DTCM" SG_ 2654339142 StayActiveSource_FD05_BPCM 0;
BA_ "GenSigTimeoutTime_ECM" SG_ 2654339142 StayActiveSource_FD05_BPCM 0;
BA_ "GenSigTimeoutTime_EVCU2" SG_ 2654339142 StayActiveSource_FD05_BPCM 0;
BA_ "GenSigTimeoutTime_GNMM" SG_ 2654339142 StayActiveSource_FD05_BPCM 0;
BA_ "GenSigTimeoutTime_HCP" SG_ 2654339142 StayActiveSource_FD05_BPCM 0;
BA_ "GenSigTimeoutTime_IPC" SG_ 2654339142 StayActiveSource_FD05_BPCM 0;
BA_ "GenSigTimeoutTime_RFHM" SG_ 2654339142 StayActiveSource_FD05_BPCM 0;
BA_ "GenSigTimeoutTime_SGW" SG_ 2654339142 StayActiveSource_FD05_BPCM 0;
BA_ "GenSigTimeoutTime_TCM" SG_ 2654339142 StayActiveSource_FD05_BPCM 0;
BA_ "GenSigTimeoutTime_AGSM" SG_ 2654339142 StayActiveSource_FD11_BPCM 0;
BA_ "GenSigTimeoutTime_BCM" SG_ 2654339142 StayActiveSource_FD11_BPCM 0;
BA_ "GenSigTimeoutTime_BSM" SG_ 2654339142 StayActiveSource_FD11_BPCM 0;
BA_ "GenSigTimeoutTime_CADM" SG_ 2654339142 StayActiveSource_FD11_BPCM 0;
BA_ "GenSigTimeoutTime_DMSM" SG_ 2654339142 StayActiveSource_FD11_BPCM 0;
BA_ "GenSigTimeoutTime_DTCM" SG_ 2654339142 StayActiveSource_FD11_BPCM 0;
BA_ "GenSigTimeoutTime_ECM" SG_ 2654339142 StayActiveSource_FD11_BPCM 0;
BA_ "GenSigTimeoutTime_EVCU2" SG_ 2654339142 StayActiveSource_FD11_BPCM 0;
BA_ "GenSigTimeoutTime_GNMM" SG_ 2654339142 StayActiveSource_FD11_BPCM 0;
BA_ "GenSigTimeoutTime_HCP" SG_ 2654339142 StayActiveSource_FD11_BPCM 0;
BA_ "GenSigTimeoutTime_IPC" SG_ 2654339142 StayActiveSource_FD11_BPCM 0;
BA_ "GenSigTimeoutTime_RFHM" SG_ 2654339142 StayActiveSource_FD11_BPCM 0;
BA_ "GenSigTimeoutTime_SGW" SG_ 2654339142 StayActiveSource_FD11_BPCM 0;
BA_ "GenSigTimeoutTime_TCM" SG_ 2654339142 StayActiveSource_FD11_BPCM 0;
BA_ "GenSigTimeoutTime_AGSM" SG_ 2654339142 WakeupSource_FD05_BPCM 0;
BA_ "GenSigTimeoutTime_BCM" SG_ 2654339142 WakeupSource_FD05_BPCM 0;
BA_ "GenSigTimeoutTime_BSM" SG_ 2654339142 WakeupSource_FD05_BPCM 0;
BA_ "GenSigTimeoutTime_CADM" SG_ 2654339142 WakeupSource_FD05_BPCM 0;
BA_ "GenSigTimeoutTime_DMSM" SG_ 2654339142 WakeupSource_FD05_BPCM 0;
BA_ "GenSigTimeoutTime_DTCM" SG_ 2654339142 WakeupSource_FD05_BPCM 0;
BA_ "GenSigTimeoutTime_ECM" SG_ 2654339142 WakeupSource_FD05_BPCM 0;
BA_ "GenSigTimeoutTime_EVCU2" SG_ 2654339142 WakeupSource_FD05_BPCM 0;
BA_ "GenSigTimeoutTime_GNMM" SG_ 2654339142 WakeupSource_FD05_BPCM 0;
BA_ "GenSigTimeoutTime_HCP" SG_ 2654339142 WakeupSource_FD05_BPCM 0;
BA_ "GenSigTimeoutTime_IPC" SG_ 2654339142 WakeupSource_FD05_BPCM 0;
BA_ "GenSigTimeoutTime_RFHM" SG_ 2654339142 WakeupSource_FD05_BPCM 0;
BA_ "GenSigTimeoutTime_SGW" SG_ 2654339142 WakeupSource_FD05_BPCM 0;
BA_ "GenSigTimeoutTime_TCM" SG_ 2654339142 WakeupSource_FD05_BPCM 0;
BA_ "GenSigTimeoutTime_AGSM" SG_ 2654339142 WakeupSource_FD11_BPCM 0;
BA_ "GenSigTimeoutTime_BCM" SG_ 2654339142 WakeupSource_FD11_BPCM 0;
BA_ "GenSigTimeoutTime_BSM" SG_ 2654339142 WakeupSource_FD11_BPCM 0;
BA_ "GenSigTimeoutTime_CADM" SG_ 2654339142 WakeupSource_FD11_BPCM 0;
BA_ "GenSigTimeoutTime_DMSM" SG_ 2654339142 WakeupSource_FD11_BPCM 0;
BA_ "GenSigTimeoutTime_DTCM" SG_ 2654339142 WakeupSource_FD11_BPCM 0;
BA_ "GenSigTimeoutTime_ECM" SG_ 2654339142 WakeupSource_FD11_BPCM 0;
BA_ "GenSigTimeoutTime_EVCU2" SG_ 2654339142 WakeupSource_FD11_BPCM 0;
BA_ "GenSigTimeoutTime_GNMM" SG_ 2654339142 WakeupSource_FD11_BPCM 0;
BA_ "GenSigTimeoutTime_HCP" SG_ 2654339142 WakeupSource_FD11_BPCM 0;
BA_ "GenSigTimeoutTime_IPC" SG_ 2654339142 WakeupSource_FD11_BPCM 0;
BA_ "GenSigTimeoutTime_RFHM" SG_ 2654339142 WakeupSource_FD11_BPCM 0;
BA_ "GenSigTimeoutTime_SGW" SG_ 2654339142 WakeupSource_FD11_BPCM 0;
BA_ "GenSigTimeoutTime_TCM" SG_ 2654339142 WakeupSource_FD11_BPCM 0;
BA_ "GenSigTimeoutTime_AGSM" SG_ 2654339078 CurrentCanNMState_FD03_BSM 0;
BA_ "GenSigTimeoutTime_BCM" SG_ 2654339078 CurrentCanNMState_FD03_BSM 0;
BA_ "GenSigTimeoutTime_BSM" SG_ 2654339078 CurrentCanNMState_FD03_BSM 0;
BA_ "GenSigTimeoutTime_CADM" SG_ 2654339078 CurrentCanNMState_FD03_BSM 0;
BA_ "GenSigTimeoutTime_DMSM" SG_ 2654339078 CurrentCanNMState_FD03_BSM 0;
BA_ "GenSigTimeoutTime_DTCM" SG_ 2654339078 CurrentCanNMState_FD03_BSM 0;
BA_ "GenSigTimeoutTime_ECM" SG_ 2654339078 CurrentCanNMState_FD03_BSM 0;
BA_ "GenSigTimeoutTime_EVCU2" SG_ 2654339078 CurrentCanNMState_FD03_BSM 0;
BA_ "GenSigTimeoutTime_GNMM" SG_ 2654339078 CurrentCanNMState_FD03_BSM 0;
BA_ "GenSigTimeoutTime_HCP" SG_ 2654339078 CurrentCanNMState_FD03_BSM 0;
BA_ "GenSigTimeoutTime_IPC" SG_ 2654339078 CurrentCanNMState_FD03_BSM 0;
BA_ "GenSigTimeoutTime_RFHM" SG_ 2654339078 CurrentCanNMState_FD03_BSM 0;
BA_ "GenSigTimeoutTime_TCM" SG_ 2654339078 CurrentCanNMState_FD03_BSM 0;
BA_ "GenSigTimeoutTime_AGSM" SG_ 2654339078 CurrentFailSts_FD03_BSM 0;
BA_ "GenSigTimeoutTime_BSM" SG_ 2654339078 CurrentFailSts_FD03_BSM 0;
BA_ "GenSigTimeoutTime_CADM" SG_ 2654339078 CurrentFailSts_FD03_BSM 0;
BA_ "GenSigTimeoutTime_DMSM" SG_ 2654339078 CurrentFailSts_FD03_BSM 0;
BA_ "GenSigTimeoutTime_DTCM" SG_ 2654339078 CurrentFailSts_FD03_BSM 0;
BA_ "GenSigTimeoutTime_ECM" SG_ 2654339078 CurrentFailSts_FD03_BSM 0;
BA_ "GenSigTimeoutTime_EVCU2" SG_ 2654339078 CurrentFailSts_FD03_BSM 0;
BA_ "GenSigTimeoutTime_GNMM" SG_ 2654339078 CurrentFailSts_FD03_BSM 0;
BA_ "GenSigTimeoutTime_HCP" SG_ 2654339078 CurrentFailSts_FD03_BSM 0;
BA_ "GenSigTimeoutTime_IPC" SG_ 2654339078 CurrentFailSts_FD03_BSM 0;
BA_ "GenSigTimeoutTime_RFHM" SG_ 2654339078 CurrentFailSts_FD03_BSM 0;
BA_ "GenSigTimeoutTime_TCM" SG_ 2654339078 CurrentFailSts_FD03_BSM 0;
BA_ "GenSigTimeoutTime_AGSM" SG_ 2654339078 DES_FD03_BSM 0;
BA_ "GenSigTimeoutTime_BCM" SG_ 2654339078 DES_FD03_BSM 0;
BA_ "GenSigTimeoutTime_BSM" SG_ 2654339078 DES_FD03_BSM 0;
BA_ "GenSigTimeoutTime_CADM" SG_ 2654339078 DES_FD03_BSM 0;
BA_ "GenSigTimeoutTime_DMSM" SG_ 2654339078 DES_FD03_BSM 0;
BA_ "GenSigTimeoutTime_DTCM" SG_ 2654339078 DES_FD03_BSM 0;
BA_ "GenSigTimeoutTime_ECM" SG_ 2654339078 DES_FD03_BSM 0;
BA_ "GenSigTimeoutTime_EVCU2" SG_ 2654339078 DES_FD03_BSM 0;
BA_ "GenSigTimeoutTime_GNMM" SG_ 2654339078 DES_FD03_BSM 0;
BA_ "GenSigTimeoutTime_HCP" SG_ 2654339078 DES_FD03_BSM 0;
BA_ "GenSigTimeoutTime_IPC" SG_ 2654339078 DES_FD03_BSM 0;
BA_ "GenSigTimeoutTime_RFHM" SG_ 2654339078 DES_FD03_BSM 0;
BA_ "GenSigTimeoutTime_TCM" SG_ 2654339078 DES_FD03_BSM 0;
BA_ "GenSigTimeoutTime_AGSM" SG_ 2654339078 EOL_FD03_BSM 0;
BA_ "GenSigTimeoutTime_BSM" SG_ 2654339078 EOL_FD03_BSM 0;
BA_ "GenSigTimeoutTime_CADM" SG_ 2654339078 EOL_FD03_BSM 0;
BA_ "GenSigTimeoutTime_DMSM" SG_ 2654339078 EOL_FD03_BSM 0;
BA_ "GenSigTimeoutTime_DTCM" SG_ 2654339078 EOL_FD03_BSM 0;
BA_ "GenSigTimeoutTime_ECM" SG_ 2654339078 EOL_FD03_BSM 0;
BA_ "GenSigTimeoutTime_EVCU2" SG_ 2654339078 EOL_FD03_BSM 0;
BA_ "GenSigTimeoutTime_GNMM" SG_ 2654339078 EOL_FD03_BSM 0;
BA_ "GenSigTimeoutTime_HCP" SG_ 2654339078 EOL_FD03_BSM 0;
BA_ "GenSigTimeoutTime_IPC" SG_ 2654339078 EOL_FD03_BSM 0;
BA_ "GenSigTimeoutTime_RFHM" SG_ 2654339078 EOL_FD03_BSM 0;
BA_ "GenSigTimeoutTime_TCM" SG_ 2654339078 EOL_FD03_BSM 0;
BA_ "GenSigTimeoutTime_AGSM" SG_ 2654339078 GenericFailSts_FD03_BSM 0;
BA_ "GenSigTimeoutTime_BSM" SG_ 2654339078 GenericFailSts_FD03_BSM 0;
BA_ "GenSigTimeoutTime_CADM" SG_ 2654339078 GenericFailSts_FD03_BSM 0;
BA_ "GenSigTimeoutTime_DMSM" SG_ 2654339078 GenericFailSts_FD03_BSM 0;
BA_ "GenSigTimeoutTime_DTCM" SG_ 2654339078 GenericFailSts_FD03_BSM 0;
BA_ "GenSigTimeoutTime_ECM" SG_ 2654339078 GenericFailSts_FD03_BSM 0;
BA_ "GenSigTimeoutTime_EVCU2" SG_ 2654339078 GenericFailSts_FD03_BSM 0;
BA_ "GenSigTimeoutTime_GNMM" SG_ 2654339078 GenericFailSts_FD03_BSM 0;
BA_ "GenSigTimeoutTime_HCP" SG_ 2654339078 GenericFailSts_FD03_BSM 0;
BA_ "GenSigTimeoutTime_IPC" SG_ 2654339078 GenericFailSts_FD03_BSM 0;
BA_ "GenSigTimeoutTime_RFHM" SG_ 2654339078 GenericFailSts_FD03_BSM 0;
BA_ "GenSigTimeoutTime_TCM" SG_ 2654339078 GenericFailSts_FD03_BSM 0;
BA_ "GenSigTimeoutTime_AGSM" SG_ 2654339078 PreviousCanNMState_FD03_BSM 0;
BA_ "GenSigTimeoutTime_BCM" SG_ 2654339078 PreviousCanNMState_FD03_BSM 0;
BA_ "GenSigTimeoutTime_BSM" SG_ 2654339078 PreviousCanNMState_FD03_BSM 0;
BA_ "GenSigTimeoutTime_CADM" SG_ 2654339078 PreviousCanNMState_FD03_BSM 0;
BA_ "GenSigTimeoutTime_DMSM" SG_ 2654339078 PreviousCanNMState_FD03_BSM 0;
BA_ "GenSigTimeoutTime_DTCM" SG_ 2654339078 PreviousCanNMState_FD03_BSM 0;
BA_ "GenSigTimeoutTime_ECM" SG_ 2654339078 PreviousCanNMState_FD03_BSM 0;
BA_ "GenSigTimeoutTime_EVCU2" SG_ 2654339078 PreviousCanNMState_FD03_BSM 0;
BA_ "GenSigTimeoutTime_GNMM" SG_ 2654339078 PreviousCanNMState_FD03_BSM 0;
BA_ "GenSigTimeoutTime_HCP" SG_ 2654339078 PreviousCanNMState_FD03_BSM 0;
BA_ "GenSigTimeoutTime_IPC" SG_ 2654339078 PreviousCanNMState_FD03_BSM 0;
BA_ "GenSigTimeoutTime_RFHM" SG_ 2654339078 PreviousCanNMState_FD03_BSM 0;
BA_ "GenSigTimeoutTime_TCM" SG_ 2654339078 PreviousCanNMState_FD03_BSM 0;
BA_ "GenSigTimeoutTime_AGSM" SG_ 2654339078 StayActiveSource_FD03_BSM 0;
BA_ "GenSigTimeoutTime_BCM" SG_ 2654339078 StayActiveSource_FD03_BSM 0;
BA_ "GenSigTimeoutTime_BSM" SG_ 2654339078 StayActiveSource_FD03_BSM 0;
BA_ "GenSigTimeoutTime_CADM" SG_ 2654339078 StayActiveSource_FD03_BSM 0;
BA_ "GenSigTimeoutTime_DMSM" SG_ 2654339078 StayActiveSource_FD03_BSM 0;
BA_ "GenSigTimeoutTime_DTCM" SG_ 2654339078 StayActiveSource_FD03_BSM 0;
BA_ "GenSigTimeoutTime_ECM" SG_ 2654339078 StayActiveSource_FD03_BSM 0;
BA_ "GenSigTimeoutTime_EVCU2" SG_ 2654339078 StayActiveSource_FD03_BSM 0;
BA_ "GenSigTimeoutTime_GNMM" SG_ 2654339078 StayActiveSource_FD03_BSM 0;
BA_ "GenSigTimeoutTime_HCP" SG_ 2654339078 StayActiveSource_FD03_BSM 0;
BA_ "GenSigTimeoutTime_IPC" SG_ 2654339078 StayActiveSource_FD03_BSM 0;
BA_ "GenSigTimeoutTime_RFHM" SG_ 2654339078 StayActiveSource_FD03_BSM 0;
BA_ "GenSigTimeoutTime_TCM" SG_ 2654339078 StayActiveSource_FD03_BSM 0;
BA_ "GenSigTimeoutTime_AGSM" SG_ 2654339078 WakeupSource_FD03_BSM 0;
BA_ "GenSigTimeoutTime_BCM" SG_ 2654339078 WakeupSource_FD03_BSM 0;
BA_ "GenSigTimeoutTime_BSM" SG_ 2654339078 WakeupSource_FD03_BSM 0;
BA_ "GenSigTimeoutTime_CADM" SG_ 2654339078 WakeupSource_FD03_BSM 0;
BA_ "GenSigTimeoutTime_DMSM" SG_ 2654339078 WakeupSource_FD03_BSM 0;
BA_ "GenSigTimeoutTime_DTCM" SG_ 2654339078 WakeupSource_FD03_BSM 0;
BA_ "GenSigTimeoutTime_ECM" SG_ 2654339078 WakeupSource_FD03_BSM 0;
BA_ "GenSigTimeoutTime_EVCU2" SG_ 2654339078 WakeupSource_FD03_BSM 0;
BA_ "GenSigTimeoutTime_GNMM" SG_ 2654339078 WakeupSource_FD03_BSM 0;
BA_ "GenSigTimeoutTime_HCP" SG_ 2654339078 WakeupSource_FD03_BSM 0;
BA_ "GenSigTimeoutTime_IPC" SG_ 2654339078 WakeupSource_FD03_BSM 0;
BA_ "GenSigTimeoutTime_RFHM" SG_ 2654339078 WakeupSource_FD03_BSM 0;
BA_ "GenSigTimeoutTime_TCM" SG_ 2654339078 WakeupSource_FD03_BSM 0;
BA_ "GenSigTimeoutTime_AGSM" SG_ 2654339213 CurrentCanNMState_FD03_CADM 0;
BA_ "GenSigTimeoutTime_BCM" SG_ 2654339213 CurrentCanNMState_FD03_CADM 0;
BA_ "GenSigTimeoutTime_BSM" SG_ 2654339213 CurrentCanNMState_FD03_CADM 0;
BA_ "GenSigTimeoutTime_CADM" SG_ 2654339213 CurrentCanNMState_FD03_CADM 0;
BA_ "GenSigTimeoutTime_DMSM" SG_ 2654339213 CurrentCanNMState_FD03_CADM 0;
BA_ "GenSigTimeoutTime_DTCM" SG_ 2654339213 CurrentCanNMState_FD03_CADM 0;
BA_ "GenSigTimeoutTime_ECM" SG_ 2654339213 CurrentCanNMState_FD03_CADM 0;
BA_ "GenSigTimeoutTime_EVCU2" SG_ 2654339213 CurrentCanNMState_FD03_CADM 0;
BA_ "GenSigTimeoutTime_GNMM" SG_ 2654339213 CurrentCanNMState_FD03_CADM 0;
BA_ "GenSigTimeoutTime_HCP" SG_ 2654339213 CurrentCanNMState_FD03_CADM 0;
BA_ "GenSigTimeoutTime_IPC" SG_ 2654339213 CurrentCanNMState_FD03_CADM 0;
BA_ "GenSigTimeoutTime_RFHM" SG_ 2654339213 CurrentCanNMState_FD03_CADM 0;
BA_ "GenSigTimeoutTime_TCM" SG_ 2654339213 CurrentCanNMState_FD03_CADM 0;
BA_ "GenSigTimeoutTime_AGSM" SG_ 2654339213 CurrentFailSts_FD03_CADM 0;
BA_ "GenSigTimeoutTime_BSM" SG_ 2654339213 CurrentFailSts_FD03_CADM 0;
BA_ "GenSigTimeoutTime_CADM" SG_ 2654339213 CurrentFailSts_FD03_CADM 0;
BA_ "GenSigTimeoutTime_DMSM" SG_ 2654339213 CurrentFailSts_FD03_CADM 0;
BA_ "GenSigTimeoutTime_DTCM" SG_ 2654339213 CurrentFailSts_FD03_CADM 0;
BA_ "GenSigTimeoutTime_ECM" SG_ 2654339213 CurrentFailSts_FD03_CADM 0;
BA_ "GenSigTimeoutTime_EVCU2" SG_ 2654339213 CurrentFailSts_FD03_CADM 0;
BA_ "GenSigTimeoutTime_GNMM" SG_ 2654339213 CurrentFailSts_FD03_CADM 0;
BA_ "GenSigTimeoutTime_HCP" SG_ 2654339213 CurrentFailSts_FD03_CADM 0;
BA_ "GenSigTimeoutTime_IPC" SG_ 2654339213 CurrentFailSts_FD03_CADM 0;
BA_ "GenSigTimeoutTime_RFHM" SG_ 2654339213 CurrentFailSts_FD03_CADM 0;
BA_ "GenSigTimeoutTime_TCM" SG_ 2654339213 CurrentFailSts_FD03_CADM 0;
BA_ "GenSigTimeoutTime_AGSM" SG_ 2654339213 DES_FD03_CADM 0;
BA_ "GenSigTimeoutTime_BCM" SG_ 2654339213 DES_FD03_CADM 0;
BA_ "GenSigTimeoutTime_BSM" SG_ 2654339213 DES_FD03_CADM 0;
BA_ "GenSigTimeoutTime_CADM" SG_ 2654339213 DES_FD03_CADM 0;
BA_ "GenSigTimeoutTime_DMSM" SG_ 2654339213 DES_FD03_CADM 0;
BA_ "GenSigTimeoutTime_DTCM" SG_ 2654339213 DES_FD03_CADM 0;
BA_ "GenSigTimeoutTime_ECM" SG_ 2654339213 DES_FD03_CADM 0;
BA_ "GenSigTimeoutTime_EVCU2" SG_ 2654339213 DES_FD03_CADM 0;
BA_ "GenSigTimeoutTime_GNMM" SG_ 2654339213 DES_FD03_CADM 0;
BA_ "GenSigTimeoutTime_HCP" SG_ 2654339213 DES_FD03_CADM 0;
BA_ "GenSigTimeoutTime_IPC" SG_ 2654339213 DES_FD03_CADM 0;
BA_ "GenSigTimeoutTime_RFHM" SG_ 2654339213 DES_FD03_CADM 0;
BA_ "GenSigTimeoutTime_TCM" SG_ 2654339213 DES_FD03_CADM 0;
BA_ "GenSigTimeoutTime_AGSM" SG_ 2654339213 EOL_FD03_CADM 0;
BA_ "GenSigTimeoutTime_BSM" SG_ 2654339213 EOL_FD03_CADM 0;
BA_ "GenSigTimeoutTime_CADM" SG_ 2654339213 EOL_FD03_CADM 0;
BA_ "GenSigTimeoutTime_DMSM" SG_ 2654339213 EOL_FD03_CADM 0;
BA_ "GenSigTimeoutTime_DTCM" SG_ 2654339213 EOL_FD03_CADM 0;
BA_ "GenSigTimeoutTime_ECM" SG_ 2654339213 EOL_FD03_CADM 0;
BA_ "GenSigTimeoutTime_EVCU2" SG_ 2654339213 EOL_FD03_CADM 0;
BA_ "GenSigTimeoutTime_GNMM" SG_ 2654339213 EOL_FD03_CADM 0;
BA_ "GenSigTimeoutTime_HCP" SG_ 2654339213 EOL_FD03_CADM 0;
BA_ "GenSigTimeoutTime_IPC" SG_ 2654339213 EOL_FD03_CADM 0;
BA_ "GenSigTimeoutTime_RFHM" SG_ 2654339213 EOL_FD03_CADM 0;
BA_ "GenSigTimeoutTime_TCM" SG_ 2654339213 EOL_FD03_CADM 0;
BA_ "GenSigTimeoutTime_AGSM" SG_ 2654339213 GenericFailSts_FD03_CADM 0;
BA_ "GenSigTimeoutTime_BSM" SG_ 2654339213 GenericFailSts_FD03_CADM 0;
BA_ "GenSigTimeoutTime_CADM" SG_ 2654339213 GenericFailSts_FD03_CADM 0;
BA_ "GenSigTimeoutTime_DMSM" SG_ 2654339213 GenericFailSts_FD03_CADM 0;
BA_ "GenSigTimeoutTime_DTCM" SG_ 2654339213 GenericFailSts_FD03_CADM 0;
BA_ "GenSigTimeoutTime_ECM" SG_ 2654339213 GenericFailSts_FD03_CADM 0;
BA_ "GenSigTimeoutTime_EVCU2" SG_ 2654339213 GenericFailSts_FD03_CADM 0;
BA_ "GenSigTimeoutTime_GNMM" SG_ 2654339213 GenericFailSts_FD03_CADM 0;
BA_ "GenSigTimeoutTime_HCP" SG_ 2654339213 GenericFailSts_FD03_CADM 0;
BA_ "GenSigTimeoutTime_IPC" SG_ 2654339213 GenericFailSts_FD03_CADM 0;
BA_ "GenSigTimeoutTime_RFHM" SG_ 2654339213 GenericFailSts_FD03_CADM 0;
BA_ "GenSigTimeoutTime_TCM" SG_ 2654339213 GenericFailSts_FD03_CADM 0;
BA_ "GenSigTimeoutTime_AGSM" SG_ 2654339213 PreviousCanNMState_FD03_CADM 0;
BA_ "GenSigTimeoutTime_BCM" SG_ 2654339213 PreviousCanNMState_FD03_CADM 0;
BA_ "GenSigTimeoutTime_BSM" SG_ 2654339213 PreviousCanNMState_FD03_CADM 0;
BA_ "GenSigTimeoutTime_CADM" SG_ 2654339213 PreviousCanNMState_FD03_CADM 0;
BA_ "GenSigTimeoutTime_DMSM" SG_ 2654339213 PreviousCanNMState_FD03_CADM 0;
BA_ "GenSigTimeoutTime_DTCM" SG_ 2654339213 PreviousCanNMState_FD03_CADM 0;
BA_ "GenSigTimeoutTime_ECM" SG_ 2654339213 PreviousCanNMState_FD03_CADM 0;
BA_ "GenSigTimeoutTime_EVCU2" SG_ 2654339213 PreviousCanNMState_FD03_CADM 0;
BA_ "GenSigTimeoutTime_GNMM" SG_ 2654339213 PreviousCanNMState_FD03_CADM 0;
BA_ "GenSigTimeoutTime_HCP" SG_ 2654339213 PreviousCanNMState_FD03_CADM 0;
BA_ "GenSigTimeoutTime_IPC" SG_ 2654339213 PreviousCanNMState_FD03_CADM 0;
BA_ "GenSigTimeoutTime_RFHM" SG_ 2654339213 PreviousCanNMState_FD03_CADM 0;
BA_ "GenSigTimeoutTime_TCM" SG_ 2654339213 PreviousCanNMState_FD03_CADM 0;
BA_ "GenSigTimeoutTime_AGSM" SG_ 2654339213 StayActiveSource_FD03_CADM 0;
BA_ "GenSigTimeoutTime_BCM" SG_ 2654339213 StayActiveSource_FD03_CADM 0;
BA_ "GenSigTimeoutTime_BSM" SG_ 2654339213 StayActiveSource_FD03_CADM 0;
BA_ "GenSigTimeoutTime_CADM" SG_ 2654339213 StayActiveSource_FD03_CADM 0;
BA_ "GenSigTimeoutTime_DMSM" SG_ 2654339213 StayActiveSource_FD03_CADM 0;
BA_ "GenSigTimeoutTime_DTCM" SG_ 2654339213 StayActiveSource_FD03_CADM 0;
BA_ "GenSigTimeoutTime_ECM" SG_ 2654339213 StayActiveSource_FD03_CADM 0;
BA_ "GenSigTimeoutTime_EVCU2" SG_ 2654339213 StayActiveSource_FD03_CADM 0;
BA_ "GenSigTimeoutTime_GNMM" SG_ 2654339213 StayActiveSource_FD03_CADM 0;
BA_ "GenSigTimeoutTime_HCP" SG_ 2654339213 StayActiveSource_FD03_CADM 0;
BA_ "GenSigTimeoutTime_IPC" SG_ 2654339213 StayActiveSource_FD03_CADM 0;
BA_ "GenSigTimeoutTime_RFHM" SG_ 2654339213 StayActiveSource_FD03_CADM 0;
BA_ "GenSigTimeoutTime_TCM" SG_ 2654339213 StayActiveSource_FD03_CADM 0;
BA_ "GenSigTimeoutTime_AGSM" SG_ 2654339213 WakeupSource_FD03_CADM 0;
BA_ "GenSigTimeoutTime_BCM" SG_ 2654339213 WakeupSource_FD03_CADM 0;
BA_ "GenSigTimeoutTime_BSM" SG_ 2654339213 WakeupSource_FD03_CADM 0;
BA_ "GenSigTimeoutTime_CADM" SG_ 2654339213 WakeupSource_FD03_CADM 0;
BA_ "GenSigTimeoutTime_DMSM" SG_ 2654339213 WakeupSource_FD03_CADM 0;
BA_ "GenSigTimeoutTime_DTCM" SG_ 2654339213 WakeupSource_FD03_CADM 0;
BA_ "GenSigTimeoutTime_ECM" SG_ 2654339213 WakeupSource_FD03_CADM 0;
BA_ "GenSigTimeoutTime_EVCU2" SG_ 2654339213 WakeupSource_FD03_CADM 0;
BA_ "GenSigTimeoutTime_GNMM" SG_ 2654339213 WakeupSource_FD03_CADM 0;
BA_ "GenSigTimeoutTime_HCP" SG_ 2654339213 WakeupSource_FD03_CADM 0;
BA_ "GenSigTimeoutTime_IPC" SG_ 2654339213 WakeupSource_FD03_CADM 0;
BA_ "GenSigTimeoutTime_RFHM" SG_ 2654339213 WakeupSource_FD03_CADM 0;
BA_ "GenSigTimeoutTime_TCM" SG_ 2654339213 WakeupSource_FD03_CADM 0;
BA_ "GenSigTimeoutTime_AGSM" SG_ 2654339225 CurrentCanNMState_FD03_DMSM 0;
BA_ "GenSigTimeoutTime_BCM" SG_ 2654339225 CurrentCanNMState_FD03_DMSM 0;
BA_ "GenSigTimeoutTime_BSM" SG_ 2654339225 CurrentCanNMState_FD03_DMSM 0;
BA_ "GenSigTimeoutTime_CADM" SG_ 2654339225 CurrentCanNMState_FD03_DMSM 0;
BA_ "GenSigTimeoutTime_DMSM" SG_ 2654339225 CurrentCanNMState_FD03_DMSM 0;
BA_ "GenSigTimeoutTime_DTCM" SG_ 2654339225 CurrentCanNMState_FD03_DMSM 0;
BA_ "GenSigTimeoutTime_ECM" SG_ 2654339225 CurrentCanNMState_FD03_DMSM 0;
BA_ "GenSigTimeoutTime_EVCU2" SG_ 2654339225 CurrentCanNMState_FD03_DMSM 0;
BA_ "GenSigTimeoutTime_GNMM" SG_ 2654339225 CurrentCanNMState_FD03_DMSM 0;
BA_ "GenSigTimeoutTime_HCP" SG_ 2654339225 CurrentCanNMState_FD03_DMSM 0;
BA_ "GenSigTimeoutTime_IPC" SG_ 2654339225 CurrentCanNMState_FD03_DMSM 0;
BA_ "GenSigTimeoutTime_RFHM" SG_ 2654339225 CurrentCanNMState_FD03_DMSM 0;
BA_ "GenSigTimeoutTime_TCM" SG_ 2654339225 CurrentCanNMState_FD03_DMSM 0;
BA_ "GenSigTimeoutTime_AGSM" SG_ 2654339225 CurrentFailSts_FD03_DMSM 0;
BA_ "GenSigTimeoutTime_BSM" SG_ 2654339225 CurrentFailSts_FD03_DMSM 0;
BA_ "GenSigTimeoutTime_CADM" SG_ 2654339225 CurrentFailSts_FD03_DMSM 0;
BA_ "GenSigTimeoutTime_DMSM" SG_ 2654339225 CurrentFailSts_FD03_DMSM 0;
BA_ "GenSigTimeoutTime_DTCM" SG_ 2654339225 CurrentFailSts_FD03_DMSM 0;
BA_ "GenSigTimeoutTime_ECM" SG_ 2654339225 CurrentFailSts_FD03_DMSM 0;
BA_ "GenSigTimeoutTime_EVCU2" SG_ 2654339225 CurrentFailSts_FD03_DMSM 0;
BA_ "GenSigTimeoutTime_GNMM" SG_ 2654339225 CurrentFailSts_FD03_DMSM 0;
BA_ "GenSigTimeoutTime_HCP" SG_ 2654339225 CurrentFailSts_FD03_DMSM 0;
BA_ "GenSigTimeoutTime_IPC" SG_ 2654339225 CurrentFailSts_FD03_DMSM 0;
BA_ "GenSigTimeoutTime_RFHM" SG_ 2654339225 CurrentFailSts_FD03_DMSM 0;
BA_ "GenSigTimeoutTime_TCM" SG_ 2654339225 CurrentFailSts_FD03_DMSM 0;
BA_ "GenSigTimeoutTime_AGSM" SG_ 2654339225 DES_FD03_DMSM 0;
BA_ "GenSigTimeoutTime_BCM" SG_ 2654339225 DES_FD03_DMSM 0;
BA_ "GenSigTimeoutTime_BSM" SG_ 2654339225 DES_FD03_DMSM 0;
BA_ "GenSigTimeoutTime_CADM" SG_ 2654339225 DES_FD03_DMSM 0;
BA_ "GenSigTimeoutTime_DMSM" SG_ 2654339225 DES_FD03_DMSM 0;
BA_ "GenSigTimeoutTime_DTCM" SG_ 2654339225 DES_FD03_DMSM 0;
BA_ "GenSigTimeoutTime_ECM" SG_ 2654339225 DES_FD03_DMSM 0;
BA_ "GenSigTimeoutTime_EVCU2" SG_ 2654339225 DES_FD03_DMSM 0;
BA_ "GenSigTimeoutTime_GNMM" SG_ 2654339225 DES_FD03_DMSM 0;
BA_ "GenSigTimeoutTime_HCP" SG_ 2654339225 DES_FD03_DMSM 0;
BA_ "GenSigTimeoutTime_IPC" SG_ 2654339225 DES_FD03_DMSM 0;
BA_ "GenSigTimeoutTime_RFHM" SG_ 2654339225 DES_FD03_DMSM 0;
BA_ "GenSigTimeoutTime_TCM" SG_ 2654339225 DES_FD03_DMSM 0;
BA_ "GenSigTimeoutTime_AGSM" SG_ 2654339225 EOL_FD03_DMSM 0;
BA_ "GenSigTimeoutTime_BSM" SG_ 2654339225 EOL_FD03_DMSM 0;
BA_ "GenSigTimeoutTime_CADM" SG_ 2654339225 EOL_FD03_DMSM 0;
BA_ "GenSigTimeoutTime_DMSM" SG_ 2654339225 EOL_FD03_DMSM 0;
BA_ "GenSigTimeoutTime_DTCM" SG_ 2654339225 EOL_FD03_DMSM 0;
BA_ "GenSigTimeoutTime_ECM" SG_ 2654339225 EOL_FD03_DMSM 0;
BA_ "GenSigTimeoutTime_EVCU2" SG_ 2654339225 EOL_FD03_DMSM 0;
BA_ "GenSigTimeoutTime_GNMM" SG_ 2654339225 EOL_FD03_DMSM 0;
BA_ "GenSigTimeoutTime_HCP" SG_ 2654339225 EOL_FD03_DMSM 0;
BA_ "GenSigTimeoutTime_IPC" SG_ 2654339225 EOL_FD03_DMSM 0;
BA_ "GenSigTimeoutTime_RFHM" SG_ 2654339225 EOL_FD03_DMSM 0;
BA_ "GenSigTimeoutTime_TCM" SG_ 2654339225 EOL_FD03_DMSM 0;
BA_ "GenSigTimeoutTime_AGSM" SG_ 2654339225 GenericFailSts_FD03_DMSM 0;
BA_ "GenSigTimeoutTime_BSM" SG_ 2654339225 GenericFailSts_FD03_DMSM 0;
BA_ "GenSigTimeoutTime_CADM" SG_ 2654339225 GenericFailSts_FD03_DMSM 0;
BA_ "GenSigTimeoutTime_DMSM" SG_ 2654339225 GenericFailSts_FD03_DMSM 0;
BA_ "GenSigTimeoutTime_DTCM" SG_ 2654339225 GenericFailSts_FD03_DMSM 0;
BA_ "GenSigTimeoutTime_ECM" SG_ 2654339225 GenericFailSts_FD03_DMSM 0;
BA_ "GenSigTimeoutTime_EVCU2" SG_ 2654339225 GenericFailSts_FD03_DMSM 0;
BA_ "GenSigTimeoutTime_GNMM" SG_ 2654339225 GenericFailSts_FD03_DMSM 0;
BA_ "GenSigTimeoutTime_HCP" SG_ 2654339225 GenericFailSts_FD03_DMSM 0;
BA_ "GenSigTimeoutTime_IPC" SG_ 2654339225 GenericFailSts_FD03_DMSM 0;
BA_ "GenSigTimeoutTime_RFHM" SG_ 2654339225 GenericFailSts_FD03_DMSM 0;
BA_ "GenSigTimeoutTime_TCM" SG_ 2654339225 GenericFailSts_FD03_DMSM 0;
BA_ "GenSigTimeoutTime_AGSM" SG_ 2654339225 PreviousCanNMState_FD03_DMSM 0;
BA_ "GenSigTimeoutTime_BCM" SG_ 2654339225 PreviousCanNMState_FD03_DMSM 0;
BA_ "GenSigTimeoutTime_BSM" SG_ 2654339225 PreviousCanNMState_FD03_DMSM 0;
BA_ "GenSigTimeoutTime_CADM" SG_ 2654339225 PreviousCanNMState_FD03_DMSM 0;
BA_ "GenSigTimeoutTime_DMSM" SG_ 2654339225 PreviousCanNMState_FD03_DMSM 0;
BA_ "GenSigTimeoutTime_DTCM" SG_ 2654339225 PreviousCanNMState_FD03_DMSM 0;
BA_ "GenSigTimeoutTime_ECM" SG_ 2654339225 PreviousCanNMState_FD03_DMSM 0;
BA_ "GenSigTimeoutTime_EVCU2" SG_ 2654339225 PreviousCanNMState_FD03_DMSM 0;
BA_ "GenSigTimeoutTime_GNMM" SG_ 2654339225 PreviousCanNMState_FD03_DMSM 0;
BA_ "GenSigTimeoutTime_HCP" SG_ 2654339225 PreviousCanNMState_FD03_DMSM 0;
BA_ "GenSigTimeoutTime_IPC" SG_ 2654339225 PreviousCanNMState_FD03_DMSM 0;
BA_ "GenSigTimeoutTime_RFHM" SG_ 2654339225 PreviousCanNMState_FD03_DMSM 0;
BA_ "GenSigTimeoutTime_TCM" SG_ 2654339225 PreviousCanNMState_FD03_DMSM 0;
BA_ "GenSigTimeoutTime_AGSM" SG_ 2654339225 StayActiveSource_FD03_DMSM 0;
BA_ "GenSigTimeoutTime_BCM" SG_ 2654339225 StayActiveSource_FD03_DMSM 0;
BA_ "GenSigTimeoutTime_BSM" SG_ 2654339225 StayActiveSource_FD03_DMSM 0;
BA_ "GenSigTimeoutTime_CADM" SG_ 2654339225 StayActiveSource_FD03_DMSM 0;
BA_ "GenSigTimeoutTime_DMSM" SG_ 2654339225 StayActiveSource_FD03_DMSM 0;
BA_ "GenSigTimeoutTime_DTCM" SG_ 2654339225 StayActiveSource_FD03_DMSM 0;
BA_ "GenSigTimeoutTime_ECM" SG_ 2654339225 StayActiveSource_FD03_DMSM 0;
BA_ "GenSigTimeoutTime_EVCU2" SG_ 2654339225 StayActiveSource_FD03_DMSM 0;
BA_ "GenSigTimeoutTime_GNMM" SG_ 2654339225 StayActiveSource_FD03_DMSM 0;
BA_ "GenSigTimeoutTime_HCP" SG_ 2654339225 StayActiveSource_FD03_DMSM 0;
BA_ "GenSigTimeoutTime_IPC" SG_ 2654339225 StayActiveSource_FD03_DMSM 0;
BA_ "GenSigTimeoutTime_RFHM" SG_ 2654339225 StayActiveSource_FD03_DMSM 0;
BA_ "GenSigTimeoutTime_TCM" SG_ 2654339225 StayActiveSource_FD03_DMSM 0;
BA_ "GenSigTimeoutTime_AGSM" SG_ 2654339225 WakeupSource_FD03_DMSM 0;
BA_ "GenSigTimeoutTime_BCM" SG_ 2654339225 WakeupSource_FD03_DMSM 0;
BA_ "GenSigTimeoutTime_BSM" SG_ 2654339225 WakeupSource_FD03_DMSM 0;
BA_ "GenSigTimeoutTime_CADM" SG_ 2654339225 WakeupSource_FD03_DMSM 0;
BA_ "GenSigTimeoutTime_DMSM" SG_ 2654339225 WakeupSource_FD03_DMSM 0;
BA_ "GenSigTimeoutTime_DTCM" SG_ 2654339225 WakeupSource_FD03_DMSM 0;
BA_ "GenSigTimeoutTime_ECM" SG_ 2654339225 WakeupSource_FD03_DMSM 0;
BA_ "GenSigTimeoutTime_EVCU2" SG_ 2654339225 WakeupSource_FD03_DMSM 0;
BA_ "GenSigTimeoutTime_GNMM" SG_ 2654339225 WakeupSource_FD03_DMSM 0;
BA_ "GenSigTimeoutTime_HCP" SG_ 2654339225 WakeupSource_FD03_DMSM 0;
BA_ "GenSigTimeoutTime_IPC" SG_ 2654339225 WakeupSource_FD03_DMSM 0;
BA_ "GenSigTimeoutTime_RFHM" SG_ 2654339225 WakeupSource_FD03_DMSM 0;
BA_ "GenSigTimeoutTime_TCM" SG_ 2654339225 WakeupSource_FD03_DMSM 0;
BA_ "GenSigTimeoutTime_AGSM" SG_ 2654339139 CurrentCanNMState_FD03_DTCM 0;
BA_ "GenSigTimeoutTime_BCM" SG_ 2654339139 CurrentCanNMState_FD03_DTCM 0;
BA_ "GenSigTimeoutTime_BSM" SG_ 2654339139 CurrentCanNMState_FD03_DTCM 0;
BA_ "GenSigTimeoutTime_CADM" SG_ 2654339139 CurrentCanNMState_FD03_DTCM 0;
BA_ "GenSigTimeoutTime_DMSM" SG_ 2654339139 CurrentCanNMState_FD03_DTCM 0;
BA_ "GenSigTimeoutTime_DTCM" SG_ 2654339139 CurrentCanNMState_FD03_DTCM 0;
BA_ "GenSigTimeoutTime_ECM" SG_ 2654339139 CurrentCanNMState_FD03_DTCM 0;
BA_ "GenSigTimeoutTime_EVCU2" SG_ 2654339139 CurrentCanNMState_FD03_DTCM 0;
BA_ "GenSigTimeoutTime_GNMM" SG_ 2654339139 CurrentCanNMState_FD03_DTCM 0;
BA_ "GenSigTimeoutTime_HCP" SG_ 2654339139 CurrentCanNMState_FD03_DTCM 0;
BA_ "GenSigTimeoutTime_IPC" SG_ 2654339139 CurrentCanNMState_FD03_DTCM 0;
BA_ "GenSigTimeoutTime_RFHM" SG_ 2654339139 CurrentCanNMState_FD03_DTCM 0;
BA_ "GenSigTimeoutTime_TCM" SG_ 2654339139 CurrentCanNMState_FD03_DTCM 0;
BA_ "GenSigTimeoutTime_AGSM" SG_ 2654339139 CurrentFailSts_FD03_DTCM 0;
BA_ "GenSigTimeoutTime_BSM" SG_ 2654339139 CurrentFailSts_FD03_DTCM 0;
BA_ "GenSigTimeoutTime_CADM" SG_ 2654339139 CurrentFailSts_FD03_DTCM 0;
BA_ "GenSigTimeoutTime_DMSM" SG_ 2654339139 CurrentFailSts_FD03_DTCM 0;
BA_ "GenSigTimeoutTime_DTCM" SG_ 2654339139 CurrentFailSts_FD03_DTCM 0;
BA_ "GenSigTimeoutTime_ECM" SG_ 2654339139 CurrentFailSts_FD03_DTCM 0;
BA_ "GenSigTimeoutTime_EVCU2" SG_ 2654339139 CurrentFailSts_FD03_DTCM 0;
BA_ "GenSigTimeoutTime_GNMM" SG_ 2654339139 CurrentFailSts_FD03_DTCM 0;
BA_ "GenSigTimeoutTime_HCP" SG_ 2654339139 CurrentFailSts_FD03_DTCM 0;
BA_ "GenSigTimeoutTime_IPC" SG_ 2654339139 CurrentFailSts_FD03_DTCM 0;
BA_ "GenSigTimeoutTime_RFHM" SG_ 2654339139 CurrentFailSts_FD03_DTCM 0;
BA_ "GenSigTimeoutTime_TCM" SG_ 2654339139 CurrentFailSts_FD03_DTCM 0;
BA_ "GenSigTimeoutTime_AGSM" SG_ 2654339139 DES_FD03_DTCM 0;
BA_ "GenSigTimeoutTime_BCM" SG_ 2654339139 DES_FD03_DTCM 0;
BA_ "GenSigTimeoutTime_BSM" SG_ 2654339139 DES_FD03_DTCM 0;
BA_ "GenSigTimeoutTime_CADM" SG_ 2654339139 DES_FD03_DTCM 0;
BA_ "GenSigTimeoutTime_DMSM" SG_ 2654339139 DES_FD03_DTCM 0;
BA_ "GenSigTimeoutTime_DTCM" SG_ 2654339139 DES_FD03_DTCM 0;
BA_ "GenSigTimeoutTime_ECM" SG_ 2654339139 DES_FD03_DTCM 0;
BA_ "GenSigTimeoutTime_EVCU2" SG_ 2654339139 DES_FD03_DTCM 0;
BA_ "GenSigTimeoutTime_GNMM" SG_ 2654339139 DES_FD03_DTCM 0;
BA_ "GenSigTimeoutTime_HCP" SG_ 2654339139 DES_FD03_DTCM 0;
BA_ "GenSigTimeoutTime_IPC" SG_ 2654339139 DES_FD03_DTCM 0;
BA_ "GenSigTimeoutTime_RFHM" SG_ 2654339139 DES_FD03_DTCM 0;
BA_ "GenSigTimeoutTime_TCM" SG_ 2654339139 DES_FD03_DTCM 0;
BA_ "GenSigTimeoutTime_AGSM" SG_ 2654339139 EOL_FD03_DTCM 0;
BA_ "GenSigTimeoutTime_BSM" SG_ 2654339139 EOL_FD03_DTCM 0;
BA_ "GenSigTimeoutTime_CADM" SG_ 2654339139 EOL_FD03_DTCM 0;
BA_ "GenSigTimeoutTime_DMSM" SG_ 2654339139 EOL_FD03_DTCM 0;
BA_ "GenSigTimeoutTime_DTCM" SG_ 2654339139 EOL_FD03_DTCM 0;
BA_ "GenSigTimeoutTime_ECM" SG_ 2654339139 EOL_FD03_DTCM 0;
BA_ "GenSigTimeoutTime_EVCU2" SG_ 2654339139 EOL_FD03_DTCM 0;
BA_ "GenSigTimeoutTime_GNMM" SG_ 2654339139 EOL_FD03_DTCM 0;
BA_ "GenSigTimeoutTime_HCP" SG_ 2654339139 EOL_FD03_DTCM 0;
BA_ "GenSigTimeoutTime_IPC" SG_ 2654339139 EOL_FD03_DTCM 0;
BA_ "GenSigTimeoutTime_RFHM" SG_ 2654339139 EOL_FD03_DTCM 0;
BA_ "GenSigTimeoutTime_TCM" SG_ 2654339139 EOL_FD03_DTCM 0;
BA_ "GenSigTimeoutTime_AGSM" SG_ 2654339139 GenericFailSts_FD03_DTCM 0;
BA_ "GenSigTimeoutTime_BSM" SG_ 2654339139 GenericFailSts_FD03_DTCM 0;
BA_ "GenSigTimeoutTime_CADM" SG_ 2654339139 GenericFailSts_FD03_DTCM 0;
BA_ "GenSigTimeoutTime_DMSM" SG_ 2654339139 GenericFailSts_FD03_DTCM 0;
BA_ "GenSigTimeoutTime_DTCM" SG_ 2654339139 GenericFailSts_FD03_DTCM 0;
BA_ "GenSigTimeoutTime_ECM" SG_ 2654339139 GenericFailSts_FD03_DTCM 0;
BA_ "GenSigTimeoutTime_EVCU2" SG_ 2654339139 GenericFailSts_FD03_DTCM 0;
BA_ "GenSigTimeoutTime_GNMM" SG_ 2654339139 GenericFailSts_FD03_DTCM 0;
BA_ "GenSigTimeoutTime_HCP" SG_ 2654339139 GenericFailSts_FD03_DTCM 0;
BA_ "GenSigTimeoutTime_IPC" SG_ 2654339139 GenericFailSts_FD03_DTCM 0;
BA_ "GenSigTimeoutTime_RFHM" SG_ 2654339139 GenericFailSts_FD03_DTCM 0;
BA_ "GenSigTimeoutTime_TCM" SG_ 2654339139 GenericFailSts_FD03_DTCM 0;
BA_ "GenSigTimeoutTime_AGSM" SG_ 2654339139 PreviousCanNMState_FD03_DTCM 0;
BA_ "GenSigTimeoutTime_BCM" SG_ 2654339139 PreviousCanNMState_FD03_DTCM 0;
BA_ "GenSigTimeoutTime_BSM" SG_ 2654339139 PreviousCanNMState_FD03_DTCM 0;
BA_ "GenSigTimeoutTime_CADM" SG_ 2654339139 PreviousCanNMState_FD03_DTCM 0;
BA_ "GenSigTimeoutTime_DMSM" SG_ 2654339139 PreviousCanNMState_FD03_DTCM 0;
BA_ "GenSigTimeoutTime_DTCM" SG_ 2654339139 PreviousCanNMState_FD03_DTCM 0;
BA_ "GenSigTimeoutTime_ECM" SG_ 2654339139 PreviousCanNMState_FD03_DTCM 0;
BA_ "GenSigTimeoutTime_EVCU2" SG_ 2654339139 PreviousCanNMState_FD03_DTCM 0;
BA_ "GenSigTimeoutTime_GNMM" SG_ 2654339139 PreviousCanNMState_FD03_DTCM 0;
BA_ "GenSigTimeoutTime_HCP" SG_ 2654339139 PreviousCanNMState_FD03_DTCM 0;
BA_ "GenSigTimeoutTime_IPC" SG_ 2654339139 PreviousCanNMState_FD03_DTCM 0;
BA_ "GenSigTimeoutTime_RFHM" SG_ 2654339139 PreviousCanNMState_FD03_DTCM 0;
BA_ "GenSigTimeoutTime_TCM" SG_ 2654339139 PreviousCanNMState_FD03_DTCM 0;
BA_ "GenSigTimeoutTime_AGSM" SG_ 2654339139 StayActiveSource_FD03_DTCM 0;
BA_ "GenSigTimeoutTime_BCM" SG_ 2654339139 StayActiveSource_FD03_DTCM 0;
BA_ "GenSigTimeoutTime_BSM" SG_ 2654339139 StayActiveSource_FD03_DTCM 0;
BA_ "GenSigTimeoutTime_CADM" SG_ 2654339139 StayActiveSource_FD03_DTCM 0;
BA_ "GenSigTimeoutTime_DMSM" SG_ 2654339139 StayActiveSource_FD03_DTCM 0;
BA_ "GenSigTimeoutTime_DTCM" SG_ 2654339139 StayActiveSource_FD03_DTCM 0;
BA_ "GenSigTimeoutTime_ECM" SG_ 2654339139 StayActiveSource_FD03_DTCM 0;
BA_ "GenSigTimeoutTime_EVCU2" SG_ 2654339139 StayActiveSource_FD03_DTCM 0;
BA_ "GenSigTimeoutTime_GNMM" SG_ 2654339139 StayActiveSource_FD03_DTCM 0;
BA_ "GenSigTimeoutTime_HCP" SG_ 2654339139 StayActiveSource_FD03_DTCM 0;
BA_ "GenSigTimeoutTime_IPC" SG_ 2654339139 StayActiveSource_FD03_DTCM 0;
BA_ "GenSigTimeoutTime_RFHM" SG_ 2654339139 StayActiveSource_FD03_DTCM 0;
BA_ "GenSigTimeoutTime_TCM" SG_ 2654339139 StayActiveSource_FD03_DTCM 0;
BA_ "GenSigTimeoutTime_AGSM" SG_ 2654339139 WakeupSource_FD03_DTCM 0;
BA_ "GenSigTimeoutTime_BCM" SG_ 2654339139 WakeupSource_FD03_DTCM 0;
BA_ "GenSigTimeoutTime_BSM" SG_ 2654339139 WakeupSource_FD03_DTCM 0;
BA_ "GenSigTimeoutTime_CADM" SG_ 2654339139 WakeupSource_FD03_DTCM 0;
BA_ "GenSigTimeoutTime_DMSM" SG_ 2654339139 WakeupSource_FD03_DTCM 0;
BA_ "GenSigTimeoutTime_DTCM" SG_ 2654339139 WakeupSource_FD03_DTCM 0;
BA_ "GenSigTimeoutTime_ECM" SG_ 2654339139 WakeupSource_FD03_DTCM 0;
BA_ "GenSigTimeoutTime_EVCU2" SG_ 2654339139 WakeupSource_FD03_DTCM 0;
BA_ "GenSigTimeoutTime_GNMM" SG_ 2654339139 WakeupSource_FD03_DTCM 0;
BA_ "GenSigTimeoutTime_HCP" SG_ 2654339139 WakeupSource_FD03_DTCM 0;
BA_ "GenSigTimeoutTime_IPC" SG_ 2654339139 WakeupSource_FD03_DTCM 0;
BA_ "GenSigTimeoutTime_RFHM" SG_ 2654339139 WakeupSource_FD03_DTCM 0;
BA_ "GenSigTimeoutTime_TCM" SG_ 2654339139 WakeupSource_FD03_DTCM 0;
VAL_ 1058 BarPrsAbsV 0 "Valid" 1 "Not_Valid";
VAL_ 1058 CARB_PERM 0 "False" 1 "True";
VAL_ 1058 CarbWarmUp 0 "False" 1 "True";
VAL_ 1058 CldStrtDenominator 0 "Not_Active" 1 "Active";
VAL_ 1058 EngineOFFTime 1023 "SNA";
VAL_ 1058 EngIntAirTmp 255 "SNA";
VAL_ 1058 EngIntAirTmpV 0 "Valid" 1 "Not_Valid";
VAL_ 1058 EngOffTmPT 0 "SNA";
VAL_ 1058 EngOffTmPTV 1 "SNA";
VAL_ 1058 EstCatCnvTmp 255 "SNA";
VAL_ 1058 GenDenominator 0 "False" 1 "True";
VAL_ 1058 IgnCntrTrue 0 "False" 1 "True";
VAL_ 1058 Inp_CSD_Fail 0 "Fail_Not_Present" 1 "Fail_Present";
VAL_ 1058 Inp_ICC_Fail 0 "Fail_Not_Present" 1 "Fail_Present";
VAL_ 1058 InputsGDFail 0 "False" 1 "True";
VAL_ 1058 OAT_PT_EstV 0 "Valid" 1 "Not_Valid";
VAL_ 611 AirBagFailSts 0 "Fail_Not_Present_Lamp_Off" 1 "Fail_Not_Present_Lamp_Flashing" 2 "Fail_Present_Lamp_On" 3 "Not_Used";
VAL_ 611 SBR1RowDriverSeatConfigSts 0 "Seat_Not_Checked" 1 "Seat_Checked";
VAL_ 611 SBR1RowDriverSeatSts 0 "Seat_Belt_Fasten" 1 "Seat_Belt_Not_Fasten" 3 "SNA";
VAL_ 611 SBR1RowPsngrSeatConfigSts 0 "Seat_Not_Checked" 1 "Seat_Checked";
VAL_ 611 SBR1RowPsngrSeatSts 0 "Seat_Belt_Fasten" 1 "Seat_Belt_Not_Fasten" 2 "Seat_Safe" 3 "Seat_Not_Safe" 7 "SNA";
VAL_ 1954 SBR1RowPsngrSeatPPDSts 0 "ODS_STAT_NOCC" 1 "ODS_STAT_OCC" 2 "ODS_FAULT" 3 "SNA";
VAL_ 274 LatAcceleration 4095 "SNA";
VAL_ 274 LatAccelerationFailSts 0 "Fail_Not_Present" 1 "Fail_Present";
VAL_ 274 LongAcceleration 4095 "SNA";
VAL_ 274 LongAccelerationFailSts 0 "Fail_Not_Present" 1 "Fail_Present";
VAL_ 274 YawRate 4095 "SNA";
VAL_ 274 YawRateFailSts 0 "Fail_Not_Present" 1 "Fail_Present";
VAL_ 2654339094 CurrentCanNMState_FD03_AGSM 0 "Uninitialized State" 1 "Bus-Sleep State" 2 "Prepare-Bus State" 3 "Ready-Sleep State" 4 "Normal Operation State" 5 "Repeat Message State" 6 "Synchronize State" 7 "Offline State";
VAL_ 2654339094 CurrentCanNMState_FD16_AGSM 0 "Uninitialized State" 1 "Bus-Sleep State" 2 "Prepare-Bus State" 3 "Ready-Sleep State" 4 "Normal Operation State" 5 "Repeat Message State" 6 "Synchronize State" 7 "Offline State";
VAL_ 2654339094 CurrentFailSts_FD03_AGSM 0 "No_Fail_Present" 1 "Fail_Present";
VAL_ 2654339094 CurrentFailSts_FD16_AGSM 0 "No_Fail_Present" 1 "Fail_Present";
VAL_ 2654339094 DES_FD03_AGSM 0 "Error_Active_state" 1 "Error_passive_warning_state" 2 "Bus_off_state" 3 "Not_used";
VAL_ 2654339094 DES_FD16_AGSM 0 "Error_Active_state" 1 "Error_passive_warning_state" 2 "Bus_off_state" 3 "Not_used";
VAL_ 2654339094 EOL_FD03_AGSM 0 "No_EOL_Programming" 1 "EOL_Programming";
VAL_ 2654339094 EOL_FD16_AGSM 0 "No_EOL_Programming" 1 "EOL_Programming";
VAL_ 2654339094 GenericFailSts_FD03_AGSM 0 "No_Fail_Present" 1 "Fail_Present";
VAL_ 2654339094 GenericFailSts_FD16_AGSM 0 "No_Fail_Present" 1 "Fail_Present";
VAL_ 2654339094 PreviousCanNMState_FD03_AGSM 0 "Uninitialized State" 1 "Bus-Sleep State" 2 "Prepare-Bus State" 3 "Ready-Sleep State" 4 "Normal Operation State" 5 "Repeat Message State" 6 "Synchronize State" 7 "Offline State";
VAL_ 2654339094 PreviousCanNMState_FD16_AGSM 0 "Uninitialized State" 1 "Bus-Sleep State" 2 "Prepare-Bus State" 3 "Ready-Sleep State" 4 "Normal Operation State" 5 "Repeat Message State" 6 "Synchronize State" 7 "Offline State";
VAL_ 2654339094 StayActiveSource_FD03_AGSM 0 "CANNM_Ready_Sleep" 1 "IGN_ON" 2 "NonDefault_Diag" 4 "ING_OFF_NormSt_RptSt" 1073741824 "SASource_Not_Listed";
VAL_ 2654339094 WakeupSource_FD03_AGSM 0 "No_Wakeup" 1 "IGN_ON" 129 "FD1_Psv_WU" 130 "FD2_Psv_WU" 131 "FD3_Psv_WU" 132 "FD4_Psv_WU" 133 "FD5_Psv_WU" 134 "FD6_Psv_WU" 135 "FD7_Psv_WU" 136 "FD8_Psv_WU" 137 "FD9_Psv_WU" 138 "FD10_Psv_WU" 139 "FD11_Psv_WU" 140 "FD12_Psv_WU" 141 "FD13_Psv_WU" 142 "FD14_Psv_WU" 143 "FD15_Psv_WU" 144 "FD16_Psv_WU" 145 "FD17_Psv_WU" 146 "FD18_Psv_WU" 147 "FD19_Psv_WU" 148 "FD20_Psv_WU" 149 "FD21_Psv_WU" 150 "FD22_Psv_WU" 151 "FD23_Psv_WU" 152 "FD24_Psv_WU" 153 "FD25_Psv_WU" 154 "FD26_Psv_WU" 155 "FD27_Psv_WU" 156 "FD28_Psv_WU" 157 "FD29_Psv_WU" 158 "BHCAN_Psv_WU" 159 "CCAN_Psv_WU" 254 "WUSource_Not_Listed";
VAL_ 2654339094 WakeupSource_FD16_AGSM 0 "No_Wakeup";
VAL_ 2654339072 CurrentCanNMState_FD01_BCM 0 "Uninitialized State" 1 "Bus-Sleep State" 2 "Prepare-Bus State" 3 "Ready-Sleep State" 4 "Normal Operation State" 5 "Repeat Message State" 6 "Synchronize State" 7 "Offline State";
VAL_ 2654339072 CurrentCanNMState_FD02_BCM 0 "Uninitialized State" 1 "Bus-Sleep State" 2 "Prepare-Bus State" 3 "Ready-Sleep State" 4 "Normal Operation State" 5 "Repeat Message State" 6 "Synchronize State" 7 "Offline State";
VAL_ 2654339072 CurrentCanNMState_FD03_BCM 0 "Uninitialized State" 1 "Bus-Sleep State" 2 "Prepare-Bus State" 3 "Ready-Sleep State" 4 "Normal Operation State" 5 "Repeat Message State" 6 "Synchronize State" 7 "Offline State";
VAL_ 2654339072 CurrentCanNMState_FD04_BCM 0 "Uninitialized State" 1 "Bus-Sleep State" 2 "Prepare-Bus State" 3 "Ready-Sleep State" 4 "Normal Operation State" 5 "Repeat Message State" 6 "Synchronize State" 7 "Offline State";
VAL_ 2654339072 CurrentFailSts_FD01_BCM 0 "No_Fail_Present" 1 "Fail_Present";
VAL_ 2654339072 CurrentFailSts_FD02_BCM 0 "No_Fail_Present" 1 "Fail_Present";
VAL_ 2654339072 CurrentFailSts_FD03_BCM 0 "No_Fail_Present" 1 "Fail_Present";
VAL_ 2654339072 CurrentFailSts_FD04_BCM 0 "No_Fail_Present" 1 "Fail_Present";
VAL_ 2654339072 DES_FD01_BCM 0 "Error_Active_state" 1 "Error_passive_warning_state" 2 "Bus_off_state" 3 "Not_used";
VAL_ 2654339072 DES_FD02_BCM 0 "Error_Active_state" 1 "Error_passive_warning_state" 2 "Bus_off_state" 3 "Not_used";
VAL_ 2654339072 DES_FD03_BCM 0 "Error_Active_state" 1 "Error_passive_warning_state" 2 "Bus_off_state" 3 "Not_used";
VAL_ 2654339072 DES_FD04_BCM 0 "Error_Active_state" 1 "Error_passive_warning_state" 2 "Bus_off_state" 3 "Not_used";
VAL_ 2654339072 EOL_FD01_BCM 0 "No_EOL_Programming" 1 "EOL_Programming";
VAL_ 2654339072 EOL_FD02_BCM 0 "No_EOL_Programming" 1 "EOL_Programming";
VAL_ 2654339072 EOL_FD03_BCM 0 "No_EOL_Programming" 1 "EOL_Programming";
VAL_ 2654339072 EOL_FD04_BCM 0 "No_EOL_Programming" 1 "EOL_Programming";
VAL_ 2654339072 GenericFailSts_FD01_BCM 0 "No_Fail_Present" 1 "Fail_Present";
VAL_ 2654339072 GenericFailSts_FD02_BCM 0 "No_Fail_Present" 1 "Fail_Present";
VAL_ 2654339072 GenericFailSts_FD03_BCM 0 "No_Fail_Present" 1 "Fail_Present";
VAL_ 2654339072 GenericFailSts_FD04_BCM 0 "No_Fail_Present" 1 "Fail_Present";
VAL_ 2654339072 PreviousCanNMState_FD01_BCM 0 "Uninitialized State" 1 "Bus-Sleep State" 2 "Prepare-Bus State" 3 "Ready-Sleep State" 4 "Normal Operation State" 5 "Repeat Message State" 6 "Synchronize State" 7 "Offline State";
VAL_ 2654339072 PreviousCanNMState_FD02_BCM 0 "Uninitialized State" 1 "Bus-Sleep State" 2 "Prepare-Bus State" 3 "Ready-Sleep State" 4 "Normal Operation State" 5 "Repeat Message State" 6 "Synchronize State" 7 "Offline State";
VAL_ 2654339072 PreviousCanNMState_FD03_BCM 0 "Uninitialized State" 1 "Bus-Sleep State" 2 "Prepare-Bus State" 3 "Ready-Sleep State" 4 "Normal Operation State" 5 "Repeat Message State" 6 "Synchronize State" 7 "Offline State";
VAL_ 2654339072 PreviousCanNMState_FD04_BCM 0 "Uninitialized State" 1 "Bus-Sleep State" 2 "Prepare-Bus State" 3 "Ready-Sleep State" 4 "Normal Operation State" 5 "Repeat Message State" 6 "Synchronize State" 7 "Offline State";
VAL_ 2654339072 StayActiveSource_FD01_BCM 0 "None" 1 "Ignition_Active" 2 "CmdIgnSts_LK_to_ACC_RUN_START" 4 "HazardSwitch_ON" 8 "DrvDoorAjar" 16 "DrvDoor2Ajar" 32 "PsngrDoorAjar" 64 "LR_DoorAjar" 128 "RR_DoorAjar" 256 "TrunkAjar" 512 "BonnetAjar" 1024 "RAPHandle_Req" 2048 "MainLightSelector_Req_OFF" 4096 "HiBmLvr_Stat_HIBM_FLASH_ON_PSD" 8192 "LowBeamSts_SET" 16384 "ParkingLightSts_SET" 32768 "FlashToPass_SET" 65536 "RemStActvSts_Active" 131072 "Fuel_Door_Release_Switch" 262144 "ENGINE_FD_8_RefuelEvent_Pending" 524288 "OHC_1_Front_Int_LG_Sw_1" 1048576 "HFRM_1_RearKick" 2097152 "LeakCheckTimerExpired" 4194304 "Horn_Req_Not_Pressed_to_Pressed" 8388608 "Comfort_Enable_Time_not_0" 16777216 "CmdIgnSts_ACC_RUN_START" 33554432 "ENGINE_FD_8_LeakTestSts_1" 67108864 "Non_Default_Diagnostic_Session" 134217728 "RL_Lk_Sw_LK_RQ_or_UNLK_RQ" 268435456 "RR_Lk_Sw_LK_RQ_or_UNLK_RQ" 536870912 "FD_CAN1" 1073741824 "FD_CAN2" 2147483648 "FD_CAN3" 4294967296 "FD_CAN4" 8589934592 "BH_CAN" 17179869184 "C_CAN1" 34359738368 "EVAP_SWC" 68719476736 "FUEL_DR_REL_SWC" 137438953472 "Other_Software_Factory_Component";
VAL_ 2654339072 StayActiveSource_FD02_BCM 0 "None" 1 "Ignition_Active" 2 "CmdIgnSts_LK_to_ACC_RUN_START" 4 "HazardSwitch_ON" 8 "DrvDoorAjar" 16 "DrvDoor2Ajar" 32 "PsngrDoorAjar" 64 "LR_DoorAjar" 128 "RR_DoorAjar" 256 "TrunkAjar" 512 "BonnetAjar" 1024 "RAPHandle_Req" 2048 "MainLightSelector_Req_OFF" 4096 "HiBmLvr_Stat_HIBM_FLASH_ON_PSD" 8192 "LowBeamSts_SET" 16384 "ParkingLightSts_SET" 32768 "FlashToPass_SET" 65536 "RemStActvSts_Active" 131072 "Fuel_Door_Release_Switch" 262144 "ENGINE_FD_8_RefuelEvent_Pending" 524288 "OHC_1_Front_Int_LG_Sw_1" 1048576 "HFRM_1_RearKick" 2097152 "LeakCheckTimerExpired" 4194304 "Horn_Req_Not_Pressed_to_Pressed" 8388608 "Comfort_Enable_Time_not_0" 16777216 "CmdIgnSts_ACC_RUN_START" 33554432 "ENGINE_FD_8_LeakTestSts_1" 67108864 "Non_Default_Diagnostic_Session" 134217728 "RL_Lk_Sw_LK_RQ_or_UNLK_RQ" 268435456 "RR_Lk_Sw_LK_RQ_or_UNLK_RQ" 536870912 "FD_CAN1" 1073741824 "FD_CAN2" 2147483648 "FD_CAN3" 4294967296 "FD_CAN4" 8589934592 "BH_CAN" 17179869184 "C_CAN1" 34359738368 "EVAP_SWC" 68719476736 "FUEL_DR_REL_SWC" 137438953472 "Other_Software_Factory_Component";
VAL_ 2654339072 StayActiveSource_FD03_BCM 0 "None" 1 "Ignition_Active" 2 "CmdIgnSts_LK_to_ACC_RUN_START" 4 "HazardSwitch_ON" 8 "DrvDoorAjar" 16 "DrvDoor2Ajar" 32 "PsngrDoorAjar" 64 "LR_DoorAjar" 128 "RR_DoorAjar" 256 "TrunkAjar" 512 "BonnetAjar" 1024 "RAPHandle_Req" 2048 "MainLightSelector_Req_OFF" 4096 "HiBmLvr_Stat_HIBM_FLASH_ON_PSD" 8192 "LowBeamSts_SET" 16384 "ParkingLightSts_SET" 32768 "FlashToPass_SET" 65536 "RemStActvSts_Active" 131072 "Fuel_Door_Release_Switch" 262144 "ENGINE_FD_8_RefuelEvent_Pending" 524288 "OHC_1_Front_Int_LG_Sw_1" 1048576 "HFRM_1_RearKick" 2097152 "LeakCheckTimerExpired" 4194304 "Horn_Req_Not_Pressed_to_Pressed" 8388608 "Comfort_Enable_Time_not_0" 16777216 "CmdIgnSts_ACC_RUN_START" 33554432 "ENGINE_FD_8_LeakTestSts_1" 67108864 "Non_Default_Diagnostic_Session" 134217728 "RL_Lk_Sw_LK_RQ_or_UNLK_RQ" 268435456 "RR_Lk_Sw_LK_RQ_or_UNLK_RQ" 536870912 "FD_CAN1" 1073741824 "FD_CAN2" 2147483648 "FD_CAN3" 4294967296 "FD_CAN4" 8589934592 "BH_CAN" 17179869184 "C_CAN1" 34359738368 "EVAP_SWC" 68719476736 "FUEL_DR_REL_SWC" 137438953472 "Other_Software_Factory_Component";
VAL_ 2654339072 StayActiveSource_FD04_BCM 0 "None" 1 "Ignition_Active" 2 "CmdIgnSts_LK_to_ACC_RUN_START" 4 "HazardSwitch_ON" 8 "DrvDoorAjar" 16 "DrvDoor2Ajar" 32 "PsngrDoorAjar" 64 "LR_DoorAjar" 128 "RR_DoorAjar" 256 "TrunkAjar" 512 "BonnetAjar" 1024 "RAPHandle_Req" 2048 "MainLightSelector_Req_OFF" 4096 "HiBmLvr_Stat_HIBM_FLASH_ON_PSD" 8192 "LowBeamSts_SET" 16384 "ParkingLightSts_SET" 32768 "FlashToPass_SET" 65536 "RemStActvSts_Active" 131072 "Fuel_Door_Release_Switch" 262144 "ENGINE_FD_8_RefuelEvent_Pending" 524288 "OHC_1_Front_Int_LG_Sw_1" 1048576 "HFRM_1_RearKick" 2097152 "LeakCheckTimerExpired" 4194304 "Horn_Req_Not_Pressed_to_Pressed" 8388608 "Comfort_Enable_Time_not_0" 16777216 "CmdIgnSts_ACC_RUN_START" 33554432 "ENGINE_FD_8_LeakTestSts_1" 67108864 "Non_Default_Diagnostic_Session" 134217728 "RL_Lk_Sw_LK_RQ_or_UNLK_RQ" 268435456 "RR_Lk_Sw_LK_RQ_or_UNLK_RQ" 536870912 "FD_CAN1" 1073741824 "FD_CAN2" 2147483648 "FD_CAN3" 4294967296 "FD_CAN4" 8589934592 "BH_CAN" 17179869184 "C_CAN1" 34359738368 "EVAP_SWC" 68719476736 "FUEL_DR_REL_SWC" 137438953472 "Other_Software_Factory_Component";
VAL_ 2654339072 WakeupSource_FD01_BCM 0 "None" 1 "Ignition_Active" 2 "CmdIgnSts_LK_to_ACC_RUN_START" 3 "HazardSwitch_ON" 4 "DrvDoorAjar" 5 "DrvDoor2Ajar" 6 "PsngrDoorAjar" 7 "LR_DoorAjar" 8 "RR_DoorAjar" 9 "TrunkAjar" 10 "BonnetAjar" 11 "RAPHandle_Req" 12 "MainLightSelector_Req_OFF" 13 "HiBmLvr_Stat_HIBM_FLASH_ON_PSD" 14 "LowBeamSts_SET" 15 "ParkingLightSts_SET" 16 "FlashToPass_SET" 17 "RemStActvSts_Active" 18 "Fuel_Door_Release_Switch" 19 "ENGINE_FD_8_RefuelEvent_Pending" 20 "OHC_1_Front_Int_LG_Sw_1" 21 "HFRM_1_RearKick" 22 "LeakCheckTimerExpired" 23 "Horn_Req_Not Pressed_to_Pressed" 24 "Comfort_Enable_Time_not_0" 25 "CmdIgnSts_ACC_RUN_START" 26 "ENGINE_FD_8_LeakTestSts_1" 27 "Non_Default_Diagnostic_Session" 28 "RL_Lk_Sw_LK_RQ_or_UNLK_RQ" 29 "RR_Lk_Sw_LK_RQ_or_UNLK_RQ" 30 "FD-CAN1" 31 "FD-CAN2" 32 "FD-CAN3" 33 "FD-CAN4" 34 "BH-CAN" 35 "C-CAN1" 36 "EVAP_SWC" 37 "FUEL_DR_REL_SWC" 38 "Other_Software_Factory_Component" 39 "OHC_1_Front_Map_LGT_RT_Sw" 40 "OHC_1_Front_Map_LGT_LT_Sw" 41 "Fog_Lights_Signal " 42 "DOME_ON_OR_DOME_DEFEAT " 43 "Screen_Open_Close_is_pressed" 44 "Diagnostic_Message_Routing_DMR" 45 "LIN1_Wakeup_Signal_Detected" 46 "LIN2_Wakeup_Signal_Detected" 47 "LIN3_Wakeup_Signal_Detected" 48 "LIN4_Wakeup_Signal_Detected" 49 "LIN5_Wakeup_Signal_Detected" 50 "LIN6_Wakeup_Signal_Detected" 51 "LIN7_Wakeup_Signal_Detected" 52 "LIN8_Wakeup_Signal_Detected" 53 "LIN9_Wakeup_Signal_Detected" 54 "LIN10_Wakeup_Signal_Detected" 55 "FRUNK_RELEASE_SWITCH" 56 "ALCOHOL_INTERLOCK_INPUT" 57 "Reserved" 58 "Reserved" 59 "Reserved" 60 "Reserved" 61 "Reserved" 62 "Reserved" 63 "Reserved" 64 "Reserved" 65 "Reserved" 66 "Reserved" 67 "Reserved" 68 "Reserved" 69 "Reserved" 70 "Reserved" 71 "Reserved" 72 "Reserved" 73 "Reserved" 74 "Reserved" 75 "Reserved" 76 "Reserved" 77 "Reserved" 78 "Reserved" 79 "Reserved" 80 "Reserved" 81 "Reserved" 82 "Reserved" 83 "Reserved" 84 "Reserved" 85 "Reserved" 86 "Reserved" 87 "Reserved" 88 "Reserved" 89 "Reserved" 90 "Reserved" 91 "Reserved" 92 "Reserved" 93 "Reserved" 94 "Reserved" 95 "Reserved" 96 "Reserved" 97 "Reserved" 98 "Reserved" 99 "Reserved" 100 "Reserved" 101 "Reserved" 102 "Reserved" 103 "Reserved" 104 "Reserved" 105 "Reserved" 106 "Reserved" 107 "Reserved" 108 "Reserved" 109 "Reserved" 110 "Reserved" 111 "Reserved" 112 "Reserved" 113 "Reserved" 114 "Reserved" 115 "Reserved" 116 "Reserved" 117 "Reserved" 118 "Reserved" 119 "Reserved" 120 "Reserved" 121 "Reserved" 122 "Reserved" 123 "Reserved" 124 "Reserved" 125 "Reserved" 126 "Reserved" 127 "Reserved" 128 "Reserved" 129 "FD_CAN1" 130 "FD_CAN2" 131 "FD_CAN3" 132 "FD_CAN4" 133 "FD_CAN5" 134 "FD_CAN6" 135 "FD_CAN7" 136 "FD_CAN8" 137 "FD_CAN9" 138 "FD_CAN10" 139 "FD_CAN11" 140 "FD_CAN12" 141 "FD_CAN13" 142 "FD_CAN14" 143 "FD_CAN15" 144 "FD_CAN16" 145 "FD_CAN17" 146 "FD_CAN18" 147 "FD_CAN19" 148 "FD_CAN20" 149 "FD_CAN21" 150 "FD_CAN22" 151 "FD_CAN23" 152 "FD_CAN24" 153 "FD_CAN25" 154 "FD_CAN26" 155 "FD_CAN27" 156 "FD_CAN28" 157 "FD_CAN29" 158 "FD_CAN30" 159 "FD_CAN31" 160 "BH-CAN" 161 "BH-CAN1" 162 "BH-CAN2" 163 "C-CAN" 164 "C-CAN1" 165 "Reserved" 166 "Reserved" 167 "Reserved" 168 "Reserved" 169 "Reserved" 170 "Reserved" 171 "Reserved" 172 "Reserved" 173 "Reserved" 174 "Reserved" 175 "Reserved" 176 "Reserved" 177 "Reserved" 178 "Reserved" 179 "Reserved" 180 "Reserved" 181 "Reserved" 182 "Reserved" 183 "Reserved" 184 "Reserved" 185 "Reserved" 186 "Reserved" 187 "Reserved" 188 "Reserved" 189 "Reserved" 190 "Reserved" 191 "Reserved" 192 "Reserved" 193 "Reserved" 194 "Reserved" 195 "Reserved" 196 "Reserved" 197 "Reserved" 198 "Reserved" 199 "Reserved" 200 "Reserved" 201 "Reserved" 202 "Reserved" 203 "Reserved" 204 "Reserved" 205 "Reserved" 206 "Reserved" 207 "Reserved" 208 "Reserved" 209 "Reserved" 210 "Reserved" 211 "Reserved" 212 "Reserved" 213 "Reserved" 214 "Reserved" 215 "Reserved" 216 "Reserved" 217 "Reserved" 218 "Reserved" 219 "Reserved" 220 "Reserved" 221 "Reserved" 222 "Reserved" 223 "Reserved" 224 "Reserved" 225 "Reserved" 226 "Reserved" 227 "Reserved" 228 "Reserved" 229 "Reserved" 230 "Reserved" 231 "Reserved" 232 "Reserved" 233 "Reserved" 234 "Reserved" 235 "Reserved" 236 "Reserved" 237 "Reserved" 238 "Reserved" 239 "Reserved" 240 "Reserved" 241 "Reserved" 242 "Reserved" 243 "Reserved" 244 "Reserved" 245 "Reserved" 246 "Reserved" 247 "Reserved" 248 "Reserved" 249 "Reserved" 250 "Reserved" 251 "Reserved" 252 "Reserved" 253 "Reserved" 254 "WUSource_Not_Listed" 255 "Reserved";
VAL_ 2654339072 WakeupSource_FD02_BCM 0 "None" 1 "Ignition_Active" 2 "CmdIgnSts_LK_to_ACC_RUN_START" 3 "HazardSwitch_ON" 4 "DrvDoorAjar" 5 "DrvDoor2Ajar" 6 "PsngrDoorAjar" 7 "LR_DoorAjar" 8 "RR_DoorAjar" 9 "TrunkAjar" 10 "BonnetAjar" 11 "RAPHandle_Req" 12 "MainLightSelector_Req_OFF" 13 "HiBmLvr_Stat_HIBM_FLASH_ON_PSD" 14 "LowBeamSts_SET" 15 "ParkingLightSts_SET" 16 "FlashToPass_SET" 17 "RemStActvSts_Active" 18 "Fuel_Door_Release_Switch" 19 "ENGINE_FD_8_RefuelEvent_Pending" 20 "OHC_1_Front_Int_LG_Sw_1" 21 "HFRM_1_RearKick" 22 "LeakCheckTimerExpired" 23 "Horn_Req_Not Pressed_to_Pressed" 24 "Comfort_Enable_Time_not_0" 25 "CmdIgnSts_ACC_RUN_START" 26 "ENGINE_FD_8_LeakTestSts_1" 27 "Non_Default_Diagnostic_Session" 28 "RL_Lk_Sw_LK_RQ_or_UNLK_RQ" 29 "RR_Lk_Sw_LK_RQ_or_UNLK_RQ" 30 "FD-CAN1" 31 "FD-CAN2" 32 "FD-CAN3" 33 "FD-CAN4" 34 "BH-CAN" 35 "C-CAN1" 36 "EVAP_SWC" 37 "FUEL_DR_REL_SWC" 38 "Other_Software_Factory_Component" 39 "OHC_1_Front_Map_LGT_RT_Sw" 40 "OHC_1_Front_Map_LGT_LT_Sw" 41 "Fog_Lights_Signal " 42 "DOME_ON_OR_DOME_DEFEAT " 43 "Screen_Open_Close_is_pressed" 44 "Diagnostic_Message_Routing_DMR" 45 "LIN1_Wakeup_Signal_Detected" 46 "LIN2_Wakeup_Signal_Detected" 47 "LIN3_Wakeup_Signal_Detected" 48 "LIN4_Wakeup_Signal_Detected" 49 "LIN5_Wakeup_Signal_Detected" 50 "LIN6_Wakeup_Signal_Detected" 51 "LIN7_Wakeup_Signal_Detected" 52 "LIN8_Wakeup_Signal_Detected" 53 "LIN9_Wakeup_Signal_Detected" 54 "LIN10_Wakeup_Signal_Detected" 55 "FRUNK_RELEASE_SWITCH" 56 "ALCOHOL_INTERLOCK_INPUT" 57 "Reserved" 58 "Reserved" 59 "Reserved" 60 "Reserved" 61 "Reserved" 62 "Reserved" 63 "Reserved" 64 "Reserved" 65 "Reserved" 66 "Reserved" 67 "Reserved" 68 "Reserved" 69 "Reserved" 70 "Reserved" 71 "Reserved" 72 "Reserved" 73 "Reserved" 74 "Reserved" 75 "Reserved" 76 "Reserved" 77 "Reserved" 78 "Reserved" 79 "Reserved" 80 "Reserved" 81 "Reserved" 82 "Reserved" 83 "Reserved" 84 "Reserved" 85 "Reserved" 86 "Reserved" 87 "Reserved" 88 "Reserved" 89 "Reserved" 90 "Reserved" 91 "Reserved" 92 "Reserved" 93 "Reserved" 94 "Reserved" 95 "Reserved" 96 "Reserved" 97 "Reserved" 98 "Reserved" 99 "Reserved" 100 "Reserved" 101 "Reserved" 102 "Reserved" 103 "Reserved" 104 "Reserved" 105 "Reserved" 106 "Reserved" 107 "Reserved" 108 "Reserved" 109 "Reserved" 110 "Reserved" 111 "Reserved" 112 "Reserved" 113 "Reserved" 114 "Reserved" 115 "Reserved" 116 "Reserved" 117 "Reserved" 118 "Reserved" 119 "Reserved" 120 "Reserved" 121 "Reserved" 122 "Reserved" 123 "Reserved" 124 "Reserved" 125 "Reserved" 126 "Reserved" 127 "Reserved" 128 "Reserved" 129 "FD_CAN1" 130 "FD_CAN2" 131 "FD_CAN3" 132 "FD_CAN4" 133 "FD_CAN5" 134 "FD_CAN6" 135 "FD_CAN7" 136 "FD_CAN8" 137 "FD_CAN9" 138 "FD_CAN10" 139 "FD_CAN11" 140 "FD_CAN12" 141 "FD_CAN13" 142 "FD_CAN14" 143 "FD_CAN15" 144 "FD_CAN16" 145 "FD_CAN17" 146 "FD_CAN18" 147 "FD_CAN19" 148 "FD_CAN20" 149 "FD_CAN21" 150 "FD_CAN22" 151 "FD_CAN23" 152 "FD_CAN24" 153 "FD_CAN25" 154 "FD_CAN26" 155 "FD_CAN27" 156 "FD_CAN28" 157 "FD_CAN29" 158 "FD_CAN30" 159 "FD_CAN31" 160 "BH-CAN" 161 "BH-CAN1" 162 "BH-CAN2" 163 "C-CAN" 164 "C-CAN1" 165 "Reserved" 166 "Reserved" 167 "Reserved" 168 "Reserved" 169 "Reserved" 170 "Reserved" 171 "Reserved" 172 "Reserved" 173 "Reserved" 174 "Reserved" 175 "Reserved" 176 "Reserved" 177 "Reserved" 178 "Reserved" 179 "Reserved" 180 "Reserved" 181 "Reserved" 182 "Reserved" 183 "Reserved" 184 "Reserved" 185 "Reserved" 186 "Reserved" 187 "Reserved" 188 "Reserved" 189 "Reserved" 190 "Reserved" 191 "Reserved" 192 "Reserved" 193 "Reserved" 194 "Reserved" 195 "Reserved" 196 "Reserved" 197 "Reserved" 198 "Reserved" 199 "Reserved" 200 "Reserved" 201 "Reserved" 202 "Reserved" 203 "Reserved" 204 "Reserved" 205 "Reserved" 206 "Reserved" 207 "Reserved" 208 "Reserved" 209 "Reserved" 210 "Reserved" 211 "Reserved" 212 "Reserved" 213 "Reserved" 214 "Reserved" 215 "Reserved" 216 "Reserved" 217 "Reserved" 218 "Reserved" 219 "Reserved" 220 "Reserved" 221 "Reserved" 222 "Reserved" 223 "Reserved" 224 "Reserved" 225 "Reserved" 226 "Reserved" 227 "Reserved" 228 "Reserved" 229 "Reserved" 230 "Reserved" 231 "Reserved" 232 "Reserved" 233 "Reserved" 234 "Reserved" 235 "Reserved" 236 "Reserved" 237 "Reserved" 238 "Reserved" 239 "Reserved" 240 "Reserved" 241 "Reserved" 242 "Reserved" 243 "Reserved" 244 "Reserved" 245 "Reserved" 246 "Reserved" 247 "Reserved" 248 "Reserved" 249 "Reserved" 250 "Reserved" 251 "Reserved" 252 "Reserved" 253 "Reserved" 254 "WUSource_Not_Listed" 255 "Reserved";
VAL_ 2654339072 WakeupSource_FD03_BCM 0 "None" 1 "Ignition_Active" 2 "CmdIgnSts_LK_to_ACC_RUN_START" 3 "HazardSwitch_ON" 4 "DrvDoorAjar" 5 "DrvDoor2Ajar" 6 "PsngrDoorAjar" 7 "LR_DoorAjar" 8 "RR_DoorAjar" 9 "TrunkAjar" 10 "BonnetAjar" 11 "RAPHandle_Req" 12 "MainLightSelector_Req_OFF" 13 "HiBmLvr_Stat_HIBM_FLASH_ON_PSD" 14 "LowBeamSts_SET" 15 "ParkingLightSts_SET" 16 "FlashToPass_SET" 17 "RemStActvSts_Active" 18 "Fuel_Door_Release_Switch" 19 "ENGINE_FD_8_RefuelEvent_Pending" 20 "OHC_1_Front_Int_LG_Sw_1" 21 "HFRM_1_RearKick" 22 "LeakCheckTimerExpired" 23 "Horn_Req_Not Pressed_to_Pressed" 24 "Comfort_Enable_Time_not_0" 25 "CmdIgnSts_ACC_RUN_START" 26 "ENGINE_FD_8_LeakTestSts_1" 27 "Non_Default_Diagnostic_Session" 28 "RL_Lk_Sw_LK_RQ_or_UNLK_RQ" 29 "RR_Lk_Sw_LK_RQ_or_UNLK_RQ" 30 "FD-CAN1" 31 "FD-CAN2" 32 "FD-CAN3" 33 "FD-CAN4" 34 "BH-CAN" 35 "C-CAN1" 36 "EVAP_SWC" 37 "FUEL_DR_REL_SWC" 38 "Other_Software_Factory_Component" 39 "OHC_1_Front_Map_LGT_RT_Sw" 40 "OHC_1_Front_Map_LGT_LT_Sw" 41 "Fog_Lights_Signal " 42 "DOME_ON_OR_DOME_DEFEAT " 43 "Screen_Open_Close_is_pressed" 44 "Diagnostic_Message_Routing_DMR" 45 "LIN1_Wakeup_Signal_Detected" 46 "LIN2_Wakeup_Signal_Detected" 47 "LIN3_Wakeup_Signal_Detected" 48 "LIN4_Wakeup_Signal_Detected" 49 "LIN5_Wakeup_Signal_Detected" 50 "LIN6_Wakeup_Signal_Detected" 51 "LIN7_Wakeup_Signal_Detected" 52 "LIN8_Wakeup_Signal_Detected" 53 "LIN9_Wakeup_Signal_Detected" 54 "LIN10_Wakeup_Signal_Detected" 55 "FRUNK_RELEASE_SWITCH" 56 "ALCOHOL_INTERLOCK_INPUT" 57 "Reserved" 58 "Reserved" 59 "Reserved" 60 "Reserved" 61 "Reserved" 62 "Reserved" 63 "Reserved" 64 "Reserved" 65 "Reserved" 66 "Reserved" 67 "Reserved" 68 "Reserved" 69 "Reserved" 70 "Reserved" 71 "Reserved" 72 "Reserved" 73 "Reserved" 74 "Reserved" 75 "Reserved" 76 "Reserved" 77 "Reserved" 78 "Reserved" 79 "Reserved" 80 "Reserved" 81 "Reserved" 82 "Reserved" 83 "Reserved" 84 "Reserved" 85 "Reserved" 86 "Reserved" 87 "Reserved" 88 "Reserved" 89 "Reserved" 90 "Reserved" 91 "Reserved" 92 "Reserved" 93 "Reserved" 94 "Reserved" 95 "Reserved" 96 "Reserved" 97 "Reserved" 98 "Reserved" 99 "Reserved" 100 "Reserved" 101 "Reserved" 102 "Reserved" 103 "Reserved" 104 "Reserved" 105 "Reserved" 106 "Reserved" 107 "Reserved" 108 "Reserved" 109 "Reserved" 110 "Reserved" 111 "Reserved" 112 "Reserved" 113 "Reserved" 114 "Reserved" 115 "Reserved" 116 "Reserved" 117 "Reserved" 118 "Reserved" 119 "Reserved" 120 "Reserved" 121 "Reserved" 122 "Reserved" 123 "Reserved" 124 "Reserved" 125 "Reserved" 126 "Reserved" 127 "Reserved" 128 "Reserved" 129 "FD_CAN1" 130 "FD_CAN2" 131 "FD_CAN3" 132 "FD_CAN4" 133 "FD_CAN5" 134 "FD_CAN6" 135 "FD_CAN7" 136 "FD_CAN8" 137 "FD_CAN9" 138 "FD_CAN10" 139 "FD_CAN11" 140 "FD_CAN12" 141 "FD_CAN13" 142 "FD_CAN14" 143 "FD_CAN15" 144 "FD_CAN16" 145 "FD_CAN17" 146 "FD_CAN18" 147 "FD_CAN19" 148 "FD_CAN20" 149 "FD_CAN21" 150 "FD_CAN22" 151 "FD_CAN23" 152 "FD_CAN24" 153 "FD_CAN25" 154 "FD_CAN26" 155 "FD_CAN27" 156 "FD_CAN28" 157 "FD_CAN29" 158 "FD_CAN30" 159 "FD_CAN31" 160 "BH-CAN" 161 "BH-CAN1" 162 "BH-CAN2" 163 "C-CAN" 164 "C-CAN1" 165 "Reserved" 166 "Reserved" 167 "Reserved" 168 "Reserved" 169 "Reserved" 170 "Reserved" 171 "Reserved" 172 "Reserved" 173 "Reserved" 174 "Reserved" 175 "Reserved" 176 "Reserved" 177 "Reserved" 178 "Reserved" 179 "Reserved" 180 "Reserved" 181 "Reserved" 182 "Reserved" 183 "Reserved" 184 "Reserved" 185 "Reserved" 186 "Reserved" 187 "Reserved" 188 "Reserved" 189 "Reserved" 190 "Reserved" 191 "Reserved" 192 "Reserved" 193 "Reserved" 194 "Reserved" 195 "Reserved" 196 "Reserved" 197 "Reserved" 198 "Reserved" 199 "Reserved" 200 "Reserved" 201 "Reserved" 202 "Reserved" 203 "Reserved" 204 "Reserved" 205 "Reserved" 206 "Reserved" 207 "Reserved" 208 "Reserved" 209 "Reserved" 210 "Reserved" 211 "Reserved" 212 "Reserved" 213 "Reserved" 214 "Reserved" 215 "Reserved" 216 "Reserved" 217 "Reserved" 218 "Reserved" 219 "Reserved" 220 "Reserved" 221 "Reserved" 222 "Reserved" 223 "Reserved" 224 "Reserved" 225 "Reserved" 226 "Reserved" 227 "Reserved" 228 "Reserved" 229 "Reserved" 230 "Reserved" 231 "Reserved" 232 "Reserved" 233 "Reserved" 234 "Reserved" 235 "Reserved" 236 "Reserved" 237 "Reserved" 238 "Reserved" 239 "Reserved" 240 "Reserved" 241 "Reserved" 242 "Reserved" 243 "Reserved" 244 "Reserved" 245 "Reserved" 246 "Reserved" 247 "Reserved" 248 "Reserved" 249 "Reserved" 250 "Reserved" 251 "Reserved" 252 "Reserved" 253 "Reserved" 254 "WUSource_Not_Listed" 255 "Reserved";
VAL_ 2654339072 WakeupSource_FD04_BCM 0 "None" 1 "Ignition_Active" 2 "CmdIgnSts_LK_to_ACC_RUN_START" 3 "HazardSwitch_ON" 4 "DrvDoorAjar" 5 "DrvDoor2Ajar" 6 "PsngrDoorAjar" 7 "LR_DoorAjar" 8 "RR_DoorAjar" 9 "TrunkAjar" 10 "BonnetAjar" 11 "RAPHandle_Req" 12 "MainLightSelector_Req_OFF" 13 "HiBmLvr_Stat_HIBM_FLASH_ON_PSD" 14 "LowBeamSts_SET" 15 "ParkingLightSts_SET" 16 "FlashToPass_SET" 17 "RemStActvSts_Active" 18 "Fuel_Door_Release_Switch" 19 "ENGINE_FD_8_RefuelEvent_Pending" 20 "OHC_1_Front_Int_LG_Sw_1" 21 "HFRM_1_RearKick" 22 "LeakCheckTimerExpired" 23 "Horn_Req_Not Pressed_to_Pressed" 24 "Comfort_Enable_Time_not_0" 25 "CmdIgnSts_ACC_RUN_START" 26 "ENGINE_FD_8_LeakTestSts_1" 27 "Non_Default_Diagnostic_Session" 28 "RL_Lk_Sw_LK_RQ_or_UNLK_RQ" 29 "RR_Lk_Sw_LK_RQ_or_UNLK_RQ" 30 "FD-CAN1" 31 "FD-CAN2" 32 "FD-CAN3" 33 "FD-CAN4" 34 "BH-CAN" 35 "C-CAN1" 36 "EVAP_SWC" 37 "FUEL_DR_REL_SWC" 38 "Other_Software_Factory_Component" 39 "OHC_1_Front_Map_LGT_RT_Sw" 40 "OHC_1_Front_Map_LGT_LT_Sw" 41 "Fog_Lights_Signal " 42 "DOME_ON_OR_DOME_DEFEAT " 43 "Screen_Open_Close_is_pressed" 44 "Diagnostic_Message_Routing_DMR" 45 "LIN1_Wakeup_Signal_Detected" 46 "LIN2_Wakeup_Signal_Detected" 47 "LIN3_Wakeup_Signal_Detected" 48 "LIN4_Wakeup_Signal_Detected" 49 "LIN5_Wakeup_Signal_Detected" 50 "LIN6_Wakeup_Signal_Detected" 51 "LIN7_Wakeup_Signal_Detected" 52 "LIN8_Wakeup_Signal_Detected" 53 "LIN9_Wakeup_Signal_Detected" 54 "LIN10_Wakeup_Signal_Detected" 55 "FRUNK_RELEASE_SWITCH" 56 "ALCOHOL_INTERLOCK_INPUT" 57 "Reserved" 58 "Reserved" 59 "Reserved" 60 "Reserved" 61 "Reserved" 62 "Reserved" 63 "Reserved" 64 "Reserved" 65 "Reserved" 66 "Reserved" 67 "Reserved" 68 "Reserved" 69 "Reserved" 70 "Reserved" 71 "Reserved" 72 "Reserved" 73 "Reserved" 74 "Reserved" 75 "Reserved" 76 "Reserved" 77 "Reserved" 78 "Reserved" 79 "Reserved" 80 "Reserved" 81 "Reserved" 82 "Reserved" 83 "Reserved" 84 "Reserved" 85 "Reserved" 86 "Reserved" 87 "Reserved" 88 "Reserved" 89 "Reserved" 90 "Reserved" 91 "Reserved" 92 "Reserved" 93 "Reserved" 94 "Reserved" 95 "Reserved" 96 "Reserved" 97 "Reserved" 98 "Reserved" 99 "Reserved" 100 "Reserved" 101 "Reserved" 102 "Reserved" 103 "Reserved" 104 "Reserved" 105 "Reserved" 106 "Reserved" 107 "Reserved" 108 "Reserved" 109 "Reserved" 110 "Reserved" 111 "Reserved" 112 "Reserved" 113 "Reserved" 114 "Reserved" 115 "Reserved" 116 "Reserved" 117 "Reserved" 118 "Reserved" 119 "Reserved" 120 "Reserved" 121 "Reserved" 122 "Reserved" 123 "Reserved" 124 "Reserved" 125 "Reserved" 126 "Reserved" 127 "Reserved" 128 "Reserved" 129 "FD_CAN1" 130 "FD_CAN2" 131 "FD_CAN3" 132 "FD_CAN4" 133 "FD_CAN5" 134 "FD_CAN6" 135 "FD_CAN7" 136 "FD_CAN8" 137 "FD_CAN9" 138 "FD_CAN10" 139 "FD_CAN11" 140 "FD_CAN12" 141 "FD_CAN13" 142 "FD_CAN14" 143 "FD_CAN15" 144 "FD_CAN16" 145 "FD_CAN17" 146 "FD_CAN18" 147 "FD_CAN19" 148 "FD_CAN20" 149 "FD_CAN21" 150 "FD_CAN22" 151 "FD_CAN23" 152 "FD_CAN24" 153 "FD_CAN25" 154 "FD_CAN26" 155 "FD_CAN27" 156 "FD_CAN28" 157 "FD_CAN29" 158 "FD_CAN30" 159 "FD_CAN31" 160 "BH-CAN" 161 "BH-CAN1" 162 "BH-CAN2" 163 "C-CAN" 164 "C-CAN1" 165 "Reserved" 166 "Reserved" 167 "Reserved" 168 "Reserved" 169 "Reserved" 170 "Reserved" 171 "Reserved" 172 "Reserved" 173 "Reserved" 174 "Reserved" 175 "Reserved" 176 "Reserved" 177 "Reserved" 178 "Reserved" 179 "Reserved" 180 "Reserved" 181 "Reserved" 182 "Reserved" 183 "Reserved" 184 "Reserved" 185 "Reserved" 186 "Reserved" 187 "Reserved" 188 "Reserved" 189 "Reserved" 190 "Reserved" 191 "Reserved" 192 "Reserved" 193 "Reserved" 194 "Reserved" 195 "Reserved" 196 "Reserved" 197 "Reserved" 198 "Reserved" 199 "Reserved" 200 "Reserved" 201 "Reserved" 202 "Reserved" 203 "Reserved" 204 "Reserved" 205 "Reserved" 206 "Reserved" 207 "Reserved" 208 "Reserved" 209 "Reserved" 210 "Reserved" 211 "Reserved" 212 "Reserved" 213 "Reserved" 214 "Reserved" 215 "Reserved" 216 "Reserved" 217 "Reserved" 218 "Reserved" 219 "Reserved" 220 "Reserved" 221 "Reserved" 222 "Reserved" 223 "Reserved" 224 "Reserved" 225 "Reserved" 226 "Reserved" 227 "Reserved" 228 "Reserved" 229 "Reserved" 230 "Reserved" 231 "Reserved" 232 "Reserved" 233 "Reserved" 234 "Reserved" 235 "Reserved" 236 "Reserved" 237 "Reserved" 238 "Reserved" 239 "Reserved" 240 "Reserved" 241 "Reserved" 242 "Reserved" 243 "Reserved" 244 "Reserved" 245 "Reserved" 246 "Reserved" 247 "Reserved" 248 "Reserved" 249 "Reserved" 250 "Reserved" 251 "Reserved" 252 "Reserved" 253 "Reserved" 254 "WUSource_Not_Listed" 255 "Reserved";
VAL_ 2654339142 CurrentCanNMState_FD05_BPCM 0 "Uninitialized State" 1 "Bus-Sleep State" 2 "Prepare-Bus State" 3 "Ready-Sleep State" 4 "Normal Operation State" 5 "Repeat Message State" 6 "Synchronize State" 7 "Offline State";
VAL_ 2654339142 CurrentCanNMState_FD11_BPCM 0 "Uninitialized State" 1 "Bus-Sleep State" 2 "Prepare-Bus State" 3 "Ready-Sleep State" 4 "Normal Operation State" 5 "Repeat Message State" 6 "Synchronize State" 7 "Offline State";
VAL_ 2654339142 CurrentFailSts_FD05_BPCM 0 "No_Fail_Present" 1 "Fail_Present";
VAL_ 2654339142 CurrentFailSts_FD11_BPCM 0 "No_Fail_Present" 1 "Fail_Present";
VAL_ 2654339142 DES_FD05_BPCM 0 "Error_Active_state" 1 "Error_passive_warning_state" 2 "Bus_off_state" 3 "Not_used";
VAL_ 2654339142 DES_FD11_BPCM 0 "Error_Active_state" 1 "Error_passive_warning_state" 2 "Bus_off_state" 3 "Not_used";
VAL_ 2654339142 EOL_FD05_BPCM 0 "No_EOL_Programming" 1 "EOL_Programming";
VAL_ 2654339142 EOL_FD11_BPCM 0 "No_EOL_Programming" 1 "EOL_Programming";
VAL_ 2654339142 GenericFailSts_FD05_BPCM 0 "No_Fail_Present" 1 "Fail_Present";
VAL_ 2654339142 GenericFailSts_FD11_BPCM 0 "No_Fail_Present" 1 "Fail_Present";
VAL_ 2654339142 PreviousCanNMState_FD05_BPCM 0 "Uninitialized State" 1 "Bus-Sleep State" 2 "Prepare-Bus State" 3 "Ready-Sleep State" 4 "Normal Operation State" 5 "Repeat Message State" 6 "Synchronize State" 7 "Offline State";
VAL_ 2654339142 PreviousCanNMState_FD11_BPCM 0 "Uninitialized State" 1 "Bus-Sleep State" 2 "Prepare-Bus State" 3 "Ready-Sleep State" 4 "Normal Operation State" 5 "Repeat Message State" 6 "Synchronize State" 7 "Offline State";
VAL_ 2654339142 StayActiveSource_FD11_BPCM 0 "CANNM_Ready_Sleep" 1 "IGN_ON" 2 "NonDefault_Diag" 4 "ING_OFF_NormSt_RptSt" 8 "HV_ON" 1073741824 "SASource_Not_Listed";
VAL_ 2654339142 WakeupSource_FD05_BPCM 0 "No_Wakeup";
VAL_ 2654339142 WakeupSource_FD11_BPCM 0 "No_Wakeup";
VAL_ 2654339078 CurrentCanNMState_FD03_BSM 0 "Uninitialized State" 1 "Bus-Sleep State" 2 "Prepare-Bus State" 3 "Ready-Sleep State" 4 "Normal Operation State" 5 "Repeat Message State" 6 "Synchronize State" 7 "Offline State";
VAL_ 2654339078 CurrentFailSts_FD03_BSM 0 "No_Fail_Present" 1 "Fail_Present";
VAL_ 2654339078 DES_FD03_BSM 0 "Error_Active_state" 1 "Error_passive_warning_state" 2 "Bus_off_state" 3 "Not_used";
VAL_ 2654339078 EOL_FD03_BSM 0 "No_EOL_Programming" 1 "EOL_Programming";
VAL_ 2654339078 GenericFailSts_FD03_BSM 0 "No_Fail_Present" 1 "Fail_Present";
VAL_ 2654339078 PreviousCanNMState_FD03_BSM 0 "Uninitialized State" 1 "Bus-Sleep State" 2 "Prepare-Bus State" 3 "Ready-Sleep State" 4 "Normal Operation State" 5 "Repeat Message State" 6 "Synchronize State" 7 "Offline State";
VAL_ 2654339078 StayActiveSource_FD03_BSM 0 "CANNM_Ready_Sleep" 1 "IGN_ON" 2 "NonDefault_Diag" 4 "ING_OFF_NormSt_RptSt" 8 "EPB_Switch_Apply_Release_Request" 10 "Brake_Pedal_Pressed" 20 "Vahicle_is_Moving" 1073741824 "SASource_Not_Listed";
VAL_ 2654339078 WakeupSource_FD03_BSM 0 "No_Wakeup" 1 "IGN_ON" 131 "FD3_Psv_WU" 254 "WUSource_Not_Listed" 255 "HW_DIA_WU";
VAL_ 2654339213 CurrentCanNMState_FD03_CADM 0 "Uninitialized State" 1 "Bus-Sleep State" 2 "Prepare-Bus State" 3 "Ready-Sleep State" 4 "Normal Operation State" 5 "Repeat Message State" 6 "Synchronize State" 7 "Offline State";
VAL_ 2654339213 CurrentFailSts_FD03_CADM 0 "No_Fail_Present" 1 "Fail_Present";
VAL_ 2654339213 DES_FD03_CADM 0 "Error_Active_state" 1 "Error_passive_warning_state" 2 "Bus_off_state" 3 "Not_used";
VAL_ 2654339213 EOL_FD03_CADM 0 "No_EOL_Programming" 1 "EOL_Programming";
VAL_ 2654339213 GenericFailSts_FD03_CADM 0 "No_Fail_Present" 1 "Fail_Present";
VAL_ 2654339213 PreviousCanNMState_FD03_CADM 0 "Uninitialized State" 1 "Bus-Sleep State" 2 "Prepare-Bus State" 3 "Ready-Sleep State" 4 "Normal Operation State" 5 "Repeat Message State" 6 "Synchronize State" 7 "Offline State";
VAL_ 2654339213 WakeupSource_FD03_CADM 0 "No_Wakeup";
VAL_ 2654339225 CurrentCanNMState_FD03_DMSM 0 "Uninitialized State" 1 "Bus-Sleep State" 2 "Prepare-Bus State" 3 "Ready-Sleep State" 4 "Normal Operation State" 5 "Repeat Message State" 6 "Synchronize State" 7 "Offline State";
VAL_ 2654339225 CurrentFailSts_FD03_DMSM 0 "No_Fail_Present" 1 "Fail_Present";
VAL_ 2654339225 DES_FD03_DMSM 0 "Error_Active_state" 1 "Error_passive_warning_state" 2 "Bus_off_state" 3 "Not_used";
VAL_ 2654339225 EOL_FD03_DMSM 0 "No_EOL_Programming" 1 "EOL_Programming";
VAL_ 2654339225 GenericFailSts_FD03_DMSM 0 "No_Fail_Present" 1 "Fail_Present";
VAL_ 2654339225 PreviousCanNMState_FD03_DMSM 0 "Uninitialized State" 1 "Bus-Sleep State" 2 "Prepare-Bus State" 3 "Ready-Sleep State" 4 "Normal Operation State" 5 "Repeat Message State" 6 "Synchronize State" 7 "Offline State";
VAL_ 2654339225 WakeupSource_FD03_DMSM 0 "No_Wakeup";
VAL_ 2654339139 CurrentCanNMState_FD03_DTCM 0 "Uninitialized State" 1 "Bus-Sleep State" 2 "Prepare-Bus State" 3 "Ready-Sleep State" 4 "Normal Operation State" 5 "Repeat Message State" 6 "Synchronize State" 7 "Offline State";
VAL_ 2654339139 CurrentFailSts_FD03_DTCM 0 "No_Fail_Present" 1 "Fail_Present";
VAL_ 2654339139 DES_FD03_DTCM 0 "Error_Active_state" 1 "Error_passive_warning_state" 2 "Bus_off_state" 3 "Not_used";
VAL_ 2654339139 EOL_FD03_DTCM 0 "No_EOL_Programming" 1 "EOL_Programming";
VAL_ 2654339139 GenericFailSts_FD03_DTCM 0 "No_Fail_Present" 1 "Fail_Present";
VAL_ 2654339139 PreviousCanNMState_FD03_DTCM 0 "Uninitialized State" 1 "Bus-Sleep State" 2 "Prepare-Bus State" 3 "Ready-Sleep State" 4 "Normal Operation State" 5 "Repeat Message State" 6 "Synchronize State" 7 "Offline State";
VAL_ 2654339139 WakeupSource_FD03_DTCM 0 "No_Wakeup";
