VERSION ""

NS_ :

BS_:

BU_: AGSM BCM BSM CADM DMSM DTCM ECM EVCU2 GNMM HCP IPC RFHM SGW TCM
BO_ 1432 IPC_FD_6: 32 IPC
 SG_ AverageFuelConsumptionAPlus : 105|10@0+ (0.1,0) [0|102.3] "km/l, l/100km, km/kWh, or kWh/100km" SGW
 SG_ AverageFuelConsumptionBPlus : 121|10@0+ (0.1,0) [0|102.3] "km/l, l/100km, km/kWh, or kWh/100km" SGW
 SG_ CRC_IPC6 : 191|8@0+ (1,0) [0|255] "-" BCM,CADM
 SG_ HAS_SoH_IPC : 76|1@0+ (1,0) [0|1] "" BCM,CADM
 SG_ MessageCounter_IPC6 : 179|4@0+ (1,0) [0|15] "-" BCM,CADM
 SG_ PartialOdometerAPlus : 75|20@0+ (0.1,0) [0|104857.5] "km or mi." SGW
 SG_ PartialOdometerBPlus : 27|20@0+ (0.1,0) [0|104857.5] "km or mi." SGW
 SG_ PowerMode_RQ : 4|3@0+ (1,0) [0|6] "" BCM
 SG_ TravelingTimeAPlus_Hour : 137|10@0+ (1,0) [0|1023] "Hour" SGW
 SG_ TravelingTimeAPlus_Minute : 127|6@0+ (1,0) [0|63] "Minute" SGW
 SG_ TravelingTimeAPlus_Second : 111|6@0+ (1,0) [0|63] "Second" SGW
 SG_ TravelingTimeBPlus_Hour : 161|10@0+ (1,0) [0|1023] "Hour" SGW
 SG_ TravelingTimeBPlus_Minute : 167|6@0+ (1,0) [0|63] "Minute" SGW
 SG_ TravelingTimeBPlus_Second : 143|6@0+ (1,0) [0|63] "Second" SGW
 SG_ TrlrLgtChkReq : 17|2@0+ (1,0) [0|3] "" BCM

BO_ 1897 IPC_FD_7: 48 IPC
 SG_ VehPerfAccelPeak_X_Neg : 21|9@0+ (0.08,0) [0|40.88] "m/s2" SGW
 SG_ VehPerfAccelPeak_X_Pos : 7|9@0+ (0.08,0) [0|40.88] "m/s2" SGW
 SG_ VehPerfAccelPeak_Y_Neg : 14|9@0+ (0.08,0) [0|40.88] "m/s2" SGW
 SG_ VehPerfAccelPeak_Y_Pos : 28|9@0+ (0.08,0) [0|40.88] "m/s2" SGW

BO_ 604 IPC_SRT_FD_1: 64 IPC
 SG_ SRT_100mphTm_B : 111|8@0+ (0.1,0) [0|25.1] "sec" SGW
 SG_ SRT_100mphTm_C : 103|8@0+ (0.1,0) [0|25.1] "sec" SGW
 SG_ SRT_100mphTm_L : 119|8@0+ (0.1,0) [0|25.1] "sec" SGW
 SG_ SRT_100mphTmB : 135|8@0+ (0.1,0) [0|25.1] "sec" SGW
 SG_ SRT_100mphTmC : 127|8@0+ (0.1,0) [0|25.1] "sec" SGW
 SG_ SRT_100mphTmL : 143|8@0+ (0.1,0) [0|25.1] "sec" SGW
 SG_ SRT_60mphTm_B : 87|8@0+ (0.1,0) [0|25.1] "sec" SGW
 SG_ SRT_60mphTm_C : 79|8@0+ (0.1,0) [0|25.1] "sec" SGW
 SG_ SRT_60mphTm_L : 95|8@0+ (0.1,0) [0|25.1] "sec" SGW
 SG_ SRT_60mphTmB : 63|8@0+ (0.1,0) [0|25.1] "sec" SGW
 SG_ SRT_60mphTmC : 55|8@0+ (0.1,0) [0|25.1] "sec" SGW
 SG_ SRT_60mphTmL : 71|8@0+ (0.1,0) [0|25.1] "sec" SGW
 SG_ SRT_BrkTm_B : 375|8@0+ (0.1,0) [0|25.1] "sec" SGW
 SG_ SRT_BrkTm_C : 367|8@0+ (0.1,0) [0|25.1] "sec" SGW
 SG_ SRT_BrkTm_L : 383|8@0+ (0.1,0) [0|25.1] "sec" SGW
 SG_ SRT_BrkTmB : 351|8@0+ (0.1,0) [0|25.1] "sec" SGW
 SG_ SRT_BrkTmC : 343|8@0+ (0.1,0) [0|25.1] "sec" SGW
 SG_ SRT_BrkTmL : 359|8@0+ (0.1,0) [0|25.1] "sec" SGW
 SG_ SRT_eighthTm_B : 183|8@0+ (0.1,0) [0|25.1] "sec" SGW
 SG_ SRT_eighthTm_C : 175|8@0+ (0.1,0) [0|25.1] "sec" SGW
 SG_ SRT_eighthTm_L : 191|8@0+ (0.1,0) [0|25.1] "sec" SGW
 SG_ SRT_eighthTmB : 159|8@0+ (0.1,0) [0|25.1] "sec" SGW
 SG_ SRT_eighthTmC : 151|8@0+ (0.1,0) [0|25.1] "sec" SGW
 SG_ SRT_eighthTmL : 167|8@0+ (0.1,0) [0|25.1] "sec" SGW
 SG_ SRT_EthSpdB_M : 255|8@0+ (1,0) [0|254] "km/h" SGW
 SG_ SRT_EthSpdB_US : 279|8@0+ (1,0) [0|254] "mph" SGW
 SG_ SRT_EthSpdC_M : 247|8@0+ (1,0) [0|254] "km/h" SGW
 SG_ SRT_EthSpdC_US : 271|8@0+ (1,0) [0|254] "mph" SGW
 SG_ SRT_EthSpdL_M : 263|8@0+ (1,0) [0|254] "km/h" SGW
 SG_ SRT_EthSpdL_US : 287|8@0+ (1,0) [0|254] "mph" SGW
 SG_ SRT_QrtSpdB_M : 303|8@0+ (1,0) [0|254] "km/h" SGW
 SG_ SRT_QrtSpdB_US : 327|8@0+ (1,0) [0|254] "mph" SGW
 SG_ SRT_QrtSpdC_M : 295|8@0+ (1,0) [0|254] "km/h" SGW
 SG_ SRT_QrtSpdC_US : 319|8@0+ (1,0) [0|254] "mph" SGW
 SG_ SRT_QrtSpdL_M : 311|8@0+ (1,0) [0|254] "km/h" SGW
 SG_ SRT_QrtSpdL_US : 335|8@0+ (1,0) [0|254] "mph" SGW
 SG_ SRT_quarterTm_B : 231|8@0+ (0.1,0) [0|25.1] "sec" SGW
 SG_ SRT_quarterTm_C : 223|8@0+ (0.1,0) [0|25.1] "sec" SGW
 SG_ SRT_quarterTm_L : 239|8@0+ (0.1,0) [0|25.1] "sec" SGW
 SG_ SRT_quarterTmB : 207|8@0+ (0.1,0) [0|25.1] "sec" SGW
 SG_ SRT_quarterTmC : 199|8@0+ (0.1,0) [0|25.1] "sec" SGW
 SG_ SRT_quarterTmL : 215|8@0+ (0.1,0) [0|25.1] "sec" SGW
 SG_ SRT_ReactTm_B : 39|8@0+ (0.01,-1.25) [-1.25|1.25] "sec" SGW
 SG_ SRT_ReactTm_C : 31|8@0+ (0.01,-1.25) [-1.25|1.25] "sec" SGW
 SG_ SRT_ReactTm_L : 47|8@0+ (0.01,-1.25) [-1.25|1.25] "sec" SGW
 SG_ SRT_ReactTmB : 15|8@0+ (0.01,-1.25) [-1.25|1.25] "sec" SGW
 SG_ SRT_ReactTmC : 7|8@0+ (0.01,-1.25) [-1.25|1.25] "sec" SGW
 SG_ SRT_ReactTmL : 23|8@0+ (0.01,-1.25) [-1.25|1.25] "sec" SGW

BO_ 605 IPC_SRT_FD_2: 64 IPC
 SG_ SRT_1000ftTm_B : 183|8@0+ (0.1,0) [0|25.1] "sec" SGW
 SG_ SRT_1000ftTm_C : 175|8@0+ (0.1,0) [0|25.1] "sec" SGW
 SG_ SRT_1000ftTm_L : 191|8@0+ (0.1,0) [0|25.1] "sec" SGW
 SG_ SRT_1000ftTmB : 159|8@0+ (0.1,0) [0|25.1] "sec" SGW
 SG_ SRT_1000ftTmC : 151|8@0+ (0.1,0) [0|25.1] "sec" SGW
 SG_ SRT_1000ftTmL : 167|8@0+ (0.1,0) [0|25.1] "sec" SGW
 SG_ SRT_330ftTm_B : 135|8@0+ (0.1,0) [0|25.1] "sec" SGW
 SG_ SRT_330ftTm_C : 127|8@0+ (0.1,0) [0|25.1] "sec" SGW
 SG_ SRT_330ftTm_L : 143|8@0+ (0.1,0) [0|25.1] "sec" SGW
 SG_ SRT_330ftTmB : 111|8@0+ (0.1,0) [0|25.1] "sec" SGW
 SG_ SRT_330ftTmC : 103|8@0+ (0.1,0) [0|25.1] "sec" SGW
 SG_ SRT_330ftTmL : 119|8@0+ (0.1,0) [0|25.1] "sec" SGW
 SG_ SRT_60ftTm_B : 224|9@0+ (0.01,0) [0|5.02] "sec" SGW
 SG_ SRT_60ftTm_C : 208|9@0+ (0.01,0) [0|5.02] "sec" SGW
 SG_ SRT_60ftTm_L : 240|9@0+ (0.01,0) [0|5.02] "sec" SGW
 SG_ SRT_60ftTmB : 256|9@0+ (0.01,0) [0|5.11] "sec" SGW
 SG_ SRT_60ftTmC : 272|9@0+ (0.01,0) [0|5.02] "sec" SGW
 SG_ SRT_60ftTmL : 192|9@0+ (0.01,0) [0|5.02] "sec" SGW
 SG_ SRT_BrkDistB_M : 15|8@0+ (1,0) [0|251] "m" SGW
 SG_ SRT_BrkDistB_US : 39|8@0+ (1,0) [0|251] "Yards" SGW
 SG_ SRT_BrkDistC_M : 7|8@0+ (1,0) [0|251] "m" SGW
 SG_ SRT_BrkDistC_US : 31|8@0+ (1,0) [0|251] "Yards" SGW
 SG_ SRT_BrkDistL_M : 23|8@0+ (1,0) [0|251] "m" SGW
 SG_ SRT_BrkDistL_US : 47|8@0+ (1,0) [0|251] "Yards" SGW
 SG_ SRT_BrkSpdB_M : 63|8@0+ (1,0) [0|254] "km/h" SGW
 SG_ SRT_BrkSpdB_US : 87|8@0+ (1,0) [0|254] "mph" SGW
 SG_ SRT_BrkSpdC_M : 55|8@0+ (1,0) [0|254] "km/h" SGW
 SG_ SRT_BrkSpdC_US : 79|8@0+ (1,0) [0|254] "mph" SGW
 SG_ SRT_BrkSpdL_M : 71|8@0+ (1,0) [0|254] "km/h" SGW
 SG_ SRT_BrkSpdL_US : 95|8@0+ (1,0) [0|254] "mph" SGW

BO_ 1443 IPC_VEHICLE_SETUP: 48 IPC
 SG_ Act_Lane_Mgt : 91|2@0+ (1,0) [0|3] "-" BCM,CADM,SGW
 SG_ Act_Lane_Mgt_Strength : 123|2@0+ (1,0) [0|3] "-" BCM,CADM,SGW
 SG_ Active_Park_Mode : 219|1@0+ (1,0) [0|1] "" BCM,BSM,SGW
 SG_ Active_Park_Prox_Chime : 218|1@0+ (1,0) [0|1] "" BCM,SGW
 SG_ AmbientLightingLevel : 118|4@0+ (1,0) [0|15] "" SGW
 SG_ Auto_Fold_Mirr : 255|1@0+ (1,0) [0|1] "-" BCM,SGW
 SG_ AutoHighBeamEnable : 92|1@0+ (1,0) [0|1] "-" BCM,SGW
 SG_ AutoParkBrake : 103|1@0+ (1,0) [0|1] "" BCM,BSM,SGW
 SG_ AutoUnlockDoorExit : 162|1@0+ (1,0) [0|1] "-" BCM,SGW
 SG_ Backup_Cam_Delay : 173|1@0+ (1,0) [0|1] "-" BCM,SGW
 SG_ BSDEnable : 140|2@0+ (1,0) [0|3] "" BCM,CADM,SGW
 SG_ Consum_Unit : 238|3@0+ (1,0) [0|7] "" BCM,SGW
 SG_ CorneringEnable : 82|1@0+ (1,0) [0|1] "-" BCM,SGW
 SG_ CRC_IPCVS1 : 319|8@0+ (1,0) [0|255] "-" CADM,EVCU2
 SG_ Dist_Unit : 231|1@0+ (1,0) [0|1] "" BCM,ECM,SGW
 SG_ DRLEnable : 80|1@0+ (1,0) [0|1] "-" BCM,SGW
 SG_ Drowsy_Driver_Alert : 120|1@0+ (1,0) [0|1] "-" BCM,CADM,SGW
 SG_ DynamicGrid : 100|1@0+ (1,0) [0|1] "" BCM,SGW
 SG_ Easy_Exit_D : 174|1@0+ (1,0) [0|1] "-" BCM,SGW
 SG_ Eng_Off_Pwr_Delay : 187|2@0+ (1,0) [0|3] "-" BCM,SGW
 SG_ EPB_MaintenanceMode : 155|1@0+ (1,0) [0|1] "-" SGW
 SG_ FlashLightWLock : 159|1@0+ (1,0) [0|1] "-" BCM,SGW
 SG_ FOA_AppAlert_Disable_UserReq : 290|1@0+ (1,0) [0|1] "" BCM
 SG_ FSFCWPlusActivationMode : 149|2@0+ (1,0) [0|3] "-" BCM,CADM,SGW
 SG_ FSFCWPlusSetting : 143|3@0+ (1,0) [0|7] "-" BCM,CADM,SGW
 SG_ Fwrd_Cam_Guidelines : 189|1@0+ (1,0) [0|1] "-" BCM,SGW
 SG_ GreetingLightsEnable : 81|1@0+ (1,0) [0|1] "-" BCM,SGW
 SG_ HeadlightsOffDelay : 145|2@0+ (1,0) [0|3] "-" BCM,SGW
 SG_ HeadLightWipers : 167|1@0+ (1,0) [0|1] "-" BCM,SGW
 SG_ Hill_Start_Assist : 184|1@0+ (1,0) [0|1] "-" BCM,BSM,SGW
 SG_ HourMode : 87|1@0+ (1,0) [0|1] "-" BCM,SGW
 SG_ HP_Unit : 245|2@0+ (1,0) [0|3] "" BCM,SGW
 SG_ Illuminated_Approach : 68|2@0+ (1,0) [0|3] "-" BCM,SGW
 SG_ IPCProgrammed : 40|1@0+ (1,0) [0|1] "-" BCM,SGW
 SG_ LanguageSelection : 135|8@0+ (1,0) [0|255] "-" BCM,SGW
 SG_ LDW_Intensity : 154|2@0+ (1,0) [0|3] "-" BCM,CADM,SGW
 SG_ LDW_Sensibility : 147|2@0+ (1,0) [0|3] "-" BCM,CADM,SGW
 SG_ MessageCounter_IPCVS1 : 307|4@0+ (1,0) [0|15] "-" CADM,EVCU2
 SG_ NavRepetition : 105|1@0+ (1,0) [0|1] "" BCM,SGW
 SG_ New_Spd_Zone_Ind : 247|2@0+ (1,0) [0|3] "" BCM,SGW
 SG_ Paddle_Shifter : 188|1@0+ (1,0) [0|1] "-" BCM,SGW
 SG_ PamChimeVolumeFront : 107|2@0+ (1,0) [0|3] "" BCM,SGW
 SG_ PamChimeVolumeRear : 111|2@0+ (1,0) [0|3] "" BCM,SGW
 SG_ PassiveEntry : 101|1@0+ (1,0) [0|1] "" BCM,RFHM,SGW
 SG_ Ped_EM_Brk_Warn_Act : 175|1@0+ (1,0) [0|1] "-" BCM,CADM,SGW
 SG_ PhoneRepetition : 114|1@0+ (1,0) [0|1] "" BCM,SGW
 SG_ PLGAlert : 168|1@0+ (1,0) [0|1] "-" BCM,SGW
 SG_ Power_Side_Step : 220|1@0+ (1,0) [0|1] "" BCM,SGW
 SG_ Proximity_WU : 121|1@0+ (1,0) [0|1] "-" BCM,RFHM,SGW
 SG_ PwrLev : 7|3@0+ (1,0) [0|7] "" BCM,EVCU2,SGW
 SG_ RainSensorLevel : 93|1@0+ (1,0) [0|1] "-" BCM,SGW
 SG_ Rdy_To_Drive : 223|1@0+ (1,0) [0|1] "" SGW
 SG_ Rear_Brk_Asst : 190|1@0+ (1,0) [0|1] "" BCM,SGW
 SG_ RemoteDoorUnlock : 102|1@0+ (1,0) [0|1] "" BCM,SGW
 SG_ RemStNrmlStEnbl : 178|2@0+ (1,0) [0|3] "-" BCM,SGW
 SG_ RKEMemoryLinkEnable : 166|1@0+ (1,0) [0|1] "-" BCM,SGW
 SG_ SOC_Max_Lev : 308|1@0+ (1,0) [0|1] "" EVCU2,SGW
 SG_ SoundHornLock : 127|2@0+ (1,0) [0|3] "" BCM,SGW
 SG_ SoundHornRemoteStart : 104|1@0+ (1,0) [0|1] "" BCM,SGW
 SG_ Speed_Unit : 253|1@0+ (1,0) [0|1] "" BCM,CADM,EVCU2,SGW
 SG_ SpeedLockDoorEnable : 94|1@0+ (1,0) [0|1] "-" BCM,SGW
 SG_ StaticGrid : 99|1@0+ (1,0) [0|1] "" BCM,SGW
 SG_ Susp_Auto_Ent_Ext : 195|1@0+ (1,0) [0|1] "" BCM,SGW
 SG_ Susp_Disp_Message : 207|1@0+ (1,0) [0|1] "" BCM,SGW
 SG_ Susp_Flsh_Lght_Low : 198|1@0+ (1,0) [0|1] "" BCM,SGW
 SG_ Susp_Sound_Hrn_Low : 199|1@0+ (1,0) [0|1] "" BCM,SGW
 SG_ Susp_Tire_Jack : 200|1@0+ (1,0) [0|1] "" BCM,SGW
 SG_ SVC_Delay : 192|1@0+ (1,0) [0|1] "" BCM,SGW
 SG_ SVC_Guidelines : 193|1@0+ (1,0) [0|1] "" BCM,SGW
 SG_ TelematicSetupACK : 97|2@0+ (1,0) [0|3] "-" BCM,SGW
 SG_ Temp_Unit : 239|1@0+ (1,0) [0|1] "" BCM,SGW
 SG_ Tilt_Mirr_Rev : 210|1@0+ (1,0) [0|1] "" BCM,SGW
 SG_ Tire_Fill_Alert : 215|1@0+ (1,0) [0|1] "" BCM,RFHM,SGW
 SG_ Torque_Unit : 254|1@0+ (1,0) [0|1] "" BCM,SGW
 SG_ Traffic_Sign_Info : 230|1@0+ (1,0) [0|1] "" BCM,CADM,SGW
 SG_ Traffic_Sign_Warn : 171|3@0+ (1,0) [0|3] "" BCM,SGW
 SG_ Trail_Brk_Type : 217|2@0+ (1,0) [0|3] "" BCM,SGW
 SG_ Trail_Name : 235|4@0+ (1,0) [0|16] "" BCM,SGW
 SG_ Trail_Num : 214|2@0+ (1,0) [0|3] "" BCM,SGW
 SG_ Trailer_detection_blind_spot : 310|1@0+ (1,0) [0|1] "-" BCM,CADM,SGW
 SG_ TyrePress_Unit : 243|2@0+ (1,0) [0|3] "" BCM,SGW

CM_ SG_ 1432 AverageFuelConsumptionAPlus "Used to give information about the average fuel consumption for Trip A.";
CM_ SG_ 1432 AverageFuelConsumptionBPlus "Used to give information about the average fuel consumption for Trip B.";
CM_ SG_ 1432 CRC_IPC6 "CRC according to SAE J1850 standard at each frame transmission.";
CM_ SG_ 1432 HAS_SoH_IPC "HAS SoH IPC";
CM_ SG_ 1432 MessageCounter_IPC6 "This signal is a counter used for safety checks strategies. This counter is incremented of 1 (one) unit at each frame transmission.";
CM_ SG_ 1432 PartialOdometerAPlus "Used to give information about the partial odometer for Trip A";
CM_ SG_ 1432 PartialOdometerBPlus "Used to give information about the partial odometer for Trip B.";
CM_ SG_ 1432 PowerMode_RQ "Power Mode Request";
CM_ SG_ 1432 TravelingTimeAPlus_Hour "Used to give information about hours of travel time for Trip A.";
CM_ SG_ 1432 TravelingTimeAPlus_Minute "Used to give information about minutes of travel time for Trip A.";
CM_ SG_ 1432 TravelingTimeAPlus_Second "Used to give information about seconds of travel time for Trip A";
CM_ SG_ 1432 TravelingTimeBPlus_Hour "Used to give information about hours of travel time for Trip B.";
CM_ SG_ 1432 TravelingTimeBPlus_Minute "Used to give information about minutes of travel time for Trip B.";
CM_ SG_ 1432 TravelingTimeBPlus_Second "Used to give information about seconds of travel time for Trip B";
CM_ SG_ 1432 TrlrLgtChkReq "trailer light check request signal to the BCM from the IPC to give the setting request";
CM_ SG_ 1897 VehPerfAccelPeak_X_Neg "Vehicle lateral acceleration peak (forward)";
CM_ SG_ 1897 VehPerfAccelPeak_X_Pos "Vehicle longitudinal acceleration peak (forward)";
CM_ SG_ 1897 VehPerfAccelPeak_Y_Neg "Vehicle lateral acceleration peak (backward)";
CM_ SG_ 1897 VehPerfAccelPeak_Y_Pos "Vehicle longitudinal acceleration peak (backward)";
CM_ SG_ 604 SRT_100mphTm_B "SRT 0 to 100  timer - best";
CM_ SG_ 604 SRT_100mphTm_C "SRT 0 to 100  timer - current";
CM_ SG_ 604 SRT_100mphTm_L "SRT 0 to 100 to 0 timer - last";
CM_ SG_ 604 SRT_100mphTmB "SRT 0 to 100  timer - best";
CM_ SG_ 604 SRT_100mphTmC "SRT 0 to 100  timer - current";
CM_ SG_ 604 SRT_100mphTmL "SRT 0 to 100  timer - last";
CM_ SG_ 604 SRT_60mphTm_B "SRT 0 to 60 timer - best";
CM_ SG_ 604 SRT_60mphTm_C "SRT 0 to 60 timer - current";
CM_ SG_ 604 SRT_60mphTm_L "SRT 0 to 60 timer - last";
CM_ SG_ 604 SRT_60mphTmB "SRT 0 to 60 timer - best";
CM_ SG_ 604 SRT_60mphTmC "SRT 0 to 60 timer - current";
CM_ SG_ 604 SRT_60mphTmL "SRT 0 to 60 timer - last";
CM_ SG_ 604 SRT_BrkTm_B "SRT braking timer - best";
CM_ SG_ 604 SRT_BrkTm_C "SRT braking timer - current";
CM_ SG_ 604 SRT_BrkTm_L "SRT braking timer - last";
CM_ SG_ 604 SRT_BrkTmB "SRT braking timer - best";
CM_ SG_ 604 SRT_BrkTmC "SRT braking timer - current";
CM_ SG_ 604 SRT_BrkTmL "SRT braking timer - last";
CM_ SG_ 604 SRT_eighthTm_B "SRT eighth mile timer - best";
CM_ SG_ 604 SRT_eighthTm_C "SRT eighth mile timer - current";
CM_ SG_ 604 SRT_eighthTm_L "SRT eighth mile timer - last";
CM_ SG_ 604 SRT_eighthTmB "SRT eighth mile timer - best";
CM_ SG_ 604 SRT_eighthTmC "SRT eighth mile timer - current";
CM_ SG_ 604 SRT_eighthTmL "SRT eighth mile timer - last";
CM_ SG_ 604 SRT_EthSpdB_M "SRT eighth mile speed - best in kmph";
CM_ SG_ 604 SRT_EthSpdB_US "SRT eighth mile speed - best in mph";
CM_ SG_ 604 SRT_EthSpdC_M "SRT eighth mile speed - current in kmph";
CM_ SG_ 604 SRT_EthSpdC_US "SRT eighth mile speed - current in mph";
CM_ SG_ 604 SRT_EthSpdL_M "SRT eighth mile speed - last in kmph";
CM_ SG_ 604 SRT_EthSpdL_US "SRT eighth mile speed - last in mph";
CM_ SG_ 604 SRT_QrtSpdB_M "SRT quarter mile speed - best in kmph";
CM_ SG_ 604 SRT_QrtSpdB_US "SRT quarter mile speed - best in mph";
CM_ SG_ 604 SRT_QrtSpdC_M "SRT quarter mile speed - current in kmph";
CM_ SG_ 604 SRT_QrtSpdC_US "SRT quarter mile speed - current in mph";
CM_ SG_ 604 SRT_QrtSpdL_M "SRT quarter mile speed - last in kmph";
CM_ SG_ 604 SRT_QrtSpdL_US "SRT quarter mile speed - last in mph";
CM_ SG_ 604 SRT_quarterTm_B "SRT quarter mile timer - best";
CM_ SG_ 604 SRT_quarterTm_C "SRT quarter mile timer - current";
CM_ SG_ 604 SRT_quarterTm_L "SRT quarter mile timer - last";
CM_ SG_ 604 SRT_quarterTmB "SRT quarter mile timer - best";
CM_ SG_ 604 SRT_quarterTmC "SRT quarter mile timer - current";
CM_ SG_ 604 SRT_quarterTmL "SRT quarter mile timer - last";
CM_ SG_ 604 SRT_ReactTm_B "SRT reaction time - best";
CM_ SG_ 604 SRT_ReactTm_C "SRT reaction time - current";
CM_ SG_ 604 SRT_ReactTm_L "SRT reaction time - last";
CM_ SG_ 604 SRT_ReactTmB "SRT reaction time - best";
CM_ SG_ 604 SRT_ReactTmC "SRT reaction time - current";
CM_ SG_ 604 SRT_ReactTmL "SRT reaction time - last";
CM_ SG_ 605 SRT_1000ftTm_B "SRT 1000 ft time - Best (U)";
CM_ SG_ 605 SRT_1000ftTm_C "SRT 1000 ft time - Current (U)";
CM_ SG_ 605 SRT_1000ftTm_L "SRT 1000 ft time - Last (U)";
CM_ SG_ 605 SRT_1000ftTmB "SRT 1000 ft time - Best (M)";
CM_ SG_ 605 SRT_1000ftTmC "SRT 1000 ft time - Current (M)";
CM_ SG_ 605 SRT_1000ftTmL "SRT 1000 ft time - Last (M)";
CM_ SG_ 605 SRT_330ftTm_B "SRT 300 ft time - Best (U)";
CM_ SG_ 605 SRT_330ftTm_C "SRT 300 ft time - Current (U)";
CM_ SG_ 605 SRT_330ftTm_L "SRT 300 ft time - Last (U)";
CM_ SG_ 605 SRT_330ftTmB "SRT 300 ft time - Best (M)";
CM_ SG_ 605 SRT_330ftTmC "SRT 300 ft time - Current (M)";
CM_ SG_ 605 SRT_330ftTmL "SRT 300 ft time - Last (M)";
CM_ SG_ 605 SRT_60ftTm_B "SRT 60 foot time - best";
CM_ SG_ 605 SRT_60ftTm_C "SRT 60 foot time - current";
CM_ SG_ 605 SRT_60ftTm_L "SRT 60 foot time - last";
CM_ SG_ 605 SRT_60ftTmB "SRT 60 foot time - Best (U)";
CM_ SG_ 605 SRT_60ftTmC "SRT 60 foot time - current";
CM_ SG_ 605 SRT_60ftTmL "SRT 60 foot time - last";
CM_ SG_ 605 SRT_BrkDistB_M "SRT braking distance - best in meters";
CM_ SG_ 605 SRT_BrkDistB_US "SRT braking distance - best in yards";
CM_ SG_ 605 SRT_BrkDistC_M "SRT braking distance - current in meters";
CM_ SG_ 605 SRT_BrkDistC_US "SRT braking distance - current in yards";
CM_ SG_ 605 SRT_BrkDistL_M "SRT braking distance - last in meters";
CM_ SG_ 605 SRT_BrkDistL_US "SRT braking distance - last in yards";
CM_ SG_ 605 SRT_BrkSpdB_M "SRT braking speed - best in kmph";
CM_ SG_ 605 SRT_BrkSpdB_US "SRT braking speed - best in mph";
CM_ SG_ 605 SRT_BrkSpdC_M "SRT braking speed - current in kmph";
CM_ SG_ 605 SRT_BrkSpdC_US "SRT braking speed - current in mph";
CM_ SG_ 605 SRT_BrkSpdL_M "SRT braking speed - last in kmph";
CM_ SG_ 605 SRT_BrkSpdL_US "SRT braking speed - last in mph";
CM_ SG_ 1443 Act_Lane_Mgt "Act Lane Mgt setting";
CM_ SG_ 1443 Act_Lane_Mgt_Strength "Act Lane Mgt Strength setting";
CM_ SG_ 1443 Active_Park_Mode "Active Parksense Mode setting";
CM_ SG_ 1443 Active_Park_Prox_Chime "Active Parksense Proximity Chime setting";
CM_ SG_ 1443 AmbientLightingLevel "This signal is used to give information about the Ambient Lighting Level selected";
CM_ SG_ 1443 Auto_Fold_Mirr "Auto Folding Mirror setting";
CM_ SG_ 1443 AutoHighBeamEnable "This signal is used to give information about the Auto High Beam feature selected";
CM_ SG_ 1443 AutoParkBrake "This signal is used to give information about the Auto Park Brake selected";
CM_ SG_ 1443 AutoUnlockDoorExit "This signal is used to give information about the Auto Unlock Door on Exit feature selected";
CM_ SG_ 1443 Backup_Cam_Delay "Backup Camera Delay setting";
CM_ SG_ 1443 BSDEnable "This signal is used to give information about the Blind Spot Alert feature selected";
CM_ SG_ 1443 Consum_Unit "Consumption Unit setting";
CM_ SG_ 1443 CorneringEnable "This signal is used to give information about the Cornering Lights selected";
CM_ SG_ 1443 CRC_IPCVS1 "CRC according to SAE J1850 standard at each frame transmission.";
CM_ SG_ 1443 Dist_Unit "Distance Unit setting";
CM_ SG_ 1443 DRLEnable "This signal is used to give information about the DRL feature selected";
CM_ SG_ 1443 Drowsy_Driver_Alert "Drowsy Driver Alert setting";
CM_ SG_ 1443 DynamicGrid "Rear View Camera Dynamic Gridlines request";
CM_ SG_ 1443 Easy_Exit_D "Driver Easy Exit Seat setting";
CM_ SG_ 1443 Eng_Off_Pwr_Delay "Engine Off Power Delay setting";
CM_ SG_ 1443 EPB_MaintenanceMode "This signal is used to give information about the Maintenance Mode feature selected";
CM_ SG_ 1443 FlashLightWLock "This signal is used to give information about the Flash Light With Lock selected";
CM_ SG_ 1443 FOA_AppAlert_Disable_UserReq "Forgotten Object Alert IPC disable request";
CM_ SG_ 1443 FSFCWPlusActivationMode "This signal is used to give information about the FSFCW Activation Mode setting";
CM_ SG_ 1443 FSFCWPlusSetting "This signal is used to give information about the FSFCW setting";
CM_ SG_ 1443 Fwrd_Cam_Guidelines "Forward Facing Camera Guidelines setting";
CM_ SG_ 1443 GreetingLightsEnable "This signal is used to give information about the Greeting Lights selected";
CM_ SG_ 1443 HeadlightsOffDelay "This signal is used to give information about the Headlights Off Delay selected";
CM_ SG_ 1443 HeadLightWipers "Setting to turn on/off headlights with wipers";
CM_ SG_ 1443 Hill_Start_Assist "Hill Start Assist setting";
CM_ SG_ 1443 HourMode "This signal is used to give information about the Hour Mode selected.";
CM_ SG_ 1443 HP_Unit "Horsepower Unit setting";
CM_ SG_ 1443 Illuminated_Approach "Illuminated Approach setting";
CM_ SG_ 1443 IPCProgrammed "IPC Settings Defaults Programmed Status";
CM_ SG_ 1443 LanguageSelection "This signal is used to give information about the Language selected";
CM_ SG_ 1443 LDW_Intensity "This signal is used to give information about the LDW Intensity selected";
CM_ SG_ 1443 LDW_Sensibility "This signal is used to give information about the LDW Sensibility selected";
CM_ SG_ 1443 MessageCounter_IPCVS1 "This signal is a counter used for safety checks strategies. This counter is incremented of 1 (one) unit at each frame transmission.";
CM_ SG_ 1443 NavRepetition "This signal is used to give information about the Navigation Repetition selected";
CM_ SG_ 1443 New_Spd_Zone_Ind "New Speed Zone Indication setting";
CM_ SG_ 1443 Paddle_Shifter "Paddle Shifter setting";
CM_ SG_ 1443 PamChimeVolumeFront "This signal is used to give information about the PAM  Chime Volume selected";
CM_ SG_ 1443 PamChimeVolumeRear "This signal is used to give information about the PAM 8Ch Chime Volume selected";
CM_ SG_ 1443 PassiveEntry "This signal is used to give information about the Passive Entry selected";
CM_ SG_ 1443 Ped_EM_Brk_Warn_Act "Pedestrian Emergency Braking Warning & Active Braking setting";
CM_ SG_ 1443 PhoneRepetition "This signal is used to give information about the Phone Repetition selected";
CM_ SG_ 1443 PLGAlert "Setting to turn on/off the power liftgate chime";
CM_ SG_ 1443 Power_Side_Step "Power side step setting";
CM_ SG_ 1443 Proximity_WU "Proximity Wakeup setting";
CM_ SG_ 1443 PwrLev "This signal is used to give information about the Power Level selected.";
CM_ SG_ 1443 RainSensorLevel "This signal is used to give information about the Rain Sensor Level selected";
CM_ SG_ 1443 Rdy_To_Drive "Ready to Driver Pop Up setting";
CM_ SG_ 1443 Rear_Brk_Asst "Rear Braking Assist setting";
CM_ SG_ 1443 RemoteDoorUnlock "This signal is used to give information about the Remote Door Unlock selected";
CM_ SG_ 1443 RemStNrmlStEnbl "Setting to allow seat heating and venting for all starts, remote starts, or none";
CM_ SG_ 1443 RKEMemoryLinkEnable "To enable or disable RKE linked to memory";
CM_ SG_ 1443 SOC_Max_Lev "Customer top of SOC selection.";
CM_ SG_ 1443 SoundHornLock "This signal is used to give information about the Sound Horn with Lock selected";
CM_ SG_ 1443 SoundHornRemoteStart "This signal is used to give information about the Sound Horn with Remote Start selected";
CM_ SG_ 1443 Speed_Unit "Speed Unit setting";
CM_ SG_ 1443 SpeedLockDoorEnable "This signal is used to give information about the Autoclose feature selected";
CM_ SG_ 1443 StaticGrid "Rear View Camera Static Gridlines request";
CM_ SG_ 1443 Susp_Auto_Ent_Ext "Suspension Auto Entry/Exit setting";
CM_ SG_ 1443 Susp_Disp_Message "Suspension Display Messages setting";
CM_ SG_ 1443 Susp_Flsh_Lght_Low "Suspension Flash Lights with Lower setting";
CM_ SG_ 1443 Susp_Sound_Hrn_Low "Suspension Sound Horn with Lower setting";
CM_ SG_ 1443 Susp_Tire_Jack "Suspension Tire/Jack Mode setting";
CM_ SG_ 1443 SVC_Delay "Surround View Camera Delay setting";
CM_ SG_ 1443 SVC_Guidelines "Surround View Camera Guidelines setting";
CM_ SG_ 1443 TelematicSetupACK "Used to give information about the acknowledge of the requested setup changes by telematic module.";
CM_ SG_ 1443 Temp_Unit "Temperature Unit setting";
CM_ SG_ 1443 Tilt_Mirr_Rev "Tilt Mirrors in Reverse setting";
CM_ SG_ 1443 Tire_Fill_Alert "Tire Fill Alert setting";
CM_ SG_ 1443 Torque_Unit "Torque Unit setting";
CM_ SG_ 1443 Traffic_Sign_Info "Traffic Sign Information setting";
CM_ SG_ 1443 Traffic_Sign_Warn "Traffic Sign Warning setting";
CM_ SG_ 1443 Trail_Brk_Type "Trailer Brake Type setting";
CM_ SG_ 1443 Trail_Name "Trailer Name setting";
CM_ SG_ 1443 Trail_Num "Trailer Number setting";
CM_ SG_ 1443 Trailer_detection_blind_spot "Trailer_detection_blind_spot";
CM_ SG_ 1443 TyrePress_Unit "Tyre Pressure setting";

BA_DEF_ SG_ "GenSigStartValue" INT 0 2147483647;
BA_DEF_ SG_ "GenSigInactiveValue" INT 0 2147483647;
BA_DEF_ SG_ "GenSigSendType" ENUM "NotUsed","OnWrite","OnWriteWithRepetition","OnChange","OnChangeWithRepetition","IfActive","IfActiveWithRepetition","NoSigSendType";
BA_DEF_ SG_ "SystemSignalLongSymbol" STRING ;
BA_DEF_ SG_ "GenSigTimeoutTime_AGSM" INT 0 65535;
BA_DEF_ SG_ "GenSigTimeoutTime_BCM" INT 0 65535;
BA_DEF_ SG_ "GenSigTimeoutTime_BSM" INT 0 65535;
BA_DEF_ SG_ "GenSigTimeoutTime_CADM" INT 0 65535;
BA_DEF_ SG_ "GenSigTimeoutTime_DMSM" INT 0 65535;
BA_DEF_ SG_ "GenSigTimeoutTime_DTCM" INT 0 65535;
BA_DEF_ SG_ "GenSigTimeoutTime_ECM" INT 0 65535;
BA_DEF_ SG_ "GenSigTimeoutTime_EVCU2" INT 0 65535;
BA_DEF_ SG_ "GenSigTimeoutTime_GNMM" INT 0 65535;
BA_DEF_ SG_ "GenSigTimeoutTime_HCP" INT 0 65535;
BA_DEF_ SG_ "GenSigTimeoutTime_IPC" INT 0 65535;
BA_DEF_ SG_ "GenSigTimeoutTime_RFHM" INT 0 65535;
BA_DEF_ SG_ "GenSigTimeoutTime_SGW" INT 0 65535;
BA_DEF_ SG_ "GenSigTimeoutTime_TCM" INT 0 65535;
BA_DEF_ BO_ "DiagRequest" ENUM "No","Yes";
BA_DEF_ BO_ "Type" ENUM "P","C","PE","COC","PE_Cntrl","E","E_Cntrl","OC","S","BAF","DC","EM","MM","ISO-TP","-";
BA_DEF_ BO_ "DiagResponse" ENUM "No","Yes";
BA_DEF_ BO_ "NmMessage" ENUM "No","Yes";
BA_DEF_ BO_ "GenMsgSendType" ENUM "Cyclic","NotUsed","NotUsed","NotUsed","NotUsed","NotUsed","NotUsed","NotUsed","NoMsgSendType";
BA_DEF_ BO_ "GenMsgNrOfRepetition" INT 0 255;
BA_DEF_ BO_ "GenMsgILSupport" ENUM "No","Yes";
BA_DEF_ BO_ "GenMsgStartDelayTime" INT 0 65535;
BA_DEF_ BO_ "GenMsgCycleTimeFast" INT 0 65535;
BA_DEF_ BO_ "GenMsgCycleTime" INT 0 65535;
BA_DEF_ BO_ "GenMsgDelayTime" INT 0 65535;
BA_DEF_ BO_ "NmAsrMessage" ENUM "No","Yes";
BA_DEF_ BO_ "DiagState" ENUM "No","Yes";
BA_DEF_ BO_ "DiagConnection" HEX 0 65535;
BA_DEF_ BO_ "VFrameFormat" ENUM "StandardCAN","ExtendedCAN","reserved","reserved","reserved","reserved","reserved","reserved","reserved","reserved","reserved","reserved","reserved","reserved","StandardCAN_FD","ExtendedCAN_FD";
BA_DEF_ BO_ "CANFD_BRS" ENUM "0","1";
BA_DEF_DEF_ "DiagRequest" "No";
BA_DEF_DEF_ "Type" "-";
BA_DEF_DEF_ "DiagResponse" "No";
BA_DEF_DEF_ "NmMessage" "No";
BA_DEF_DEF_ "GenMsgSendType" "NoMsgSendType";
BA_DEF_DEF_ "GenMsgNrOfRepetition" 0;
BA_DEF_DEF_ "GenMsgILSupport" "No";
BA_DEF_DEF_ "GenMsgStartDelayTime" 0;
BA_DEF_DEF_ "GenMsgCycleTimeFast" 0;
BA_DEF_DEF_ "GenMsgCycleTime" 0;
BA_DEF_DEF_ "GenMsgDelayTime" 0;
BA_DEF_DEF_ "NmAsrMessage" "No";
BA_DEF_DEF_ "DiagState" "No";
BA_DEF_DEF_ "DiagConnection" 0;
BA_DEF_DEF_ "VFrameFormat" "StandardCAN_FD";
BA_DEF_DEF_ "CANFD_BRS" "0";
BA_DEF_DEF_ "GenSigStartValue" 0;
BA_DEF_DEF_ "GenSigInactiveValue" 0;
BA_DEF_DEF_ "GenSigSendType" "NoSigSendType";
BA_DEF_DEF_ "SystemSignalLongSymbol" "";
BA_DEF_DEF_ "GenSigTimeoutTime_AGSM" 2500;
BA_DEF_DEF_ "GenSigTimeoutTime_BCM" 2500;
BA_DEF_DEF_ "GenSigTimeoutTime_BSM" 2500;
BA_DEF_DEF_ "GenSigTimeoutTime_CADM" 2500;
BA_DEF_DEF_ "GenSigTimeoutTime_DMSM" 2500;
BA_DEF_DEF_ "GenSigTimeoutTime_DTCM" 2500;
BA_DEF_DEF_ "GenSigTimeoutTime_ECM" 2500;
BA_DEF_DEF_ "GenSigTimeoutTime_EVCU2" 2500;
BA_DEF_DEF_ "GenSigTimeoutTime_GNMM" 2500;
BA_DEF_DEF_ "GenSigTimeoutTime_HCP" 2500;
BA_DEF_DEF_ "GenSigTimeoutTime_IPC" 2500;
BA_DEF_DEF_ "GenSigTimeoutTime_RFHM" 2500;
BA_DEF_DEF_ "GenSigTimeoutTime_SGW" 2500;
BA_DEF_DEF_ "GenSigTimeoutTime_TCM" 2500;
BA_ "Type" BO_ 1432 3;
BA_ "GenMsgSendType" BO_ 1432 0;
BA_ "GenMsgNrOfRepetition" BO_ 1432 2;
BA_ "GenMsgILSupport" BO_ 1432 1;
BA_ "GenMsgCycleTimeFast" BO_ 1432 20;
BA_ "GenMsgCycleTime" BO_ 1432 1000;
BA_ "GenMsgDelayTime" BO_ 1432 20;
BA_ "CANFD_BRS" BO_ 1432 1;
BA_ "Type" BO_ 1897 1;
BA_ "GenMsgSendType" BO_ 1897 0;
BA_ "GenMsgNrOfRepetition" BO_ 1897 2;
BA_ "GenMsgILSupport" BO_ 1897 1;
BA_ "GenMsgCycleTimeFast" BO_ 1897 20;
BA_ "GenMsgCycleTime" BO_ 1897 1000;
BA_ "GenMsgDelayTime" BO_ 1897 20;
BA_ "CANFD_BRS" BO_ 1897 1;
BA_ "Type" BO_ 604 3;
BA_ "GenMsgSendType" BO_ 604 0;
BA_ "GenMsgNrOfRepetition" BO_ 604 2;
BA_ "GenMsgILSupport" BO_ 604 1;
BA_ "GenMsgCycleTimeFast" BO_ 604 20;
BA_ "GenMsgCycleTime" BO_ 604 1000;
BA_ "GenMsgDelayTime" BO_ 604 20;
BA_ "CANFD_BRS" BO_ 604 1;
BA_ "Type" BO_ 605 3;
BA_ "GenMsgSendType" BO_ 605 0;
BA_ "GenMsgNrOfRepetition" BO_ 605 2;
BA_ "GenMsgILSupport" BO_ 605 1;
BA_ "GenMsgCycleTimeFast" BO_ 605 20;
BA_ "GenMsgCycleTime" BO_ 605 1000;
BA_ "GenMsgDelayTime" BO_ 605 20;
BA_ "CANFD_BRS" BO_ 605 1;
BA_ "Type" BO_ 1443 3;
BA_ "GenMsgSendType" BO_ 1443 0;
BA_ "GenMsgNrOfRepetition" BO_ 1443 2;
BA_ "GenMsgILSupport" BO_ 1443 1;
BA_ "GenMsgCycleTimeFast" BO_ 1443 20;
BA_ "GenMsgCycleTime" BO_ 1443 1000;
BA_ "GenMsgDelayTime" BO_ 1443 20;
BA_ "CANFD_BRS" BO_ 1443 1;
BA_ "GenSigSendType" SG_ 1432 AverageFuelConsumptionAPlus 3;
BA_ "GenSigTimeoutTime_AGSM" SG_ 1432 AverageFuelConsumptionAPlus 0;
BA_ "GenSigTimeoutTime_BCM" SG_ 1432 AverageFuelConsumptionAPlus 0;
BA_ "GenSigTimeoutTime_BSM" SG_ 1432 AverageFuelConsumptionAPlus 0;
BA_ "GenSigTimeoutTime_CADM" SG_ 1432 AverageFuelConsumptionAPlus 0;
BA_ "GenSigTimeoutTime_DMSM" SG_ 1432 AverageFuelConsumptionAPlus 0;
BA_ "GenSigTimeoutTime_DTCM" SG_ 1432 AverageFuelConsumptionAPlus 0;
BA_ "GenSigTimeoutTime_ECM" SG_ 1432 AverageFuelConsumptionAPlus 0;
BA_ "GenSigTimeoutTime_EVCU2" SG_ 1432 AverageFuelConsumptionAPlus 0;
BA_ "GenSigTimeoutTime_GNMM" SG_ 1432 AverageFuelConsumptionAPlus 0;
BA_ "GenSigTimeoutTime_HCP" SG_ 1432 AverageFuelConsumptionAPlus 0;
BA_ "GenSigTimeoutTime_IPC" SG_ 1432 AverageFuelConsumptionAPlus 0;
BA_ "GenSigTimeoutTime_RFHM" SG_ 1432 AverageFuelConsumptionAPlus 0;
BA_ "GenSigTimeoutTime_TCM" SG_ 1432 AverageFuelConsumptionAPlus 0;
BA_ "GenSigSendType" SG_ 1432 AverageFuelConsumptionBPlus 3;
BA_ "GenSigTimeoutTime_AGSM" SG_ 1432 AverageFuelConsumptionBPlus 0;
BA_ "GenSigTimeoutTime_BCM" SG_ 1432 AverageFuelConsumptionBPlus 0;
BA_ "GenSigTimeoutTime_BSM" SG_ 1432 AverageFuelConsumptionBPlus 0;
BA_ "GenSigTimeoutTime_CADM" SG_ 1432 AverageFuelConsumptionBPlus 0;
BA_ "GenSigTimeoutTime_DMSM" SG_ 1432 AverageFuelConsumptionBPlus 0;
BA_ "GenSigTimeoutTime_DTCM" SG_ 1432 AverageFuelConsumptionBPlus 0;
BA_ "GenSigTimeoutTime_ECM" SG_ 1432 AverageFuelConsumptionBPlus 0;
BA_ "GenSigTimeoutTime_EVCU2" SG_ 1432 AverageFuelConsumptionBPlus 0;
BA_ "GenSigTimeoutTime_GNMM" SG_ 1432 AverageFuelConsumptionBPlus 0;
BA_ "GenSigTimeoutTime_HCP" SG_ 1432 AverageFuelConsumptionBPlus 0;
BA_ "GenSigTimeoutTime_IPC" SG_ 1432 AverageFuelConsumptionBPlus 0;
BA_ "GenSigTimeoutTime_RFHM" SG_ 1432 AverageFuelConsumptionBPlus 0;
BA_ "GenSigTimeoutTime_TCM" SG_ 1432 AverageFuelConsumptionBPlus 0;
BA_ "GenSigTimeoutTime_AGSM" SG_ 1432 CRC_IPC6 0;
BA_ "GenSigTimeoutTime_BSM" SG_ 1432 CRC_IPC6 0;
BA_ "GenSigTimeoutTime_DMSM" SG_ 1432 CRC_IPC6 0;
BA_ "GenSigTimeoutTime_DTCM" SG_ 1432 CRC_IPC6 0;
BA_ "GenSigTimeoutTime_ECM" SG_ 1432 CRC_IPC6 0;
BA_ "GenSigTimeoutTime_EVCU2" SG_ 1432 CRC_IPC6 0;
BA_ "GenSigTimeoutTime_GNMM" SG_ 1432 CRC_IPC6 0;
BA_ "GenSigTimeoutTime_HCP" SG_ 1432 CRC_IPC6 0;
BA_ "GenSigTimeoutTime_IPC" SG_ 1432 CRC_IPC6 0;
BA_ "GenSigTimeoutTime_RFHM" SG_ 1432 CRC_IPC6 0;
BA_ "GenSigTimeoutTime_SGW" SG_ 1432 CRC_IPC6 0;
BA_ "GenSigTimeoutTime_TCM" SG_ 1432 CRC_IPC6 0;
BA_ "GenSigSendType" SG_ 1432 HAS_SoH_IPC 3;
BA_ "GenSigTimeoutTime_AGSM" SG_ 1432 HAS_SoH_IPC 0;
BA_ "GenSigTimeoutTime_BSM" SG_ 1432 HAS_SoH_IPC 0;
BA_ "GenSigTimeoutTime_DMSM" SG_ 1432 HAS_SoH_IPC 0;
BA_ "GenSigTimeoutTime_DTCM" SG_ 1432 HAS_SoH_IPC 0;
BA_ "GenSigTimeoutTime_ECM" SG_ 1432 HAS_SoH_IPC 0;
BA_ "GenSigTimeoutTime_EVCU2" SG_ 1432 HAS_SoH_IPC 0;
BA_ "GenSigTimeoutTime_GNMM" SG_ 1432 HAS_SoH_IPC 0;
BA_ "GenSigTimeoutTime_HCP" SG_ 1432 HAS_SoH_IPC 0;
BA_ "GenSigTimeoutTime_IPC" SG_ 1432 HAS_SoH_IPC 0;
BA_ "GenSigTimeoutTime_RFHM" SG_ 1432 HAS_SoH_IPC 0;
BA_ "GenSigTimeoutTime_SGW" SG_ 1432 HAS_SoH_IPC 0;
BA_ "GenSigTimeoutTime_TCM" SG_ 1432 HAS_SoH_IPC 0;
BA_ "GenSigTimeoutTime_AGSM" SG_ 1432 MessageCounter_IPC6 0;
BA_ "GenSigTimeoutTime_BSM" SG_ 1432 MessageCounter_IPC6 0;
BA_ "GenSigTimeoutTime_DMSM" SG_ 1432 MessageCounter_IPC6 0;
BA_ "GenSigTimeoutTime_DTCM" SG_ 1432 MessageCounter_IPC6 0;
BA_ "GenSigTimeoutTime_ECM" SG_ 1432 MessageCounter_IPC6 0;
BA_ "GenSigTimeoutTime_EVCU2" SG_ 1432 MessageCounter_IPC6 0;
BA_ "GenSigTimeoutTime_GNMM" SG_ 1432 MessageCounter_IPC6 0;
BA_ "GenSigTimeoutTime_HCP" SG_ 1432 MessageCounter_IPC6 0;
BA_ "GenSigTimeoutTime_IPC" SG_ 1432 MessageCounter_IPC6 0;
BA_ "GenSigTimeoutTime_RFHM" SG_ 1432 MessageCounter_IPC6 0;
BA_ "GenSigTimeoutTime_SGW" SG_ 1432 MessageCounter_IPC6 0;
BA_ "GenSigTimeoutTime_TCM" SG_ 1432 MessageCounter_IPC6 0;
BA_ "GenSigSendType" SG_ 1432 PartialOdometerAPlus 3;
BA_ "GenSigTimeoutTime_AGSM" SG_ 1432 PartialOdometerAPlus 0;
BA_ "GenSigTimeoutTime_BCM" SG_ 1432 PartialOdometerAPlus 0;
BA_ "GenSigTimeoutTime_BSM" SG_ 1432 PartialOdometerAPlus 0;
BA_ "GenSigTimeoutTime_CADM" SG_ 1432 PartialOdometerAPlus 0;
BA_ "GenSigTimeoutTime_DMSM" SG_ 1432 PartialOdometerAPlus 0;
BA_ "GenSigTimeoutTime_DTCM" SG_ 1432 PartialOdometerAPlus 0;
BA_ "GenSigTimeoutTime_ECM" SG_ 1432 PartialOdometerAPlus 0;
BA_ "GenSigTimeoutTime_EVCU2" SG_ 1432 PartialOdometerAPlus 0;
BA_ "GenSigTimeoutTime_GNMM" SG_ 1432 PartialOdometerAPlus 0;
BA_ "GenSigTimeoutTime_HCP" SG_ 1432 PartialOdometerAPlus 0;
BA_ "GenSigTimeoutTime_IPC" SG_ 1432 PartialOdometerAPlus 0;
BA_ "GenSigTimeoutTime_RFHM" SG_ 1432 PartialOdometerAPlus 0;
BA_ "GenSigTimeoutTime_TCM" SG_ 1432 PartialOdometerAPlus 0;
BA_ "GenSigSendType" SG_ 1432 PartialOdometerBPlus 3;
BA_ "GenSigTimeoutTime_AGSM" SG_ 1432 PartialOdometerBPlus 0;
BA_ "GenSigTimeoutTime_BCM" SG_ 1432 PartialOdometerBPlus 0;
BA_ "GenSigTimeoutTime_BSM" SG_ 1432 PartialOdometerBPlus 0;
BA_ "GenSigTimeoutTime_CADM" SG_ 1432 PartialOdometerBPlus 0;
BA_ "GenSigTimeoutTime_DMSM" SG_ 1432 PartialOdometerBPlus 0;
BA_ "GenSigTimeoutTime_DTCM" SG_ 1432 PartialOdometerBPlus 0;
BA_ "GenSigTimeoutTime_ECM" SG_ 1432 PartialOdometerBPlus 0;
BA_ "GenSigTimeoutTime_EVCU2" SG_ 1432 PartialOdometerBPlus 0;
BA_ "GenSigTimeoutTime_GNMM" SG_ 1432 PartialOdometerBPlus 0;
BA_ "GenSigTimeoutTime_HCP" SG_ 1432 PartialOdometerBPlus 0;
BA_ "GenSigTimeoutTime_IPC" SG_ 1432 PartialOdometerBPlus 0;
BA_ "GenSigTimeoutTime_RFHM" SG_ 1432 PartialOdometerBPlus 0;
BA_ "GenSigTimeoutTime_TCM" SG_ 1432 PartialOdometerBPlus 0;
BA_ "GenSigSendType" SG_ 1432 PowerMode_RQ 3;
BA_ "GenSigTimeoutTime_AGSM" SG_ 1432 PowerMode_RQ 0;
BA_ "GenSigTimeoutTime_BSM" SG_ 1432 PowerMode_RQ 0;
BA_ "GenSigTimeoutTime_CADM" SG_ 1432 PowerMode_RQ 0;
BA_ "GenSigTimeoutTime_DMSM" SG_ 1432 PowerMode_RQ 0;
BA_ "GenSigTimeoutTime_DTCM" SG_ 1432 PowerMode_RQ 0;
BA_ "GenSigTimeoutTime_ECM" SG_ 1432 PowerMode_RQ 0;
BA_ "GenSigTimeoutTime_EVCU2" SG_ 1432 PowerMode_RQ 0;
BA_ "GenSigTimeoutTime_GNMM" SG_ 1432 PowerMode_RQ 0;
BA_ "GenSigTimeoutTime_HCP" SG_ 1432 PowerMode_RQ 0;
BA_ "GenSigTimeoutTime_IPC" SG_ 1432 PowerMode_RQ 0;
BA_ "GenSigTimeoutTime_RFHM" SG_ 1432 PowerMode_RQ 0;
BA_ "GenSigTimeoutTime_SGW" SG_ 1432 PowerMode_RQ 0;
BA_ "GenSigTimeoutTime_TCM" SG_ 1432 PowerMode_RQ 0;
BA_ "GenSigSendType" SG_ 1432 TravelingTimeAPlus_Hour 3;
BA_ "GenSigTimeoutTime_AGSM" SG_ 1432 TravelingTimeAPlus_Hour 0;
BA_ "GenSigTimeoutTime_BCM" SG_ 1432 TravelingTimeAPlus_Hour 0;
BA_ "GenSigTimeoutTime_BSM" SG_ 1432 TravelingTimeAPlus_Hour 0;
BA_ "GenSigTimeoutTime_CADM" SG_ 1432 TravelingTimeAPlus_Hour 0;
BA_ "GenSigTimeoutTime_DMSM" SG_ 1432 TravelingTimeAPlus_Hour 0;
BA_ "GenSigTimeoutTime_DTCM" SG_ 1432 TravelingTimeAPlus_Hour 0;
BA_ "GenSigTimeoutTime_ECM" SG_ 1432 TravelingTimeAPlus_Hour 0;
BA_ "GenSigTimeoutTime_EVCU2" SG_ 1432 TravelingTimeAPlus_Hour 0;
BA_ "GenSigTimeoutTime_GNMM" SG_ 1432 TravelingTimeAPlus_Hour 0;
BA_ "GenSigTimeoutTime_HCP" SG_ 1432 TravelingTimeAPlus_Hour 0;
BA_ "GenSigTimeoutTime_IPC" SG_ 1432 TravelingTimeAPlus_Hour 0;
BA_ "GenSigTimeoutTime_RFHM" SG_ 1432 TravelingTimeAPlus_Hour 0;
BA_ "GenSigTimeoutTime_TCM" SG_ 1432 TravelingTimeAPlus_Hour 0;
BA_ "GenSigSendType" SG_ 1432 TravelingTimeAPlus_Minute 3;
BA_ "GenSigTimeoutTime_AGSM" SG_ 1432 TravelingTimeAPlus_Minute 0;
BA_ "GenSigTimeoutTime_BCM" SG_ 1432 TravelingTimeAPlus_Minute 0;
BA_ "GenSigTimeoutTime_BSM" SG_ 1432 TravelingTimeAPlus_Minute 0;
BA_ "GenSigTimeoutTime_CADM" SG_ 1432 TravelingTimeAPlus_Minute 0;
BA_ "GenSigTimeoutTime_DMSM" SG_ 1432 TravelingTimeAPlus_Minute 0;
BA_ "GenSigTimeoutTime_DTCM" SG_ 1432 TravelingTimeAPlus_Minute 0;
BA_ "GenSigTimeoutTime_ECM" SG_ 1432 TravelingTimeAPlus_Minute 0;
BA_ "GenSigTimeoutTime_EVCU2" SG_ 1432 TravelingTimeAPlus_Minute 0;
BA_ "GenSigTimeoutTime_GNMM" SG_ 1432 TravelingTimeAPlus_Minute 0;
BA_ "GenSigTimeoutTime_HCP" SG_ 1432 TravelingTimeAPlus_Minute 0;
BA_ "GenSigTimeoutTime_IPC" SG_ 1432 TravelingTimeAPlus_Minute 0;
BA_ "GenSigTimeoutTime_RFHM" SG_ 1432 TravelingTimeAPlus_Minute 0;
BA_ "GenSigTimeoutTime_TCM" SG_ 1432 TravelingTimeAPlus_Minute 0;
BA_ "GenSigTimeoutTime_AGSM" SG_ 1432 TravelingTimeAPlus_Second 0;
BA_ "GenSigTimeoutTime_BCM" SG_ 1432 TravelingTimeAPlus_Second 0;
BA_ "GenSigTimeoutTime_BSM" SG_ 1432 TravelingTimeAPlus_Second 0;
BA_ "GenSigTimeoutTime_CADM" SG_ 1432 TravelingTimeAPlus_Second 0;
BA_ "GenSigTimeoutTime_DMSM" SG_ 1432 TravelingTimeAPlus_Second 0;
BA_ "GenSigTimeoutTime_DTCM" SG_ 1432 TravelingTimeAPlus_Second 0;
BA_ "GenSigTimeoutTime_ECM" SG_ 1432 TravelingTimeAPlus_Second 0;
BA_ "GenSigTimeoutTime_EVCU2" SG_ 1432 TravelingTimeAPlus_Second 0;
BA_ "GenSigTimeoutTime_GNMM" SG_ 1432 TravelingTimeAPlus_Second 0;
BA_ "GenSigTimeoutTime_HCP" SG_ 1432 TravelingTimeAPlus_Second 0;
BA_ "GenSigTimeoutTime_IPC" SG_ 1432 TravelingTimeAPlus_Second 0;
BA_ "GenSigTimeoutTime_RFHM" SG_ 1432 TravelingTimeAPlus_Second 0;
BA_ "GenSigTimeoutTime_TCM" SG_ 1432 TravelingTimeAPlus_Second 0;
BA_ "GenSigSendType" SG_ 1432 TravelingTimeBPlus_Hour 3;
BA_ "GenSigTimeoutTime_AGSM" SG_ 1432 TravelingTimeBPlus_Hour 0;
BA_ "GenSigTimeoutTime_BCM" SG_ 1432 TravelingTimeBPlus_Hour 0;
BA_ "GenSigTimeoutTime_BSM" SG_ 1432 TravelingTimeBPlus_Hour 0;
BA_ "GenSigTimeoutTime_CADM" SG_ 1432 TravelingTimeBPlus_Hour 0;
BA_ "GenSigTimeoutTime_DMSM" SG_ 1432 TravelingTimeBPlus_Hour 0;
BA_ "GenSigTimeoutTime_DTCM" SG_ 1432 TravelingTimeBPlus_Hour 0;
BA_ "GenSigTimeoutTime_ECM" SG_ 1432 TravelingTimeBPlus_Hour 0;
BA_ "GenSigTimeoutTime_EVCU2" SG_ 1432 TravelingTimeBPlus_Hour 0;
BA_ "GenSigTimeoutTime_GNMM" SG_ 1432 TravelingTimeBPlus_Hour 0;
BA_ "GenSigTimeoutTime_HCP" SG_ 1432 TravelingTimeBPlus_Hour 0;
BA_ "GenSigTimeoutTime_IPC" SG_ 1432 TravelingTimeBPlus_Hour 0;
BA_ "GenSigTimeoutTime_RFHM" SG_ 1432 TravelingTimeBPlus_Hour 0;
BA_ "GenSigTimeoutTime_TCM" SG_ 1432 TravelingTimeBPlus_Hour 0;
BA_ "GenSigSendType" SG_ 1432 TravelingTimeBPlus_Minute 3;
BA_ "GenSigTimeoutTime_AGSM" SG_ 1432 TravelingTimeBPlus_Minute 0;
BA_ "GenSigTimeoutTime_BCM" SG_ 1432 TravelingTimeBPlus_Minute 0;
BA_ "GenSigTimeoutTime_BSM" SG_ 1432 TravelingTimeBPlus_Minute 0;
BA_ "GenSigTimeoutTime_CADM" SG_ 1432 TravelingTimeBPlus_Minute 0;
BA_ "GenSigTimeoutTime_DMSM" SG_ 1432 TravelingTimeBPlus_Minute 0;
BA_ "GenSigTimeoutTime_DTCM" SG_ 1432 TravelingTimeBPlus_Minute 0;
BA_ "GenSigTimeoutTime_ECM" SG_ 1432 TravelingTimeBPlus_Minute 0;
BA_ "GenSigTimeoutTime_EVCU2" SG_ 1432 TravelingTimeBPlus_Minute 0;
BA_ "GenSigTimeoutTime_GNMM" SG_ 1432 TravelingTimeBPlus_Minute 0;
BA_ "GenSigTimeoutTime_HCP" SG_ 1432 TravelingTimeBPlus_Minute 0;
BA_ "GenSigTimeoutTime_IPC" SG_ 1432 TravelingTimeBPlus_Minute 0;
BA_ "GenSigTimeoutTime_RFHM" SG_ 1432 TravelingTimeBPlus_Minute 0;
BA_ "GenSigTimeoutTime_TCM" SG_ 1432 TravelingTimeBPlus_Minute 0;
BA_ "GenSigTimeoutTime_AGSM" SG_ 1432 TravelingTimeBPlus_Second 0;
BA_ "GenSigTimeoutTime_BCM" SG_ 1432 TravelingTimeBPlus_Second 0;
BA_ "GenSigTimeoutTime_BSM" SG_ 1432 TravelingTimeBPlus_Second 0;
BA_ "GenSigTimeoutTime_CADM" SG_ 1432 TravelingTimeBPlus_Second 0;
BA_ "GenSigTimeoutTime_DMSM" SG_ 1432 TravelingTimeBPlus_Second 0;
BA_ "GenSigTimeoutTime_DTCM" SG_ 1432 TravelingTimeBPlus_Second 0;
BA_ "GenSigTimeoutTime_ECM" SG_ 1432 TravelingTimeBPlus_Second 0;
BA_ "GenSigTimeoutTime_EVCU2" SG_ 1432 TravelingTimeBPlus_Second 0;
BA_ "GenSigTimeoutTime_GNMM" SG_ 1432 TravelingTimeBPlus_Second 0;
BA_ "GenSigTimeoutTime_HCP" SG_ 1432 TravelingTimeBPlus_Second 0;
BA_ "GenSigTimeoutTime_IPC" SG_ 1432 TravelingTimeBPlus_Second 0;
BA_ "GenSigTimeoutTime_RFHM" SG_ 1432 TravelingTimeBPlus_Second 0;
BA_ "GenSigTimeoutTime_TCM" SG_ 1432 TravelingTimeBPlus_Second 0;
BA_ "GenSigSendType" SG_ 1432 TrlrLgtChkReq 3;
BA_ "GenSigTimeoutTime_AGSM" SG_ 1432 TrlrLgtChkReq 0;
BA_ "GenSigTimeoutTime_BSM" SG_ 1432 TrlrLgtChkReq 0;
BA_ "GenSigTimeoutTime_CADM" SG_ 1432 TrlrLgtChkReq 0;
BA_ "GenSigTimeoutTime_DMSM" SG_ 1432 TrlrLgtChkReq 0;
BA_ "GenSigTimeoutTime_DTCM" SG_ 1432 TrlrLgtChkReq 0;
BA_ "GenSigTimeoutTime_ECM" SG_ 1432 TrlrLgtChkReq 0;
BA_ "GenSigTimeoutTime_EVCU2" SG_ 1432 TrlrLgtChkReq 0;
BA_ "GenSigTimeoutTime_GNMM" SG_ 1432 TrlrLgtChkReq 0;
BA_ "GenSigTimeoutTime_HCP" SG_ 1432 TrlrLgtChkReq 0;
BA_ "GenSigTimeoutTime_IPC" SG_ 1432 TrlrLgtChkReq 0;
BA_ "GenSigTimeoutTime_RFHM" SG_ 1432 TrlrLgtChkReq 0;
BA_ "GenSigTimeoutTime_SGW" SG_ 1432 TrlrLgtChkReq 0;
BA_ "GenSigTimeoutTime_TCM" SG_ 1432 TrlrLgtChkReq 0;
BA_ "GenSigTimeoutTime_AGSM" SG_ 1897 VehPerfAccelPeak_X_Neg 0;
BA_ "GenSigTimeoutTime_BCM" SG_ 1897 VehPerfAccelPeak_X_Neg 0;
BA_ "GenSigTimeoutTime_BSM" SG_ 1897 VehPerfAccelPeak_X_Neg 0;
BA_ "GenSigTimeoutTime_CADM" SG_ 1897 VehPerfAccelPeak_X_Neg 0;
BA_ "GenSigTimeoutTime_DMSM" SG_ 1897 VehPerfAccelPeak_X_Neg 0;
BA_ "GenSigTimeoutTime_DTCM" SG_ 1897 VehPerfAccelPeak_X_Neg 0;
BA_ "GenSigTimeoutTime_ECM" SG_ 1897 VehPerfAccelPeak_X_Neg 0;
BA_ "GenSigTimeoutTime_EVCU2" SG_ 1897 VehPerfAccelPeak_X_Neg 0;
BA_ "GenSigTimeoutTime_GNMM" SG_ 1897 VehPerfAccelPeak_X_Neg 0;
BA_ "GenSigTimeoutTime_HCP" SG_ 1897 VehPerfAccelPeak_X_Neg 0;
BA_ "GenSigTimeoutTime_IPC" SG_ 1897 VehPerfAccelPeak_X_Neg 0;
BA_ "GenSigTimeoutTime_RFHM" SG_ 1897 VehPerfAccelPeak_X_Neg 0;
BA_ "GenSigTimeoutTime_TCM" SG_ 1897 VehPerfAccelPeak_X_Neg 0;
BA_ "GenSigTimeoutTime_AGSM" SG_ 1897 VehPerfAccelPeak_X_Pos 0;
BA_ "GenSigTimeoutTime_BCM" SG_ 1897 VehPerfAccelPeak_X_Pos 0;
BA_ "GenSigTimeoutTime_BSM" SG_ 1897 VehPerfAccelPeak_X_Pos 0;
BA_ "GenSigTimeoutTime_CADM" SG_ 1897 VehPerfAccelPeak_X_Pos 0;
BA_ "GenSigTimeoutTime_DMSM" SG_ 1897 VehPerfAccelPeak_X_Pos 0;
BA_ "GenSigTimeoutTime_DTCM" SG_ 1897 VehPerfAccelPeak_X_Pos 0;
BA_ "GenSigTimeoutTime_ECM" SG_ 1897 VehPerfAccelPeak_X_Pos 0;
BA_ "GenSigTimeoutTime_EVCU2" SG_ 1897 VehPerfAccelPeak_X_Pos 0;
BA_ "GenSigTimeoutTime_GNMM" SG_ 1897 VehPerfAccelPeak_X_Pos 0;
BA_ "GenSigTimeoutTime_HCP" SG_ 1897 VehPerfAccelPeak_X_Pos 0;
BA_ "GenSigTimeoutTime_IPC" SG_ 1897 VehPerfAccelPeak_X_Pos 0;
BA_ "GenSigTimeoutTime_RFHM" SG_ 1897 VehPerfAccelPeak_X_Pos 0;
BA_ "GenSigTimeoutTime_TCM" SG_ 1897 VehPerfAccelPeak_X_Pos 0;
BA_ "GenSigTimeoutTime_AGSM" SG_ 1897 VehPerfAccelPeak_Y_Neg 0;
BA_ "GenSigTimeoutTime_BCM" SG_ 1897 VehPerfAccelPeak_Y_Neg 0;
BA_ "GenSigTimeoutTime_BSM" SG_ 1897 VehPerfAccelPeak_Y_Neg 0;
BA_ "GenSigTimeoutTime_CADM" SG_ 1897 VehPerfAccelPeak_Y_Neg 0;
BA_ "GenSigTimeoutTime_DMSM" SG_ 1897 VehPerfAccelPeak_Y_Neg 0;
BA_ "GenSigTimeoutTime_DTCM" SG_ 1897 VehPerfAccelPeak_Y_Neg 0;
BA_ "GenSigTimeoutTime_ECM" SG_ 1897 VehPerfAccelPeak_Y_Neg 0;
BA_ "GenSigTimeoutTime_EVCU2" SG_ 1897 VehPerfAccelPeak_Y_Neg 0;
BA_ "GenSigTimeoutTime_GNMM" SG_ 1897 VehPerfAccelPeak_Y_Neg 0;
BA_ "GenSigTimeoutTime_HCP" SG_ 1897 VehPerfAccelPeak_Y_Neg 0;
BA_ "GenSigTimeoutTime_IPC" SG_ 1897 VehPerfAccelPeak_Y_Neg 0;
BA_ "GenSigTimeoutTime_RFHM" SG_ 1897 VehPerfAccelPeak_Y_Neg 0;
BA_ "GenSigTimeoutTime_TCM" SG_ 1897 VehPerfAccelPeak_Y_Neg 0;
BA_ "GenSigTimeoutTime_AGSM" SG_ 1897 VehPerfAccelPeak_Y_Pos 0;
BA_ "GenSigTimeoutTime_BCM" SG_ 1897 VehPerfAccelPeak_Y_Pos 0;
BA_ "GenSigTimeoutTime_BSM" SG_ 1897 VehPerfAccelPeak_Y_Pos 0;
BA_ "GenSigTimeoutTime_CADM" SG_ 1897 VehPerfAccelPeak_Y_Pos 0;
BA_ "GenSigTimeoutTime_DMSM" SG_ 1897 VehPerfAccelPeak_Y_Pos 0;
BA_ "GenSigTimeoutTime_DTCM" SG_ 1897 VehPerfAccelPeak_Y_Pos 0;
BA_ "GenSigTimeoutTime_ECM" SG_ 1897 VehPerfAccelPeak_Y_Pos 0;
BA_ "GenSigTimeoutTime_EVCU2" SG_ 1897 VehPerfAccelPeak_Y_Pos 0;
BA_ "GenSigTimeoutTime_GNMM" SG_ 1897 VehPerfAccelPeak_Y_Pos 0;
BA_ "GenSigTimeoutTime_HCP" SG_ 1897 VehPerfAccelPeak_Y_Pos 0;
BA_ "GenSigTimeoutTime_IPC" SG_ 1897 VehPerfAccelPeak_Y_Pos 0;
BA_ "GenSigTimeoutTime_RFHM" SG_ 1897 VehPerfAccelPeak_Y_Pos 0;
BA_ "GenSigTimeoutTime_TCM" SG_ 1897 VehPerfAccelPeak_Y_Pos 0;
BA_ "GenSigStartValue" SG_ 604 SRT_100mphTm_B 255;
BA_ "GenSigSendType" SG_ 604 SRT_100mphTm_B 3;
BA_ "GenSigTimeoutTime_AGSM" SG_ 604 SRT_100mphTm_B 0;
BA_ "GenSigTimeoutTime_BCM" SG_ 604 SRT_100mphTm_B 0;
BA_ "GenSigTimeoutTime_BSM" SG_ 604 SRT_100mphTm_B 0;
BA_ "GenSigTimeoutTime_CADM" SG_ 604 SRT_100mphTm_B 0;
BA_ "GenSigTimeoutTime_DMSM" SG_ 604 SRT_100mphTm_B 0;
BA_ "GenSigTimeoutTime_DTCM" SG_ 604 SRT_100mphTm_B 0;
BA_ "GenSigTimeoutTime_ECM" SG_ 604 SRT_100mphTm_B 0;
BA_ "GenSigTimeoutTime_EVCU2" SG_ 604 SRT_100mphTm_B 0;
BA_ "GenSigTimeoutTime_GNMM" SG_ 604 SRT_100mphTm_B 0;
BA_ "GenSigTimeoutTime_HCP" SG_ 604 SRT_100mphTm_B 0;
BA_ "GenSigTimeoutTime_IPC" SG_ 604 SRT_100mphTm_B 0;
BA_ "GenSigTimeoutTime_RFHM" SG_ 604 SRT_100mphTm_B 0;
BA_ "GenSigTimeoutTime_TCM" SG_ 604 SRT_100mphTm_B 0;
BA_ "GenSigStartValue" SG_ 604 SRT_100mphTm_C 255;
BA_ "GenSigSendType" SG_ 604 SRT_100mphTm_C 3;
BA_ "GenSigTimeoutTime_AGSM" SG_ 604 SRT_100mphTm_C 0;
BA_ "GenSigTimeoutTime_BCM" SG_ 604 SRT_100mphTm_C 0;
BA_ "GenSigTimeoutTime_BSM" SG_ 604 SRT_100mphTm_C 0;
BA_ "GenSigTimeoutTime_CADM" SG_ 604 SRT_100mphTm_C 0;
BA_ "GenSigTimeoutTime_DMSM" SG_ 604 SRT_100mphTm_C 0;
BA_ "GenSigTimeoutTime_DTCM" SG_ 604 SRT_100mphTm_C 0;
BA_ "GenSigTimeoutTime_ECM" SG_ 604 SRT_100mphTm_C 0;
BA_ "GenSigTimeoutTime_EVCU2" SG_ 604 SRT_100mphTm_C 0;
BA_ "GenSigTimeoutTime_GNMM" SG_ 604 SRT_100mphTm_C 0;
BA_ "GenSigTimeoutTime_HCP" SG_ 604 SRT_100mphTm_C 0;
BA_ "GenSigTimeoutTime_IPC" SG_ 604 SRT_100mphTm_C 0;
BA_ "GenSigTimeoutTime_RFHM" SG_ 604 SRT_100mphTm_C 0;
BA_ "GenSigTimeoutTime_TCM" SG_ 604 SRT_100mphTm_C 0;
BA_ "GenSigStartValue" SG_ 604 SRT_100mphTm_L 255;
BA_ "GenSigSendType" SG_ 604 SRT_100mphTm_L 3;
BA_ "GenSigTimeoutTime_AGSM" SG_ 604 SRT_100mphTm_L 0;
BA_ "GenSigTimeoutTime_BCM" SG_ 604 SRT_100mphTm_L 0;
BA_ "GenSigTimeoutTime_BSM" SG_ 604 SRT_100mphTm_L 0;
BA_ "GenSigTimeoutTime_CADM" SG_ 604 SRT_100mphTm_L 0;
BA_ "GenSigTimeoutTime_DMSM" SG_ 604 SRT_100mphTm_L 0;
BA_ "GenSigTimeoutTime_DTCM" SG_ 604 SRT_100mphTm_L 0;
BA_ "GenSigTimeoutTime_ECM" SG_ 604 SRT_100mphTm_L 0;
BA_ "GenSigTimeoutTime_EVCU2" SG_ 604 SRT_100mphTm_L 0;
BA_ "GenSigTimeoutTime_GNMM" SG_ 604 SRT_100mphTm_L 0;
BA_ "GenSigTimeoutTime_HCP" SG_ 604 SRT_100mphTm_L 0;
BA_ "GenSigTimeoutTime_IPC" SG_ 604 SRT_100mphTm_L 0;
BA_ "GenSigTimeoutTime_RFHM" SG_ 604 SRT_100mphTm_L 0;
BA_ "GenSigTimeoutTime_TCM" SG_ 604 SRT_100mphTm_L 0;
BA_ "GenSigStartValue" SG_ 604 SRT_100mphTmB 255;
BA_ "GenSigSendType" SG_ 604 SRT_100mphTmB 3;
BA_ "GenSigTimeoutTime_AGSM" SG_ 604 SRT_100mphTmB 0;
BA_ "GenSigTimeoutTime_BCM" SG_ 604 SRT_100mphTmB 0;
BA_ "GenSigTimeoutTime_BSM" SG_ 604 SRT_100mphTmB 0;
BA_ "GenSigTimeoutTime_CADM" SG_ 604 SRT_100mphTmB 0;
BA_ "GenSigTimeoutTime_DMSM" SG_ 604 SRT_100mphTmB 0;
BA_ "GenSigTimeoutTime_DTCM" SG_ 604 SRT_100mphTmB 0;
BA_ "GenSigTimeoutTime_ECM" SG_ 604 SRT_100mphTmB 0;
BA_ "GenSigTimeoutTime_EVCU2" SG_ 604 SRT_100mphTmB 0;
BA_ "GenSigTimeoutTime_GNMM" SG_ 604 SRT_100mphTmB 0;
BA_ "GenSigTimeoutTime_HCP" SG_ 604 SRT_100mphTmB 0;
BA_ "GenSigTimeoutTime_IPC" SG_ 604 SRT_100mphTmB 0;
BA_ "GenSigTimeoutTime_RFHM" SG_ 604 SRT_100mphTmB 0;
BA_ "GenSigTimeoutTime_TCM" SG_ 604 SRT_100mphTmB 0;
BA_ "GenSigStartValue" SG_ 604 SRT_100mphTmC 255;
BA_ "GenSigSendType" SG_ 604 SRT_100mphTmC 3;
BA_ "GenSigTimeoutTime_AGSM" SG_ 604 SRT_100mphTmC 0;
BA_ "GenSigTimeoutTime_BCM" SG_ 604 SRT_100mphTmC 0;
BA_ "GenSigTimeoutTime_BSM" SG_ 604 SRT_100mphTmC 0;
BA_ "GenSigTimeoutTime_CADM" SG_ 604 SRT_100mphTmC 0;
BA_ "GenSigTimeoutTime_DMSM" SG_ 604 SRT_100mphTmC 0;
BA_ "GenSigTimeoutTime_DTCM" SG_ 604 SRT_100mphTmC 0;
BA_ "GenSigTimeoutTime_ECM" SG_ 604 SRT_100mphTmC 0;
BA_ "GenSigTimeoutTime_EVCU2" SG_ 604 SRT_100mphTmC 0;
BA_ "GenSigTimeoutTime_GNMM" SG_ 604 SRT_100mphTmC 0;
BA_ "GenSigTimeoutTime_HCP" SG_ 604 SRT_100mphTmC 0;
BA_ "GenSigTimeoutTime_IPC" SG_ 604 SRT_100mphTmC 0;
BA_ "GenSigTimeoutTime_RFHM" SG_ 604 SRT_100mphTmC 0;
BA_ "GenSigTimeoutTime_TCM" SG_ 604 SRT_100mphTmC 0;
BA_ "GenSigStartValue" SG_ 604 SRT_100mphTmL 255;
BA_ "GenSigSendType" SG_ 604 SRT_100mphTmL 3;
BA_ "GenSigTimeoutTime_AGSM" SG_ 604 SRT_100mphTmL 0;
BA_ "GenSigTimeoutTime_BCM" SG_ 604 SRT_100mphTmL 0;
BA_ "GenSigTimeoutTime_BSM" SG_ 604 SRT_100mphTmL 0;
BA_ "GenSigTimeoutTime_CADM" SG_ 604 SRT_100mphTmL 0;
BA_ "GenSigTimeoutTime_DMSM" SG_ 604 SRT_100mphTmL 0;
BA_ "GenSigTimeoutTime_DTCM" SG_ 604 SRT_100mphTmL 0;
BA_ "GenSigTimeoutTime_ECM" SG_ 604 SRT_100mphTmL 0;
BA_ "GenSigTimeoutTime_EVCU2" SG_ 604 SRT_100mphTmL 0;
BA_ "GenSigTimeoutTime_GNMM" SG_ 604 SRT_100mphTmL 0;
BA_ "GenSigTimeoutTime_HCP" SG_ 604 SRT_100mphTmL 0;
BA_ "GenSigTimeoutTime_IPC" SG_ 604 SRT_100mphTmL 0;
BA_ "GenSigTimeoutTime_RFHM" SG_ 604 SRT_100mphTmL 0;
BA_ "GenSigTimeoutTime_TCM" SG_ 604 SRT_100mphTmL 0;
BA_ "GenSigStartValue" SG_ 604 SRT_60mphTm_B 255;
BA_ "GenSigSendType" SG_ 604 SRT_60mphTm_B 3;
BA_ "GenSigTimeoutTime_AGSM" SG_ 604 SRT_60mphTm_B 0;
BA_ "GenSigTimeoutTime_BCM" SG_ 604 SRT_60mphTm_B 0;
BA_ "GenSigTimeoutTime_BSM" SG_ 604 SRT_60mphTm_B 0;
BA_ "GenSigTimeoutTime_CADM" SG_ 604 SRT_60mphTm_B 0;
BA_ "GenSigTimeoutTime_DMSM" SG_ 604 SRT_60mphTm_B 0;
BA_ "GenSigTimeoutTime_DTCM" SG_ 604 SRT_60mphTm_B 0;
BA_ "GenSigTimeoutTime_ECM" SG_ 604 SRT_60mphTm_B 0;
BA_ "GenSigTimeoutTime_EVCU2" SG_ 604 SRT_60mphTm_B 0;
BA_ "GenSigTimeoutTime_GNMM" SG_ 604 SRT_60mphTm_B 0;
BA_ "GenSigTimeoutTime_HCP" SG_ 604 SRT_60mphTm_B 0;
BA_ "GenSigTimeoutTime_IPC" SG_ 604 SRT_60mphTm_B 0;
BA_ "GenSigTimeoutTime_RFHM" SG_ 604 SRT_60mphTm_B 0;
BA_ "GenSigTimeoutTime_TCM" SG_ 604 SRT_60mphTm_B 0;
BA_ "GenSigStartValue" SG_ 604 SRT_60mphTm_C 255;
BA_ "GenSigSendType" SG_ 604 SRT_60mphTm_C 3;
BA_ "GenSigTimeoutTime_AGSM" SG_ 604 SRT_60mphTm_C 0;
BA_ "GenSigTimeoutTime_BCM" SG_ 604 SRT_60mphTm_C 0;
BA_ "GenSigTimeoutTime_BSM" SG_ 604 SRT_60mphTm_C 0;
BA_ "GenSigTimeoutTime_CADM" SG_ 604 SRT_60mphTm_C 0;
BA_ "GenSigTimeoutTime_DMSM" SG_ 604 SRT_60mphTm_C 0;
BA_ "GenSigTimeoutTime_DTCM" SG_ 604 SRT_60mphTm_C 0;
BA_ "GenSigTimeoutTime_ECM" SG_ 604 SRT_60mphTm_C 0;
BA_ "GenSigTimeoutTime_EVCU2" SG_ 604 SRT_60mphTm_C 0;
BA_ "GenSigTimeoutTime_GNMM" SG_ 604 SRT_60mphTm_C 0;
BA_ "GenSigTimeoutTime_HCP" SG_ 604 SRT_60mphTm_C 0;
BA_ "GenSigTimeoutTime_IPC" SG_ 604 SRT_60mphTm_C 0;
BA_ "GenSigTimeoutTime_RFHM" SG_ 604 SRT_60mphTm_C 0;
BA_ "GenSigTimeoutTime_TCM" SG_ 604 SRT_60mphTm_C 0;
BA_ "GenSigStartValue" SG_ 604 SRT_60mphTm_L 255;
BA_ "GenSigSendType" SG_ 604 SRT_60mphTm_L 3;
BA_ "GenSigTimeoutTime_AGSM" SG_ 604 SRT_60mphTm_L 0;
BA_ "GenSigTimeoutTime_BCM" SG_ 604 SRT_60mphTm_L 0;
BA_ "GenSigTimeoutTime_BSM" SG_ 604 SRT_60mphTm_L 0;
BA_ "GenSigTimeoutTime_CADM" SG_ 604 SRT_60mphTm_L 0;
BA_ "GenSigTimeoutTime_DMSM" SG_ 604 SRT_60mphTm_L 0;
BA_ "GenSigTimeoutTime_DTCM" SG_ 604 SRT_60mphTm_L 0;
BA_ "GenSigTimeoutTime_ECM" SG_ 604 SRT_60mphTm_L 0;
BA_ "GenSigTimeoutTime_EVCU2" SG_ 604 SRT_60mphTm_L 0;
BA_ "GenSigTimeoutTime_GNMM" SG_ 604 SRT_60mphTm_L 0;
BA_ "GenSigTimeoutTime_HCP" SG_ 604 SRT_60mphTm_L 0;
BA_ "GenSigTimeoutTime_IPC" SG_ 604 SRT_60mphTm_L 0;
BA_ "GenSigTimeoutTime_RFHM" SG_ 604 SRT_60mphTm_L 0;
BA_ "GenSigTimeoutTime_TCM" SG_ 604 SRT_60mphTm_L 0;
BA_ "GenSigStartValue" SG_ 604 SRT_60mphTmB 255;
BA_ "GenSigSendType" SG_ 604 SRT_60mphTmB 3;
BA_ "GenSigTimeoutTime_AGSM" SG_ 604 SRT_60mphTmB 0;
BA_ "GenSigTimeoutTime_BCM" SG_ 604 SRT_60mphTmB 0;
BA_ "GenSigTimeoutTime_BSM" SG_ 604 SRT_60mphTmB 0;
BA_ "GenSigTimeoutTime_CADM" SG_ 604 SRT_60mphTmB 0;
BA_ "GenSigTimeoutTime_DMSM" SG_ 604 SRT_60mphTmB 0;
BA_ "GenSigTimeoutTime_DTCM" SG_ 604 SRT_60mphTmB 0;
BA_ "GenSigTimeoutTime_ECM" SG_ 604 SRT_60mphTmB 0;
BA_ "GenSigTimeoutTime_EVCU2" SG_ 604 SRT_60mphTmB 0;
BA_ "GenSigTimeoutTime_GNMM" SG_ 604 SRT_60mphTmB 0;
BA_ "GenSigTimeoutTime_HCP" SG_ 604 SRT_60mphTmB 0;
BA_ "GenSigTimeoutTime_IPC" SG_ 604 SRT_60mphTmB 0;
BA_ "GenSigTimeoutTime_RFHM" SG_ 604 SRT_60mphTmB 0;
BA_ "GenSigTimeoutTime_TCM" SG_ 604 SRT_60mphTmB 0;
BA_ "GenSigStartValue" SG_ 604 SRT_60mphTmC 255;
BA_ "GenSigSendType" SG_ 604 SRT_60mphTmC 3;
BA_ "GenSigTimeoutTime_AGSM" SG_ 604 SRT_60mphTmC 0;
BA_ "GenSigTimeoutTime_BCM" SG_ 604 SRT_60mphTmC 0;
BA_ "GenSigTimeoutTime_BSM" SG_ 604 SRT_60mphTmC 0;
BA_ "GenSigTimeoutTime_CADM" SG_ 604 SRT_60mphTmC 0;
BA_ "GenSigTimeoutTime_DMSM" SG_ 604 SRT_60mphTmC 0;
BA_ "GenSigTimeoutTime_DTCM" SG_ 604 SRT_60mphTmC 0;
BA_ "GenSigTimeoutTime_ECM" SG_ 604 SRT_60mphTmC 0;
BA_ "GenSigTimeoutTime_EVCU2" SG_ 604 SRT_60mphTmC 0;
BA_ "GenSigTimeoutTime_GNMM" SG_ 604 SRT_60mphTmC 0;
BA_ "GenSigTimeoutTime_HCP" SG_ 604 SRT_60mphTmC 0;
BA_ "GenSigTimeoutTime_IPC" SG_ 604 SRT_60mphTmC 0;
BA_ "GenSigTimeoutTime_RFHM" SG_ 604 SRT_60mphTmC 0;
BA_ "GenSigTimeoutTime_TCM" SG_ 604 SRT_60mphTmC 0;
BA_ "GenSigStartValue" SG_ 604 SRT_60mphTmL 255;
BA_ "GenSigSendType" SG_ 604 SRT_60mphTmL 3;
BA_ "GenSigTimeoutTime_AGSM" SG_ 604 SRT_60mphTmL 0;
BA_ "GenSigTimeoutTime_BCM" SG_ 604 SRT_60mphTmL 0;
BA_ "GenSigTimeoutTime_BSM" SG_ 604 SRT_60mphTmL 0;
BA_ "GenSigTimeoutTime_CADM" SG_ 604 SRT_60mphTmL 0;
BA_ "GenSigTimeoutTime_DMSM" SG_ 604 SRT_60mphTmL 0;
BA_ "GenSigTimeoutTime_DTCM" SG_ 604 SRT_60mphTmL 0;
BA_ "GenSigTimeoutTime_ECM" SG_ 604 SRT_60mphTmL 0;
BA_ "GenSigTimeoutTime_EVCU2" SG_ 604 SRT_60mphTmL 0;
BA_ "GenSigTimeoutTime_GNMM" SG_ 604 SRT_60mphTmL 0;
BA_ "GenSigTimeoutTime_HCP" SG_ 604 SRT_60mphTmL 0;
BA_ "GenSigTimeoutTime_IPC" SG_ 604 SRT_60mphTmL 0;
BA_ "GenSigTimeoutTime_RFHM" SG_ 604 SRT_60mphTmL 0;
BA_ "GenSigTimeoutTime_TCM" SG_ 604 SRT_60mphTmL 0;
BA_ "GenSigStartValue" SG_ 604 SRT_BrkTm_B 255;
BA_ "GenSigSendType" SG_ 604 SRT_BrkTm_B 3;
BA_ "GenSigTimeoutTime_AGSM" SG_ 604 SRT_BrkTm_B 0;
BA_ "GenSigTimeoutTime_BCM" SG_ 604 SRT_BrkTm_B 0;
BA_ "GenSigTimeoutTime_BSM" SG_ 604 SRT_BrkTm_B 0;
BA_ "GenSigTimeoutTime_CADM" SG_ 604 SRT_BrkTm_B 0;
BA_ "GenSigTimeoutTime_DMSM" SG_ 604 SRT_BrkTm_B 0;
BA_ "GenSigTimeoutTime_DTCM" SG_ 604 SRT_BrkTm_B 0;
BA_ "GenSigTimeoutTime_ECM" SG_ 604 SRT_BrkTm_B 0;
BA_ "GenSigTimeoutTime_EVCU2" SG_ 604 SRT_BrkTm_B 0;
BA_ "GenSigTimeoutTime_GNMM" SG_ 604 SRT_BrkTm_B 0;
BA_ "GenSigTimeoutTime_HCP" SG_ 604 SRT_BrkTm_B 0;
BA_ "GenSigTimeoutTime_IPC" SG_ 604 SRT_BrkTm_B 0;
BA_ "GenSigTimeoutTime_RFHM" SG_ 604 SRT_BrkTm_B 0;
BA_ "GenSigTimeoutTime_TCM" SG_ 604 SRT_BrkTm_B 0;
BA_ "GenSigStartValue" SG_ 604 SRT_BrkTm_C 255;
BA_ "GenSigSendType" SG_ 604 SRT_BrkTm_C 3;
BA_ "GenSigTimeoutTime_AGSM" SG_ 604 SRT_BrkTm_C 0;
BA_ "GenSigTimeoutTime_BCM" SG_ 604 SRT_BrkTm_C 0;
BA_ "GenSigTimeoutTime_BSM" SG_ 604 SRT_BrkTm_C 0;
BA_ "GenSigTimeoutTime_CADM" SG_ 604 SRT_BrkTm_C 0;
BA_ "GenSigTimeoutTime_DMSM" SG_ 604 SRT_BrkTm_C 0;
BA_ "GenSigTimeoutTime_DTCM" SG_ 604 SRT_BrkTm_C 0;
BA_ "GenSigTimeoutTime_ECM" SG_ 604 SRT_BrkTm_C 0;
BA_ "GenSigTimeoutTime_EVCU2" SG_ 604 SRT_BrkTm_C 0;
BA_ "GenSigTimeoutTime_GNMM" SG_ 604 SRT_BrkTm_C 0;
BA_ "GenSigTimeoutTime_HCP" SG_ 604 SRT_BrkTm_C 0;
BA_ "GenSigTimeoutTime_IPC" SG_ 604 SRT_BrkTm_C 0;
BA_ "GenSigTimeoutTime_RFHM" SG_ 604 SRT_BrkTm_C 0;
BA_ "GenSigTimeoutTime_TCM" SG_ 604 SRT_BrkTm_C 0;
BA_ "GenSigStartValue" SG_ 604 SRT_BrkTm_L 255;
BA_ "GenSigSendType" SG_ 604 SRT_BrkTm_L 3;
BA_ "GenSigTimeoutTime_AGSM" SG_ 604 SRT_BrkTm_L 0;
BA_ "GenSigTimeoutTime_BCM" SG_ 604 SRT_BrkTm_L 0;
BA_ "GenSigTimeoutTime_BSM" SG_ 604 SRT_BrkTm_L 0;
BA_ "GenSigTimeoutTime_CADM" SG_ 604 SRT_BrkTm_L 0;
BA_ "GenSigTimeoutTime_DMSM" SG_ 604 SRT_BrkTm_L 0;
BA_ "GenSigTimeoutTime_DTCM" SG_ 604 SRT_BrkTm_L 0;
BA_ "GenSigTimeoutTime_ECM" SG_ 604 SRT_BrkTm_L 0;
BA_ "GenSigTimeoutTime_EVCU2" SG_ 604 SRT_BrkTm_L 0;
BA_ "GenSigTimeoutTime_GNMM" SG_ 604 SRT_BrkTm_L 0;
BA_ "GenSigTimeoutTime_HCP" SG_ 604 SRT_BrkTm_L 0;
BA_ "GenSigTimeoutTime_IPC" SG_ 604 SRT_BrkTm_L 0;
BA_ "GenSigTimeoutTime_RFHM" SG_ 604 SRT_BrkTm_L 0;
BA_ "GenSigTimeoutTime_TCM" SG_ 604 SRT_BrkTm_L 0;
BA_ "GenSigStartValue" SG_ 604 SRT_BrkTmB 255;
BA_ "GenSigSendType" SG_ 604 SRT_BrkTmB 3;
BA_ "GenSigTimeoutTime_AGSM" SG_ 604 SRT_BrkTmB 0;
BA_ "GenSigTimeoutTime_BCM" SG_ 604 SRT_BrkTmB 0;
BA_ "GenSigTimeoutTime_BSM" SG_ 604 SRT_BrkTmB 0;
BA_ "GenSigTimeoutTime_CADM" SG_ 604 SRT_BrkTmB 0;
BA_ "GenSigTimeoutTime_DMSM" SG_ 604 SRT_BrkTmB 0;
BA_ "GenSigTimeoutTime_DTCM" SG_ 604 SRT_BrkTmB 0;
BA_ "GenSigTimeoutTime_ECM" SG_ 604 SRT_BrkTmB 0;
BA_ "GenSigTimeoutTime_EVCU2" SG_ 604 SRT_BrkTmB 0;
BA_ "GenSigTimeoutTime_GNMM" SG_ 604 SRT_BrkTmB 0;
BA_ "GenSigTimeoutTime_HCP" SG_ 604 SRT_BrkTmB 0;
BA_ "GenSigTimeoutTime_IPC" SG_ 604 SRT_BrkTmB 0;
BA_ "GenSigTimeoutTime_RFHM" SG_ 604 SRT_BrkTmB 0;
BA_ "GenSigTimeoutTime_TCM" SG_ 604 SRT_BrkTmB 0;
BA_ "GenSigStartValue" SG_ 604 SRT_BrkTmC 255;
BA_ "GenSigSendType" SG_ 604 SRT_BrkTmC 3;
BA_ "GenSigTimeoutTime_AGSM" SG_ 604 SRT_BrkTmC 0;
BA_ "GenSigTimeoutTime_BCM" SG_ 604 SRT_BrkTmC 0;
BA_ "GenSigTimeoutTime_BSM" SG_ 604 SRT_BrkTmC 0;
BA_ "GenSigTimeoutTime_CADM" SG_ 604 SRT_BrkTmC 0;
BA_ "GenSigTimeoutTime_DMSM" SG_ 604 SRT_BrkTmC 0;
BA_ "GenSigTimeoutTime_DTCM" SG_ 604 SRT_BrkTmC 0;
BA_ "GenSigTimeoutTime_ECM" SG_ 604 SRT_BrkTmC 0;
BA_ "GenSigTimeoutTime_EVCU2" SG_ 604 SRT_BrkTmC 0;
BA_ "GenSigTimeoutTime_GNMM" SG_ 604 SRT_BrkTmC 0;
BA_ "GenSigTimeoutTime_HCP" SG_ 604 SRT_BrkTmC 0;
BA_ "GenSigTimeoutTime_IPC" SG_ 604 SRT_BrkTmC 0;
BA_ "GenSigTimeoutTime_RFHM" SG_ 604 SRT_BrkTmC 0;
BA_ "GenSigTimeoutTime_TCM" SG_ 604 SRT_BrkTmC 0;
BA_ "GenSigStartValue" SG_ 604 SRT_BrkTmL 255;
BA_ "GenSigSendType" SG_ 604 SRT_BrkTmL 3;
BA_ "GenSigTimeoutTime_AGSM" SG_ 604 SRT_BrkTmL 0;
BA_ "GenSigTimeoutTime_BCM" SG_ 604 SRT_BrkTmL 0;
BA_ "GenSigTimeoutTime_BSM" SG_ 604 SRT_BrkTmL 0;
BA_ "GenSigTimeoutTime_CADM" SG_ 604 SRT_BrkTmL 0;
BA_ "GenSigTimeoutTime_DMSM" SG_ 604 SRT_BrkTmL 0;
BA_ "GenSigTimeoutTime_DTCM" SG_ 604 SRT_BrkTmL 0;
BA_ "GenSigTimeoutTime_ECM" SG_ 604 SRT_BrkTmL 0;
BA_ "GenSigTimeoutTime_EVCU2" SG_ 604 SRT_BrkTmL 0;
BA_ "GenSigTimeoutTime_GNMM" SG_ 604 SRT_BrkTmL 0;
BA_ "GenSigTimeoutTime_HCP" SG_ 604 SRT_BrkTmL 0;
BA_ "GenSigTimeoutTime_IPC" SG_ 604 SRT_BrkTmL 0;
BA_ "GenSigTimeoutTime_RFHM" SG_ 604 SRT_BrkTmL 0;
BA_ "GenSigTimeoutTime_TCM" SG_ 604 SRT_BrkTmL 0;
BA_ "GenSigStartValue" SG_ 604 SRT_eighthTm_B 255;
BA_ "GenSigSendType" SG_ 604 SRT_eighthTm_B 3;
BA_ "GenSigTimeoutTime_AGSM" SG_ 604 SRT_eighthTm_B 0;
BA_ "GenSigTimeoutTime_BCM" SG_ 604 SRT_eighthTm_B 0;
BA_ "GenSigTimeoutTime_BSM" SG_ 604 SRT_eighthTm_B 0;
BA_ "GenSigTimeoutTime_CADM" SG_ 604 SRT_eighthTm_B 0;
BA_ "GenSigTimeoutTime_DMSM" SG_ 604 SRT_eighthTm_B 0;
BA_ "GenSigTimeoutTime_DTCM" SG_ 604 SRT_eighthTm_B 0;
BA_ "GenSigTimeoutTime_ECM" SG_ 604 SRT_eighthTm_B 0;
BA_ "GenSigTimeoutTime_EVCU2" SG_ 604 SRT_eighthTm_B 0;
BA_ "GenSigTimeoutTime_GNMM" SG_ 604 SRT_eighthTm_B 0;
BA_ "GenSigTimeoutTime_HCP" SG_ 604 SRT_eighthTm_B 0;
BA_ "GenSigTimeoutTime_IPC" SG_ 604 SRT_eighthTm_B 0;
BA_ "GenSigTimeoutTime_RFHM" SG_ 604 SRT_eighthTm_B 0;
BA_ "GenSigTimeoutTime_TCM" SG_ 604 SRT_eighthTm_B 0;
BA_ "GenSigStartValue" SG_ 604 SRT_eighthTm_C 255;
BA_ "GenSigSendType" SG_ 604 SRT_eighthTm_C 3;
BA_ "GenSigTimeoutTime_AGSM" SG_ 604 SRT_eighthTm_C 0;
BA_ "GenSigTimeoutTime_BCM" SG_ 604 SRT_eighthTm_C 0;
BA_ "GenSigTimeoutTime_BSM" SG_ 604 SRT_eighthTm_C 0;
BA_ "GenSigTimeoutTime_CADM" SG_ 604 SRT_eighthTm_C 0;
BA_ "GenSigTimeoutTime_DMSM" SG_ 604 SRT_eighthTm_C 0;
BA_ "GenSigTimeoutTime_DTCM" SG_ 604 SRT_eighthTm_C 0;
BA_ "GenSigTimeoutTime_ECM" SG_ 604 SRT_eighthTm_C 0;
BA_ "GenSigTimeoutTime_EVCU2" SG_ 604 SRT_eighthTm_C 0;
BA_ "GenSigTimeoutTime_GNMM" SG_ 604 SRT_eighthTm_C 0;
BA_ "GenSigTimeoutTime_HCP" SG_ 604 SRT_eighthTm_C 0;
BA_ "GenSigTimeoutTime_IPC" SG_ 604 SRT_eighthTm_C 0;
BA_ "GenSigTimeoutTime_RFHM" SG_ 604 SRT_eighthTm_C 0;
BA_ "GenSigTimeoutTime_TCM" SG_ 604 SRT_eighthTm_C 0;
BA_ "GenSigStartValue" SG_ 604 SRT_eighthTm_L 255;
BA_ "GenSigSendType" SG_ 604 SRT_eighthTm_L 3;
BA_ "GenSigTimeoutTime_AGSM" SG_ 604 SRT_eighthTm_L 0;
BA_ "GenSigTimeoutTime_BCM" SG_ 604 SRT_eighthTm_L 0;
BA_ "GenSigTimeoutTime_BSM" SG_ 604 SRT_eighthTm_L 0;
BA_ "GenSigTimeoutTime_CADM" SG_ 604 SRT_eighthTm_L 0;
BA_ "GenSigTimeoutTime_DMSM" SG_ 604 SRT_eighthTm_L 0;
BA_ "GenSigTimeoutTime_DTCM" SG_ 604 SRT_eighthTm_L 0;
BA_ "GenSigTimeoutTime_ECM" SG_ 604 SRT_eighthTm_L 0;
BA_ "GenSigTimeoutTime_EVCU2" SG_ 604 SRT_eighthTm_L 0;
BA_ "GenSigTimeoutTime_GNMM" SG_ 604 SRT_eighthTm_L 0;
BA_ "GenSigTimeoutTime_HCP" SG_ 604 SRT_eighthTm_L 0;
BA_ "GenSigTimeoutTime_IPC" SG_ 604 SRT_eighthTm_L 0;
BA_ "GenSigTimeoutTime_RFHM" SG_ 604 SRT_eighthTm_L 0;
BA_ "GenSigTimeoutTime_TCM" SG_ 604 SRT_eighthTm_L 0;
BA_ "GenSigStartValue" SG_ 604 SRT_eighthTmB 255;
BA_ "GenSigSendType" SG_ 604 SRT_eighthTmB 3;
BA_ "GenSigTimeoutTime_AGSM" SG_ 604 SRT_eighthTmB 0;
BA_ "GenSigTimeoutTime_BCM" SG_ 604 SRT_eighthTmB 0;
BA_ "GenSigTimeoutTime_BSM" SG_ 604 SRT_eighthTmB 0;
BA_ "GenSigTimeoutTime_CADM" SG_ 604 SRT_eighthTmB 0;
BA_ "GenSigTimeoutTime_DMSM" SG_ 604 SRT_eighthTmB 0;
BA_ "GenSigTimeoutTime_DTCM" SG_ 604 SRT_eighthTmB 0;
BA_ "GenSigTimeoutTime_ECM" SG_ 604 SRT_eighthTmB 0;
BA_ "GenSigTimeoutTime_EVCU2" SG_ 604 SRT_eighthTmB 0;
BA_ "GenSigTimeoutTime_GNMM" SG_ 604 SRT_eighthTmB 0;
BA_ "GenSigTimeoutTime_HCP" SG_ 604 SRT_eighthTmB 0;
BA_ "GenSigTimeoutTime_IPC" SG_ 604 SRT_eighthTmB 0;
BA_ "GenSigTimeoutTime_RFHM" SG_ 604 SRT_eighthTmB 0;
BA_ "GenSigTimeoutTime_TCM" SG_ 604 SRT_eighthTmB 0;
BA_ "GenSigStartValue" SG_ 604 SRT_eighthTmC 255;
BA_ "GenSigSendType" SG_ 604 SRT_eighthTmC 3;
BA_ "GenSigTimeoutTime_AGSM" SG_ 604 SRT_eighthTmC 0;
BA_ "GenSigTimeoutTime_BCM" SG_ 604 SRT_eighthTmC 0;
BA_ "GenSigTimeoutTime_BSM" SG_ 604 SRT_eighthTmC 0;
BA_ "GenSigTimeoutTime_CADM" SG_ 604 SRT_eighthTmC 0;
BA_ "GenSigTimeoutTime_DMSM" SG_ 604 SRT_eighthTmC 0;
BA_ "GenSigTimeoutTime_DTCM" SG_ 604 SRT_eighthTmC 0;
BA_ "GenSigTimeoutTime_ECM" SG_ 604 SRT_eighthTmC 0;
BA_ "GenSigTimeoutTime_EVCU2" SG_ 604 SRT_eighthTmC 0;
BA_ "GenSigTimeoutTime_GNMM" SG_ 604 SRT_eighthTmC 0;
BA_ "GenSigTimeoutTime_HCP" SG_ 604 SRT_eighthTmC 0;
BA_ "GenSigTimeoutTime_IPC" SG_ 604 SRT_eighthTmC 0;
BA_ "GenSigTimeoutTime_RFHM" SG_ 604 SRT_eighthTmC 0;
BA_ "GenSigTimeoutTime_TCM" SG_ 604 SRT_eighthTmC 0;
BA_ "GenSigStartValue" SG_ 604 SRT_eighthTmL 255;
BA_ "GenSigSendType" SG_ 604 SRT_eighthTmL 3;
BA_ "GenSigTimeoutTime_AGSM" SG_ 604 SRT_eighthTmL 0;
BA_ "GenSigTimeoutTime_BCM" SG_ 604 SRT_eighthTmL 0;
BA_ "GenSigTimeoutTime_BSM" SG_ 604 SRT_eighthTmL 0;
BA_ "GenSigTimeoutTime_CADM" SG_ 604 SRT_eighthTmL 0;
BA_ "GenSigTimeoutTime_DMSM" SG_ 604 SRT_eighthTmL 0;
BA_ "GenSigTimeoutTime_DTCM" SG_ 604 SRT_eighthTmL 0;
BA_ "GenSigTimeoutTime_ECM" SG_ 604 SRT_eighthTmL 0;
BA_ "GenSigTimeoutTime_EVCU2" SG_ 604 SRT_eighthTmL 0;
BA_ "GenSigTimeoutTime_GNMM" SG_ 604 SRT_eighthTmL 0;
BA_ "GenSigTimeoutTime_HCP" SG_ 604 SRT_eighthTmL 0;
BA_ "GenSigTimeoutTime_IPC" SG_ 604 SRT_eighthTmL 0;
BA_ "GenSigTimeoutTime_RFHM" SG_ 604 SRT_eighthTmL 0;
BA_ "GenSigTimeoutTime_TCM" SG_ 604 SRT_eighthTmL 0;
BA_ "GenSigStartValue" SG_ 604 SRT_EthSpdB_M 255;
BA_ "GenSigSendType" SG_ 604 SRT_EthSpdB_M 3;
BA_ "GenSigTimeoutTime_AGSM" SG_ 604 SRT_EthSpdB_M 0;
BA_ "GenSigTimeoutTime_BCM" SG_ 604 SRT_EthSpdB_M 0;
BA_ "GenSigTimeoutTime_BSM" SG_ 604 SRT_EthSpdB_M 0;
BA_ "GenSigTimeoutTime_CADM" SG_ 604 SRT_EthSpdB_M 0;
BA_ "GenSigTimeoutTime_DMSM" SG_ 604 SRT_EthSpdB_M 0;
BA_ "GenSigTimeoutTime_DTCM" SG_ 604 SRT_EthSpdB_M 0;
BA_ "GenSigTimeoutTime_ECM" SG_ 604 SRT_EthSpdB_M 0;
BA_ "GenSigTimeoutTime_EVCU2" SG_ 604 SRT_EthSpdB_M 0;
BA_ "GenSigTimeoutTime_GNMM" SG_ 604 SRT_EthSpdB_M 0;
BA_ "GenSigTimeoutTime_HCP" SG_ 604 SRT_EthSpdB_M 0;
BA_ "GenSigTimeoutTime_IPC" SG_ 604 SRT_EthSpdB_M 0;
BA_ "GenSigTimeoutTime_RFHM" SG_ 604 SRT_EthSpdB_M 0;
BA_ "GenSigTimeoutTime_TCM" SG_ 604 SRT_EthSpdB_M 0;
BA_ "GenSigStartValue" SG_ 604 SRT_EthSpdB_US 255;
BA_ "GenSigSendType" SG_ 604 SRT_EthSpdB_US 3;
BA_ "GenSigTimeoutTime_AGSM" SG_ 604 SRT_EthSpdB_US 0;
BA_ "GenSigTimeoutTime_BCM" SG_ 604 SRT_EthSpdB_US 0;
BA_ "GenSigTimeoutTime_BSM" SG_ 604 SRT_EthSpdB_US 0;
BA_ "GenSigTimeoutTime_CADM" SG_ 604 SRT_EthSpdB_US 0;
BA_ "GenSigTimeoutTime_DMSM" SG_ 604 SRT_EthSpdB_US 0;
BA_ "GenSigTimeoutTime_DTCM" SG_ 604 SRT_EthSpdB_US 0;
BA_ "GenSigTimeoutTime_ECM" SG_ 604 SRT_EthSpdB_US 0;
BA_ "GenSigTimeoutTime_EVCU2" SG_ 604 SRT_EthSpdB_US 0;
BA_ "GenSigTimeoutTime_GNMM" SG_ 604 SRT_EthSpdB_US 0;
BA_ "GenSigTimeoutTime_HCP" SG_ 604 SRT_EthSpdB_US 0;
BA_ "GenSigTimeoutTime_IPC" SG_ 604 SRT_EthSpdB_US 0;
BA_ "GenSigTimeoutTime_RFHM" SG_ 604 SRT_EthSpdB_US 0;
BA_ "GenSigTimeoutTime_TCM" SG_ 604 SRT_EthSpdB_US 0;
BA_ "GenSigStartValue" SG_ 604 SRT_EthSpdC_M 255;
BA_ "GenSigSendType" SG_ 604 SRT_EthSpdC_M 3;
BA_ "GenSigTimeoutTime_AGSM" SG_ 604 SRT_EthSpdC_M 0;
BA_ "GenSigTimeoutTime_BCM" SG_ 604 SRT_EthSpdC_M 0;
BA_ "GenSigTimeoutTime_BSM" SG_ 604 SRT_EthSpdC_M 0;
BA_ "GenSigTimeoutTime_CADM" SG_ 604 SRT_EthSpdC_M 0;
BA_ "GenSigTimeoutTime_DMSM" SG_ 604 SRT_EthSpdC_M 0;
BA_ "GenSigTimeoutTime_DTCM" SG_ 604 SRT_EthSpdC_M 0;
BA_ "GenSigTimeoutTime_ECM" SG_ 604 SRT_EthSpdC_M 0;
BA_ "GenSigTimeoutTime_EVCU2" SG_ 604 SRT_EthSpdC_M 0;
BA_ "GenSigTimeoutTime_GNMM" SG_ 604 SRT_EthSpdC_M 0;
BA_ "GenSigTimeoutTime_HCP" SG_ 604 SRT_EthSpdC_M 0;
BA_ "GenSigTimeoutTime_IPC" SG_ 604 SRT_EthSpdC_M 0;
BA_ "GenSigTimeoutTime_RFHM" SG_ 604 SRT_EthSpdC_M 0;
BA_ "GenSigTimeoutTime_TCM" SG_ 604 SRT_EthSpdC_M 0;
BA_ "GenSigStartValue" SG_ 604 SRT_EthSpdC_US 255;
BA_ "GenSigSendType" SG_ 604 SRT_EthSpdC_US 3;
BA_ "GenSigTimeoutTime_AGSM" SG_ 604 SRT_EthSpdC_US 0;
BA_ "GenSigTimeoutTime_BCM" SG_ 604 SRT_EthSpdC_US 0;
BA_ "GenSigTimeoutTime_BSM" SG_ 604 SRT_EthSpdC_US 0;
BA_ "GenSigTimeoutTime_CADM" SG_ 604 SRT_EthSpdC_US 0;
BA_ "GenSigTimeoutTime_DMSM" SG_ 604 SRT_EthSpdC_US 0;
BA_ "GenSigTimeoutTime_DTCM" SG_ 604 SRT_EthSpdC_US 0;
BA_ "GenSigTimeoutTime_ECM" SG_ 604 SRT_EthSpdC_US 0;
BA_ "GenSigTimeoutTime_EVCU2" SG_ 604 SRT_EthSpdC_US 0;
BA_ "GenSigTimeoutTime_GNMM" SG_ 604 SRT_EthSpdC_US 0;
BA_ "GenSigTimeoutTime_HCP" SG_ 604 SRT_EthSpdC_US 0;
BA_ "GenSigTimeoutTime_IPC" SG_ 604 SRT_EthSpdC_US 0;
BA_ "GenSigTimeoutTime_RFHM" SG_ 604 SRT_EthSpdC_US 0;
BA_ "GenSigTimeoutTime_TCM" SG_ 604 SRT_EthSpdC_US 0;
BA_ "GenSigStartValue" SG_ 604 SRT_EthSpdL_M 255;
BA_ "GenSigSendType" SG_ 604 SRT_EthSpdL_M 3;
BA_ "GenSigTimeoutTime_AGSM" SG_ 604 SRT_EthSpdL_M 0;
BA_ "GenSigTimeoutTime_BCM" SG_ 604 SRT_EthSpdL_M 0;
BA_ "GenSigTimeoutTime_BSM" SG_ 604 SRT_EthSpdL_M 0;
BA_ "GenSigTimeoutTime_CADM" SG_ 604 SRT_EthSpdL_M 0;
BA_ "GenSigTimeoutTime_DMSM" SG_ 604 SRT_EthSpdL_M 0;
BA_ "GenSigTimeoutTime_DTCM" SG_ 604 SRT_EthSpdL_M 0;
BA_ "GenSigTimeoutTime_ECM" SG_ 604 SRT_EthSpdL_M 0;
BA_ "GenSigTimeoutTime_EVCU2" SG_ 604 SRT_EthSpdL_M 0;
BA_ "GenSigTimeoutTime_GNMM" SG_ 604 SRT_EthSpdL_M 0;
BA_ "GenSigTimeoutTime_HCP" SG_ 604 SRT_EthSpdL_M 0;
BA_ "GenSigTimeoutTime_IPC" SG_ 604 SRT_EthSpdL_M 0;
BA_ "GenSigTimeoutTime_RFHM" SG_ 604 SRT_EthSpdL_M 0;
BA_ "GenSigTimeoutTime_TCM" SG_ 604 SRT_EthSpdL_M 0;
BA_ "GenSigStartValue" SG_ 604 SRT_EthSpdL_US 255;
BA_ "GenSigSendType" SG_ 604 SRT_EthSpdL_US 3;
BA_ "GenSigTimeoutTime_AGSM" SG_ 604 SRT_EthSpdL_US 0;
BA_ "GenSigTimeoutTime_BCM" SG_ 604 SRT_EthSpdL_US 0;
BA_ "GenSigTimeoutTime_BSM" SG_ 604 SRT_EthSpdL_US 0;
BA_ "GenSigTimeoutTime_CADM" SG_ 604 SRT_EthSpdL_US 0;
BA_ "GenSigTimeoutTime_DMSM" SG_ 604 SRT_EthSpdL_US 0;
BA_ "GenSigTimeoutTime_DTCM" SG_ 604 SRT_EthSpdL_US 0;
BA_ "GenSigTimeoutTime_ECM" SG_ 604 SRT_EthSpdL_US 0;
BA_ "GenSigTimeoutTime_EVCU2" SG_ 604 SRT_EthSpdL_US 0;
BA_ "GenSigTimeoutTime_GNMM" SG_ 604 SRT_EthSpdL_US 0;
BA_ "GenSigTimeoutTime_HCP" SG_ 604 SRT_EthSpdL_US 0;
BA_ "GenSigTimeoutTime_IPC" SG_ 604 SRT_EthSpdL_US 0;
BA_ "GenSigTimeoutTime_RFHM" SG_ 604 SRT_EthSpdL_US 0;
BA_ "GenSigTimeoutTime_TCM" SG_ 604 SRT_EthSpdL_US 0;
BA_ "GenSigStartValue" SG_ 604 SRT_QrtSpdB_M 255;
BA_ "GenSigSendType" SG_ 604 SRT_QrtSpdB_M 3;
BA_ "GenSigTimeoutTime_AGSM" SG_ 604 SRT_QrtSpdB_M 0;
BA_ "GenSigTimeoutTime_BCM" SG_ 604 SRT_QrtSpdB_M 0;
BA_ "GenSigTimeoutTime_BSM" SG_ 604 SRT_QrtSpdB_M 0;
BA_ "GenSigTimeoutTime_CADM" SG_ 604 SRT_QrtSpdB_M 0;
BA_ "GenSigTimeoutTime_DMSM" SG_ 604 SRT_QrtSpdB_M 0;
BA_ "GenSigTimeoutTime_DTCM" SG_ 604 SRT_QrtSpdB_M 0;
BA_ "GenSigTimeoutTime_ECM" SG_ 604 SRT_QrtSpdB_M 0;
BA_ "GenSigTimeoutTime_EVCU2" SG_ 604 SRT_QrtSpdB_M 0;
BA_ "GenSigTimeoutTime_GNMM" SG_ 604 SRT_QrtSpdB_M 0;
BA_ "GenSigTimeoutTime_HCP" SG_ 604 SRT_QrtSpdB_M 0;
BA_ "GenSigTimeoutTime_IPC" SG_ 604 SRT_QrtSpdB_M 0;
BA_ "GenSigTimeoutTime_RFHM" SG_ 604 SRT_QrtSpdB_M 0;
BA_ "GenSigTimeoutTime_TCM" SG_ 604 SRT_QrtSpdB_M 0;
BA_ "GenSigStartValue" SG_ 604 SRT_QrtSpdB_US 255;
BA_ "GenSigSendType" SG_ 604 SRT_QrtSpdB_US 3;
BA_ "GenSigTimeoutTime_AGSM" SG_ 604 SRT_QrtSpdB_US 0;
BA_ "GenSigTimeoutTime_BCM" SG_ 604 SRT_QrtSpdB_US 0;
BA_ "GenSigTimeoutTime_BSM" SG_ 604 SRT_QrtSpdB_US 0;
BA_ "GenSigTimeoutTime_CADM" SG_ 604 SRT_QrtSpdB_US 0;
BA_ "GenSigTimeoutTime_DMSM" SG_ 604 SRT_QrtSpdB_US 0;
BA_ "GenSigTimeoutTime_DTCM" SG_ 604 SRT_QrtSpdB_US 0;
BA_ "GenSigTimeoutTime_ECM" SG_ 604 SRT_QrtSpdB_US 0;
BA_ "GenSigTimeoutTime_EVCU2" SG_ 604 SRT_QrtSpdB_US 0;
BA_ "GenSigTimeoutTime_GNMM" SG_ 604 SRT_QrtSpdB_US 0;
BA_ "GenSigTimeoutTime_HCP" SG_ 604 SRT_QrtSpdB_US 0;
BA_ "GenSigTimeoutTime_IPC" SG_ 604 SRT_QrtSpdB_US 0;
BA_ "GenSigTimeoutTime_RFHM" SG_ 604 SRT_QrtSpdB_US 0;
BA_ "GenSigTimeoutTime_TCM" SG_ 604 SRT_QrtSpdB_US 0;
BA_ "GenSigStartValue" SG_ 604 SRT_QrtSpdC_M 255;
BA_ "GenSigSendType" SG_ 604 SRT_QrtSpdC_M 3;
BA_ "GenSigTimeoutTime_AGSM" SG_ 604 SRT_QrtSpdC_M 0;
BA_ "GenSigTimeoutTime_BCM" SG_ 604 SRT_QrtSpdC_M 0;
BA_ "GenSigTimeoutTime_BSM" SG_ 604 SRT_QrtSpdC_M 0;
BA_ "GenSigTimeoutTime_CADM" SG_ 604 SRT_QrtSpdC_M 0;
BA_ "GenSigTimeoutTime_DMSM" SG_ 604 SRT_QrtSpdC_M 0;
BA_ "GenSigTimeoutTime_DTCM" SG_ 604 SRT_QrtSpdC_M 0;
BA_ "GenSigTimeoutTime_ECM" SG_ 604 SRT_QrtSpdC_M 0;
BA_ "GenSigTimeoutTime_EVCU2" SG_ 604 SRT_QrtSpdC_M 0;
BA_ "GenSigTimeoutTime_GNMM" SG_ 604 SRT_QrtSpdC_M 0;
BA_ "GenSigTimeoutTime_HCP" SG_ 604 SRT_QrtSpdC_M 0;
BA_ "GenSigTimeoutTime_IPC" SG_ 604 SRT_QrtSpdC_M 0;
BA_ "GenSigTimeoutTime_RFHM" SG_ 604 SRT_QrtSpdC_M 0;
BA_ "GenSigTimeoutTime_TCM" SG_ 604 SRT_QrtSpdC_M 0;
BA_ "GenSigStartValue" SG_ 604 SRT_QrtSpdC_US 255;
BA_ "GenSigSendType" SG_ 604 SRT_QrtSpdC_US 3;
BA_ "GenSigTimeoutTime_AGSM" SG_ 604 SRT_QrtSpdC_US 0;
BA_ "GenSigTimeoutTime_BCM" SG_ 604 SRT_QrtSpdC_US 0;
BA_ "GenSigTimeoutTime_BSM" SG_ 604 SRT_QrtSpdC_US 0;
BA_ "GenSigTimeoutTime_CADM" SG_ 604 SRT_QrtSpdC_US 0;
BA_ "GenSigTimeoutTime_DMSM" SG_ 604 SRT_QrtSpdC_US 0;
BA_ "GenSigTimeoutTime_DTCM" SG_ 604 SRT_QrtSpdC_US 0;
BA_ "GenSigTimeoutTime_ECM" SG_ 604 SRT_QrtSpdC_US 0;
BA_ "GenSigTimeoutTime_EVCU2" SG_ 604 SRT_QrtSpdC_US 0;
BA_ "GenSigTimeoutTime_GNMM" SG_ 604 SRT_QrtSpdC_US 0;
BA_ "GenSigTimeoutTime_HCP" SG_ 604 SRT_QrtSpdC_US 0;
BA_ "GenSigTimeoutTime_IPC" SG_ 604 SRT_QrtSpdC_US 0;
BA_ "GenSigTimeoutTime_RFHM" SG_ 604 SRT_QrtSpdC_US 0;
BA_ "GenSigTimeoutTime_TCM" SG_ 604 SRT_QrtSpdC_US 0;
BA_ "GenSigStartValue" SG_ 604 SRT_QrtSpdL_M 255;
BA_ "GenSigSendType" SG_ 604 SRT_QrtSpdL_M 3;
BA_ "GenSigTimeoutTime_AGSM" SG_ 604 SRT_QrtSpdL_M 0;
BA_ "GenSigTimeoutTime_BCM" SG_ 604 SRT_QrtSpdL_M 0;
BA_ "GenSigTimeoutTime_BSM" SG_ 604 SRT_QrtSpdL_M 0;
BA_ "GenSigTimeoutTime_CADM" SG_ 604 SRT_QrtSpdL_M 0;
BA_ "GenSigTimeoutTime_DMSM" SG_ 604 SRT_QrtSpdL_M 0;
BA_ "GenSigTimeoutTime_DTCM" SG_ 604 SRT_QrtSpdL_M 0;
BA_ "GenSigTimeoutTime_ECM" SG_ 604 SRT_QrtSpdL_M 0;
BA_ "GenSigTimeoutTime_EVCU2" SG_ 604 SRT_QrtSpdL_M 0;
BA_ "GenSigTimeoutTime_GNMM" SG_ 604 SRT_QrtSpdL_M 0;
BA_ "GenSigTimeoutTime_HCP" SG_ 604 SRT_QrtSpdL_M 0;
BA_ "GenSigTimeoutTime_IPC" SG_ 604 SRT_QrtSpdL_M 0;
BA_ "GenSigTimeoutTime_RFHM" SG_ 604 SRT_QrtSpdL_M 0;
BA_ "GenSigTimeoutTime_TCM" SG_ 604 SRT_QrtSpdL_M 0;
BA_ "GenSigStartValue" SG_ 604 SRT_QrtSpdL_US 255;
BA_ "GenSigSendType" SG_ 604 SRT_QrtSpdL_US 3;
BA_ "GenSigTimeoutTime_AGSM" SG_ 604 SRT_QrtSpdL_US 0;
BA_ "GenSigTimeoutTime_BCM" SG_ 604 SRT_QrtSpdL_US 0;
BA_ "GenSigTimeoutTime_BSM" SG_ 604 SRT_QrtSpdL_US 0;
BA_ "GenSigTimeoutTime_CADM" SG_ 604 SRT_QrtSpdL_US 0;
BA_ "GenSigTimeoutTime_DMSM" SG_ 604 SRT_QrtSpdL_US 0;
BA_ "GenSigTimeoutTime_DTCM" SG_ 604 SRT_QrtSpdL_US 0;
BA_ "GenSigTimeoutTime_ECM" SG_ 604 SRT_QrtSpdL_US 0;
BA_ "GenSigTimeoutTime_EVCU2" SG_ 604 SRT_QrtSpdL_US 0;
BA_ "GenSigTimeoutTime_GNMM" SG_ 604 SRT_QrtSpdL_US 0;
BA_ "GenSigTimeoutTime_HCP" SG_ 604 SRT_QrtSpdL_US 0;
BA_ "GenSigTimeoutTime_IPC" SG_ 604 SRT_QrtSpdL_US 0;
BA_ "GenSigTimeoutTime_RFHM" SG_ 604 SRT_QrtSpdL_US 0;
BA_ "GenSigTimeoutTime_TCM" SG_ 604 SRT_QrtSpdL_US 0;
BA_ "GenSigStartValue" SG_ 604 SRT_quarterTm_B 255;
BA_ "GenSigSendType" SG_ 604 SRT_quarterTm_B 3;
BA_ "GenSigTimeoutTime_AGSM" SG_ 604 SRT_quarterTm_B 0;
BA_ "GenSigTimeoutTime_BCM" SG_ 604 SRT_quarterTm_B 0;
BA_ "GenSigTimeoutTime_BSM" SG_ 604 SRT_quarterTm_B 0;
BA_ "GenSigTimeoutTime_CADM" SG_ 604 SRT_quarterTm_B 0;
BA_ "GenSigTimeoutTime_DMSM" SG_ 604 SRT_quarterTm_B 0;
BA_ "GenSigTimeoutTime_DTCM" SG_ 604 SRT_quarterTm_B 0;
BA_ "GenSigTimeoutTime_ECM" SG_ 604 SRT_quarterTm_B 0;
BA_ "GenSigTimeoutTime_EVCU2" SG_ 604 SRT_quarterTm_B 0;
BA_ "GenSigTimeoutTime_GNMM" SG_ 604 SRT_quarterTm_B 0;
BA_ "GenSigTimeoutTime_HCP" SG_ 604 SRT_quarterTm_B 0;
BA_ "GenSigTimeoutTime_IPC" SG_ 604 SRT_quarterTm_B 0;
BA_ "GenSigTimeoutTime_RFHM" SG_ 604 SRT_quarterTm_B 0;
BA_ "GenSigTimeoutTime_TCM" SG_ 604 SRT_quarterTm_B 0;
BA_ "GenSigStartValue" SG_ 604 SRT_quarterTm_C 255;
BA_ "GenSigSendType" SG_ 604 SRT_quarterTm_C 3;
BA_ "GenSigTimeoutTime_AGSM" SG_ 604 SRT_quarterTm_C 0;
BA_ "GenSigTimeoutTime_BCM" SG_ 604 SRT_quarterTm_C 0;
BA_ "GenSigTimeoutTime_BSM" SG_ 604 SRT_quarterTm_C 0;
BA_ "GenSigTimeoutTime_CADM" SG_ 604 SRT_quarterTm_C 0;
BA_ "GenSigTimeoutTime_DMSM" SG_ 604 SRT_quarterTm_C 0;
BA_ "GenSigTimeoutTime_DTCM" SG_ 604 SRT_quarterTm_C 0;
BA_ "GenSigTimeoutTime_ECM" SG_ 604 SRT_quarterTm_C 0;
BA_ "GenSigTimeoutTime_EVCU2" SG_ 604 SRT_quarterTm_C 0;
BA_ "GenSigTimeoutTime_GNMM" SG_ 604 SRT_quarterTm_C 0;
BA_ "GenSigTimeoutTime_HCP" SG_ 604 SRT_quarterTm_C 0;
BA_ "GenSigTimeoutTime_IPC" SG_ 604 SRT_quarterTm_C 0;
BA_ "GenSigTimeoutTime_RFHM" SG_ 604 SRT_quarterTm_C 0;
BA_ "GenSigTimeoutTime_TCM" SG_ 604 SRT_quarterTm_C 0;
BA_ "GenSigStartValue" SG_ 604 SRT_quarterTm_L 255;
BA_ "GenSigSendType" SG_ 604 SRT_quarterTm_L 3;
BA_ "GenSigTimeoutTime_AGSM" SG_ 604 SRT_quarterTm_L 0;
BA_ "GenSigTimeoutTime_BCM" SG_ 604 SRT_quarterTm_L 0;
BA_ "GenSigTimeoutTime_BSM" SG_ 604 SRT_quarterTm_L 0;
BA_ "GenSigTimeoutTime_CADM" SG_ 604 SRT_quarterTm_L 0;
BA_ "GenSigTimeoutTime_DMSM" SG_ 604 SRT_quarterTm_L 0;
BA_ "GenSigTimeoutTime_DTCM" SG_ 604 SRT_quarterTm_L 0;
BA_ "GenSigTimeoutTime_ECM" SG_ 604 SRT_quarterTm_L 0;
BA_ "GenSigTimeoutTime_EVCU2" SG_ 604 SRT_quarterTm_L 0;
BA_ "GenSigTimeoutTime_GNMM" SG_ 604 SRT_quarterTm_L 0;
BA_ "GenSigTimeoutTime_HCP" SG_ 604 SRT_quarterTm_L 0;
BA_ "GenSigTimeoutTime_IPC" SG_ 604 SRT_quarterTm_L 0;
BA_ "GenSigTimeoutTime_RFHM" SG_ 604 SRT_quarterTm_L 0;
BA_ "GenSigTimeoutTime_TCM" SG_ 604 SRT_quarterTm_L 0;
BA_ "GenSigStartValue" SG_ 604 SRT_quarterTmB 255;
BA_ "GenSigSendType" SG_ 604 SRT_quarterTmB 3;
BA_ "GenSigTimeoutTime_AGSM" SG_ 604 SRT_quarterTmB 0;
BA_ "GenSigTimeoutTime_BCM" SG_ 604 SRT_quarterTmB 0;
BA_ "GenSigTimeoutTime_BSM" SG_ 604 SRT_quarterTmB 0;
BA_ "GenSigTimeoutTime_CADM" SG_ 604 SRT_quarterTmB 0;
BA_ "GenSigTimeoutTime_DMSM" SG_ 604 SRT_quarterTmB 0;
BA_ "GenSigTimeoutTime_DTCM" SG_ 604 SRT_quarterTmB 0;
BA_ "GenSigTimeoutTime_ECM" SG_ 604 SRT_quarterTmB 0;
BA_ "GenSigTimeoutTime_EVCU2" SG_ 604 SRT_quarterTmB 0;
BA_ "GenSigTimeoutTime_GNMM" SG_ 604 SRT_quarterTmB 0;
BA_ "GenSigTimeoutTime_HCP" SG_ 604 SRT_quarterTmB 0;
BA_ "GenSigTimeoutTime_IPC" SG_ 604 SRT_quarterTmB 0;
BA_ "GenSigTimeoutTime_RFHM" SG_ 604 SRT_quarterTmB 0;
BA_ "GenSigTimeoutTime_TCM" SG_ 604 SRT_quarterTmB 0;
BA_ "GenSigStartValue" SG_ 604 SRT_quarterTmC 255;
BA_ "GenSigSendType" SG_ 604 SRT_quarterTmC 3;
BA_ "GenSigTimeoutTime_AGSM" SG_ 604 SRT_quarterTmC 0;
BA_ "GenSigTimeoutTime_BCM" SG_ 604 SRT_quarterTmC 0;
BA_ "GenSigTimeoutTime_BSM" SG_ 604 SRT_quarterTmC 0;
BA_ "GenSigTimeoutTime_CADM" SG_ 604 SRT_quarterTmC 0;
BA_ "GenSigTimeoutTime_DMSM" SG_ 604 SRT_quarterTmC 0;
BA_ "GenSigTimeoutTime_DTCM" SG_ 604 SRT_quarterTmC 0;
BA_ "GenSigTimeoutTime_ECM" SG_ 604 SRT_quarterTmC 0;
BA_ "GenSigTimeoutTime_EVCU2" SG_ 604 SRT_quarterTmC 0;
BA_ "GenSigTimeoutTime_GNMM" SG_ 604 SRT_quarterTmC 0;
BA_ "GenSigTimeoutTime_HCP" SG_ 604 SRT_quarterTmC 0;
BA_ "GenSigTimeoutTime_IPC" SG_ 604 SRT_quarterTmC 0;
BA_ "GenSigTimeoutTime_RFHM" SG_ 604 SRT_quarterTmC 0;
BA_ "GenSigTimeoutTime_TCM" SG_ 604 SRT_quarterTmC 0;
BA_ "GenSigStartValue" SG_ 604 SRT_quarterTmL 255;
BA_ "GenSigSendType" SG_ 604 SRT_quarterTmL 3;
BA_ "GenSigTimeoutTime_AGSM" SG_ 604 SRT_quarterTmL 0;
BA_ "GenSigTimeoutTime_BCM" SG_ 604 SRT_quarterTmL 0;
BA_ "GenSigTimeoutTime_BSM" SG_ 604 SRT_quarterTmL 0;
BA_ "GenSigTimeoutTime_CADM" SG_ 604 SRT_quarterTmL 0;
BA_ "GenSigTimeoutTime_DMSM" SG_ 604 SRT_quarterTmL 0;
BA_ "GenSigTimeoutTime_DTCM" SG_ 604 SRT_quarterTmL 0;
BA_ "GenSigTimeoutTime_ECM" SG_ 604 SRT_quarterTmL 0;
BA_ "GenSigTimeoutTime_EVCU2" SG_ 604 SRT_quarterTmL 0;
BA_ "GenSigTimeoutTime_GNMM" SG_ 604 SRT_quarterTmL 0;
BA_ "GenSigTimeoutTime_HCP" SG_ 604 SRT_quarterTmL 0;
BA_ "GenSigTimeoutTime_IPC" SG_ 604 SRT_quarterTmL 0;
BA_ "GenSigTimeoutTime_RFHM" SG_ 604 SRT_quarterTmL 0;
BA_ "GenSigTimeoutTime_TCM" SG_ 604 SRT_quarterTmL 0;
BA_ "GenSigStartValue" SG_ 604 SRT_ReactTm_B 255;
BA_ "GenSigSendType" SG_ 604 SRT_ReactTm_B 3;
BA_ "GenSigTimeoutTime_AGSM" SG_ 604 SRT_ReactTm_B 0;
BA_ "GenSigTimeoutTime_BCM" SG_ 604 SRT_ReactTm_B 0;
BA_ "GenSigTimeoutTime_BSM" SG_ 604 SRT_ReactTm_B 0;
BA_ "GenSigTimeoutTime_CADM" SG_ 604 SRT_ReactTm_B 0;
BA_ "GenSigTimeoutTime_DMSM" SG_ 604 SRT_ReactTm_B 0;
BA_ "GenSigTimeoutTime_DTCM" SG_ 604 SRT_ReactTm_B 0;
BA_ "GenSigTimeoutTime_ECM" SG_ 604 SRT_ReactTm_B 0;
BA_ "GenSigTimeoutTime_EVCU2" SG_ 604 SRT_ReactTm_B 0;
BA_ "GenSigTimeoutTime_GNMM" SG_ 604 SRT_ReactTm_B 0;
BA_ "GenSigTimeoutTime_HCP" SG_ 604 SRT_ReactTm_B 0;
BA_ "GenSigTimeoutTime_IPC" SG_ 604 SRT_ReactTm_B 0;
BA_ "GenSigTimeoutTime_RFHM" SG_ 604 SRT_ReactTm_B 0;
BA_ "GenSigTimeoutTime_TCM" SG_ 604 SRT_ReactTm_B 0;
BA_ "GenSigStartValue" SG_ 604 SRT_ReactTm_C 255;
BA_ "GenSigSendType" SG_ 604 SRT_ReactTm_C 3;
BA_ "GenSigTimeoutTime_AGSM" SG_ 604 SRT_ReactTm_C 0;
BA_ "GenSigTimeoutTime_BCM" SG_ 604 SRT_ReactTm_C 0;
BA_ "GenSigTimeoutTime_BSM" SG_ 604 SRT_ReactTm_C 0;
BA_ "GenSigTimeoutTime_CADM" SG_ 604 SRT_ReactTm_C 0;
BA_ "GenSigTimeoutTime_DMSM" SG_ 604 SRT_ReactTm_C 0;
BA_ "GenSigTimeoutTime_DTCM" SG_ 604 SRT_ReactTm_C 0;
BA_ "GenSigTimeoutTime_ECM" SG_ 604 SRT_ReactTm_C 0;
BA_ "GenSigTimeoutTime_EVCU2" SG_ 604 SRT_ReactTm_C 0;
BA_ "GenSigTimeoutTime_GNMM" SG_ 604 SRT_ReactTm_C 0;
BA_ "GenSigTimeoutTime_HCP" SG_ 604 SRT_ReactTm_C 0;
BA_ "GenSigTimeoutTime_IPC" SG_ 604 SRT_ReactTm_C 0;
BA_ "GenSigTimeoutTime_RFHM" SG_ 604 SRT_ReactTm_C 0;
BA_ "GenSigTimeoutTime_TCM" SG_ 604 SRT_ReactTm_C 0;
BA_ "GenSigStartValue" SG_ 604 SRT_ReactTm_L 255;
BA_ "GenSigSendType" SG_ 604 SRT_ReactTm_L 3;
BA_ "GenSigTimeoutTime_AGSM" SG_ 604 SRT_ReactTm_L 0;
BA_ "GenSigTimeoutTime_BCM" SG_ 604 SRT_ReactTm_L 0;
BA_ "GenSigTimeoutTime_BSM" SG_ 604 SRT_ReactTm_L 0;
BA_ "GenSigTimeoutTime_CADM" SG_ 604 SRT_ReactTm_L 0;
BA_ "GenSigTimeoutTime_DMSM" SG_ 604 SRT_ReactTm_L 0;
BA_ "GenSigTimeoutTime_DTCM" SG_ 604 SRT_ReactTm_L 0;
BA_ "GenSigTimeoutTime_ECM" SG_ 604 SRT_ReactTm_L 0;
BA_ "GenSigTimeoutTime_EVCU2" SG_ 604 SRT_ReactTm_L 0;
BA_ "GenSigTimeoutTime_GNMM" SG_ 604 SRT_ReactTm_L 0;
BA_ "GenSigTimeoutTime_HCP" SG_ 604 SRT_ReactTm_L 0;
BA_ "GenSigTimeoutTime_IPC" SG_ 604 SRT_ReactTm_L 0;
BA_ "GenSigTimeoutTime_RFHM" SG_ 604 SRT_ReactTm_L 0;
BA_ "GenSigTimeoutTime_TCM" SG_ 604 SRT_ReactTm_L 0;
BA_ "GenSigStartValue" SG_ 604 SRT_ReactTmB 255;
BA_ "GenSigSendType" SG_ 604 SRT_ReactTmB 3;
BA_ "GenSigTimeoutTime_AGSM" SG_ 604 SRT_ReactTmB 0;
BA_ "GenSigTimeoutTime_BCM" SG_ 604 SRT_ReactTmB 0;
BA_ "GenSigTimeoutTime_BSM" SG_ 604 SRT_ReactTmB 0;
BA_ "GenSigTimeoutTime_CADM" SG_ 604 SRT_ReactTmB 0;
BA_ "GenSigTimeoutTime_DMSM" SG_ 604 SRT_ReactTmB 0;
BA_ "GenSigTimeoutTime_DTCM" SG_ 604 SRT_ReactTmB 0;
BA_ "GenSigTimeoutTime_ECM" SG_ 604 SRT_ReactTmB 0;
BA_ "GenSigTimeoutTime_EVCU2" SG_ 604 SRT_ReactTmB 0;
BA_ "GenSigTimeoutTime_GNMM" SG_ 604 SRT_ReactTmB 0;
BA_ "GenSigTimeoutTime_HCP" SG_ 604 SRT_ReactTmB 0;
BA_ "GenSigTimeoutTime_IPC" SG_ 604 SRT_ReactTmB 0;
BA_ "GenSigTimeoutTime_RFHM" SG_ 604 SRT_ReactTmB 0;
BA_ "GenSigTimeoutTime_TCM" SG_ 604 SRT_ReactTmB 0;
BA_ "GenSigStartValue" SG_ 604 SRT_ReactTmC 255;
BA_ "GenSigSendType" SG_ 604 SRT_ReactTmC 3;
BA_ "GenSigTimeoutTime_AGSM" SG_ 604 SRT_ReactTmC 0;
BA_ "GenSigTimeoutTime_BCM" SG_ 604 SRT_ReactTmC 0;
BA_ "GenSigTimeoutTime_BSM" SG_ 604 SRT_ReactTmC 0;
BA_ "GenSigTimeoutTime_CADM" SG_ 604 SRT_ReactTmC 0;
BA_ "GenSigTimeoutTime_DMSM" SG_ 604 SRT_ReactTmC 0;
BA_ "GenSigTimeoutTime_DTCM" SG_ 604 SRT_ReactTmC 0;
BA_ "GenSigTimeoutTime_ECM" SG_ 604 SRT_ReactTmC 0;
BA_ "GenSigTimeoutTime_EVCU2" SG_ 604 SRT_ReactTmC 0;
BA_ "GenSigTimeoutTime_GNMM" SG_ 604 SRT_ReactTmC 0;
BA_ "GenSigTimeoutTime_HCP" SG_ 604 SRT_ReactTmC 0;
BA_ "GenSigTimeoutTime_IPC" SG_ 604 SRT_ReactTmC 0;
BA_ "GenSigTimeoutTime_RFHM" SG_ 604 SRT_ReactTmC 0;
BA_ "GenSigTimeoutTime_TCM" SG_ 604 SRT_ReactTmC 0;
BA_ "GenSigStartValue" SG_ 604 SRT_ReactTmL 255;
BA_ "GenSigSendType" SG_ 604 SRT_ReactTmL 3;
BA_ "GenSigTimeoutTime_AGSM" SG_ 604 SRT_ReactTmL 0;
BA_ "GenSigTimeoutTime_BCM" SG_ 604 SRT_ReactTmL 0;
BA_ "GenSigTimeoutTime_BSM" SG_ 604 SRT_ReactTmL 0;
BA_ "GenSigTimeoutTime_CADM" SG_ 604 SRT_ReactTmL 0;
BA_ "GenSigTimeoutTime_DMSM" SG_ 604 SRT_ReactTmL 0;
BA_ "GenSigTimeoutTime_DTCM" SG_ 604 SRT_ReactTmL 0;
BA_ "GenSigTimeoutTime_ECM" SG_ 604 SRT_ReactTmL 0;
BA_ "GenSigTimeoutTime_EVCU2" SG_ 604 SRT_ReactTmL 0;
BA_ "GenSigTimeoutTime_GNMM" SG_ 604 SRT_ReactTmL 0;
BA_ "GenSigTimeoutTime_HCP" SG_ 604 SRT_ReactTmL 0;
BA_ "GenSigTimeoutTime_IPC" SG_ 604 SRT_ReactTmL 0;
BA_ "GenSigTimeoutTime_RFHM" SG_ 604 SRT_ReactTmL 0;
BA_ "GenSigTimeoutTime_TCM" SG_ 604 SRT_ReactTmL 0;
BA_ "GenSigStartValue" SG_ 605 SRT_1000ftTm_B 255;
BA_ "GenSigSendType" SG_ 605 SRT_1000ftTm_B 3;
BA_ "GenSigTimeoutTime_AGSM" SG_ 605 SRT_1000ftTm_B 0;
BA_ "GenSigTimeoutTime_BCM" SG_ 605 SRT_1000ftTm_B 0;
BA_ "GenSigTimeoutTime_BSM" SG_ 605 SRT_1000ftTm_B 0;
BA_ "GenSigTimeoutTime_CADM" SG_ 605 SRT_1000ftTm_B 0;
BA_ "GenSigTimeoutTime_DMSM" SG_ 605 SRT_1000ftTm_B 0;
BA_ "GenSigTimeoutTime_DTCM" SG_ 605 SRT_1000ftTm_B 0;
BA_ "GenSigTimeoutTime_ECM" SG_ 605 SRT_1000ftTm_B 0;
BA_ "GenSigTimeoutTime_EVCU2" SG_ 605 SRT_1000ftTm_B 0;
BA_ "GenSigTimeoutTime_GNMM" SG_ 605 SRT_1000ftTm_B 0;
BA_ "GenSigTimeoutTime_HCP" SG_ 605 SRT_1000ftTm_B 0;
BA_ "GenSigTimeoutTime_IPC" SG_ 605 SRT_1000ftTm_B 0;
BA_ "GenSigTimeoutTime_RFHM" SG_ 605 SRT_1000ftTm_B 0;
BA_ "GenSigTimeoutTime_TCM" SG_ 605 SRT_1000ftTm_B 0;
BA_ "GenSigStartValue" SG_ 605 SRT_1000ftTm_C 255;
BA_ "GenSigSendType" SG_ 605 SRT_1000ftTm_C 3;
BA_ "GenSigTimeoutTime_AGSM" SG_ 605 SRT_1000ftTm_C 0;
BA_ "GenSigTimeoutTime_BCM" SG_ 605 SRT_1000ftTm_C 0;
BA_ "GenSigTimeoutTime_BSM" SG_ 605 SRT_1000ftTm_C 0;
BA_ "GenSigTimeoutTime_CADM" SG_ 605 SRT_1000ftTm_C 0;
BA_ "GenSigTimeoutTime_DMSM" SG_ 605 SRT_1000ftTm_C 0;
BA_ "GenSigTimeoutTime_DTCM" SG_ 605 SRT_1000ftTm_C 0;
BA_ "GenSigTimeoutTime_ECM" SG_ 605 SRT_1000ftTm_C 0;
BA_ "GenSigTimeoutTime_EVCU2" SG_ 605 SRT_1000ftTm_C 0;
BA_ "GenSigTimeoutTime_GNMM" SG_ 605 SRT_1000ftTm_C 0;
BA_ "GenSigTimeoutTime_HCP" SG_ 605 SRT_1000ftTm_C 0;
BA_ "GenSigTimeoutTime_IPC" SG_ 605 SRT_1000ftTm_C 0;
BA_ "GenSigTimeoutTime_RFHM" SG_ 605 SRT_1000ftTm_C 0;
BA_ "GenSigTimeoutTime_TCM" SG_ 605 SRT_1000ftTm_C 0;
BA_ "GenSigStartValue" SG_ 605 SRT_1000ftTm_L 255;
BA_ "GenSigSendType" SG_ 605 SRT_1000ftTm_L 3;
BA_ "GenSigTimeoutTime_AGSM" SG_ 605 SRT_1000ftTm_L 0;
BA_ "GenSigTimeoutTime_BCM" SG_ 605 SRT_1000ftTm_L 0;
BA_ "GenSigTimeoutTime_BSM" SG_ 605 SRT_1000ftTm_L 0;
BA_ "GenSigTimeoutTime_CADM" SG_ 605 SRT_1000ftTm_L 0;
BA_ "GenSigTimeoutTime_DMSM" SG_ 605 SRT_1000ftTm_L 0;
BA_ "GenSigTimeoutTime_DTCM" SG_ 605 SRT_1000ftTm_L 0;
BA_ "GenSigTimeoutTime_ECM" SG_ 605 SRT_1000ftTm_L 0;
BA_ "GenSigTimeoutTime_EVCU2" SG_ 605 SRT_1000ftTm_L 0;
BA_ "GenSigTimeoutTime_GNMM" SG_ 605 SRT_1000ftTm_L 0;
BA_ "GenSigTimeoutTime_HCP" SG_ 605 SRT_1000ftTm_L 0;
BA_ "GenSigTimeoutTime_IPC" SG_ 605 SRT_1000ftTm_L 0;
BA_ "GenSigTimeoutTime_RFHM" SG_ 605 SRT_1000ftTm_L 0;
BA_ "GenSigTimeoutTime_TCM" SG_ 605 SRT_1000ftTm_L 0;
BA_ "GenSigStartValue" SG_ 605 SRT_1000ftTmB 255;
BA_ "GenSigSendType" SG_ 605 SRT_1000ftTmB 3;
BA_ "GenSigTimeoutTime_AGSM" SG_ 605 SRT_1000ftTmB 0;
BA_ "GenSigTimeoutTime_BCM" SG_ 605 SRT_1000ftTmB 0;
BA_ "GenSigTimeoutTime_BSM" SG_ 605 SRT_1000ftTmB 0;
BA_ "GenSigTimeoutTime_CADM" SG_ 605 SRT_1000ftTmB 0;
BA_ "GenSigTimeoutTime_DMSM" SG_ 605 SRT_1000ftTmB 0;
BA_ "GenSigTimeoutTime_DTCM" SG_ 605 SRT_1000ftTmB 0;
BA_ "GenSigTimeoutTime_ECM" SG_ 605 SRT_1000ftTmB 0;
BA_ "GenSigTimeoutTime_EVCU2" SG_ 605 SRT_1000ftTmB 0;
BA_ "GenSigTimeoutTime_GNMM" SG_ 605 SRT_1000ftTmB 0;
BA_ "GenSigTimeoutTime_HCP" SG_ 605 SRT_1000ftTmB 0;
BA_ "GenSigTimeoutTime_IPC" SG_ 605 SRT_1000ftTmB 0;
BA_ "GenSigTimeoutTime_RFHM" SG_ 605 SRT_1000ftTmB 0;
BA_ "GenSigTimeoutTime_TCM" SG_ 605 SRT_1000ftTmB 0;
BA_ "GenSigStartValue" SG_ 605 SRT_1000ftTmC 255;
BA_ "GenSigSendType" SG_ 605 SRT_1000ftTmC 3;
BA_ "GenSigTimeoutTime_AGSM" SG_ 605 SRT_1000ftTmC 0;
BA_ "GenSigTimeoutTime_BCM" SG_ 605 SRT_1000ftTmC 0;
BA_ "GenSigTimeoutTime_BSM" SG_ 605 SRT_1000ftTmC 0;
BA_ "GenSigTimeoutTime_CADM" SG_ 605 SRT_1000ftTmC 0;
BA_ "GenSigTimeoutTime_DMSM" SG_ 605 SRT_1000ftTmC 0;
BA_ "GenSigTimeoutTime_DTCM" SG_ 605 SRT_1000ftTmC 0;
BA_ "GenSigTimeoutTime_ECM" SG_ 605 SRT_1000ftTmC 0;
BA_ "GenSigTimeoutTime_EVCU2" SG_ 605 SRT_1000ftTmC 0;
BA_ "GenSigTimeoutTime_GNMM" SG_ 605 SRT_1000ftTmC 0;
BA_ "GenSigTimeoutTime_HCP" SG_ 605 SRT_1000ftTmC 0;
BA_ "GenSigTimeoutTime_IPC" SG_ 605 SRT_1000ftTmC 0;
BA_ "GenSigTimeoutTime_RFHM" SG_ 605 SRT_1000ftTmC 0;
BA_ "GenSigTimeoutTime_TCM" SG_ 605 SRT_1000ftTmC 0;
BA_ "GenSigStartValue" SG_ 605 SRT_1000ftTmL 255;
BA_ "GenSigSendType" SG_ 605 SRT_1000ftTmL 3;
BA_ "GenSigTimeoutTime_AGSM" SG_ 605 SRT_1000ftTmL 0;
BA_ "GenSigTimeoutTime_BCM" SG_ 605 SRT_1000ftTmL 0;
BA_ "GenSigTimeoutTime_BSM" SG_ 605 SRT_1000ftTmL 0;
BA_ "GenSigTimeoutTime_CADM" SG_ 605 SRT_1000ftTmL 0;
BA_ "GenSigTimeoutTime_DMSM" SG_ 605 SRT_1000ftTmL 0;
BA_ "GenSigTimeoutTime_DTCM" SG_ 605 SRT_1000ftTmL 0;
BA_ "GenSigTimeoutTime_ECM" SG_ 605 SRT_1000ftTmL 0;
BA_ "GenSigTimeoutTime_EVCU2" SG_ 605 SRT_1000ftTmL 0;
BA_ "GenSigTimeoutTime_GNMM" SG_ 605 SRT_1000ftTmL 0;
BA_ "GenSigTimeoutTime_HCP" SG_ 605 SRT_1000ftTmL 0;
BA_ "GenSigTimeoutTime_IPC" SG_ 605 SRT_1000ftTmL 0;
BA_ "GenSigTimeoutTime_RFHM" SG_ 605 SRT_1000ftTmL 0;
BA_ "GenSigTimeoutTime_TCM" SG_ 605 SRT_1000ftTmL 0;
BA_ "GenSigStartValue" SG_ 605 SRT_330ftTm_B 255;
BA_ "GenSigSendType" SG_ 605 SRT_330ftTm_B 3;
BA_ "GenSigTimeoutTime_AGSM" SG_ 605 SRT_330ftTm_B 0;
BA_ "GenSigTimeoutTime_BCM" SG_ 605 SRT_330ftTm_B 0;
BA_ "GenSigTimeoutTime_BSM" SG_ 605 SRT_330ftTm_B 0;
BA_ "GenSigTimeoutTime_CADM" SG_ 605 SRT_330ftTm_B 0;
BA_ "GenSigTimeoutTime_DMSM" SG_ 605 SRT_330ftTm_B 0;
BA_ "GenSigTimeoutTime_DTCM" SG_ 605 SRT_330ftTm_B 0;
BA_ "GenSigTimeoutTime_ECM" SG_ 605 SRT_330ftTm_B 0;
BA_ "GenSigTimeoutTime_EVCU2" SG_ 605 SRT_330ftTm_B 0;
BA_ "GenSigTimeoutTime_GNMM" SG_ 605 SRT_330ftTm_B 0;
BA_ "GenSigTimeoutTime_HCP" SG_ 605 SRT_330ftTm_B 0;
BA_ "GenSigTimeoutTime_IPC" SG_ 605 SRT_330ftTm_B 0;
BA_ "GenSigTimeoutTime_RFHM" SG_ 605 SRT_330ftTm_B 0;
BA_ "GenSigTimeoutTime_TCM" SG_ 605 SRT_330ftTm_B 0;
BA_ "GenSigStartValue" SG_ 605 SRT_330ftTm_C 255;
BA_ "GenSigSendType" SG_ 605 SRT_330ftTm_C 3;
BA_ "GenSigTimeoutTime_AGSM" SG_ 605 SRT_330ftTm_C 0;
BA_ "GenSigTimeoutTime_BCM" SG_ 605 SRT_330ftTm_C 0;
BA_ "GenSigTimeoutTime_BSM" SG_ 605 SRT_330ftTm_C 0;
BA_ "GenSigTimeoutTime_CADM" SG_ 605 SRT_330ftTm_C 0;
BA_ "GenSigTimeoutTime_DMSM" SG_ 605 SRT_330ftTm_C 0;
BA_ "GenSigTimeoutTime_DTCM" SG_ 605 SRT_330ftTm_C 0;
BA_ "GenSigTimeoutTime_ECM" SG_ 605 SRT_330ftTm_C 0;
BA_ "GenSigTimeoutTime_EVCU2" SG_ 605 SRT_330ftTm_C 0;
BA_ "GenSigTimeoutTime_GNMM" SG_ 605 SRT_330ftTm_C 0;
BA_ "GenSigTimeoutTime_HCP" SG_ 605 SRT_330ftTm_C 0;
BA_ "GenSigTimeoutTime_IPC" SG_ 605 SRT_330ftTm_C 0;
BA_ "GenSigTimeoutTime_RFHM" SG_ 605 SRT_330ftTm_C 0;
BA_ "GenSigTimeoutTime_TCM" SG_ 605 SRT_330ftTm_C 0;
BA_ "GenSigStartValue" SG_ 605 SRT_330ftTm_L 255;
BA_ "GenSigSendType" SG_ 605 SRT_330ftTm_L 3;
BA_ "GenSigTimeoutTime_AGSM" SG_ 605 SRT_330ftTm_L 0;
BA_ "GenSigTimeoutTime_BCM" SG_ 605 SRT_330ftTm_L 0;
BA_ "GenSigTimeoutTime_BSM" SG_ 605 SRT_330ftTm_L 0;
BA_ "GenSigTimeoutTime_CADM" SG_ 605 SRT_330ftTm_L 0;
BA_ "GenSigTimeoutTime_DMSM" SG_ 605 SRT_330ftTm_L 0;
BA_ "GenSigTimeoutTime_DTCM" SG_ 605 SRT_330ftTm_L 0;
BA_ "GenSigTimeoutTime_ECM" SG_ 605 SRT_330ftTm_L 0;
BA_ "GenSigTimeoutTime_EVCU2" SG_ 605 SRT_330ftTm_L 0;
BA_ "GenSigTimeoutTime_GNMM" SG_ 605 SRT_330ftTm_L 0;
BA_ "GenSigTimeoutTime_HCP" SG_ 605 SRT_330ftTm_L 0;
BA_ "GenSigTimeoutTime_IPC" SG_ 605 SRT_330ftTm_L 0;
BA_ "GenSigTimeoutTime_RFHM" SG_ 605 SRT_330ftTm_L 0;
BA_ "GenSigTimeoutTime_TCM" SG_ 605 SRT_330ftTm_L 0;
BA_ "GenSigStartValue" SG_ 605 SRT_330ftTmB 255;
BA_ "GenSigSendType" SG_ 605 SRT_330ftTmB 3;
BA_ "GenSigTimeoutTime_AGSM" SG_ 605 SRT_330ftTmB 0;
BA_ "GenSigTimeoutTime_BCM" SG_ 605 SRT_330ftTmB 0;
BA_ "GenSigTimeoutTime_BSM" SG_ 605 SRT_330ftTmB 0;
BA_ "GenSigTimeoutTime_CADM" SG_ 605 SRT_330ftTmB 0;
BA_ "GenSigTimeoutTime_DMSM" SG_ 605 SRT_330ftTmB 0;
BA_ "GenSigTimeoutTime_DTCM" SG_ 605 SRT_330ftTmB 0;
BA_ "GenSigTimeoutTime_ECM" SG_ 605 SRT_330ftTmB 0;
BA_ "GenSigTimeoutTime_EVCU2" SG_ 605 SRT_330ftTmB 0;
BA_ "GenSigTimeoutTime_GNMM" SG_ 605 SRT_330ftTmB 0;
BA_ "GenSigTimeoutTime_HCP" SG_ 605 SRT_330ftTmB 0;
BA_ "GenSigTimeoutTime_IPC" SG_ 605 SRT_330ftTmB 0;
BA_ "GenSigTimeoutTime_RFHM" SG_ 605 SRT_330ftTmB 0;
BA_ "GenSigTimeoutTime_TCM" SG_ 605 SRT_330ftTmB 0;
BA_ "GenSigStartValue" SG_ 605 SRT_330ftTmC 255;
BA_ "GenSigSendType" SG_ 605 SRT_330ftTmC 3;
BA_ "GenSigTimeoutTime_AGSM" SG_ 605 SRT_330ftTmC 0;
BA_ "GenSigTimeoutTime_BCM" SG_ 605 SRT_330ftTmC 0;
BA_ "GenSigTimeoutTime_BSM" SG_ 605 SRT_330ftTmC 0;
BA_ "GenSigTimeoutTime_CADM" SG_ 605 SRT_330ftTmC 0;
BA_ "GenSigTimeoutTime_DMSM" SG_ 605 SRT_330ftTmC 0;
BA_ "GenSigTimeoutTime_DTCM" SG_ 605 SRT_330ftTmC 0;
BA_ "GenSigTimeoutTime_ECM" SG_ 605 SRT_330ftTmC 0;
BA_ "GenSigTimeoutTime_EVCU2" SG_ 605 SRT_330ftTmC 0;
BA_ "GenSigTimeoutTime_GNMM" SG_ 605 SRT_330ftTmC 0;
BA_ "GenSigTimeoutTime_HCP" SG_ 605 SRT_330ftTmC 0;
BA_ "GenSigTimeoutTime_IPC" SG_ 605 SRT_330ftTmC 0;
BA_ "GenSigTimeoutTime_RFHM" SG_ 605 SRT_330ftTmC 0;
BA_ "GenSigTimeoutTime_TCM" SG_ 605 SRT_330ftTmC 0;
BA_ "GenSigStartValue" SG_ 605 SRT_330ftTmL 255;
BA_ "GenSigSendType" SG_ 605 SRT_330ftTmL 3;
BA_ "GenSigTimeoutTime_AGSM" SG_ 605 SRT_330ftTmL 0;
BA_ "GenSigTimeoutTime_BCM" SG_ 605 SRT_330ftTmL 0;
BA_ "GenSigTimeoutTime_BSM" SG_ 605 SRT_330ftTmL 0;
BA_ "GenSigTimeoutTime_CADM" SG_ 605 SRT_330ftTmL 0;
BA_ "GenSigTimeoutTime_DMSM" SG_ 605 SRT_330ftTmL 0;
BA_ "GenSigTimeoutTime_DTCM" SG_ 605 SRT_330ftTmL 0;
BA_ "GenSigTimeoutTime_ECM" SG_ 605 SRT_330ftTmL 0;
BA_ "GenSigTimeoutTime_EVCU2" SG_ 605 SRT_330ftTmL 0;
BA_ "GenSigTimeoutTime_GNMM" SG_ 605 SRT_330ftTmL 0;
BA_ "GenSigTimeoutTime_HCP" SG_ 605 SRT_330ftTmL 0;
BA_ "GenSigTimeoutTime_IPC" SG_ 605 SRT_330ftTmL 0;
BA_ "GenSigTimeoutTime_RFHM" SG_ 605 SRT_330ftTmL 0;
BA_ "GenSigTimeoutTime_TCM" SG_ 605 SRT_330ftTmL 0;
BA_ "GenSigStartValue" SG_ 605 SRT_60ftTm_B 511;
BA_ "GenSigSendType" SG_ 605 SRT_60ftTm_B 3;
BA_ "GenSigTimeoutTime_AGSM" SG_ 605 SRT_60ftTm_B 0;
BA_ "GenSigTimeoutTime_BCM" SG_ 605 SRT_60ftTm_B 0;
BA_ "GenSigTimeoutTime_BSM" SG_ 605 SRT_60ftTm_B 0;
BA_ "GenSigTimeoutTime_CADM" SG_ 605 SRT_60ftTm_B 0;
BA_ "GenSigTimeoutTime_DMSM" SG_ 605 SRT_60ftTm_B 0;
BA_ "GenSigTimeoutTime_DTCM" SG_ 605 SRT_60ftTm_B 0;
BA_ "GenSigTimeoutTime_ECM" SG_ 605 SRT_60ftTm_B 0;
BA_ "GenSigTimeoutTime_EVCU2" SG_ 605 SRT_60ftTm_B 0;
BA_ "GenSigTimeoutTime_GNMM" SG_ 605 SRT_60ftTm_B 0;
BA_ "GenSigTimeoutTime_HCP" SG_ 605 SRT_60ftTm_B 0;
BA_ "GenSigTimeoutTime_IPC" SG_ 605 SRT_60ftTm_B 0;
BA_ "GenSigTimeoutTime_RFHM" SG_ 605 SRT_60ftTm_B 0;
BA_ "GenSigTimeoutTime_TCM" SG_ 605 SRT_60ftTm_B 0;
BA_ "GenSigStartValue" SG_ 605 SRT_60ftTm_C 511;
BA_ "GenSigSendType" SG_ 605 SRT_60ftTm_C 3;
BA_ "GenSigTimeoutTime_AGSM" SG_ 605 SRT_60ftTm_C 0;
BA_ "GenSigTimeoutTime_BCM" SG_ 605 SRT_60ftTm_C 0;
BA_ "GenSigTimeoutTime_BSM" SG_ 605 SRT_60ftTm_C 0;
BA_ "GenSigTimeoutTime_CADM" SG_ 605 SRT_60ftTm_C 0;
BA_ "GenSigTimeoutTime_DMSM" SG_ 605 SRT_60ftTm_C 0;
BA_ "GenSigTimeoutTime_DTCM" SG_ 605 SRT_60ftTm_C 0;
BA_ "GenSigTimeoutTime_ECM" SG_ 605 SRT_60ftTm_C 0;
BA_ "GenSigTimeoutTime_EVCU2" SG_ 605 SRT_60ftTm_C 0;
BA_ "GenSigTimeoutTime_GNMM" SG_ 605 SRT_60ftTm_C 0;
BA_ "GenSigTimeoutTime_HCP" SG_ 605 SRT_60ftTm_C 0;
BA_ "GenSigTimeoutTime_IPC" SG_ 605 SRT_60ftTm_C 0;
BA_ "GenSigTimeoutTime_RFHM" SG_ 605 SRT_60ftTm_C 0;
BA_ "GenSigTimeoutTime_TCM" SG_ 605 SRT_60ftTm_C 0;
BA_ "GenSigStartValue" SG_ 605 SRT_60ftTm_L 511;
BA_ "GenSigSendType" SG_ 605 SRT_60ftTm_L 3;
BA_ "GenSigTimeoutTime_AGSM" SG_ 605 SRT_60ftTm_L 0;
BA_ "GenSigTimeoutTime_BCM" SG_ 605 SRT_60ftTm_L 0;
BA_ "GenSigTimeoutTime_BSM" SG_ 605 SRT_60ftTm_L 0;
BA_ "GenSigTimeoutTime_CADM" SG_ 605 SRT_60ftTm_L 0;
BA_ "GenSigTimeoutTime_DMSM" SG_ 605 SRT_60ftTm_L 0;
BA_ "GenSigTimeoutTime_DTCM" SG_ 605 SRT_60ftTm_L 0;
BA_ "GenSigTimeoutTime_ECM" SG_ 605 SRT_60ftTm_L 0;
BA_ "GenSigTimeoutTime_EVCU2" SG_ 605 SRT_60ftTm_L 0;
BA_ "GenSigTimeoutTime_GNMM" SG_ 605 SRT_60ftTm_L 0;
BA_ "GenSigTimeoutTime_HCP" SG_ 605 SRT_60ftTm_L 0;
BA_ "GenSigTimeoutTime_IPC" SG_ 605 SRT_60ftTm_L 0;
BA_ "GenSigTimeoutTime_RFHM" SG_ 605 SRT_60ftTm_L 0;
BA_ "GenSigTimeoutTime_TCM" SG_ 605 SRT_60ftTm_L 0;
BA_ "GenSigStartValue" SG_ 605 SRT_60ftTmB 511;
BA_ "GenSigSendType" SG_ 605 SRT_60ftTmB 4;
BA_ "GenSigTimeoutTime_AGSM" SG_ 605 SRT_60ftTmB 0;
BA_ "GenSigTimeoutTime_BCM" SG_ 605 SRT_60ftTmB 0;
BA_ "GenSigTimeoutTime_BSM" SG_ 605 SRT_60ftTmB 0;
BA_ "GenSigTimeoutTime_CADM" SG_ 605 SRT_60ftTmB 0;
BA_ "GenSigTimeoutTime_DMSM" SG_ 605 SRT_60ftTmB 0;
BA_ "GenSigTimeoutTime_DTCM" SG_ 605 SRT_60ftTmB 0;
BA_ "GenSigTimeoutTime_ECM" SG_ 605 SRT_60ftTmB 0;
BA_ "GenSigTimeoutTime_EVCU2" SG_ 605 SRT_60ftTmB 0;
BA_ "GenSigTimeoutTime_GNMM" SG_ 605 SRT_60ftTmB 0;
BA_ "GenSigTimeoutTime_HCP" SG_ 605 SRT_60ftTmB 0;
BA_ "GenSigTimeoutTime_IPC" SG_ 605 SRT_60ftTmB 0;
BA_ "GenSigTimeoutTime_RFHM" SG_ 605 SRT_60ftTmB 0;
BA_ "GenSigTimeoutTime_TCM" SG_ 605 SRT_60ftTmB 0;
BA_ "GenSigStartValue" SG_ 605 SRT_60ftTmC 511;
BA_ "GenSigSendType" SG_ 605 SRT_60ftTmC 3;
BA_ "GenSigTimeoutTime_AGSM" SG_ 605 SRT_60ftTmC 0;
BA_ "GenSigTimeoutTime_BCM" SG_ 605 SRT_60ftTmC 0;
BA_ "GenSigTimeoutTime_BSM" SG_ 605 SRT_60ftTmC 0;
BA_ "GenSigTimeoutTime_CADM" SG_ 605 SRT_60ftTmC 0;
BA_ "GenSigTimeoutTime_DMSM" SG_ 605 SRT_60ftTmC 0;
BA_ "GenSigTimeoutTime_DTCM" SG_ 605 SRT_60ftTmC 0;
BA_ "GenSigTimeoutTime_ECM" SG_ 605 SRT_60ftTmC 0;
BA_ "GenSigTimeoutTime_EVCU2" SG_ 605 SRT_60ftTmC 0;
BA_ "GenSigTimeoutTime_GNMM" SG_ 605 SRT_60ftTmC 0;
BA_ "GenSigTimeoutTime_HCP" SG_ 605 SRT_60ftTmC 0;
BA_ "GenSigTimeoutTime_IPC" SG_ 605 SRT_60ftTmC 0;
BA_ "GenSigTimeoutTime_RFHM" SG_ 605 SRT_60ftTmC 0;
BA_ "GenSigTimeoutTime_TCM" SG_ 605 SRT_60ftTmC 0;
BA_ "GenSigStartValue" SG_ 605 SRT_60ftTmL 511;
BA_ "GenSigSendType" SG_ 605 SRT_60ftTmL 3;
BA_ "GenSigTimeoutTime_AGSM" SG_ 605 SRT_60ftTmL 0;
BA_ "GenSigTimeoutTime_BCM" SG_ 605 SRT_60ftTmL 0;
BA_ "GenSigTimeoutTime_BSM" SG_ 605 SRT_60ftTmL 0;
BA_ "GenSigTimeoutTime_CADM" SG_ 605 SRT_60ftTmL 0;
BA_ "GenSigTimeoutTime_DMSM" SG_ 605 SRT_60ftTmL 0;
BA_ "GenSigTimeoutTime_DTCM" SG_ 605 SRT_60ftTmL 0;
BA_ "GenSigTimeoutTime_ECM" SG_ 605 SRT_60ftTmL 0;
BA_ "GenSigTimeoutTime_EVCU2" SG_ 605 SRT_60ftTmL 0;
BA_ "GenSigTimeoutTime_GNMM" SG_ 605 SRT_60ftTmL 0;
BA_ "GenSigTimeoutTime_HCP" SG_ 605 SRT_60ftTmL 0;
BA_ "GenSigTimeoutTime_IPC" SG_ 605 SRT_60ftTmL 0;
BA_ "GenSigTimeoutTime_RFHM" SG_ 605 SRT_60ftTmL 0;
BA_ "GenSigTimeoutTime_TCM" SG_ 605 SRT_60ftTmL 0;
BA_ "GenSigStartValue" SG_ 605 SRT_BrkDistB_M 255;
BA_ "GenSigSendType" SG_ 605 SRT_BrkDistB_M 3;
BA_ "GenSigTimeoutTime_AGSM" SG_ 605 SRT_BrkDistB_M 0;
BA_ "GenSigTimeoutTime_BCM" SG_ 605 SRT_BrkDistB_M 0;
BA_ "GenSigTimeoutTime_BSM" SG_ 605 SRT_BrkDistB_M 0;
BA_ "GenSigTimeoutTime_CADM" SG_ 605 SRT_BrkDistB_M 0;
BA_ "GenSigTimeoutTime_DMSM" SG_ 605 SRT_BrkDistB_M 0;
BA_ "GenSigTimeoutTime_DTCM" SG_ 605 SRT_BrkDistB_M 0;
BA_ "GenSigTimeoutTime_ECM" SG_ 605 SRT_BrkDistB_M 0;
BA_ "GenSigTimeoutTime_EVCU2" SG_ 605 SRT_BrkDistB_M 0;
BA_ "GenSigTimeoutTime_GNMM" SG_ 605 SRT_BrkDistB_M 0;
BA_ "GenSigTimeoutTime_HCP" SG_ 605 SRT_BrkDistB_M 0;
BA_ "GenSigTimeoutTime_IPC" SG_ 605 SRT_BrkDistB_M 0;
BA_ "GenSigTimeoutTime_RFHM" SG_ 605 SRT_BrkDistB_M 0;
BA_ "GenSigTimeoutTime_TCM" SG_ 605 SRT_BrkDistB_M 0;
BA_ "GenSigStartValue" SG_ 605 SRT_BrkDistB_US 255;
BA_ "GenSigSendType" SG_ 605 SRT_BrkDistB_US 3;
BA_ "GenSigTimeoutTime_AGSM" SG_ 605 SRT_BrkDistB_US 0;
BA_ "GenSigTimeoutTime_BCM" SG_ 605 SRT_BrkDistB_US 0;
BA_ "GenSigTimeoutTime_BSM" SG_ 605 SRT_BrkDistB_US 0;
BA_ "GenSigTimeoutTime_CADM" SG_ 605 SRT_BrkDistB_US 0;
BA_ "GenSigTimeoutTime_DMSM" SG_ 605 SRT_BrkDistB_US 0;
BA_ "GenSigTimeoutTime_DTCM" SG_ 605 SRT_BrkDistB_US 0;
BA_ "GenSigTimeoutTime_ECM" SG_ 605 SRT_BrkDistB_US 0;
BA_ "GenSigTimeoutTime_EVCU2" SG_ 605 SRT_BrkDistB_US 0;
BA_ "GenSigTimeoutTime_GNMM" SG_ 605 SRT_BrkDistB_US 0;
BA_ "GenSigTimeoutTime_HCP" SG_ 605 SRT_BrkDistB_US 0;
BA_ "GenSigTimeoutTime_IPC" SG_ 605 SRT_BrkDistB_US 0;
BA_ "GenSigTimeoutTime_RFHM" SG_ 605 SRT_BrkDistB_US 0;
BA_ "GenSigTimeoutTime_TCM" SG_ 605 SRT_BrkDistB_US 0;
BA_ "GenSigStartValue" SG_ 605 SRT_BrkDistC_M 255;
BA_ "GenSigSendType" SG_ 605 SRT_BrkDistC_M 3;
BA_ "GenSigTimeoutTime_AGSM" SG_ 605 SRT_BrkDistC_M 0;
BA_ "GenSigTimeoutTime_BCM" SG_ 605 SRT_BrkDistC_M 0;
BA_ "GenSigTimeoutTime_BSM" SG_ 605 SRT_BrkDistC_M 0;
BA_ "GenSigTimeoutTime_CADM" SG_ 605 SRT_BrkDistC_M 0;
BA_ "GenSigTimeoutTime_DMSM" SG_ 605 SRT_BrkDistC_M 0;
BA_ "GenSigTimeoutTime_DTCM" SG_ 605 SRT_BrkDistC_M 0;
BA_ "GenSigTimeoutTime_ECM" SG_ 605 SRT_BrkDistC_M 0;
BA_ "GenSigTimeoutTime_EVCU2" SG_ 605 SRT_BrkDistC_M 0;
BA_ "GenSigTimeoutTime_GNMM" SG_ 605 SRT_BrkDistC_M 0;
BA_ "GenSigTimeoutTime_HCP" SG_ 605 SRT_BrkDistC_M 0;
BA_ "GenSigTimeoutTime_IPC" SG_ 605 SRT_BrkDistC_M 0;
BA_ "GenSigTimeoutTime_RFHM" SG_ 605 SRT_BrkDistC_M 0;
BA_ "GenSigTimeoutTime_TCM" SG_ 605 SRT_BrkDistC_M 0;
BA_ "GenSigStartValue" SG_ 605 SRT_BrkDistC_US 255;
BA_ "GenSigSendType" SG_ 605 SRT_BrkDistC_US 3;
BA_ "GenSigTimeoutTime_AGSM" SG_ 605 SRT_BrkDistC_US 0;
BA_ "GenSigTimeoutTime_BCM" SG_ 605 SRT_BrkDistC_US 0;
BA_ "GenSigTimeoutTime_BSM" SG_ 605 SRT_BrkDistC_US 0;
BA_ "GenSigTimeoutTime_CADM" SG_ 605 SRT_BrkDistC_US 0;
BA_ "GenSigTimeoutTime_DMSM" SG_ 605 SRT_BrkDistC_US 0;
BA_ "GenSigTimeoutTime_DTCM" SG_ 605 SRT_BrkDistC_US 0;
BA_ "GenSigTimeoutTime_ECM" SG_ 605 SRT_BrkDistC_US 0;
BA_ "GenSigTimeoutTime_EVCU2" SG_ 605 SRT_BrkDistC_US 0;
BA_ "GenSigTimeoutTime_GNMM" SG_ 605 SRT_BrkDistC_US 0;
BA_ "GenSigTimeoutTime_HCP" SG_ 605 SRT_BrkDistC_US 0;
BA_ "GenSigTimeoutTime_IPC" SG_ 605 SRT_BrkDistC_US 0;
BA_ "GenSigTimeoutTime_RFHM" SG_ 605 SRT_BrkDistC_US 0;
BA_ "GenSigTimeoutTime_TCM" SG_ 605 SRT_BrkDistC_US 0;
BA_ "GenSigStartValue" SG_ 605 SRT_BrkDistL_M 255;
BA_ "GenSigSendType" SG_ 605 SRT_BrkDistL_M 3;
BA_ "GenSigTimeoutTime_AGSM" SG_ 605 SRT_BrkDistL_M 0;
BA_ "GenSigTimeoutTime_BCM" SG_ 605 SRT_BrkDistL_M 0;
BA_ "GenSigTimeoutTime_BSM" SG_ 605 SRT_BrkDistL_M 0;
BA_ "GenSigTimeoutTime_CADM" SG_ 605 SRT_BrkDistL_M 0;
BA_ "GenSigTimeoutTime_DMSM" SG_ 605 SRT_BrkDistL_M 0;
BA_ "GenSigTimeoutTime_DTCM" SG_ 605 SRT_BrkDistL_M 0;
BA_ "GenSigTimeoutTime_ECM" SG_ 605 SRT_BrkDistL_M 0;
BA_ "GenSigTimeoutTime_EVCU2" SG_ 605 SRT_BrkDistL_M 0;
BA_ "GenSigTimeoutTime_GNMM" SG_ 605 SRT_BrkDistL_M 0;
BA_ "GenSigTimeoutTime_HCP" SG_ 605 SRT_BrkDistL_M 0;
BA_ "GenSigTimeoutTime_IPC" SG_ 605 SRT_BrkDistL_M 0;
BA_ "GenSigTimeoutTime_RFHM" SG_ 605 SRT_BrkDistL_M 0;
BA_ "GenSigTimeoutTime_TCM" SG_ 605 SRT_BrkDistL_M 0;
BA_ "GenSigStartValue" SG_ 605 SRT_BrkDistL_US 255;
BA_ "GenSigSendType" SG_ 605 SRT_BrkDistL_US 3;
BA_ "GenSigTimeoutTime_AGSM" SG_ 605 SRT_BrkDistL_US 0;
BA_ "GenSigTimeoutTime_BCM" SG_ 605 SRT_BrkDistL_US 0;
BA_ "GenSigTimeoutTime_BSM" SG_ 605 SRT_BrkDistL_US 0;
BA_ "GenSigTimeoutTime_CADM" SG_ 605 SRT_BrkDistL_US 0;
BA_ "GenSigTimeoutTime_DMSM" SG_ 605 SRT_BrkDistL_US 0;
BA_ "GenSigTimeoutTime_DTCM" SG_ 605 SRT_BrkDistL_US 0;
BA_ "GenSigTimeoutTime_ECM" SG_ 605 SRT_BrkDistL_US 0;
BA_ "GenSigTimeoutTime_EVCU2" SG_ 605 SRT_BrkDistL_US 0;
BA_ "GenSigTimeoutTime_GNMM" SG_ 605 SRT_BrkDistL_US 0;
BA_ "GenSigTimeoutTime_HCP" SG_ 605 SRT_BrkDistL_US 0;
BA_ "GenSigTimeoutTime_IPC" SG_ 605 SRT_BrkDistL_US 0;
BA_ "GenSigTimeoutTime_RFHM" SG_ 605 SRT_BrkDistL_US 0;
BA_ "GenSigTimeoutTime_TCM" SG_ 605 SRT_BrkDistL_US 0;
BA_ "GenSigStartValue" SG_ 605 SRT_BrkSpdB_M 255;
BA_ "GenSigSendType" SG_ 605 SRT_BrkSpdB_M 3;
BA_ "GenSigTimeoutTime_AGSM" SG_ 605 SRT_BrkSpdB_M 0;
BA_ "GenSigTimeoutTime_BCM" SG_ 605 SRT_BrkSpdB_M 0;
BA_ "GenSigTimeoutTime_BSM" SG_ 605 SRT_BrkSpdB_M 0;
BA_ "GenSigTimeoutTime_CADM" SG_ 605 SRT_BrkSpdB_M 0;
BA_ "GenSigTimeoutTime_DMSM" SG_ 605 SRT_BrkSpdB_M 0;
BA_ "GenSigTimeoutTime_DTCM" SG_ 605 SRT_BrkSpdB_M 0;
BA_ "GenSigTimeoutTime_ECM" SG_ 605 SRT_BrkSpdB_M 0;
BA_ "GenSigTimeoutTime_EVCU2" SG_ 605 SRT_BrkSpdB_M 0;
BA_ "GenSigTimeoutTime_GNMM" SG_ 605 SRT_BrkSpdB_M 0;
BA_ "GenSigTimeoutTime_HCP" SG_ 605 SRT_BrkSpdB_M 0;
BA_ "GenSigTimeoutTime_IPC" SG_ 605 SRT_BrkSpdB_M 0;
BA_ "GenSigTimeoutTime_RFHM" SG_ 605 SRT_BrkSpdB_M 0;
BA_ "GenSigTimeoutTime_TCM" SG_ 605 SRT_BrkSpdB_M 0;
BA_ "GenSigStartValue" SG_ 605 SRT_BrkSpdB_US 255;
BA_ "GenSigSendType" SG_ 605 SRT_BrkSpdB_US 3;
BA_ "GenSigTimeoutTime_AGSM" SG_ 605 SRT_BrkSpdB_US 0;
BA_ "GenSigTimeoutTime_BCM" SG_ 605 SRT_BrkSpdB_US 0;
BA_ "GenSigTimeoutTime_BSM" SG_ 605 SRT_BrkSpdB_US 0;
BA_ "GenSigTimeoutTime_CADM" SG_ 605 SRT_BrkSpdB_US 0;
BA_ "GenSigTimeoutTime_DMSM" SG_ 605 SRT_BrkSpdB_US 0;
BA_ "GenSigTimeoutTime_DTCM" SG_ 605 SRT_BrkSpdB_US 0;
BA_ "GenSigTimeoutTime_ECM" SG_ 605 SRT_BrkSpdB_US 0;
BA_ "GenSigTimeoutTime_EVCU2" SG_ 605 SRT_BrkSpdB_US 0;
BA_ "GenSigTimeoutTime_GNMM" SG_ 605 SRT_BrkSpdB_US 0;
BA_ "GenSigTimeoutTime_HCP" SG_ 605 SRT_BrkSpdB_US 0;
BA_ "GenSigTimeoutTime_IPC" SG_ 605 SRT_BrkSpdB_US 0;
BA_ "GenSigTimeoutTime_RFHM" SG_ 605 SRT_BrkSpdB_US 0;
BA_ "GenSigTimeoutTime_TCM" SG_ 605 SRT_BrkSpdB_US 0;
BA_ "GenSigStartValue" SG_ 605 SRT_BrkSpdC_M 255;
BA_ "GenSigSendType" SG_ 605 SRT_BrkSpdC_M 3;
BA_ "GenSigTimeoutTime_AGSM" SG_ 605 SRT_BrkSpdC_M 0;
BA_ "GenSigTimeoutTime_BCM" SG_ 605 SRT_BrkSpdC_M 0;
BA_ "GenSigTimeoutTime_BSM" SG_ 605 SRT_BrkSpdC_M 0;
BA_ "GenSigTimeoutTime_CADM" SG_ 605 SRT_BrkSpdC_M 0;
BA_ "GenSigTimeoutTime_DMSM" SG_ 605 SRT_BrkSpdC_M 0;
BA_ "GenSigTimeoutTime_DTCM" SG_ 605 SRT_BrkSpdC_M 0;
BA_ "GenSigTimeoutTime_ECM" SG_ 605 SRT_BrkSpdC_M 0;
BA_ "GenSigTimeoutTime_EVCU2" SG_ 605 SRT_BrkSpdC_M 0;
BA_ "GenSigTimeoutTime_GNMM" SG_ 605 SRT_BrkSpdC_M 0;
BA_ "GenSigTimeoutTime_HCP" SG_ 605 SRT_BrkSpdC_M 0;
BA_ "GenSigTimeoutTime_IPC" SG_ 605 SRT_BrkSpdC_M 0;
BA_ "GenSigTimeoutTime_RFHM" SG_ 605 SRT_BrkSpdC_M 0;
BA_ "GenSigTimeoutTime_TCM" SG_ 605 SRT_BrkSpdC_M 0;
BA_ "GenSigStartValue" SG_ 605 SRT_BrkSpdC_US 255;
BA_ "GenSigSendType" SG_ 605 SRT_BrkSpdC_US 3;
BA_ "GenSigTimeoutTime_AGSM" SG_ 605 SRT_BrkSpdC_US 0;
BA_ "GenSigTimeoutTime_BCM" SG_ 605 SRT_BrkSpdC_US 0;
BA_ "GenSigTimeoutTime_BSM" SG_ 605 SRT_BrkSpdC_US 0;
BA_ "GenSigTimeoutTime_CADM" SG_ 605 SRT_BrkSpdC_US 0;
BA_ "GenSigTimeoutTime_DMSM" SG_ 605 SRT_BrkSpdC_US 0;
BA_ "GenSigTimeoutTime_DTCM" SG_ 605 SRT_BrkSpdC_US 0;
BA_ "GenSigTimeoutTime_ECM" SG_ 605 SRT_BrkSpdC_US 0;
BA_ "GenSigTimeoutTime_EVCU2" SG_ 605 SRT_BrkSpdC_US 0;
BA_ "GenSigTimeoutTime_GNMM" SG_ 605 SRT_BrkSpdC_US 0;
BA_ "GenSigTimeoutTime_HCP" SG_ 605 SRT_BrkSpdC_US 0;
BA_ "GenSigTimeoutTime_IPC" SG_ 605 SRT_BrkSpdC_US 0;
BA_ "GenSigTimeoutTime_RFHM" SG_ 605 SRT_BrkSpdC_US 0;
BA_ "GenSigTimeoutTime_TCM" SG_ 605 SRT_BrkSpdC_US 0;
BA_ "GenSigStartValue" SG_ 605 SRT_BrkSpdL_M 255;
BA_ "GenSigSendType" SG_ 605 SRT_BrkSpdL_M 3;
BA_ "GenSigTimeoutTime_AGSM" SG_ 605 SRT_BrkSpdL_M 0;
BA_ "GenSigTimeoutTime_BCM" SG_ 605 SRT_BrkSpdL_M 0;
BA_ "GenSigTimeoutTime_BSM" SG_ 605 SRT_BrkSpdL_M 0;
BA_ "GenSigTimeoutTime_CADM" SG_ 605 SRT_BrkSpdL_M 0;
BA_ "GenSigTimeoutTime_DMSM" SG_ 605 SRT_BrkSpdL_M 0;
BA_ "GenSigTimeoutTime_DTCM" SG_ 605 SRT_BrkSpdL_M 0;
BA_ "GenSigTimeoutTime_ECM" SG_ 605 SRT_BrkSpdL_M 0;
BA_ "GenSigTimeoutTime_EVCU2" SG_ 605 SRT_BrkSpdL_M 0;
BA_ "GenSigTimeoutTime_GNMM" SG_ 605 SRT_BrkSpdL_M 0;
BA_ "GenSigTimeoutTime_HCP" SG_ 605 SRT_BrkSpdL_M 0;
BA_ "GenSigTimeoutTime_IPC" SG_ 605 SRT_BrkSpdL_M 0;
BA_ "GenSigTimeoutTime_RFHM" SG_ 605 SRT_BrkSpdL_M 0;
BA_ "GenSigTimeoutTime_TCM" SG_ 605 SRT_BrkSpdL_M 0;
BA_ "GenSigStartValue" SG_ 605 SRT_BrkSpdL_US 255;
BA_ "GenSigSendType" SG_ 605 SRT_BrkSpdL_US 3;
BA_ "GenSigTimeoutTime_AGSM" SG_ 605 SRT_BrkSpdL_US 0;
BA_ "GenSigTimeoutTime_BCM" SG_ 605 SRT_BrkSpdL_US 0;
BA_ "GenSigTimeoutTime_BSM" SG_ 605 SRT_BrkSpdL_US 0;
BA_ "GenSigTimeoutTime_CADM" SG_ 605 SRT_BrkSpdL_US 0;
BA_ "GenSigTimeoutTime_DMSM" SG_ 605 SRT_BrkSpdL_US 0;
BA_ "GenSigTimeoutTime_DTCM" SG_ 605 SRT_BrkSpdL_US 0;
BA_ "GenSigTimeoutTime_ECM" SG_ 605 SRT_BrkSpdL_US 0;
BA_ "GenSigTimeoutTime_EVCU2" SG_ 605 SRT_BrkSpdL_US 0;
BA_ "GenSigTimeoutTime_GNMM" SG_ 605 SRT_BrkSpdL_US 0;
BA_ "GenSigTimeoutTime_HCP" SG_ 605 SRT_BrkSpdL_US 0;
BA_ "GenSigTimeoutTime_IPC" SG_ 605 SRT_BrkSpdL_US 0;
BA_ "GenSigTimeoutTime_RFHM" SG_ 605 SRT_BrkSpdL_US 0;
BA_ "GenSigTimeoutTime_TCM" SG_ 605 SRT_BrkSpdL_US 0;
BA_ "GenSigSendType" SG_ 1443 Act_Lane_Mgt 3;
BA_ "GenSigTimeoutTime_AGSM" SG_ 1443 Act_Lane_Mgt 0;
BA_ "GenSigTimeoutTime_BSM" SG_ 1443 Act_Lane_Mgt 0;
BA_ "GenSigTimeoutTime_DMSM" SG_ 1443 Act_Lane_Mgt 0;
BA_ "GenSigTimeoutTime_DTCM" SG_ 1443 Act_Lane_Mgt 0;
BA_ "GenSigTimeoutTime_ECM" SG_ 1443 Act_Lane_Mgt 0;
BA_ "GenSigTimeoutTime_EVCU2" SG_ 1443 Act_Lane_Mgt 0;
BA_ "GenSigTimeoutTime_GNMM" SG_ 1443 Act_Lane_Mgt 0;
BA_ "GenSigTimeoutTime_HCP" SG_ 1443 Act_Lane_Mgt 0;
BA_ "GenSigTimeoutTime_IPC" SG_ 1443 Act_Lane_Mgt 0;
BA_ "GenSigTimeoutTime_RFHM" SG_ 1443 Act_Lane_Mgt 0;
BA_ "GenSigTimeoutTime_TCM" SG_ 1443 Act_Lane_Mgt 0;
BA_ "GenSigSendType" SG_ 1443 Act_Lane_Mgt_Strength 3;
BA_ "GenSigTimeoutTime_AGSM" SG_ 1443 Act_Lane_Mgt_Strength 0;
BA_ "GenSigTimeoutTime_BSM" SG_ 1443 Act_Lane_Mgt_Strength 0;
BA_ "GenSigTimeoutTime_DMSM" SG_ 1443 Act_Lane_Mgt_Strength 0;
BA_ "GenSigTimeoutTime_DTCM" SG_ 1443 Act_Lane_Mgt_Strength 0;
BA_ "GenSigTimeoutTime_ECM" SG_ 1443 Act_Lane_Mgt_Strength 0;
BA_ "GenSigTimeoutTime_EVCU2" SG_ 1443 Act_Lane_Mgt_Strength 0;
BA_ "GenSigTimeoutTime_GNMM" SG_ 1443 Act_Lane_Mgt_Strength 0;
BA_ "GenSigTimeoutTime_HCP" SG_ 1443 Act_Lane_Mgt_Strength 0;
BA_ "GenSigTimeoutTime_IPC" SG_ 1443 Act_Lane_Mgt_Strength 0;
BA_ "GenSigTimeoutTime_RFHM" SG_ 1443 Act_Lane_Mgt_Strength 0;
BA_ "GenSigTimeoutTime_TCM" SG_ 1443 Act_Lane_Mgt_Strength 0;
BA_ "GenSigSendType" SG_ 1443 Active_Park_Mode 3;
BA_ "GenSigTimeoutTime_AGSM" SG_ 1443 Active_Park_Mode 0;
BA_ "GenSigTimeoutTime_CADM" SG_ 1443 Active_Park_Mode 0;
BA_ "GenSigTimeoutTime_DMSM" SG_ 1443 Active_Park_Mode 0;
BA_ "GenSigTimeoutTime_DTCM" SG_ 1443 Active_Park_Mode 0;
BA_ "GenSigTimeoutTime_ECM" SG_ 1443 Active_Park_Mode 0;
BA_ "GenSigTimeoutTime_EVCU2" SG_ 1443 Active_Park_Mode 0;
BA_ "GenSigTimeoutTime_GNMM" SG_ 1443 Active_Park_Mode 0;
BA_ "GenSigTimeoutTime_HCP" SG_ 1443 Active_Park_Mode 0;
BA_ "GenSigTimeoutTime_IPC" SG_ 1443 Active_Park_Mode 0;
BA_ "GenSigTimeoutTime_RFHM" SG_ 1443 Active_Park_Mode 0;
BA_ "GenSigTimeoutTime_TCM" SG_ 1443 Active_Park_Mode 0;
BA_ "GenSigSendType" SG_ 1443 Active_Park_Prox_Chime 3;
BA_ "GenSigTimeoutTime_AGSM" SG_ 1443 Active_Park_Prox_Chime 0;
BA_ "GenSigTimeoutTime_BSM" SG_ 1443 Active_Park_Prox_Chime 0;
BA_ "GenSigTimeoutTime_CADM" SG_ 1443 Active_Park_Prox_Chime 0;
BA_ "GenSigTimeoutTime_DMSM" SG_ 1443 Active_Park_Prox_Chime 0;
BA_ "GenSigTimeoutTime_DTCM" SG_ 1443 Active_Park_Prox_Chime 0;
BA_ "GenSigTimeoutTime_ECM" SG_ 1443 Active_Park_Prox_Chime 0;
BA_ "GenSigTimeoutTime_EVCU2" SG_ 1443 Active_Park_Prox_Chime 0;
BA_ "GenSigTimeoutTime_GNMM" SG_ 1443 Active_Park_Prox_Chime 0;
BA_ "GenSigTimeoutTime_HCP" SG_ 1443 Active_Park_Prox_Chime 0;
BA_ "GenSigTimeoutTime_IPC" SG_ 1443 Active_Park_Prox_Chime 0;
BA_ "GenSigTimeoutTime_RFHM" SG_ 1443 Active_Park_Prox_Chime 0;
BA_ "GenSigTimeoutTime_TCM" SG_ 1443 Active_Park_Prox_Chime 0;
BA_ "GenSigStartValue" SG_ 1443 AmbientLightingLevel 4;
BA_ "GenSigSendType" SG_ 1443 AmbientLightingLevel 3;
BA_ "GenSigTimeoutTime_AGSM" SG_ 1443 AmbientLightingLevel 0;
BA_ "GenSigTimeoutTime_BCM" SG_ 1443 AmbientLightingLevel 0;
BA_ "GenSigTimeoutTime_BSM" SG_ 1443 AmbientLightingLevel 0;
BA_ "GenSigTimeoutTime_CADM" SG_ 1443 AmbientLightingLevel 0;
BA_ "GenSigTimeoutTime_DMSM" SG_ 1443 AmbientLightingLevel 0;
BA_ "GenSigTimeoutTime_DTCM" SG_ 1443 AmbientLightingLevel 0;
BA_ "GenSigTimeoutTime_ECM" SG_ 1443 AmbientLightingLevel 0;
BA_ "GenSigTimeoutTime_EVCU2" SG_ 1443 AmbientLightingLevel 0;
BA_ "GenSigTimeoutTime_GNMM" SG_ 1443 AmbientLightingLevel 0;
BA_ "GenSigTimeoutTime_HCP" SG_ 1443 AmbientLightingLevel 0;
BA_ "GenSigTimeoutTime_IPC" SG_ 1443 AmbientLightingLevel 0;
BA_ "GenSigTimeoutTime_RFHM" SG_ 1443 AmbientLightingLevel 0;
BA_ "GenSigTimeoutTime_TCM" SG_ 1443 AmbientLightingLevel 0;
BA_ "GenSigSendType" SG_ 1443 Auto_Fold_Mirr 3;
BA_ "GenSigTimeoutTime_AGSM" SG_ 1443 Auto_Fold_Mirr 0;
BA_ "GenSigTimeoutTime_BSM" SG_ 1443 Auto_Fold_Mirr 0;
BA_ "GenSigTimeoutTime_CADM" SG_ 1443 Auto_Fold_Mirr 0;
BA_ "GenSigTimeoutTime_DMSM" SG_ 1443 Auto_Fold_Mirr 0;
BA_ "GenSigTimeoutTime_DTCM" SG_ 1443 Auto_Fold_Mirr 0;
BA_ "GenSigTimeoutTime_ECM" SG_ 1443 Auto_Fold_Mirr 0;
BA_ "GenSigTimeoutTime_EVCU2" SG_ 1443 Auto_Fold_Mirr 0;
BA_ "GenSigTimeoutTime_GNMM" SG_ 1443 Auto_Fold_Mirr 0;
BA_ "GenSigTimeoutTime_HCP" SG_ 1443 Auto_Fold_Mirr 0;
BA_ "GenSigTimeoutTime_IPC" SG_ 1443 Auto_Fold_Mirr 0;
BA_ "GenSigTimeoutTime_RFHM" SG_ 1443 Auto_Fold_Mirr 0;
BA_ "GenSigTimeoutTime_TCM" SG_ 1443 Auto_Fold_Mirr 0;
BA_ "GenSigStartValue" SG_ 1443 AutoHighBeamEnable 1;
BA_ "GenSigSendType" SG_ 1443 AutoHighBeamEnable 3;
BA_ "GenSigTimeoutTime_AGSM" SG_ 1443 AutoHighBeamEnable 0;
BA_ "GenSigTimeoutTime_BSM" SG_ 1443 AutoHighBeamEnable 0;
BA_ "GenSigTimeoutTime_CADM" SG_ 1443 AutoHighBeamEnable 0;
BA_ "GenSigTimeoutTime_DMSM" SG_ 1443 AutoHighBeamEnable 0;
BA_ "GenSigTimeoutTime_DTCM" SG_ 1443 AutoHighBeamEnable 0;
BA_ "GenSigTimeoutTime_ECM" SG_ 1443 AutoHighBeamEnable 0;
BA_ "GenSigTimeoutTime_EVCU2" SG_ 1443 AutoHighBeamEnable 0;
BA_ "GenSigTimeoutTime_GNMM" SG_ 1443 AutoHighBeamEnable 0;
BA_ "GenSigTimeoutTime_HCP" SG_ 1443 AutoHighBeamEnable 0;
BA_ "GenSigTimeoutTime_IPC" SG_ 1443 AutoHighBeamEnable 0;
BA_ "GenSigTimeoutTime_RFHM" SG_ 1443 AutoHighBeamEnable 0;
BA_ "GenSigTimeoutTime_TCM" SG_ 1443 AutoHighBeamEnable 0;
BA_ "GenSigSendType" SG_ 1443 AutoParkBrake 3;
BA_ "GenSigTimeoutTime_AGSM" SG_ 1443 AutoParkBrake 0;
BA_ "GenSigTimeoutTime_CADM" SG_ 1443 AutoParkBrake 0;
BA_ "GenSigTimeoutTime_DMSM" SG_ 1443 AutoParkBrake 0;
BA_ "GenSigTimeoutTime_DTCM" SG_ 1443 AutoParkBrake 0;
BA_ "GenSigTimeoutTime_ECM" SG_ 1443 AutoParkBrake 0;
BA_ "GenSigTimeoutTime_EVCU2" SG_ 1443 AutoParkBrake 0;
BA_ "GenSigTimeoutTime_GNMM" SG_ 1443 AutoParkBrake 0;
BA_ "GenSigTimeoutTime_HCP" SG_ 1443 AutoParkBrake 0;
BA_ "GenSigTimeoutTime_IPC" SG_ 1443 AutoParkBrake 0;
BA_ "GenSigTimeoutTime_RFHM" SG_ 1443 AutoParkBrake 0;
BA_ "GenSigTimeoutTime_TCM" SG_ 1443 AutoParkBrake 0;
BA_ "GenSigStartValue" SG_ 1443 AutoUnlockDoorExit 1;
BA_ "GenSigSendType" SG_ 1443 AutoUnlockDoorExit 3;
BA_ "GenSigTimeoutTime_AGSM" SG_ 1443 AutoUnlockDoorExit 0;
BA_ "GenSigTimeoutTime_BSM" SG_ 1443 AutoUnlockDoorExit 0;
BA_ "GenSigTimeoutTime_CADM" SG_ 1443 AutoUnlockDoorExit 0;
BA_ "GenSigTimeoutTime_DMSM" SG_ 1443 AutoUnlockDoorExit 0;
BA_ "GenSigTimeoutTime_DTCM" SG_ 1443 AutoUnlockDoorExit 0;
BA_ "GenSigTimeoutTime_ECM" SG_ 1443 AutoUnlockDoorExit 0;
BA_ "GenSigTimeoutTime_EVCU2" SG_ 1443 AutoUnlockDoorExit 0;
BA_ "GenSigTimeoutTime_GNMM" SG_ 1443 AutoUnlockDoorExit 0;
BA_ "GenSigTimeoutTime_HCP" SG_ 1443 AutoUnlockDoorExit 0;
BA_ "GenSigTimeoutTime_IPC" SG_ 1443 AutoUnlockDoorExit 0;
BA_ "GenSigTimeoutTime_RFHM" SG_ 1443 AutoUnlockDoorExit 0;
BA_ "GenSigTimeoutTime_TCM" SG_ 1443 AutoUnlockDoorExit 0;
BA_ "GenSigSendType" SG_ 1443 Backup_Cam_Delay 3;
BA_ "GenSigTimeoutTime_AGSM" SG_ 1443 Backup_Cam_Delay 0;
BA_ "GenSigTimeoutTime_BSM" SG_ 1443 Backup_Cam_Delay 0;
BA_ "GenSigTimeoutTime_CADM" SG_ 1443 Backup_Cam_Delay 0;
BA_ "GenSigTimeoutTime_DMSM" SG_ 1443 Backup_Cam_Delay 0;
BA_ "GenSigTimeoutTime_DTCM" SG_ 1443 Backup_Cam_Delay 0;
BA_ "GenSigTimeoutTime_ECM" SG_ 1443 Backup_Cam_Delay 0;
BA_ "GenSigTimeoutTime_EVCU2" SG_ 1443 Backup_Cam_Delay 0;
BA_ "GenSigTimeoutTime_GNMM" SG_ 1443 Backup_Cam_Delay 0;
BA_ "GenSigTimeoutTime_HCP" SG_ 1443 Backup_Cam_Delay 0;
BA_ "GenSigTimeoutTime_IPC" SG_ 1443 Backup_Cam_Delay 0;
BA_ "GenSigTimeoutTime_RFHM" SG_ 1443 Backup_Cam_Delay 0;
BA_ "GenSigTimeoutTime_TCM" SG_ 1443 Backup_Cam_Delay 0;
BA_ "GenSigStartValue" SG_ 1443 BSDEnable 2;
BA_ "GenSigSendType" SG_ 1443 BSDEnable 3;
BA_ "GenSigTimeoutTime_AGSM" SG_ 1443 BSDEnable 0;
BA_ "GenSigTimeoutTime_BSM" SG_ 1443 BSDEnable 0;
BA_ "GenSigTimeoutTime_DMSM" SG_ 1443 BSDEnable 0;
BA_ "GenSigTimeoutTime_DTCM" SG_ 1443 BSDEnable 0;
BA_ "GenSigTimeoutTime_ECM" SG_ 1443 BSDEnable 0;
BA_ "GenSigTimeoutTime_EVCU2" SG_ 1443 BSDEnable 0;
BA_ "GenSigTimeoutTime_GNMM" SG_ 1443 BSDEnable 0;
BA_ "GenSigTimeoutTime_HCP" SG_ 1443 BSDEnable 0;
BA_ "GenSigTimeoutTime_IPC" SG_ 1443 BSDEnable 0;
BA_ "GenSigTimeoutTime_RFHM" SG_ 1443 BSDEnable 0;
BA_ "GenSigTimeoutTime_TCM" SG_ 1443 BSDEnable 0;
BA_ "GenSigSendType" SG_ 1443 Consum_Unit 3;
BA_ "GenSigTimeoutTime_AGSM" SG_ 1443 Consum_Unit 0;
BA_ "GenSigTimeoutTime_BSM" SG_ 1443 Consum_Unit 0;
BA_ "GenSigTimeoutTime_CADM" SG_ 1443 Consum_Unit 0;
BA_ "GenSigTimeoutTime_DMSM" SG_ 1443 Consum_Unit 0;
BA_ "GenSigTimeoutTime_DTCM" SG_ 1443 Consum_Unit 0;
BA_ "GenSigTimeoutTime_ECM" SG_ 1443 Consum_Unit 0;
BA_ "GenSigTimeoutTime_EVCU2" SG_ 1443 Consum_Unit 0;
BA_ "GenSigTimeoutTime_GNMM" SG_ 1443 Consum_Unit 0;
BA_ "GenSigTimeoutTime_HCP" SG_ 1443 Consum_Unit 0;
BA_ "GenSigTimeoutTime_IPC" SG_ 1443 Consum_Unit 0;
BA_ "GenSigTimeoutTime_RFHM" SG_ 1443 Consum_Unit 0;
BA_ "GenSigTimeoutTime_TCM" SG_ 1443 Consum_Unit 0;
BA_ "GenSigSendType" SG_ 1443 CorneringEnable 3;
BA_ "GenSigTimeoutTime_AGSM" SG_ 1443 CorneringEnable 0;
BA_ "GenSigTimeoutTime_BSM" SG_ 1443 CorneringEnable 0;
BA_ "GenSigTimeoutTime_CADM" SG_ 1443 CorneringEnable 0;
BA_ "GenSigTimeoutTime_DMSM" SG_ 1443 CorneringEnable 0;
BA_ "GenSigTimeoutTime_DTCM" SG_ 1443 CorneringEnable 0;
BA_ "GenSigTimeoutTime_ECM" SG_ 1443 CorneringEnable 0;
BA_ "GenSigTimeoutTime_EVCU2" SG_ 1443 CorneringEnable 0;
BA_ "GenSigTimeoutTime_GNMM" SG_ 1443 CorneringEnable 0;
BA_ "GenSigTimeoutTime_HCP" SG_ 1443 CorneringEnable 0;
BA_ "GenSigTimeoutTime_IPC" SG_ 1443 CorneringEnable 0;
BA_ "GenSigTimeoutTime_RFHM" SG_ 1443 CorneringEnable 0;
BA_ "GenSigTimeoutTime_TCM" SG_ 1443 CorneringEnable 0;
BA_ "GenSigTimeoutTime_AGSM" SG_ 1443 CRC_IPCVS1 0;
BA_ "GenSigTimeoutTime_BCM" SG_ 1443 CRC_IPCVS1 0;
BA_ "GenSigTimeoutTime_BSM" SG_ 1443 CRC_IPCVS1 0;
BA_ "GenSigTimeoutTime_DMSM" SG_ 1443 CRC_IPCVS1 0;
BA_ "GenSigTimeoutTime_DTCM" SG_ 1443 CRC_IPCVS1 0;
BA_ "GenSigTimeoutTime_ECM" SG_ 1443 CRC_IPCVS1 0;
BA_ "GenSigTimeoutTime_GNMM" SG_ 1443 CRC_IPCVS1 0;
BA_ "GenSigTimeoutTime_HCP" SG_ 1443 CRC_IPCVS1 0;
BA_ "GenSigTimeoutTime_IPC" SG_ 1443 CRC_IPCVS1 0;
BA_ "GenSigTimeoutTime_RFHM" SG_ 1443 CRC_IPCVS1 0;
BA_ "GenSigTimeoutTime_SGW" SG_ 1443 CRC_IPCVS1 0;
BA_ "GenSigTimeoutTime_TCM" SG_ 1443 CRC_IPCVS1 0;
BA_ "GenSigSendType" SG_ 1443 Dist_Unit 3;
BA_ "GenSigTimeoutTime_AGSM" SG_ 1443 Dist_Unit 0;
BA_ "GenSigTimeoutTime_BSM" SG_ 1443 Dist_Unit 0;
BA_ "GenSigTimeoutTime_CADM" SG_ 1443 Dist_Unit 0;
BA_ "GenSigTimeoutTime_DMSM" SG_ 1443 Dist_Unit 0;
BA_ "GenSigTimeoutTime_DTCM" SG_ 1443 Dist_Unit 0;
BA_ "GenSigTimeoutTime_EVCU2" SG_ 1443 Dist_Unit 0;
BA_ "GenSigTimeoutTime_GNMM" SG_ 1443 Dist_Unit 0;
BA_ "GenSigTimeoutTime_HCP" SG_ 1443 Dist_Unit 0;
BA_ "GenSigTimeoutTime_IPC" SG_ 1443 Dist_Unit 0;
BA_ "GenSigTimeoutTime_RFHM" SG_ 1443 Dist_Unit 0;
BA_ "GenSigTimeoutTime_TCM" SG_ 1443 Dist_Unit 0;
BA_ "GenSigSendType" SG_ 1443 DRLEnable 3;
BA_ "GenSigTimeoutTime_AGSM" SG_ 1443 DRLEnable 0;
BA_ "GenSigTimeoutTime_BSM" SG_ 1443 DRLEnable 0;
BA_ "GenSigTimeoutTime_CADM" SG_ 1443 DRLEnable 0;
BA_ "GenSigTimeoutTime_DMSM" SG_ 1443 DRLEnable 0;
BA_ "GenSigTimeoutTime_DTCM" SG_ 1443 DRLEnable 0;
BA_ "GenSigTimeoutTime_ECM" SG_ 1443 DRLEnable 0;
BA_ "GenSigTimeoutTime_EVCU2" SG_ 1443 DRLEnable 0;
BA_ "GenSigTimeoutTime_GNMM" SG_ 1443 DRLEnable 0;
BA_ "GenSigTimeoutTime_HCP" SG_ 1443 DRLEnable 0;
BA_ "GenSigTimeoutTime_IPC" SG_ 1443 DRLEnable 0;
BA_ "GenSigTimeoutTime_RFHM" SG_ 1443 DRLEnable 0;
BA_ "GenSigTimeoutTime_TCM" SG_ 1443 DRLEnable 0;
BA_ "GenSigSendType" SG_ 1443 Drowsy_Driver_Alert 3;
BA_ "GenSigTimeoutTime_AGSM" SG_ 1443 Drowsy_Driver_Alert 0;
BA_ "GenSigTimeoutTime_BSM" SG_ 1443 Drowsy_Driver_Alert 0;
BA_ "GenSigTimeoutTime_DMSM" SG_ 1443 Drowsy_Driver_Alert 0;
BA_ "GenSigTimeoutTime_DTCM" SG_ 1443 Drowsy_Driver_Alert 0;
BA_ "GenSigTimeoutTime_ECM" SG_ 1443 Drowsy_Driver_Alert 0;
BA_ "GenSigTimeoutTime_EVCU2" SG_ 1443 Drowsy_Driver_Alert 0;
BA_ "GenSigTimeoutTime_GNMM" SG_ 1443 Drowsy_Driver_Alert 0;
BA_ "GenSigTimeoutTime_HCP" SG_ 1443 Drowsy_Driver_Alert 0;
BA_ "GenSigTimeoutTime_IPC" SG_ 1443 Drowsy_Driver_Alert 0;
BA_ "GenSigTimeoutTime_RFHM" SG_ 1443 Drowsy_Driver_Alert 0;
BA_ "GenSigTimeoutTime_TCM" SG_ 1443 Drowsy_Driver_Alert 0;
BA_ "GenSigStartValue" SG_ 1443 DynamicGrid 1;
BA_ "GenSigSendType" SG_ 1443 DynamicGrid 3;
BA_ "GenSigTimeoutTime_AGSM" SG_ 1443 DynamicGrid 0;
BA_ "GenSigTimeoutTime_BSM" SG_ 1443 DynamicGrid 0;
BA_ "GenSigTimeoutTime_CADM" SG_ 1443 DynamicGrid 0;
BA_ "GenSigTimeoutTime_DMSM" SG_ 1443 DynamicGrid 0;
BA_ "GenSigTimeoutTime_DTCM" SG_ 1443 DynamicGrid 0;
BA_ "GenSigTimeoutTime_ECM" SG_ 1443 DynamicGrid 0;
BA_ "GenSigTimeoutTime_EVCU2" SG_ 1443 DynamicGrid 0;
BA_ "GenSigTimeoutTime_GNMM" SG_ 1443 DynamicGrid 0;
BA_ "GenSigTimeoutTime_HCP" SG_ 1443 DynamicGrid 0;
BA_ "GenSigTimeoutTime_IPC" SG_ 1443 DynamicGrid 0;
BA_ "GenSigTimeoutTime_RFHM" SG_ 1443 DynamicGrid 0;
BA_ "GenSigTimeoutTime_TCM" SG_ 1443 DynamicGrid 0;
BA_ "GenSigSendType" SG_ 1443 Easy_Exit_D 3;
BA_ "GenSigTimeoutTime_AGSM" SG_ 1443 Easy_Exit_D 0;
BA_ "GenSigTimeoutTime_BSM" SG_ 1443 Easy_Exit_D 0;
BA_ "GenSigTimeoutTime_CADM" SG_ 1443 Easy_Exit_D 0;
BA_ "GenSigTimeoutTime_DMSM" SG_ 1443 Easy_Exit_D 0;
BA_ "GenSigTimeoutTime_DTCM" SG_ 1443 Easy_Exit_D 0;
BA_ "GenSigTimeoutTime_ECM" SG_ 1443 Easy_Exit_D 0;
BA_ "GenSigTimeoutTime_EVCU2" SG_ 1443 Easy_Exit_D 0;
BA_ "GenSigTimeoutTime_GNMM" SG_ 1443 Easy_Exit_D 0;
BA_ "GenSigTimeoutTime_HCP" SG_ 1443 Easy_Exit_D 0;
BA_ "GenSigTimeoutTime_IPC" SG_ 1443 Easy_Exit_D 0;
BA_ "GenSigTimeoutTime_RFHM" SG_ 1443 Easy_Exit_D 0;
BA_ "GenSigTimeoutTime_TCM" SG_ 1443 Easy_Exit_D 0;
BA_ "GenSigSendType" SG_ 1443 Eng_Off_Pwr_Delay 3;
BA_ "GenSigTimeoutTime_AGSM" SG_ 1443 Eng_Off_Pwr_Delay 0;
BA_ "GenSigTimeoutTime_BSM" SG_ 1443 Eng_Off_Pwr_Delay 0;
BA_ "GenSigTimeoutTime_CADM" SG_ 1443 Eng_Off_Pwr_Delay 0;
BA_ "GenSigTimeoutTime_DMSM" SG_ 1443 Eng_Off_Pwr_Delay 0;
BA_ "GenSigTimeoutTime_DTCM" SG_ 1443 Eng_Off_Pwr_Delay 0;
BA_ "GenSigTimeoutTime_ECM" SG_ 1443 Eng_Off_Pwr_Delay 0;
BA_ "GenSigTimeoutTime_EVCU2" SG_ 1443 Eng_Off_Pwr_Delay 0;
BA_ "GenSigTimeoutTime_GNMM" SG_ 1443 Eng_Off_Pwr_Delay 0;
BA_ "GenSigTimeoutTime_HCP" SG_ 1443 Eng_Off_Pwr_Delay 0;
BA_ "GenSigTimeoutTime_IPC" SG_ 1443 Eng_Off_Pwr_Delay 0;
BA_ "GenSigTimeoutTime_RFHM" SG_ 1443 Eng_Off_Pwr_Delay 0;
BA_ "GenSigTimeoutTime_TCM" SG_ 1443 Eng_Off_Pwr_Delay 0;
BA_ "GenSigSendType" SG_ 1443 EPB_MaintenanceMode 3;
BA_ "GenSigTimeoutTime_AGSM" SG_ 1443 EPB_MaintenanceMode 0;
BA_ "GenSigTimeoutTime_BCM" SG_ 1443 EPB_MaintenanceMode 0;
BA_ "GenSigTimeoutTime_BSM" SG_ 1443 EPB_MaintenanceMode 0;
BA_ "GenSigTimeoutTime_CADM" SG_ 1443 EPB_MaintenanceMode 0;
BA_ "GenSigTimeoutTime_DMSM" SG_ 1443 EPB_MaintenanceMode 0;
BA_ "GenSigTimeoutTime_DTCM" SG_ 1443 EPB_MaintenanceMode 0;
BA_ "GenSigTimeoutTime_ECM" SG_ 1443 EPB_MaintenanceMode 0;
BA_ "GenSigTimeoutTime_EVCU2" SG_ 1443 EPB_MaintenanceMode 0;
BA_ "GenSigTimeoutTime_GNMM" SG_ 1443 EPB_MaintenanceMode 0;
BA_ "GenSigTimeoutTime_HCP" SG_ 1443 EPB_MaintenanceMode 0;
BA_ "GenSigTimeoutTime_IPC" SG_ 1443 EPB_MaintenanceMode 0;
BA_ "GenSigTimeoutTime_RFHM" SG_ 1443 EPB_MaintenanceMode 0;
BA_ "GenSigTimeoutTime_TCM" SG_ 1443 EPB_MaintenanceMode 0;
BA_ "GenSigStartValue" SG_ 1443 FlashLightWLock 1;
BA_ "GenSigSendType" SG_ 1443 FlashLightWLock 3;
BA_ "GenSigTimeoutTime_AGSM" SG_ 1443 FlashLightWLock 0;
BA_ "GenSigTimeoutTime_BSM" SG_ 1443 FlashLightWLock 0;
BA_ "GenSigTimeoutTime_CADM" SG_ 1443 FlashLightWLock 0;
BA_ "GenSigTimeoutTime_DMSM" SG_ 1443 FlashLightWLock 0;
BA_ "GenSigTimeoutTime_DTCM" SG_ 1443 FlashLightWLock 0;
BA_ "GenSigTimeoutTime_ECM" SG_ 1443 FlashLightWLock 0;
BA_ "GenSigTimeoutTime_EVCU2" SG_ 1443 FlashLightWLock 0;
BA_ "GenSigTimeoutTime_GNMM" SG_ 1443 FlashLightWLock 0;
BA_ "GenSigTimeoutTime_HCP" SG_ 1443 FlashLightWLock 0;
BA_ "GenSigTimeoutTime_IPC" SG_ 1443 FlashLightWLock 0;
BA_ "GenSigTimeoutTime_RFHM" SG_ 1443 FlashLightWLock 0;
BA_ "GenSigTimeoutTime_TCM" SG_ 1443 FlashLightWLock 0;
BA_ "GenSigSendType" SG_ 1443 FOA_AppAlert_Disable_UserReq 3;
BA_ "GenSigTimeoutTime_AGSM" SG_ 1443 FOA_AppAlert_Disable_UserReq 0;
BA_ "GenSigTimeoutTime_BSM" SG_ 1443 FOA_AppAlert_Disable_UserReq 0;
BA_ "GenSigTimeoutTime_CADM" SG_ 1443 FOA_AppAlert_Disable_UserReq 0;
BA_ "GenSigTimeoutTime_DMSM" SG_ 1443 FOA_AppAlert_Disable_UserReq 0;
BA_ "GenSigTimeoutTime_DTCM" SG_ 1443 FOA_AppAlert_Disable_UserReq 0;
BA_ "GenSigTimeoutTime_ECM" SG_ 1443 FOA_AppAlert_Disable_UserReq 0;
BA_ "GenSigTimeoutTime_EVCU2" SG_ 1443 FOA_AppAlert_Disable_UserReq 0;
BA_ "GenSigTimeoutTime_GNMM" SG_ 1443 FOA_AppAlert_Disable_UserReq 0;
BA_ "GenSigTimeoutTime_HCP" SG_ 1443 FOA_AppAlert_Disable_UserReq 0;
BA_ "GenSigTimeoutTime_IPC" SG_ 1443 FOA_AppAlert_Disable_UserReq 0;
BA_ "GenSigTimeoutTime_RFHM" SG_ 1443 FOA_AppAlert_Disable_UserReq 0;
BA_ "GenSigTimeoutTime_SGW" SG_ 1443 FOA_AppAlert_Disable_UserReq 0;
BA_ "GenSigTimeoutTime_TCM" SG_ 1443 FOA_AppAlert_Disable_UserReq 0;
BA_ "GenSigStartValue" SG_ 1443 FSFCWPlusActivationMode 1;
BA_ "GenSigSendType" SG_ 1443 FSFCWPlusActivationMode 3;
BA_ "GenSigTimeoutTime_AGSM" SG_ 1443 FSFCWPlusActivationMode 0;
BA_ "GenSigTimeoutTime_BSM" SG_ 1443 FSFCWPlusActivationMode 0;
BA_ "GenSigTimeoutTime_DMSM" SG_ 1443 FSFCWPlusActivationMode 0;
BA_ "GenSigTimeoutTime_DTCM" SG_ 1443 FSFCWPlusActivationMode 0;
BA_ "GenSigTimeoutTime_ECM" SG_ 1443 FSFCWPlusActivationMode 0;
BA_ "GenSigTimeoutTime_EVCU2" SG_ 1443 FSFCWPlusActivationMode 0;
BA_ "GenSigTimeoutTime_GNMM" SG_ 1443 FSFCWPlusActivationMode 0;
BA_ "GenSigTimeoutTime_HCP" SG_ 1443 FSFCWPlusActivationMode 0;
BA_ "GenSigTimeoutTime_IPC" SG_ 1443 FSFCWPlusActivationMode 0;
BA_ "GenSigTimeoutTime_RFHM" SG_ 1443 FSFCWPlusActivationMode 0;
BA_ "GenSigTimeoutTime_TCM" SG_ 1443 FSFCWPlusActivationMode 0;
BA_ "GenSigStartValue" SG_ 1443 FSFCWPlusSetting 3;
BA_ "GenSigSendType" SG_ 1443 FSFCWPlusSetting 3;
BA_ "GenSigTimeoutTime_AGSM" SG_ 1443 FSFCWPlusSetting 0;
BA_ "GenSigTimeoutTime_BSM" SG_ 1443 FSFCWPlusSetting 0;
BA_ "GenSigTimeoutTime_DMSM" SG_ 1443 FSFCWPlusSetting 0;
BA_ "GenSigTimeoutTime_DTCM" SG_ 1443 FSFCWPlusSetting 0;
BA_ "GenSigTimeoutTime_ECM" SG_ 1443 FSFCWPlusSetting 0;
BA_ "GenSigTimeoutTime_EVCU2" SG_ 1443 FSFCWPlusSetting 0;
BA_ "GenSigTimeoutTime_GNMM" SG_ 1443 FSFCWPlusSetting 0;
BA_ "GenSigTimeoutTime_HCP" SG_ 1443 FSFCWPlusSetting 0;
BA_ "GenSigTimeoutTime_IPC" SG_ 1443 FSFCWPlusSetting 0;
BA_ "GenSigTimeoutTime_RFHM" SG_ 1443 FSFCWPlusSetting 0;
BA_ "GenSigTimeoutTime_TCM" SG_ 1443 FSFCWPlusSetting 0;
BA_ "GenSigSendType" SG_ 1443 Fwrd_Cam_Guidelines 3;
BA_ "GenSigTimeoutTime_AGSM" SG_ 1443 Fwrd_Cam_Guidelines 0;
BA_ "GenSigTimeoutTime_BSM" SG_ 1443 Fwrd_Cam_Guidelines 0;
BA_ "GenSigTimeoutTime_CADM" SG_ 1443 Fwrd_Cam_Guidelines 0;
BA_ "GenSigTimeoutTime_DMSM" SG_ 1443 Fwrd_Cam_Guidelines 0;
BA_ "GenSigTimeoutTime_DTCM" SG_ 1443 Fwrd_Cam_Guidelines 0;
BA_ "GenSigTimeoutTime_ECM" SG_ 1443 Fwrd_Cam_Guidelines 0;
BA_ "GenSigTimeoutTime_EVCU2" SG_ 1443 Fwrd_Cam_Guidelines 0;
BA_ "GenSigTimeoutTime_GNMM" SG_ 1443 Fwrd_Cam_Guidelines 0;
BA_ "GenSigTimeoutTime_HCP" SG_ 1443 Fwrd_Cam_Guidelines 0;
BA_ "GenSigTimeoutTime_IPC" SG_ 1443 Fwrd_Cam_Guidelines 0;
BA_ "GenSigTimeoutTime_RFHM" SG_ 1443 Fwrd_Cam_Guidelines 0;
BA_ "GenSigTimeoutTime_TCM" SG_ 1443 Fwrd_Cam_Guidelines 0;
BA_ "GenSigSendType" SG_ 1443 GreetingLightsEnable 3;
BA_ "GenSigTimeoutTime_AGSM" SG_ 1443 GreetingLightsEnable 0;
BA_ "GenSigTimeoutTime_BSM" SG_ 1443 GreetingLightsEnable 0;
BA_ "GenSigTimeoutTime_CADM" SG_ 1443 GreetingLightsEnable 0;
BA_ "GenSigTimeoutTime_DMSM" SG_ 1443 GreetingLightsEnable 0;
BA_ "GenSigTimeoutTime_DTCM" SG_ 1443 GreetingLightsEnable 0;
BA_ "GenSigTimeoutTime_ECM" SG_ 1443 GreetingLightsEnable 0;
BA_ "GenSigTimeoutTime_EVCU2" SG_ 1443 GreetingLightsEnable 0;
BA_ "GenSigTimeoutTime_GNMM" SG_ 1443 GreetingLightsEnable 0;
BA_ "GenSigTimeoutTime_HCP" SG_ 1443 GreetingLightsEnable 0;
BA_ "GenSigTimeoutTime_IPC" SG_ 1443 GreetingLightsEnable 0;
BA_ "GenSigTimeoutTime_RFHM" SG_ 1443 GreetingLightsEnable 0;
BA_ "GenSigTimeoutTime_TCM" SG_ 1443 GreetingLightsEnable 0;
BA_ "GenSigSendType" SG_ 1443 HeadlightsOffDelay 3;
BA_ "GenSigTimeoutTime_AGSM" SG_ 1443 HeadlightsOffDelay 0;
BA_ "GenSigTimeoutTime_BSM" SG_ 1443 HeadlightsOffDelay 0;
BA_ "GenSigTimeoutTime_CADM" SG_ 1443 HeadlightsOffDelay 0;
BA_ "GenSigTimeoutTime_DMSM" SG_ 1443 HeadlightsOffDelay 0;
BA_ "GenSigTimeoutTime_DTCM" SG_ 1443 HeadlightsOffDelay 0;
BA_ "GenSigTimeoutTime_ECM" SG_ 1443 HeadlightsOffDelay 0;
BA_ "GenSigTimeoutTime_EVCU2" SG_ 1443 HeadlightsOffDelay 0;
BA_ "GenSigTimeoutTime_GNMM" SG_ 1443 HeadlightsOffDelay 0;
BA_ "GenSigTimeoutTime_HCP" SG_ 1443 HeadlightsOffDelay 0;
BA_ "GenSigTimeoutTime_IPC" SG_ 1443 HeadlightsOffDelay 0;
BA_ "GenSigTimeoutTime_RFHM" SG_ 1443 HeadlightsOffDelay 0;
BA_ "GenSigTimeoutTime_TCM" SG_ 1443 HeadlightsOffDelay 0;
BA_ "GenSigStartValue" SG_ 1443 HeadLightWipers 1;
BA_ "GenSigSendType" SG_ 1443 HeadLightWipers 3;
BA_ "GenSigTimeoutTime_AGSM" SG_ 1443 HeadLightWipers 0;
BA_ "GenSigTimeoutTime_BSM" SG_ 1443 HeadLightWipers 0;
BA_ "GenSigTimeoutTime_CADM" SG_ 1443 HeadLightWipers 0;
BA_ "GenSigTimeoutTime_DMSM" SG_ 1443 HeadLightWipers 0;
BA_ "GenSigTimeoutTime_DTCM" SG_ 1443 HeadLightWipers 0;
BA_ "GenSigTimeoutTime_ECM" SG_ 1443 HeadLightWipers 0;
BA_ "GenSigTimeoutTime_EVCU2" SG_ 1443 HeadLightWipers 0;
BA_ "GenSigTimeoutTime_GNMM" SG_ 1443 HeadLightWipers 0;
BA_ "GenSigTimeoutTime_HCP" SG_ 1443 HeadLightWipers 0;
BA_ "GenSigTimeoutTime_IPC" SG_ 1443 HeadLightWipers 0;
BA_ "GenSigTimeoutTime_RFHM" SG_ 1443 HeadLightWipers 0;
BA_ "GenSigTimeoutTime_TCM" SG_ 1443 HeadLightWipers 0;
BA_ "GenSigSendType" SG_ 1443 Hill_Start_Assist 3;
BA_ "GenSigTimeoutTime_AGSM" SG_ 1443 Hill_Start_Assist 0;
BA_ "GenSigTimeoutTime_CADM" SG_ 1443 Hill_Start_Assist 0;
BA_ "GenSigTimeoutTime_DMSM" SG_ 1443 Hill_Start_Assist 0;
BA_ "GenSigTimeoutTime_DTCM" SG_ 1443 Hill_Start_Assist 0;
BA_ "GenSigTimeoutTime_ECM" SG_ 1443 Hill_Start_Assist 0;
BA_ "GenSigTimeoutTime_EVCU2" SG_ 1443 Hill_Start_Assist 0;
BA_ "GenSigTimeoutTime_GNMM" SG_ 1443 Hill_Start_Assist 0;
BA_ "GenSigTimeoutTime_HCP" SG_ 1443 Hill_Start_Assist 0;
BA_ "GenSigTimeoutTime_IPC" SG_ 1443 Hill_Start_Assist 0;
BA_ "GenSigTimeoutTime_RFHM" SG_ 1443 Hill_Start_Assist 0;
BA_ "GenSigTimeoutTime_TCM" SG_ 1443 Hill_Start_Assist 0;
BA_ "GenSigSendType" SG_ 1443 HourMode 3;
BA_ "GenSigTimeoutTime_AGSM" SG_ 1443 HourMode 0;
BA_ "GenSigTimeoutTime_BSM" SG_ 1443 HourMode 0;
BA_ "GenSigTimeoutTime_CADM" SG_ 1443 HourMode 0;
BA_ "GenSigTimeoutTime_DMSM" SG_ 1443 HourMode 0;
BA_ "GenSigTimeoutTime_DTCM" SG_ 1443 HourMode 0;
BA_ "GenSigTimeoutTime_ECM" SG_ 1443 HourMode 0;
BA_ "GenSigTimeoutTime_EVCU2" SG_ 1443 HourMode 0;
BA_ "GenSigTimeoutTime_GNMM" SG_ 1443 HourMode 0;
BA_ "GenSigTimeoutTime_HCP" SG_ 1443 HourMode 0;
BA_ "GenSigTimeoutTime_IPC" SG_ 1443 HourMode 0;
BA_ "GenSigTimeoutTime_RFHM" SG_ 1443 HourMode 0;
BA_ "GenSigTimeoutTime_TCM" SG_ 1443 HourMode 0;
BA_ "GenSigSendType" SG_ 1443 HP_Unit 3;
BA_ "GenSigTimeoutTime_AGSM" SG_ 1443 HP_Unit 0;
BA_ "GenSigTimeoutTime_BSM" SG_ 1443 HP_Unit 0;
BA_ "GenSigTimeoutTime_CADM" SG_ 1443 HP_Unit 0;
BA_ "GenSigTimeoutTime_DMSM" SG_ 1443 HP_Unit 0;
BA_ "GenSigTimeoutTime_DTCM" SG_ 1443 HP_Unit 0;
BA_ "GenSigTimeoutTime_ECM" SG_ 1443 HP_Unit 0;
BA_ "GenSigTimeoutTime_EVCU2" SG_ 1443 HP_Unit 0;
BA_ "GenSigTimeoutTime_GNMM" SG_ 1443 HP_Unit 0;
BA_ "GenSigTimeoutTime_HCP" SG_ 1443 HP_Unit 0;
BA_ "GenSigTimeoutTime_IPC" SG_ 1443 HP_Unit 0;
BA_ "GenSigTimeoutTime_RFHM" SG_ 1443 HP_Unit 0;
BA_ "GenSigTimeoutTime_TCM" SG_ 1443 HP_Unit 0;
BA_ "GenSigSendType" SG_ 1443 Illuminated_Approach 3;
BA_ "GenSigTimeoutTime_AGSM" SG_ 1443 Illuminated_Approach 0;
BA_ "GenSigTimeoutTime_BSM" SG_ 1443 Illuminated_Approach 0;
BA_ "GenSigTimeoutTime_CADM" SG_ 1443 Illuminated_Approach 0;
BA_ "GenSigTimeoutTime_DMSM" SG_ 1443 Illuminated_Approach 0;
BA_ "GenSigTimeoutTime_DTCM" SG_ 1443 Illuminated_Approach 0;
BA_ "GenSigTimeoutTime_ECM" SG_ 1443 Illuminated_Approach 0;
BA_ "GenSigTimeoutTime_EVCU2" SG_ 1443 Illuminated_Approach 0;
BA_ "GenSigTimeoutTime_GNMM" SG_ 1443 Illuminated_Approach 0;
BA_ "GenSigTimeoutTime_HCP" SG_ 1443 Illuminated_Approach 0;
BA_ "GenSigTimeoutTime_IPC" SG_ 1443 Illuminated_Approach 0;
BA_ "GenSigTimeoutTime_RFHM" SG_ 1443 Illuminated_Approach 0;
BA_ "GenSigTimeoutTime_TCM" SG_ 1443 Illuminated_Approach 0;
BA_ "GenSigSendType" SG_ 1443 IPCProgrammed 3;
BA_ "GenSigTimeoutTime_AGSM" SG_ 1443 IPCProgrammed 0;
BA_ "GenSigTimeoutTime_BSM" SG_ 1443 IPCProgrammed 0;
BA_ "GenSigTimeoutTime_CADM" SG_ 1443 IPCProgrammed 0;
BA_ "GenSigTimeoutTime_DMSM" SG_ 1443 IPCProgrammed 0;
BA_ "GenSigTimeoutTime_DTCM" SG_ 1443 IPCProgrammed 0;
BA_ "GenSigTimeoutTime_ECM" SG_ 1443 IPCProgrammed 0;
BA_ "GenSigTimeoutTime_EVCU2" SG_ 1443 IPCProgrammed 0;
BA_ "GenSigTimeoutTime_GNMM" SG_ 1443 IPCProgrammed 0;
BA_ "GenSigTimeoutTime_HCP" SG_ 1443 IPCProgrammed 0;
BA_ "GenSigTimeoutTime_IPC" SG_ 1443 IPCProgrammed 0;
BA_ "GenSigTimeoutTime_RFHM" SG_ 1443 IPCProgrammed 0;
BA_ "GenSigTimeoutTime_TCM" SG_ 1443 IPCProgrammed 0;
BA_ "GenSigSendType" SG_ 1443 LanguageSelection 3;
BA_ "GenSigTimeoutTime_AGSM" SG_ 1443 LanguageSelection 0;
BA_ "GenSigTimeoutTime_BSM" SG_ 1443 LanguageSelection 0;
BA_ "GenSigTimeoutTime_CADM" SG_ 1443 LanguageSelection 0;
BA_ "GenSigTimeoutTime_DMSM" SG_ 1443 LanguageSelection 0;
BA_ "GenSigTimeoutTime_DTCM" SG_ 1443 LanguageSelection 0;
BA_ "GenSigTimeoutTime_ECM" SG_ 1443 LanguageSelection 0;
BA_ "GenSigTimeoutTime_EVCU2" SG_ 1443 LanguageSelection 0;
BA_ "GenSigTimeoutTime_GNMM" SG_ 1443 LanguageSelection 0;
BA_ "GenSigTimeoutTime_HCP" SG_ 1443 LanguageSelection 0;
BA_ "GenSigTimeoutTime_IPC" SG_ 1443 LanguageSelection 0;
BA_ "GenSigTimeoutTime_RFHM" SG_ 1443 LanguageSelection 0;
BA_ "GenSigTimeoutTime_TCM" SG_ 1443 LanguageSelection 0;
BA_ "GenSigStartValue" SG_ 1443 LDW_Intensity 2;
BA_ "GenSigSendType" SG_ 1443 LDW_Intensity 3;
BA_ "GenSigTimeoutTime_AGSM" SG_ 1443 LDW_Intensity 0;
BA_ "GenSigTimeoutTime_BSM" SG_ 1443 LDW_Intensity 0;
BA_ "GenSigTimeoutTime_DMSM" SG_ 1443 LDW_Intensity 0;
BA_ "GenSigTimeoutTime_DTCM" SG_ 1443 LDW_Intensity 0;
BA_ "GenSigTimeoutTime_ECM" SG_ 1443 LDW_Intensity 0;
BA_ "GenSigTimeoutTime_EVCU2" SG_ 1443 LDW_Intensity 0;
BA_ "GenSigTimeoutTime_GNMM" SG_ 1443 LDW_Intensity 0;
BA_ "GenSigTimeoutTime_HCP" SG_ 1443 LDW_Intensity 0;
BA_ "GenSigTimeoutTime_IPC" SG_ 1443 LDW_Intensity 0;
BA_ "GenSigTimeoutTime_RFHM" SG_ 1443 LDW_Intensity 0;
BA_ "GenSigTimeoutTime_TCM" SG_ 1443 LDW_Intensity 0;
BA_ "GenSigStartValue" SG_ 1443 LDW_Sensibility 2;
BA_ "GenSigSendType" SG_ 1443 LDW_Sensibility 3;
BA_ "GenSigTimeoutTime_AGSM" SG_ 1443 LDW_Sensibility 0;
BA_ "GenSigTimeoutTime_BSM" SG_ 1443 LDW_Sensibility 0;
BA_ "GenSigTimeoutTime_DMSM" SG_ 1443 LDW_Sensibility 0;
BA_ "GenSigTimeoutTime_DTCM" SG_ 1443 LDW_Sensibility 0;
BA_ "GenSigTimeoutTime_ECM" SG_ 1443 LDW_Sensibility 0;
BA_ "GenSigTimeoutTime_EVCU2" SG_ 1443 LDW_Sensibility 0;
BA_ "GenSigTimeoutTime_GNMM" SG_ 1443 LDW_Sensibility 0;
BA_ "GenSigTimeoutTime_HCP" SG_ 1443 LDW_Sensibility 0;
BA_ "GenSigTimeoutTime_IPC" SG_ 1443 LDW_Sensibility 0;
BA_ "GenSigTimeoutTime_RFHM" SG_ 1443 LDW_Sensibility 0;
BA_ "GenSigTimeoutTime_TCM" SG_ 1443 LDW_Sensibility 0;
BA_ "GenSigTimeoutTime_AGSM" SG_ 1443 MessageCounter_IPCVS1 0;
BA_ "GenSigTimeoutTime_BCM" SG_ 1443 MessageCounter_IPCVS1 0;
BA_ "GenSigTimeoutTime_BSM" SG_ 1443 MessageCounter_IPCVS1 0;
BA_ "GenSigTimeoutTime_DMSM" SG_ 1443 MessageCounter_IPCVS1 0;
BA_ "GenSigTimeoutTime_DTCM" SG_ 1443 MessageCounter_IPCVS1 0;
BA_ "GenSigTimeoutTime_ECM" SG_ 1443 MessageCounter_IPCVS1 0;
BA_ "GenSigTimeoutTime_GNMM" SG_ 1443 MessageCounter_IPCVS1 0;
BA_ "GenSigTimeoutTime_HCP" SG_ 1443 MessageCounter_IPCVS1 0;
BA_ "GenSigTimeoutTime_IPC" SG_ 1443 MessageCounter_IPCVS1 0;
BA_ "GenSigTimeoutTime_RFHM" SG_ 1443 MessageCounter_IPCVS1 0;
BA_ "GenSigTimeoutTime_SGW" SG_ 1443 MessageCounter_IPCVS1 0;
BA_ "GenSigTimeoutTime_TCM" SG_ 1443 MessageCounter_IPCVS1 0;
BA_ "GenSigSendType" SG_ 1443 NavRepetition 3;
BA_ "GenSigTimeoutTime_AGSM" SG_ 1443 NavRepetition 0;
BA_ "GenSigTimeoutTime_BSM" SG_ 1443 NavRepetition 0;
BA_ "GenSigTimeoutTime_CADM" SG_ 1443 NavRepetition 0;
BA_ "GenSigTimeoutTime_DMSM" SG_ 1443 NavRepetition 0;
BA_ "GenSigTimeoutTime_DTCM" SG_ 1443 NavRepetition 0;
BA_ "GenSigTimeoutTime_ECM" SG_ 1443 NavRepetition 0;
BA_ "GenSigTimeoutTime_EVCU2" SG_ 1443 NavRepetition 0;
BA_ "GenSigTimeoutTime_GNMM" SG_ 1443 NavRepetition 0;
BA_ "GenSigTimeoutTime_HCP" SG_ 1443 NavRepetition 0;
BA_ "GenSigTimeoutTime_IPC" SG_ 1443 NavRepetition 0;
BA_ "GenSigTimeoutTime_RFHM" SG_ 1443 NavRepetition 0;
BA_ "GenSigTimeoutTime_TCM" SG_ 1443 NavRepetition 0;
BA_ "GenSigSendType" SG_ 1443 New_Spd_Zone_Ind 3;
BA_ "GenSigTimeoutTime_AGSM" SG_ 1443 New_Spd_Zone_Ind 0;
BA_ "GenSigTimeoutTime_BSM" SG_ 1443 New_Spd_Zone_Ind 0;
BA_ "GenSigTimeoutTime_CADM" SG_ 1443 New_Spd_Zone_Ind 0;
BA_ "GenSigTimeoutTime_DMSM" SG_ 1443 New_Spd_Zone_Ind 0;
BA_ "GenSigTimeoutTime_DTCM" SG_ 1443 New_Spd_Zone_Ind 0;
BA_ "GenSigTimeoutTime_ECM" SG_ 1443 New_Spd_Zone_Ind 0;
BA_ "GenSigTimeoutTime_EVCU2" SG_ 1443 New_Spd_Zone_Ind 0;
BA_ "GenSigTimeoutTime_GNMM" SG_ 1443 New_Spd_Zone_Ind 0;
BA_ "GenSigTimeoutTime_HCP" SG_ 1443 New_Spd_Zone_Ind 0;
BA_ "GenSigTimeoutTime_IPC" SG_ 1443 New_Spd_Zone_Ind 0;
BA_ "GenSigTimeoutTime_RFHM" SG_ 1443 New_Spd_Zone_Ind 0;
BA_ "GenSigTimeoutTime_TCM" SG_ 1443 New_Spd_Zone_Ind 0;
BA_ "GenSigSendType" SG_ 1443 Paddle_Shifter 3;
BA_ "GenSigTimeoutTime_AGSM" SG_ 1443 Paddle_Shifter 0;
BA_ "GenSigTimeoutTime_BSM" SG_ 1443 Paddle_Shifter 0;
BA_ "GenSigTimeoutTime_CADM" SG_ 1443 Paddle_Shifter 0;
BA_ "GenSigTimeoutTime_DMSM" SG_ 1443 Paddle_Shifter 0;
BA_ "GenSigTimeoutTime_DTCM" SG_ 1443 Paddle_Shifter 0;
BA_ "GenSigTimeoutTime_ECM" SG_ 1443 Paddle_Shifter 0;
BA_ "GenSigTimeoutTime_EVCU2" SG_ 1443 Paddle_Shifter 0;
BA_ "GenSigTimeoutTime_GNMM" SG_ 1443 Paddle_Shifter 0;
BA_ "GenSigTimeoutTime_HCP" SG_ 1443 Paddle_Shifter 0;
BA_ "GenSigTimeoutTime_IPC" SG_ 1443 Paddle_Shifter 0;
BA_ "GenSigTimeoutTime_RFHM" SG_ 1443 Paddle_Shifter 0;
BA_ "GenSigTimeoutTime_TCM" SG_ 1443 Paddle_Shifter 0;
BA_ "GenSigStartValue" SG_ 1443 PamChimeVolumeFront 1;
BA_ "GenSigSendType" SG_ 1443 PamChimeVolumeFront 3;
BA_ "GenSigTimeoutTime_AGSM" SG_ 1443 PamChimeVolumeFront 0;
BA_ "GenSigTimeoutTime_BSM" SG_ 1443 PamChimeVolumeFront 0;
BA_ "GenSigTimeoutTime_CADM" SG_ 1443 PamChimeVolumeFront 0;
BA_ "GenSigTimeoutTime_DMSM" SG_ 1443 PamChimeVolumeFront 0;
BA_ "GenSigTimeoutTime_DTCM" SG_ 1443 PamChimeVolumeFront 0;
BA_ "GenSigTimeoutTime_ECM" SG_ 1443 PamChimeVolumeFront 0;
BA_ "GenSigTimeoutTime_EVCU2" SG_ 1443 PamChimeVolumeFront 0;
BA_ "GenSigTimeoutTime_GNMM" SG_ 1443 PamChimeVolumeFront 0;
BA_ "GenSigTimeoutTime_HCP" SG_ 1443 PamChimeVolumeFront 0;
BA_ "GenSigTimeoutTime_IPC" SG_ 1443 PamChimeVolumeFront 0;
BA_ "GenSigTimeoutTime_RFHM" SG_ 1443 PamChimeVolumeFront 0;
BA_ "GenSigTimeoutTime_TCM" SG_ 1443 PamChimeVolumeFront 0;
BA_ "GenSigStartValue" SG_ 1443 PamChimeVolumeRear 1;
BA_ "GenSigSendType" SG_ 1443 PamChimeVolumeRear 3;
BA_ "GenSigTimeoutTime_AGSM" SG_ 1443 PamChimeVolumeRear 0;
BA_ "GenSigTimeoutTime_BSM" SG_ 1443 PamChimeVolumeRear 0;
BA_ "GenSigTimeoutTime_CADM" SG_ 1443 PamChimeVolumeRear 0;
BA_ "GenSigTimeoutTime_DMSM" SG_ 1443 PamChimeVolumeRear 0;
BA_ "GenSigTimeoutTime_DTCM" SG_ 1443 PamChimeVolumeRear 0;
BA_ "GenSigTimeoutTime_ECM" SG_ 1443 PamChimeVolumeRear 0;
BA_ "GenSigTimeoutTime_EVCU2" SG_ 1443 PamChimeVolumeRear 0;
BA_ "GenSigTimeoutTime_GNMM" SG_ 1443 PamChimeVolumeRear 0;
BA_ "GenSigTimeoutTime_HCP" SG_ 1443 PamChimeVolumeRear 0;
BA_ "GenSigTimeoutTime_IPC" SG_ 1443 PamChimeVolumeRear 0;
BA_ "GenSigTimeoutTime_RFHM" SG_ 1443 PamChimeVolumeRear 0;
BA_ "GenSigTimeoutTime_TCM" SG_ 1443 PamChimeVolumeRear 0;
BA_ "GenSigSendType" SG_ 1443 PassiveEntry 3;
BA_ "GenSigTimeoutTime_AGSM" SG_ 1443 PassiveEntry 0;
BA_ "GenSigTimeoutTime_BSM" SG_ 1443 PassiveEntry 0;
BA_ "GenSigTimeoutTime_CADM" SG_ 1443 PassiveEntry 0;
BA_ "GenSigTimeoutTime_DMSM" SG_ 1443 PassiveEntry 0;
BA_ "GenSigTimeoutTime_DTCM" SG_ 1443 PassiveEntry 0;
BA_ "GenSigTimeoutTime_ECM" SG_ 1443 PassiveEntry 0;
BA_ "GenSigTimeoutTime_EVCU2" SG_ 1443 PassiveEntry 0;
BA_ "GenSigTimeoutTime_GNMM" SG_ 1443 PassiveEntry 0;
BA_ "GenSigTimeoutTime_HCP" SG_ 1443 PassiveEntry 0;
BA_ "GenSigTimeoutTime_IPC" SG_ 1443 PassiveEntry 0;
BA_ "GenSigTimeoutTime_TCM" SG_ 1443 PassiveEntry 0;
BA_ "GenSigSendType" SG_ 1443 Ped_EM_Brk_Warn_Act 3;
BA_ "GenSigTimeoutTime_AGSM" SG_ 1443 Ped_EM_Brk_Warn_Act 0;
BA_ "GenSigTimeoutTime_BSM" SG_ 1443 Ped_EM_Brk_Warn_Act 0;
BA_ "GenSigTimeoutTime_DMSM" SG_ 1443 Ped_EM_Brk_Warn_Act 0;
BA_ "GenSigTimeoutTime_DTCM" SG_ 1443 Ped_EM_Brk_Warn_Act 0;
BA_ "GenSigTimeoutTime_ECM" SG_ 1443 Ped_EM_Brk_Warn_Act 0;
BA_ "GenSigTimeoutTime_EVCU2" SG_ 1443 Ped_EM_Brk_Warn_Act 0;
BA_ "GenSigTimeoutTime_GNMM" SG_ 1443 Ped_EM_Brk_Warn_Act 0;
BA_ "GenSigTimeoutTime_HCP" SG_ 1443 Ped_EM_Brk_Warn_Act 0;
BA_ "GenSigTimeoutTime_IPC" SG_ 1443 Ped_EM_Brk_Warn_Act 0;
BA_ "GenSigTimeoutTime_RFHM" SG_ 1443 Ped_EM_Brk_Warn_Act 0;
BA_ "GenSigTimeoutTime_TCM" SG_ 1443 Ped_EM_Brk_Warn_Act 0;
BA_ "GenSigSendType" SG_ 1443 PhoneRepetition 3;
BA_ "GenSigTimeoutTime_AGSM" SG_ 1443 PhoneRepetition 0;
BA_ "GenSigTimeoutTime_BSM" SG_ 1443 PhoneRepetition 0;
BA_ "GenSigTimeoutTime_CADM" SG_ 1443 PhoneRepetition 0;
BA_ "GenSigTimeoutTime_DMSM" SG_ 1443 PhoneRepetition 0;
BA_ "GenSigTimeoutTime_DTCM" SG_ 1443 PhoneRepetition 0;
BA_ "GenSigTimeoutTime_ECM" SG_ 1443 PhoneRepetition 0;
BA_ "GenSigTimeoutTime_EVCU2" SG_ 1443 PhoneRepetition 0;
BA_ "GenSigTimeoutTime_GNMM" SG_ 1443 PhoneRepetition 0;
BA_ "GenSigTimeoutTime_HCP" SG_ 1443 PhoneRepetition 0;
BA_ "GenSigTimeoutTime_IPC" SG_ 1443 PhoneRepetition 0;
BA_ "GenSigTimeoutTime_RFHM" SG_ 1443 PhoneRepetition 0;
BA_ "GenSigTimeoutTime_TCM" SG_ 1443 PhoneRepetition 0;
BA_ "GenSigStartValue" SG_ 1443 PLGAlert 1;
BA_ "GenSigSendType" SG_ 1443 PLGAlert 3;
BA_ "GenSigTimeoutTime_AGSM" SG_ 1443 PLGAlert 0;
BA_ "GenSigTimeoutTime_BSM" SG_ 1443 PLGAlert 0;
BA_ "GenSigTimeoutTime_CADM" SG_ 1443 PLGAlert 0;
BA_ "GenSigTimeoutTime_DMSM" SG_ 1443 PLGAlert 0;
BA_ "GenSigTimeoutTime_DTCM" SG_ 1443 PLGAlert 0;
BA_ "GenSigTimeoutTime_ECM" SG_ 1443 PLGAlert 0;
BA_ "GenSigTimeoutTime_EVCU2" SG_ 1443 PLGAlert 0;
BA_ "GenSigTimeoutTime_GNMM" SG_ 1443 PLGAlert 0;
BA_ "GenSigTimeoutTime_HCP" SG_ 1443 PLGAlert 0;
BA_ "GenSigTimeoutTime_IPC" SG_ 1443 PLGAlert 0;
BA_ "GenSigTimeoutTime_RFHM" SG_ 1443 PLGAlert 0;
BA_ "GenSigTimeoutTime_TCM" SG_ 1443 PLGAlert 0;
BA_ "GenSigSendType" SG_ 1443 Power_Side_Step 3;
BA_ "GenSigTimeoutTime_AGSM" SG_ 1443 Power_Side_Step 0;
BA_ "GenSigTimeoutTime_BSM" SG_ 1443 Power_Side_Step 0;
BA_ "GenSigTimeoutTime_CADM" SG_ 1443 Power_Side_Step 0;
BA_ "GenSigTimeoutTime_DMSM" SG_ 1443 Power_Side_Step 0;
BA_ "GenSigTimeoutTime_DTCM" SG_ 1443 Power_Side_Step 0;
BA_ "GenSigTimeoutTime_ECM" SG_ 1443 Power_Side_Step 0;
BA_ "GenSigTimeoutTime_EVCU2" SG_ 1443 Power_Side_Step 0;
BA_ "GenSigTimeoutTime_GNMM" SG_ 1443 Power_Side_Step 0;
BA_ "GenSigTimeoutTime_HCP" SG_ 1443 Power_Side_Step 0;
BA_ "GenSigTimeoutTime_IPC" SG_ 1443 Power_Side_Step 0;
BA_ "GenSigTimeoutTime_RFHM" SG_ 1443 Power_Side_Step 0;
BA_ "GenSigTimeoutTime_TCM" SG_ 1443 Power_Side_Step 0;
BA_ "GenSigSendType" SG_ 1443 Proximity_WU 3;
BA_ "GenSigTimeoutTime_AGSM" SG_ 1443 Proximity_WU 0;
BA_ "GenSigTimeoutTime_BSM" SG_ 1443 Proximity_WU 0;
BA_ "GenSigTimeoutTime_CADM" SG_ 1443 Proximity_WU 0;
BA_ "GenSigTimeoutTime_DMSM" SG_ 1443 Proximity_WU 0;
BA_ "GenSigTimeoutTime_DTCM" SG_ 1443 Proximity_WU 0;
BA_ "GenSigTimeoutTime_ECM" SG_ 1443 Proximity_WU 0;
BA_ "GenSigTimeoutTime_EVCU2" SG_ 1443 Proximity_WU 0;
BA_ "GenSigTimeoutTime_GNMM" SG_ 1443 Proximity_WU 0;
BA_ "GenSigTimeoutTime_HCP" SG_ 1443 Proximity_WU 0;
BA_ "GenSigTimeoutTime_IPC" SG_ 1443 Proximity_WU 0;
BA_ "GenSigTimeoutTime_TCM" SG_ 1443 Proximity_WU 0;
BA_ "GenSigStartValue" SG_ 1443 PwrLev 2;
BA_ "GenSigSendType" SG_ 1443 PwrLev 3;
BA_ "GenSigTimeoutTime_AGSM" SG_ 1443 PwrLev 0;
BA_ "GenSigTimeoutTime_BSM" SG_ 1443 PwrLev 0;
BA_ "GenSigTimeoutTime_CADM" SG_ 1443 PwrLev 0;
BA_ "GenSigTimeoutTime_DMSM" SG_ 1443 PwrLev 0;
BA_ "GenSigTimeoutTime_DTCM" SG_ 1443 PwrLev 0;
BA_ "GenSigTimeoutTime_ECM" SG_ 1443 PwrLev 0;
BA_ "GenSigTimeoutTime_GNMM" SG_ 1443 PwrLev 0;
BA_ "GenSigTimeoutTime_HCP" SG_ 1443 PwrLev 0;
BA_ "GenSigTimeoutTime_IPC" SG_ 1443 PwrLev 0;
BA_ "GenSigTimeoutTime_RFHM" SG_ 1443 PwrLev 0;
BA_ "GenSigTimeoutTime_TCM" SG_ 1443 PwrLev 0;
BA_ "GenSigStartValue" SG_ 1443 RainSensorLevel 1;
BA_ "GenSigSendType" SG_ 1443 RainSensorLevel 3;
BA_ "GenSigTimeoutTime_AGSM" SG_ 1443 RainSensorLevel 0;
BA_ "GenSigTimeoutTime_BSM" SG_ 1443 RainSensorLevel 0;
BA_ "GenSigTimeoutTime_CADM" SG_ 1443 RainSensorLevel 0;
BA_ "GenSigTimeoutTime_DMSM" SG_ 1443 RainSensorLevel 0;
BA_ "GenSigTimeoutTime_DTCM" SG_ 1443 RainSensorLevel 0;
BA_ "GenSigTimeoutTime_ECM" SG_ 1443 RainSensorLevel 0;
BA_ "GenSigTimeoutTime_EVCU2" SG_ 1443 RainSensorLevel 0;
BA_ "GenSigTimeoutTime_GNMM" SG_ 1443 RainSensorLevel 0;
BA_ "GenSigTimeoutTime_HCP" SG_ 1443 RainSensorLevel 0;
BA_ "GenSigTimeoutTime_IPC" SG_ 1443 RainSensorLevel 0;
BA_ "GenSigTimeoutTime_RFHM" SG_ 1443 RainSensorLevel 0;
BA_ "GenSigTimeoutTime_TCM" SG_ 1443 RainSensorLevel 0;
BA_ "GenSigSendType" SG_ 1443 Rdy_To_Drive 3;
BA_ "GenSigTimeoutTime_AGSM" SG_ 1443 Rdy_To_Drive 0;
BA_ "GenSigTimeoutTime_BCM" SG_ 1443 Rdy_To_Drive 0;
BA_ "GenSigTimeoutTime_BSM" SG_ 1443 Rdy_To_Drive 0;
BA_ "GenSigTimeoutTime_CADM" SG_ 1443 Rdy_To_Drive 0;
BA_ "GenSigTimeoutTime_DMSM" SG_ 1443 Rdy_To_Drive 0;
BA_ "GenSigTimeoutTime_DTCM" SG_ 1443 Rdy_To_Drive 0;
BA_ "GenSigTimeoutTime_ECM" SG_ 1443 Rdy_To_Drive 0;
BA_ "GenSigTimeoutTime_EVCU2" SG_ 1443 Rdy_To_Drive 0;
BA_ "GenSigTimeoutTime_GNMM" SG_ 1443 Rdy_To_Drive 0;
BA_ "GenSigTimeoutTime_HCP" SG_ 1443 Rdy_To_Drive 0;
BA_ "GenSigTimeoutTime_IPC" SG_ 1443 Rdy_To_Drive 0;
BA_ "GenSigTimeoutTime_RFHM" SG_ 1443 Rdy_To_Drive 0;
BA_ "GenSigTimeoutTime_TCM" SG_ 1443 Rdy_To_Drive 0;
BA_ "GenSigSendType" SG_ 1443 Rear_Brk_Asst 3;
BA_ "GenSigTimeoutTime_AGSM" SG_ 1443 Rear_Brk_Asst 0;
BA_ "GenSigTimeoutTime_BSM" SG_ 1443 Rear_Brk_Asst 0;
BA_ "GenSigTimeoutTime_CADM" SG_ 1443 Rear_Brk_Asst 0;
BA_ "GenSigTimeoutTime_DMSM" SG_ 1443 Rear_Brk_Asst 0;
BA_ "GenSigTimeoutTime_DTCM" SG_ 1443 Rear_Brk_Asst 0;
BA_ "GenSigTimeoutTime_ECM" SG_ 1443 Rear_Brk_Asst 0;
BA_ "GenSigTimeoutTime_EVCU2" SG_ 1443 Rear_Brk_Asst 0;
BA_ "GenSigTimeoutTime_GNMM" SG_ 1443 Rear_Brk_Asst 0;
BA_ "GenSigTimeoutTime_HCP" SG_ 1443 Rear_Brk_Asst 0;
BA_ "GenSigTimeoutTime_IPC" SG_ 1443 Rear_Brk_Asst 0;
BA_ "GenSigTimeoutTime_RFHM" SG_ 1443 Rear_Brk_Asst 0;
BA_ "GenSigTimeoutTime_TCM" SG_ 1443 Rear_Brk_Asst 0;
BA_ "GenSigStartValue" SG_ 1443 RemoteDoorUnlock 1;
BA_ "GenSigSendType" SG_ 1443 RemoteDoorUnlock 3;
BA_ "GenSigTimeoutTime_AGSM" SG_ 1443 RemoteDoorUnlock 0;
BA_ "GenSigTimeoutTime_BSM" SG_ 1443 RemoteDoorUnlock 0;
BA_ "GenSigTimeoutTime_CADM" SG_ 1443 RemoteDoorUnlock 0;
BA_ "GenSigTimeoutTime_DMSM" SG_ 1443 RemoteDoorUnlock 0;
BA_ "GenSigTimeoutTime_DTCM" SG_ 1443 RemoteDoorUnlock 0;
BA_ "GenSigTimeoutTime_ECM" SG_ 1443 RemoteDoorUnlock 0;
BA_ "GenSigTimeoutTime_EVCU2" SG_ 1443 RemoteDoorUnlock 0;
BA_ "GenSigTimeoutTime_GNMM" SG_ 1443 RemoteDoorUnlock 0;
BA_ "GenSigTimeoutTime_HCP" SG_ 1443 RemoteDoorUnlock 0;
BA_ "GenSigTimeoutTime_IPC" SG_ 1443 RemoteDoorUnlock 0;
BA_ "GenSigTimeoutTime_RFHM" SG_ 1443 RemoteDoorUnlock 0;
BA_ "GenSigTimeoutTime_TCM" SG_ 1443 RemoteDoorUnlock 0;
BA_ "GenSigStartValue" SG_ 1443 RemStNrmlStEnbl 2;
BA_ "GenSigSendType" SG_ 1443 RemStNrmlStEnbl 3;
BA_ "GenSigTimeoutTime_AGSM" SG_ 1443 RemStNrmlStEnbl 0;
BA_ "GenSigTimeoutTime_BSM" SG_ 1443 RemStNrmlStEnbl 0;
BA_ "GenSigTimeoutTime_CADM" SG_ 1443 RemStNrmlStEnbl 0;
BA_ "GenSigTimeoutTime_DMSM" SG_ 1443 RemStNrmlStEnbl 0;
BA_ "GenSigTimeoutTime_DTCM" SG_ 1443 RemStNrmlStEnbl 0;
BA_ "GenSigTimeoutTime_ECM" SG_ 1443 RemStNrmlStEnbl 0;
BA_ "GenSigTimeoutTime_EVCU2" SG_ 1443 RemStNrmlStEnbl 0;
BA_ "GenSigTimeoutTime_GNMM" SG_ 1443 RemStNrmlStEnbl 0;
BA_ "GenSigTimeoutTime_HCP" SG_ 1443 RemStNrmlStEnbl 0;
BA_ "GenSigTimeoutTime_IPC" SG_ 1443 RemStNrmlStEnbl 0;
BA_ "GenSigTimeoutTime_RFHM" SG_ 1443 RemStNrmlStEnbl 0;
BA_ "GenSigTimeoutTime_TCM" SG_ 1443 RemStNrmlStEnbl 0;
BA_ "GenSigStartValue" SG_ 1443 RKEMemoryLinkEnable 1;
BA_ "GenSigSendType" SG_ 1443 RKEMemoryLinkEnable 3;
BA_ "GenSigTimeoutTime_AGSM" SG_ 1443 RKEMemoryLinkEnable 0;
BA_ "GenSigTimeoutTime_BSM" SG_ 1443 RKEMemoryLinkEnable 0;
BA_ "GenSigTimeoutTime_CADM" SG_ 1443 RKEMemoryLinkEnable 0;
BA_ "GenSigTimeoutTime_DMSM" SG_ 1443 RKEMemoryLinkEnable 0;
BA_ "GenSigTimeoutTime_DTCM" SG_ 1443 RKEMemoryLinkEnable 0;
BA_ "GenSigTimeoutTime_ECM" SG_ 1443 RKEMemoryLinkEnable 0;
BA_ "GenSigTimeoutTime_EVCU2" SG_ 1443 RKEMemoryLinkEnable 0;
BA_ "GenSigTimeoutTime_GNMM" SG_ 1443 RKEMemoryLinkEnable 0;
BA_ "GenSigTimeoutTime_HCP" SG_ 1443 RKEMemoryLinkEnable 0;
BA_ "GenSigTimeoutTime_IPC" SG_ 1443 RKEMemoryLinkEnable 0;
BA_ "GenSigTimeoutTime_RFHM" SG_ 1443 RKEMemoryLinkEnable 0;
BA_ "GenSigTimeoutTime_TCM" SG_ 1443 RKEMemoryLinkEnable 0;
BA_ "GenSigSendType" SG_ 1443 SOC_Max_Lev 3;
BA_ "GenSigTimeoutTime_AGSM" SG_ 1443 SOC_Max_Lev 0;
BA_ "GenSigTimeoutTime_BCM" SG_ 1443 SOC_Max_Lev 0;
BA_ "GenSigTimeoutTime_BSM" SG_ 1443 SOC_Max_Lev 0;
BA_ "GenSigTimeoutTime_CADM" SG_ 1443 SOC_Max_Lev 0;
BA_ "GenSigTimeoutTime_DMSM" SG_ 1443 SOC_Max_Lev 0;
BA_ "GenSigTimeoutTime_DTCM" SG_ 1443 SOC_Max_Lev 0;
BA_ "GenSigTimeoutTime_ECM" SG_ 1443 SOC_Max_Lev 0;
BA_ "GenSigTimeoutTime_GNMM" SG_ 1443 SOC_Max_Lev 0;
BA_ "GenSigTimeoutTime_HCP" SG_ 1443 SOC_Max_Lev 0;
BA_ "GenSigTimeoutTime_IPC" SG_ 1443 SOC_Max_Lev 0;
BA_ "GenSigTimeoutTime_RFHM" SG_ 1443 SOC_Max_Lev 0;
BA_ "GenSigTimeoutTime_TCM" SG_ 1443 SOC_Max_Lev 0;
BA_ "GenSigStartValue" SG_ 1443 SoundHornLock 1;
BA_ "GenSigSendType" SG_ 1443 SoundHornLock 3;
BA_ "GenSigTimeoutTime_AGSM" SG_ 1443 SoundHornLock 0;
BA_ "GenSigTimeoutTime_BSM" SG_ 1443 SoundHornLock 0;
BA_ "GenSigTimeoutTime_CADM" SG_ 1443 SoundHornLock 0;
BA_ "GenSigTimeoutTime_DMSM" SG_ 1443 SoundHornLock 0;
BA_ "GenSigTimeoutTime_DTCM" SG_ 1443 SoundHornLock 0;
BA_ "GenSigTimeoutTime_ECM" SG_ 1443 SoundHornLock 0;
BA_ "GenSigTimeoutTime_EVCU2" SG_ 1443 SoundHornLock 0;
BA_ "GenSigTimeoutTime_GNMM" SG_ 1443 SoundHornLock 0;
BA_ "GenSigTimeoutTime_HCP" SG_ 1443 SoundHornLock 0;
BA_ "GenSigTimeoutTime_IPC" SG_ 1443 SoundHornLock 0;
BA_ "GenSigTimeoutTime_RFHM" SG_ 1443 SoundHornLock 0;
BA_ "GenSigTimeoutTime_TCM" SG_ 1443 SoundHornLock 0;
BA_ "GenSigSendType" SG_ 1443 SoundHornRemoteStart 3;
BA_ "GenSigTimeoutTime_AGSM" SG_ 1443 SoundHornRemoteStart 0;
BA_ "GenSigTimeoutTime_BSM" SG_ 1443 SoundHornRemoteStart 0;
BA_ "GenSigTimeoutTime_CADM" SG_ 1443 SoundHornRemoteStart 0;
BA_ "GenSigTimeoutTime_DMSM" SG_ 1443 SoundHornRemoteStart 0;
BA_ "GenSigTimeoutTime_DTCM" SG_ 1443 SoundHornRemoteStart 0;
BA_ "GenSigTimeoutTime_ECM" SG_ 1443 SoundHornRemoteStart 0;
BA_ "GenSigTimeoutTime_EVCU2" SG_ 1443 SoundHornRemoteStart 0;
BA_ "GenSigTimeoutTime_GNMM" SG_ 1443 SoundHornRemoteStart 0;
BA_ "GenSigTimeoutTime_HCP" SG_ 1443 SoundHornRemoteStart 0;
BA_ "GenSigTimeoutTime_IPC" SG_ 1443 SoundHornRemoteStart 0;
BA_ "GenSigTimeoutTime_RFHM" SG_ 1443 SoundHornRemoteStart 0;
BA_ "GenSigTimeoutTime_TCM" SG_ 1443 SoundHornRemoteStart 0;
BA_ "GenSigSendType" SG_ 1443 Speed_Unit 3;
BA_ "GenSigTimeoutTime_AGSM" SG_ 1443 Speed_Unit 0;
BA_ "GenSigTimeoutTime_BSM" SG_ 1443 Speed_Unit 0;
BA_ "GenSigTimeoutTime_DMSM" SG_ 1443 Speed_Unit 0;
BA_ "GenSigTimeoutTime_DTCM" SG_ 1443 Speed_Unit 0;
BA_ "GenSigTimeoutTime_ECM" SG_ 1443 Speed_Unit 0;
BA_ "GenSigTimeoutTime_GNMM" SG_ 1443 Speed_Unit 0;
BA_ "GenSigTimeoutTime_HCP" SG_ 1443 Speed_Unit 0;
BA_ "GenSigTimeoutTime_IPC" SG_ 1443 Speed_Unit 0;
BA_ "GenSigTimeoutTime_RFHM" SG_ 1443 Speed_Unit 0;
BA_ "GenSigTimeoutTime_TCM" SG_ 1443 Speed_Unit 0;
BA_ "GenSigSendType" SG_ 1443 SpeedLockDoorEnable 3;
BA_ "GenSigTimeoutTime_AGSM" SG_ 1443 SpeedLockDoorEnable 0;
BA_ "GenSigTimeoutTime_BSM" SG_ 1443 SpeedLockDoorEnable 0;
BA_ "GenSigTimeoutTime_CADM" SG_ 1443 SpeedLockDoorEnable 0;
BA_ "GenSigTimeoutTime_DMSM" SG_ 1443 SpeedLockDoorEnable 0;
BA_ "GenSigTimeoutTime_DTCM" SG_ 1443 SpeedLockDoorEnable 0;
BA_ "GenSigTimeoutTime_ECM" SG_ 1443 SpeedLockDoorEnable 0;
BA_ "GenSigTimeoutTime_EVCU2" SG_ 1443 SpeedLockDoorEnable 0;
BA_ "GenSigTimeoutTime_GNMM" SG_ 1443 SpeedLockDoorEnable 0;
BA_ "GenSigTimeoutTime_HCP" SG_ 1443 SpeedLockDoorEnable 0;
BA_ "GenSigTimeoutTime_IPC" SG_ 1443 SpeedLockDoorEnable 0;
BA_ "GenSigTimeoutTime_RFHM" SG_ 1443 SpeedLockDoorEnable 0;
BA_ "GenSigTimeoutTime_TCM" SG_ 1443 SpeedLockDoorEnable 0;
BA_ "GenSigSendType" SG_ 1443 StaticGrid 3;
BA_ "GenSigTimeoutTime_AGSM" SG_ 1443 StaticGrid 0;
BA_ "GenSigTimeoutTime_BSM" SG_ 1443 StaticGrid 0;
BA_ "GenSigTimeoutTime_CADM" SG_ 1443 StaticGrid 0;
BA_ "GenSigTimeoutTime_DMSM" SG_ 1443 StaticGrid 0;
BA_ "GenSigTimeoutTime_DTCM" SG_ 1443 StaticGrid 0;
BA_ "GenSigTimeoutTime_ECM" SG_ 1443 StaticGrid 0;
BA_ "GenSigTimeoutTime_EVCU2" SG_ 1443 StaticGrid 0;
BA_ "GenSigTimeoutTime_GNMM" SG_ 1443 StaticGrid 0;
BA_ "GenSigTimeoutTime_HCP" SG_ 1443 StaticGrid 0;
BA_ "GenSigTimeoutTime_IPC" SG_ 1443 StaticGrid 0;
BA_ "GenSigTimeoutTime_RFHM" SG_ 1443 StaticGrid 0;
BA_ "GenSigTimeoutTime_TCM" SG_ 1443 StaticGrid 0;
BA_ "GenSigSendType" SG_ 1443 Susp_Auto_Ent_Ext 3;
BA_ "GenSigTimeoutTime_AGSM" SG_ 1443 Susp_Auto_Ent_Ext 0;
BA_ "GenSigTimeoutTime_BSM" SG_ 1443 Susp_Auto_Ent_Ext 0;
BA_ "GenSigTimeoutTime_CADM" SG_ 1443 Susp_Auto_Ent_Ext 0;
BA_ "GenSigTimeoutTime_DMSM" SG_ 1443 Susp_Auto_Ent_Ext 0;
BA_ "GenSigTimeoutTime_DTCM" SG_ 1443 Susp_Auto_Ent_Ext 0;
BA_ "GenSigTimeoutTime_ECM" SG_ 1443 Susp_Auto_Ent_Ext 0;
BA_ "GenSigTimeoutTime_EVCU2" SG_ 1443 Susp_Auto_Ent_Ext 0;
BA_ "GenSigTimeoutTime_GNMM" SG_ 1443 Susp_Auto_Ent_Ext 0;
BA_ "GenSigTimeoutTime_HCP" SG_ 1443 Susp_Auto_Ent_Ext 0;
BA_ "GenSigTimeoutTime_IPC" SG_ 1443 Susp_Auto_Ent_Ext 0;
BA_ "GenSigTimeoutTime_RFHM" SG_ 1443 Susp_Auto_Ent_Ext 0;
BA_ "GenSigTimeoutTime_TCM" SG_ 1443 Susp_Auto_Ent_Ext 0;
BA_ "GenSigSendType" SG_ 1443 Susp_Disp_Message 3;
BA_ "GenSigTimeoutTime_AGSM" SG_ 1443 Susp_Disp_Message 0;
BA_ "GenSigTimeoutTime_BSM" SG_ 1443 Susp_Disp_Message 0;
BA_ "GenSigTimeoutTime_CADM" SG_ 1443 Susp_Disp_Message 0;
BA_ "GenSigTimeoutTime_DMSM" SG_ 1443 Susp_Disp_Message 0;
BA_ "GenSigTimeoutTime_DTCM" SG_ 1443 Susp_Disp_Message 0;
BA_ "GenSigTimeoutTime_ECM" SG_ 1443 Susp_Disp_Message 0;
BA_ "GenSigTimeoutTime_EVCU2" SG_ 1443 Susp_Disp_Message 0;
BA_ "GenSigTimeoutTime_GNMM" SG_ 1443 Susp_Disp_Message 0;
BA_ "GenSigTimeoutTime_HCP" SG_ 1443 Susp_Disp_Message 0;
BA_ "GenSigTimeoutTime_IPC" SG_ 1443 Susp_Disp_Message 0;
BA_ "GenSigTimeoutTime_RFHM" SG_ 1443 Susp_Disp_Message 0;
BA_ "GenSigTimeoutTime_TCM" SG_ 1443 Susp_Disp_Message 0;
BA_ "GenSigSendType" SG_ 1443 Susp_Flsh_Lght_Low 3;
BA_ "GenSigTimeoutTime_AGSM" SG_ 1443 Susp_Flsh_Lght_Low 0;
BA_ "GenSigTimeoutTime_BSM" SG_ 1443 Susp_Flsh_Lght_Low 0;
BA_ "GenSigTimeoutTime_CADM" SG_ 1443 Susp_Flsh_Lght_Low 0;
BA_ "GenSigTimeoutTime_DMSM" SG_ 1443 Susp_Flsh_Lght_Low 0;
BA_ "GenSigTimeoutTime_DTCM" SG_ 1443 Susp_Flsh_Lght_Low 0;
BA_ "GenSigTimeoutTime_ECM" SG_ 1443 Susp_Flsh_Lght_Low 0;
BA_ "GenSigTimeoutTime_EVCU2" SG_ 1443 Susp_Flsh_Lght_Low 0;
BA_ "GenSigTimeoutTime_GNMM" SG_ 1443 Susp_Flsh_Lght_Low 0;
BA_ "GenSigTimeoutTime_HCP" SG_ 1443 Susp_Flsh_Lght_Low 0;
BA_ "GenSigTimeoutTime_IPC" SG_ 1443 Susp_Flsh_Lght_Low 0;
BA_ "GenSigTimeoutTime_RFHM" SG_ 1443 Susp_Flsh_Lght_Low 0;
BA_ "GenSigTimeoutTime_TCM" SG_ 1443 Susp_Flsh_Lght_Low 0;
BA_ "GenSigSendType" SG_ 1443 Susp_Sound_Hrn_Low 3;
BA_ "GenSigTimeoutTime_AGSM" SG_ 1443 Susp_Sound_Hrn_Low 0;
BA_ "GenSigTimeoutTime_BSM" SG_ 1443 Susp_Sound_Hrn_Low 0;
BA_ "GenSigTimeoutTime_CADM" SG_ 1443 Susp_Sound_Hrn_Low 0;
BA_ "GenSigTimeoutTime_DMSM" SG_ 1443 Susp_Sound_Hrn_Low 0;
BA_ "GenSigTimeoutTime_DTCM" SG_ 1443 Susp_Sound_Hrn_Low 0;
BA_ "GenSigTimeoutTime_ECM" SG_ 1443 Susp_Sound_Hrn_Low 0;
BA_ "GenSigTimeoutTime_EVCU2" SG_ 1443 Susp_Sound_Hrn_Low 0;
BA_ "GenSigTimeoutTime_GNMM" SG_ 1443 Susp_Sound_Hrn_Low 0;
BA_ "GenSigTimeoutTime_HCP" SG_ 1443 Susp_Sound_Hrn_Low 0;
BA_ "GenSigTimeoutTime_IPC" SG_ 1443 Susp_Sound_Hrn_Low 0;
BA_ "GenSigTimeoutTime_RFHM" SG_ 1443 Susp_Sound_Hrn_Low 0;
BA_ "GenSigTimeoutTime_TCM" SG_ 1443 Susp_Sound_Hrn_Low 0;
BA_ "GenSigSendType" SG_ 1443 Susp_Tire_Jack 3;
BA_ "GenSigTimeoutTime_AGSM" SG_ 1443 Susp_Tire_Jack 0;
BA_ "GenSigTimeoutTime_BSM" SG_ 1443 Susp_Tire_Jack 0;
BA_ "GenSigTimeoutTime_CADM" SG_ 1443 Susp_Tire_Jack 0;
BA_ "GenSigTimeoutTime_DMSM" SG_ 1443 Susp_Tire_Jack 0;
BA_ "GenSigTimeoutTime_DTCM" SG_ 1443 Susp_Tire_Jack 0;
BA_ "GenSigTimeoutTime_ECM" SG_ 1443 Susp_Tire_Jack 0;
BA_ "GenSigTimeoutTime_EVCU2" SG_ 1443 Susp_Tire_Jack 0;
BA_ "GenSigTimeoutTime_GNMM" SG_ 1443 Susp_Tire_Jack 0;
BA_ "GenSigTimeoutTime_HCP" SG_ 1443 Susp_Tire_Jack 0;
BA_ "GenSigTimeoutTime_IPC" SG_ 1443 Susp_Tire_Jack 0;
BA_ "GenSigTimeoutTime_RFHM" SG_ 1443 Susp_Tire_Jack 0;
BA_ "GenSigTimeoutTime_TCM" SG_ 1443 Susp_Tire_Jack 0;
BA_ "GenSigSendType" SG_ 1443 SVC_Delay 3;
BA_ "GenSigTimeoutTime_AGSM" SG_ 1443 SVC_Delay 0;
BA_ "GenSigTimeoutTime_BSM" SG_ 1443 SVC_Delay 0;
BA_ "GenSigTimeoutTime_CADM" SG_ 1443 SVC_Delay 0;
BA_ "GenSigTimeoutTime_DMSM" SG_ 1443 SVC_Delay 0;
BA_ "GenSigTimeoutTime_DTCM" SG_ 1443 SVC_Delay 0;
BA_ "GenSigTimeoutTime_ECM" SG_ 1443 SVC_Delay 0;
BA_ "GenSigTimeoutTime_EVCU2" SG_ 1443 SVC_Delay 0;
BA_ "GenSigTimeoutTime_GNMM" SG_ 1443 SVC_Delay 0;
BA_ "GenSigTimeoutTime_HCP" SG_ 1443 SVC_Delay 0;
BA_ "GenSigTimeoutTime_IPC" SG_ 1443 SVC_Delay 0;
BA_ "GenSigTimeoutTime_RFHM" SG_ 1443 SVC_Delay 0;
BA_ "GenSigTimeoutTime_TCM" SG_ 1443 SVC_Delay 0;
BA_ "GenSigSendType" SG_ 1443 SVC_Guidelines 3;
BA_ "GenSigTimeoutTime_AGSM" SG_ 1443 SVC_Guidelines 0;
BA_ "GenSigTimeoutTime_BSM" SG_ 1443 SVC_Guidelines 0;
BA_ "GenSigTimeoutTime_CADM" SG_ 1443 SVC_Guidelines 0;
BA_ "GenSigTimeoutTime_DMSM" SG_ 1443 SVC_Guidelines 0;
BA_ "GenSigTimeoutTime_DTCM" SG_ 1443 SVC_Guidelines 0;
BA_ "GenSigTimeoutTime_ECM" SG_ 1443 SVC_Guidelines 0;
BA_ "GenSigTimeoutTime_EVCU2" SG_ 1443 SVC_Guidelines 0;
BA_ "GenSigTimeoutTime_GNMM" SG_ 1443 SVC_Guidelines 0;
BA_ "GenSigTimeoutTime_HCP" SG_ 1443 SVC_Guidelines 0;
BA_ "GenSigTimeoutTime_IPC" SG_ 1443 SVC_Guidelines 0;
BA_ "GenSigTimeoutTime_RFHM" SG_ 1443 SVC_Guidelines 0;
BA_ "GenSigTimeoutTime_TCM" SG_ 1443 SVC_Guidelines 0;
BA_ "GenSigSendType" SG_ 1443 TelematicSetupACK 3;
BA_ "GenSigTimeoutTime_AGSM" SG_ 1443 TelematicSetupACK 0;
BA_ "GenSigTimeoutTime_BSM" SG_ 1443 TelematicSetupACK 0;
BA_ "GenSigTimeoutTime_CADM" SG_ 1443 TelematicSetupACK 0;
BA_ "GenSigTimeoutTime_DMSM" SG_ 1443 TelematicSetupACK 0;
BA_ "GenSigTimeoutTime_DTCM" SG_ 1443 TelematicSetupACK 0;
BA_ "GenSigTimeoutTime_ECM" SG_ 1443 TelematicSetupACK 0;
BA_ "GenSigTimeoutTime_EVCU2" SG_ 1443 TelematicSetupACK 0;
BA_ "GenSigTimeoutTime_GNMM" SG_ 1443 TelematicSetupACK 0;
BA_ "GenSigTimeoutTime_HCP" SG_ 1443 TelematicSetupACK 0;
BA_ "GenSigTimeoutTime_IPC" SG_ 1443 TelematicSetupACK 0;
BA_ "GenSigTimeoutTime_RFHM" SG_ 1443 TelematicSetupACK 0;
BA_ "GenSigTimeoutTime_TCM" SG_ 1443 TelematicSetupACK 0;
BA_ "GenSigSendType" SG_ 1443 Temp_Unit 3;
BA_ "GenSigTimeoutTime_AGSM" SG_ 1443 Temp_Unit 0;
BA_ "GenSigTimeoutTime_BSM" SG_ 1443 Temp_Unit 0;
BA_ "GenSigTimeoutTime_CADM" SG_ 1443 Temp_Unit 0;
BA_ "GenSigTimeoutTime_DMSM" SG_ 1443 Temp_Unit 0;
BA_ "GenSigTimeoutTime_DTCM" SG_ 1443 Temp_Unit 0;
BA_ "GenSigTimeoutTime_ECM" SG_ 1443 Temp_Unit 0;
BA_ "GenSigTimeoutTime_EVCU2" SG_ 1443 Temp_Unit 0;
BA_ "GenSigTimeoutTime_GNMM" SG_ 1443 Temp_Unit 0;
BA_ "GenSigTimeoutTime_HCP" SG_ 1443 Temp_Unit 0;
BA_ "GenSigTimeoutTime_IPC" SG_ 1443 Temp_Unit 0;
BA_ "GenSigTimeoutTime_RFHM" SG_ 1443 Temp_Unit 0;
BA_ "GenSigTimeoutTime_TCM" SG_ 1443 Temp_Unit 0;
BA_ "GenSigSendType" SG_ 1443 Tilt_Mirr_Rev 3;
BA_ "GenSigTimeoutTime_AGSM" SG_ 1443 Tilt_Mirr_Rev 0;
BA_ "GenSigTimeoutTime_BSM" SG_ 1443 Tilt_Mirr_Rev 0;
BA_ "GenSigTimeoutTime_CADM" SG_ 1443 Tilt_Mirr_Rev 0;
BA_ "GenSigTimeoutTime_DMSM" SG_ 1443 Tilt_Mirr_Rev 0;
BA_ "GenSigTimeoutTime_DTCM" SG_ 1443 Tilt_Mirr_Rev 0;
BA_ "GenSigTimeoutTime_ECM" SG_ 1443 Tilt_Mirr_Rev 0;
BA_ "GenSigTimeoutTime_EVCU2" SG_ 1443 Tilt_Mirr_Rev 0;
BA_ "GenSigTimeoutTime_GNMM" SG_ 1443 Tilt_Mirr_Rev 0;
BA_ "GenSigTimeoutTime_HCP" SG_ 1443 Tilt_Mirr_Rev 0;
BA_ "GenSigTimeoutTime_IPC" SG_ 1443 Tilt_Mirr_Rev 0;
BA_ "GenSigTimeoutTime_RFHM" SG_ 1443 Tilt_Mirr_Rev 0;
BA_ "GenSigTimeoutTime_TCM" SG_ 1443 Tilt_Mirr_Rev 0;
BA_ "GenSigSendType" SG_ 1443 Tire_Fill_Alert 3;
BA_ "GenSigTimeoutTime_AGSM" SG_ 1443 Tire_Fill_Alert 0;
BA_ "GenSigTimeoutTime_BSM" SG_ 1443 Tire_Fill_Alert 0;
BA_ "GenSigTimeoutTime_CADM" SG_ 1443 Tire_Fill_Alert 0;
BA_ "GenSigTimeoutTime_DMSM" SG_ 1443 Tire_Fill_Alert 0;
BA_ "GenSigTimeoutTime_DTCM" SG_ 1443 Tire_Fill_Alert 0;
BA_ "GenSigTimeoutTime_ECM" SG_ 1443 Tire_Fill_Alert 0;
BA_ "GenSigTimeoutTime_EVCU2" SG_ 1443 Tire_Fill_Alert 0;
BA_ "GenSigTimeoutTime_GNMM" SG_ 1443 Tire_Fill_Alert 0;
BA_ "GenSigTimeoutTime_HCP" SG_ 1443 Tire_Fill_Alert 0;
BA_ "GenSigTimeoutTime_IPC" SG_ 1443 Tire_Fill_Alert 0;
BA_ "GenSigTimeoutTime_TCM" SG_ 1443 Tire_Fill_Alert 0;
BA_ "GenSigSendType" SG_ 1443 Torque_Unit 3;
BA_ "GenSigTimeoutTime_AGSM" SG_ 1443 Torque_Unit 0;
BA_ "GenSigTimeoutTime_BSM" SG_ 1443 Torque_Unit 0;
BA_ "GenSigTimeoutTime_CADM" SG_ 1443 Torque_Unit 0;
BA_ "GenSigTimeoutTime_DMSM" SG_ 1443 Torque_Unit 0;
BA_ "GenSigTimeoutTime_DTCM" SG_ 1443 Torque_Unit 0;
BA_ "GenSigTimeoutTime_ECM" SG_ 1443 Torque_Unit 0;
BA_ "GenSigTimeoutTime_EVCU2" SG_ 1443 Torque_Unit 0;
BA_ "GenSigTimeoutTime_GNMM" SG_ 1443 Torque_Unit 0;
BA_ "GenSigTimeoutTime_HCP" SG_ 1443 Torque_Unit 0;
BA_ "GenSigTimeoutTime_IPC" SG_ 1443 Torque_Unit 0;
BA_ "GenSigTimeoutTime_RFHM" SG_ 1443 Torque_Unit 0;
BA_ "GenSigTimeoutTime_TCM" SG_ 1443 Torque_Unit 0;
BA_ "GenSigSendType" SG_ 1443 Traffic_Sign_Info 3;
BA_ "GenSigTimeoutTime_AGSM" SG_ 1443 Traffic_Sign_Info 0;
BA_ "GenSigTimeoutTime_BSM" SG_ 1443 Traffic_Sign_Info 0;
BA_ "GenSigTimeoutTime_DMSM" SG_ 1443 Traffic_Sign_Info 0;
BA_ "GenSigTimeoutTime_DTCM" SG_ 1443 Traffic_Sign_Info 0;
BA_ "GenSigTimeoutTime_ECM" SG_ 1443 Traffic_Sign_Info 0;
BA_ "GenSigTimeoutTime_EVCU2" SG_ 1443 Traffic_Sign_Info 0;
BA_ "GenSigTimeoutTime_GNMM" SG_ 1443 Traffic_Sign_Info 0;
BA_ "GenSigTimeoutTime_HCP" SG_ 1443 Traffic_Sign_Info 0;
BA_ "GenSigTimeoutTime_IPC" SG_ 1443 Traffic_Sign_Info 0;
BA_ "GenSigTimeoutTime_RFHM" SG_ 1443 Traffic_Sign_Info 0;
BA_ "GenSigTimeoutTime_TCM" SG_ 1443 Traffic_Sign_Info 0;
BA_ "GenSigSendType" SG_ 1443 Traffic_Sign_Warn 3;
BA_ "GenSigTimeoutTime_AGSM" SG_ 1443 Traffic_Sign_Warn 0;
BA_ "GenSigTimeoutTime_BSM" SG_ 1443 Traffic_Sign_Warn 0;
BA_ "GenSigTimeoutTime_CADM" SG_ 1443 Traffic_Sign_Warn 0;
BA_ "GenSigTimeoutTime_DMSM" SG_ 1443 Traffic_Sign_Warn 0;
BA_ "GenSigTimeoutTime_DTCM" SG_ 1443 Traffic_Sign_Warn 0;
BA_ "GenSigTimeoutTime_ECM" SG_ 1443 Traffic_Sign_Warn 0;
BA_ "GenSigTimeoutTime_EVCU2" SG_ 1443 Traffic_Sign_Warn 0;
BA_ "GenSigTimeoutTime_GNMM" SG_ 1443 Traffic_Sign_Warn 0;
BA_ "GenSigTimeoutTime_HCP" SG_ 1443 Traffic_Sign_Warn 0;
BA_ "GenSigTimeoutTime_IPC" SG_ 1443 Traffic_Sign_Warn 0;
BA_ "GenSigTimeoutTime_RFHM" SG_ 1443 Traffic_Sign_Warn 0;
BA_ "GenSigTimeoutTime_TCM" SG_ 1443 Traffic_Sign_Warn 0;
BA_ "GenSigSendType" SG_ 1443 Trail_Brk_Type 3;
BA_ "GenSigTimeoutTime_AGSM" SG_ 1443 Trail_Brk_Type 0;
BA_ "GenSigTimeoutTime_BSM" SG_ 1443 Trail_Brk_Type 0;
BA_ "GenSigTimeoutTime_CADM" SG_ 1443 Trail_Brk_Type 0;
BA_ "GenSigTimeoutTime_DMSM" SG_ 1443 Trail_Brk_Type 0;
BA_ "GenSigTimeoutTime_DTCM" SG_ 1443 Trail_Brk_Type 0;
BA_ "GenSigTimeoutTime_ECM" SG_ 1443 Trail_Brk_Type 0;
BA_ "GenSigTimeoutTime_EVCU2" SG_ 1443 Trail_Brk_Type 0;
BA_ "GenSigTimeoutTime_GNMM" SG_ 1443 Trail_Brk_Type 0;
BA_ "GenSigTimeoutTime_HCP" SG_ 1443 Trail_Brk_Type 0;
BA_ "GenSigTimeoutTime_IPC" SG_ 1443 Trail_Brk_Type 0;
BA_ "GenSigTimeoutTime_RFHM" SG_ 1443 Trail_Brk_Type 0;
BA_ "GenSigTimeoutTime_TCM" SG_ 1443 Trail_Brk_Type 0;
BA_ "GenSigSendType" SG_ 1443 Trail_Name 3;
BA_ "GenSigTimeoutTime_AGSM" SG_ 1443 Trail_Name 0;
BA_ "GenSigTimeoutTime_BSM" SG_ 1443 Trail_Name 0;
BA_ "GenSigTimeoutTime_CADM" SG_ 1443 Trail_Name 0;
BA_ "GenSigTimeoutTime_DMSM" SG_ 1443 Trail_Name 0;
BA_ "GenSigTimeoutTime_DTCM" SG_ 1443 Trail_Name 0;
BA_ "GenSigTimeoutTime_ECM" SG_ 1443 Trail_Name 0;
BA_ "GenSigTimeoutTime_EVCU2" SG_ 1443 Trail_Name 0;
BA_ "GenSigTimeoutTime_GNMM" SG_ 1443 Trail_Name 0;
BA_ "GenSigTimeoutTime_HCP" SG_ 1443 Trail_Name 0;
BA_ "GenSigTimeoutTime_IPC" SG_ 1443 Trail_Name 0;
BA_ "GenSigTimeoutTime_RFHM" SG_ 1443 Trail_Name 0;
BA_ "GenSigTimeoutTime_TCM" SG_ 1443 Trail_Name 0;
BA_ "GenSigSendType" SG_ 1443 Trail_Num 3;
BA_ "GenSigTimeoutTime_AGSM" SG_ 1443 Trail_Num 0;
BA_ "GenSigTimeoutTime_BSM" SG_ 1443 Trail_Num 0;
BA_ "GenSigTimeoutTime_CADM" SG_ 1443 Trail_Num 0;
BA_ "GenSigTimeoutTime_DMSM" SG_ 1443 Trail_Num 0;
BA_ "GenSigTimeoutTime_DTCM" SG_ 1443 Trail_Num 0;
BA_ "GenSigTimeoutTime_ECM" SG_ 1443 Trail_Num 0;
BA_ "GenSigTimeoutTime_EVCU2" SG_ 1443 Trail_Num 0;
BA_ "GenSigTimeoutTime_GNMM" SG_ 1443 Trail_Num 0;
BA_ "GenSigTimeoutTime_HCP" SG_ 1443 Trail_Num 0;
BA_ "GenSigTimeoutTime_IPC" SG_ 1443 Trail_Num 0;
BA_ "GenSigTimeoutTime_RFHM" SG_ 1443 Trail_Num 0;
BA_ "GenSigTimeoutTime_TCM" SG_ 1443 Trail_Num 0;
BA_ "GenSigSendType" SG_ 1443 Trailer_detection_blind_spot 3;
BA_ "GenSigTimeoutTime_AGSM" SG_ 1443 Trailer_detection_blind_spot 0;
BA_ "GenSigTimeoutTime_BSM" SG_ 1443 Trailer_detection_blind_spot 0;
BA_ "GenSigTimeoutTime_DMSM" SG_ 1443 Trailer_detection_blind_spot 0;
BA_ "GenSigTimeoutTime_DTCM" SG_ 1443 Trailer_detection_blind_spot 0;
BA_ "GenSigTimeoutTime_ECM" SG_ 1443 Trailer_detection_blind_spot 0;
BA_ "GenSigTimeoutTime_EVCU2" SG_ 1443 Trailer_detection_blind_spot 0;
BA_ "GenSigTimeoutTime_GNMM" SG_ 1443 Trailer_detection_blind_spot 0;
BA_ "GenSigTimeoutTime_HCP" SG_ 1443 Trailer_detection_blind_spot 0;
BA_ "GenSigTimeoutTime_IPC" SG_ 1443 Trailer_detection_blind_spot 0;
BA_ "GenSigTimeoutTime_RFHM" SG_ 1443 Trailer_detection_blind_spot 0;
BA_ "GenSigTimeoutTime_TCM" SG_ 1443 Trailer_detection_blind_spot 0;
BA_ "GenSigSendType" SG_ 1443 TyrePress_Unit 3;
BA_ "GenSigTimeoutTime_AGSM" SG_ 1443 TyrePress_Unit 0;
BA_ "GenSigTimeoutTime_BSM" SG_ 1443 TyrePress_Unit 0;
BA_ "GenSigTimeoutTime_CADM" SG_ 1443 TyrePress_Unit 0;
BA_ "GenSigTimeoutTime_DMSM" SG_ 1443 TyrePress_Unit 0;
BA_ "GenSigTimeoutTime_DTCM" SG_ 1443 TyrePress_Unit 0;
BA_ "GenSigTimeoutTime_ECM" SG_ 1443 TyrePress_Unit 0;
BA_ "GenSigTimeoutTime_EVCU2" SG_ 1443 TyrePress_Unit 0;
BA_ "GenSigTimeoutTime_GNMM" SG_ 1443 TyrePress_Unit 0;
BA_ "GenSigTimeoutTime_HCP" SG_ 1443 TyrePress_Unit 0;
BA_ "GenSigTimeoutTime_IPC" SG_ 1443 TyrePress_Unit 0;
BA_ "GenSigTimeoutTime_RFHM" SG_ 1443 TyrePress_Unit 0;
BA_ "GenSigTimeoutTime_TCM" SG_ 1443 TyrePress_Unit 0;
VAL_ 1432 AverageFuelConsumptionAPlus 1023 "SNA";
VAL_ 1432 AverageFuelConsumptionBPlus 1023 "SNA";
VAL_ 1432 HAS_SoH_IPC 0 "No Fault" 1 "Fault";
VAL_ 1432 PartialOdometerAPlus 1048575 "SNA";
VAL_ 1432 PartialOdometerBPlus 1048575 "SNA";
VAL_ 1432 PowerMode_RQ 0 "CUSTOMER" 1 "STORAGE" 2 "SHIP" 3 "ABBR" 7 "SNA";
VAL_ 1432 TrlrLgtChkReq 0 "Not_Request" 1 "Request" 2 "In_Progress" 3 "Cancel";
VAL_ 1897 VehPerfAccelPeak_X_Neg 511 "SNA";
VAL_ 1897 VehPerfAccelPeak_X_Pos 511 "SNA";
VAL_ 1897 VehPerfAccelPeak_Y_Neg 511 "SNA";
VAL_ 1897 VehPerfAccelPeak_Y_Pos 511 "SNA";
VAL_ 604 SRT_100mphTm_B 252 "TMR_ACTIVE" 253 "TMR_CANCEL" 254 "TMR_READY" 255 "SNA";
VAL_ 604 SRT_100mphTm_C 252 "TMR_ACTIVE" 253 "TMR_CANCEL" 254 "TMR_READY" 255 "SNA";
VAL_ 604 SRT_100mphTm_L 252 "TMR_ACTIVE" 253 "TMR_CANCEL" 254 "TMR_READY" 255 "SNA";
VAL_ 604 SRT_100mphTmB 252 "TMR_ACTIVE" 253 "TMR_CANCEL" 254 "TMR_READY" 255 "SNA";
VAL_ 604 SRT_100mphTmC 252 "TMR_ACTIVE" 253 "TMR_CANCEL" 254 "TMR_READY" 255 "SNA";
VAL_ 604 SRT_100mphTmL 252 "TMR_ACTIVE" 253 "TMR_CANCEL" 254 "TMR_READY" 255 "SNA";
VAL_ 604 SRT_60mphTm_B 252 "TMR_ACTIVE" 253 "TMR_CANCEL" 254 "TMR_READY" 255 "SNA";
VAL_ 604 SRT_60mphTm_C 252 "TMR_ACTIVE" 253 "TMR_CANCEL" 254 "TMR_READY" 255 "SNA";
VAL_ 604 SRT_60mphTm_L 252 "TMR_ACTIVE" 253 "TMR_CANCEL" 254 "TMR_READY" 255 "SNA";
VAL_ 604 SRT_60mphTmB 252 "TMR_ACTIVE" 253 "TMR_CANCEL" 254 "TMR_READY" 255 "SNA";
VAL_ 604 SRT_60mphTmC 252 "TMR_ACTIVE" 253 "TMR_CANCEL" 254 "TMR_READY" 255 "SNA";
VAL_ 604 SRT_60mphTmL 252 "TMR_ACTIVE" 253 "TMR_CANCEL" 254 "TMR_READY" 255 "SNA";
VAL_ 604 SRT_BrkTm_B 252 "TMR_ACTIVE" 253 "TMR_CANCEL" 254 "TMR_READY" 255 "SNA";
VAL_ 604 SRT_BrkTm_C 252 "TMR_ACTIVE" 253 "TMR_CANCEL" 254 "TMR_READY" 255 "SNA";
VAL_ 604 SRT_BrkTm_L 252 "TMR_ACTIVE" 253 "TMR_CANCEL" 254 "TMR_READY" 255 "SNA";
VAL_ 604 SRT_BrkTmB 252 "TMR_ACTIVE" 253 "TMR_CANCEL" 254 "TMR_READY" 255 "SNA";
VAL_ 604 SRT_BrkTmC 252 "TMR_ACTIVE" 253 "TMR_CANCEL" 254 "TMR_READY" 255 "SNA";
VAL_ 604 SRT_BrkTmL 252 "TMR_ACTIVE" 253 "TMR_CANCEL" 254 "TMR_READY" 255 "SNA";
VAL_ 604 SRT_eighthTm_B 252 "TMR_ACTIVE" 253 "TMR_CANCEL" 254 "TMR_READY" 255 "SNA";
VAL_ 604 SRT_eighthTm_C 252 "TMR_ACTIVE" 253 "TMR_CANCEL" 254 "TMR_READY" 255 "SNA";
VAL_ 604 SRT_eighthTm_L 252 "TMR_ACTIVE" 253 "TMR_CANCEL" 254 "TMR_READY" 255 "SNA";
VAL_ 604 SRT_eighthTmB 252 "TMR_ACTIVE" 253 "TMR_CANCEL" 254 "TMR_READY" 255 "SNA";
VAL_ 604 SRT_eighthTmC 252 "TMR_ACTIVE" 253 "TMR_CANCEL" 254 "TMR_READY" 255 "SNA";
VAL_ 604 SRT_eighthTmL 252 "TMR_ACTIVE" 253 "TMR_CANCEL" 254 "TMR_READY" 255 "SNA";
VAL_ 604 SRT_EthSpdB_M 255 "SNA";
VAL_ 604 SRT_EthSpdB_US 255 "SNA";
VAL_ 604 SRT_EthSpdC_M 255 "SNA";
VAL_ 604 SRT_EthSpdC_US 255 "SNA";
VAL_ 604 SRT_EthSpdL_M 255 "SNA";
VAL_ 604 SRT_EthSpdL_US 255 "SNA";
VAL_ 604 SRT_QrtSpdB_M 255 "SNA";
VAL_ 604 SRT_QrtSpdB_US 255 "SNA";
VAL_ 604 SRT_QrtSpdC_M 255 "SNA";
VAL_ 604 SRT_QrtSpdC_US 255 "SNA";
VAL_ 604 SRT_QrtSpdL_M 255 "SNA";
VAL_ 604 SRT_QrtSpdL_US 255 "SNA";
VAL_ 604 SRT_quarterTm_B 252 "TMR_ACTIVE" 253 "TMR_CANCEL" 254 "TMR_READY" 255 "SNA";
VAL_ 604 SRT_quarterTm_C 252 "TMR_ACTIVE" 253 "TMR_CANCEL" 254 "TMR_READY" 255 "SNA";
VAL_ 604 SRT_quarterTm_L 252 "TMR_ACTIVE" 253 "TMR_CANCEL" 254 "TMR_READY" 255 "SNA";
VAL_ 604 SRT_quarterTmB 252 "TMR_ACTIVE" 253 "TMR_CANCEL" 254 "TMR_READY" 255 "SNA";
VAL_ 604 SRT_quarterTmC 252 "TMR_ACTIVE" 253 "TMR_CANCEL" 254 "TMR_READY" 255 "SNA";
VAL_ 604 SRT_quarterTmL 252 "TMR_ACTIVE" 253 "TMR_CANCEL" 254 "TMR_READY" 255 "SNA";
VAL_ 604 SRT_ReactTm_B 252 "TMR_READY" 253 "OOR" 254 "TMR_NU" 255 "SNA";
VAL_ 604 SRT_ReactTm_C 252 "TMR_READY" 253 "OOR" 254 "TMR_NU" 255 "SNA";
VAL_ 604 SRT_ReactTm_L 252 "TMR_READY" 253 "OOR" 254 "TMR_NU" 255 "SNA";
VAL_ 604 SRT_ReactTmB 252 "TMR_READY" 253 "OOR" 254 "TMR_NU" 255 "SNA";
VAL_ 604 SRT_ReactTmC 252 "TMR_READY" 253 "OOR" 254 "TMR_NU" 255 "SNA";
VAL_ 604 SRT_ReactTmL 252 "TMR_READY" 253 "OOR" 254 "TMR_NU" 255 "SNA";
VAL_ 605 SRT_1000ftTm_B 252 "TMR_ACTIVE" 253 "TMR_CANCEL" 254 "TMR_READY" 255 "SNA";
VAL_ 605 SRT_1000ftTm_C 252 "TMR_ACTIVE" 253 "TMR_CANCEL" 254 "TMR_READY" 255 "SNA";
VAL_ 605 SRT_1000ftTm_L 252 "TMR_ACTIVE" 253 "TMR_CANCEL" 254 "TMR_READY" 255 "SNA";
VAL_ 605 SRT_1000ftTmB 252 "TMR_ACTIVE" 253 "TMR_CANCEL" 254 "TMR_READY" 255 "SNA";
VAL_ 605 SRT_1000ftTmC 252 "TMR_ACTIVE" 253 "TMR_CANCEL" 254 "TMR_READY" 255 "SNA";
VAL_ 605 SRT_1000ftTmL 252 "TMR_ACTIVE" 253 "TMR_CANCEL" 254 "TMR_READY" 255 "SNA";
VAL_ 605 SRT_330ftTm_B 252 "TMR_ACTIVE" 253 "TMR_CANCEL" 254 "TMR_READY" 255 "SNA";
VAL_ 605 SRT_330ftTm_C 252 "TMR_ACTIVE" 253 "TMR_CANCEL" 254 "TMR_READY" 255 "SNA";
VAL_ 605 SRT_330ftTm_L 252 "TMR_ACTIVE" 253 "TMR_CANCEL" 254 "TMR_READY" 255 "SNA";
VAL_ 605 SRT_330ftTmB 252 "TMR_ACTIVE" 253 "TMR_CANCEL" 254 "TMR_READY" 255 "SNA";
VAL_ 605 SRT_330ftTmC 252 "TMR_ACTIVE" 253 "TMR_CANCEL" 254 "TMR_READY" 255 "SNA";
VAL_ 605 SRT_330ftTmL 252 "TMR_ACTIVE" 253 "TMR_CANCEL" 254 "TMR_READY" 255 "SNA";
VAL_ 605 SRT_60ftTm_B 511 "SNA";
VAL_ 605 SRT_60ftTm_C 511 "SNA";
VAL_ 605 SRT_60ftTm_L 511 "SNA";
VAL_ 605 SRT_60ftTmB 511 "SNA";
VAL_ 605 SRT_60ftTmC 511 "SNA";
VAL_ 605 SRT_60ftTmL 511 "SNA";
VAL_ 605 SRT_BrkDistB_M 252 "TMR_ACTIVE" 253 "T_CANCEL" 254 "T_READY" 255 "SNA";
VAL_ 605 SRT_BrkDistB_US 252 "TMR_ACTIVE" 253 "T_CANCEL" 254 "T_READY" 255 "SNA";
VAL_ 605 SRT_BrkDistC_M 252 "TMR_ACTIVE" 253 "T_CANCEL" 254 "T_READY" 255 "SNA";
VAL_ 605 SRT_BrkDistC_US 252 "TMR_ACTIVE" 253 "T_CANCEL" 254 "T_READY" 255 "SNA";
VAL_ 605 SRT_BrkDistL_M 252 "TMR_ACTIVE" 253 "T_CANCEL" 254 "T_READY" 255 "SNA";
VAL_ 605 SRT_BrkDistL_US 252 "TMR_ACTIVE" 253 "T_CANCEL" 254 "T_READY" 255 "SNA";
VAL_ 605 SRT_BrkSpdB_M 255 "SNA";
VAL_ 605 SRT_BrkSpdB_US 255 "SNA";
VAL_ 605 SRT_BrkSpdC_M 255 "SNA";
VAL_ 605 SRT_BrkSpdC_US 255 "SNA";
VAL_ 605 SRT_BrkSpdL_M 255 "SNA";
VAL_ 605 SRT_BrkSpdL_US 255 "SNA";
VAL_ 1443 Act_Lane_Mgt 0 "Vib_Only" 1 "Steer_Asst_Only" 2 "Vib_Steer_Asst";
VAL_ 1443 Act_Lane_Mgt_Strength 0 "Low" 1 "Medium" 2 "High";
VAL_ 1443 Active_Park_Mode 0 "Full_Auto" 1 "Steering_Only";
VAL_ 1443 Active_Park_Prox_Chime 0 "Off" 1 "On";
VAL_ 1443 AmbientLightingLevel 0 "Level_1" 1 "Level_2" 2 "Level_3" 3 "Level_4" 4 "Level_5" 5 "Level_6" 6 "Level_7" 7 "Level_8" 8 "Level_9" 9 "Level_10" 10 "Level_11" 11 "Level_12" 12 "Level_13" 13 "Level_14" 14 "Level_15" 15 "Level_16";
VAL_ 1443 Auto_Fold_Mirr 0 "Off" 1 "On";
VAL_ 1443 AutoHighBeamEnable 0 "Not_Enable" 1 "Enable";
VAL_ 1443 AutoParkBrake 0 "On" 1 "Off";
VAL_ 1443 AutoUnlockDoorExit 0 "Not_Enable" 1 "Enable";
VAL_ 1443 Backup_Cam_Delay 0 "Off" 1 "On";
VAL_ 1443 BSDEnable 0 "Not_Enable" 1 "Enable_LED" 2 "Enable_ LED_Chime";
VAL_ 1443 Consum_Unit 0 "Km_Per_Litre" 1 "Litres_Per_100Km" 2 "Miles_Per_Gallon_UK" 3 "Miles_Per_Gallon_US" 4 "km/kWh" 5 "kWh/100km" 6 "mi/kWh" 7 "kWh/mi";
VAL_ 1443 CorneringEnable 0 "True" 1 "False";
VAL_ 1443 Dist_Unit 0 "km" 1 "miles";
VAL_ 1443 DRLEnable 0 "True" 1 "False";
VAL_ 1443 Drowsy_Driver_Alert 0 "Off" 1 "On";
VAL_ 1443 DynamicGrid 0 "Dynamic Gridlines OFF" 1 "Dynamic Gridlines ON";
VAL_ 1443 Easy_Exit_D 0 "Off" 1 "On";
VAL_ 1443 Eng_Off_Pwr_Delay 0 "Zero" 1 "Fourty_Five_Sec" 2 "Five_Min" 3 "Ten_Min";
VAL_ 1443 EPB_MaintenanceMode 0 "Off" 1 "On";
VAL_ 1443 FlashLightWLock 0 "Off" 1 "On";
VAL_ 1443 FOA_AppAlert_Disable_UserReq 0 "Not_Active" 1 "Active";
VAL_ 1443 FSFCWPlusActivationMode 0 "Near" 1 "Med" 2 "Far";
VAL_ 1443 FSFCWPlusSetting 0 "Off" 1 "Audio" 2 "Brake" 3 "Audio_Brake" 4 "Not_Request";
VAL_ 1443 Fwrd_Cam_Guidelines 0 "Off" 1 "On";
VAL_ 1443 GreetingLightsEnable 0 "True" 1 "False";
VAL_ 1443 HeadlightsOffDelay 0 "0sec" 1 "30sec" 2 "60sec" 3 "90ec";
VAL_ 1443 HeadLightWipers 0 "Off" 1 "On";
VAL_ 1443 Hill_Start_Assist 0 "Off" 1 "On";
VAL_ 1443 HourMode 0 "0_24_h" 1 "0_12_h";
VAL_ 1443 HP_Unit 0 "HP" 1 "kW" 2 "PS";
VAL_ 1443 Illuminated_Approach 0 "Zero" 1 "Thirty" 2 "Sixty" 3 "Ninety";
VAL_ 1443 IPCProgrammed 0 "Not_Programmed" 1 "Programmed";
VAL_ 1443 LanguageSelection 0 "Italian" 1 "Deutsch" 2 "English" 3 "Espanol" 4 "Francais" 5 "Portugues" 6 "Polish" 7 "Dutch" 8 "Brazilian" 9 "Turkish" 10 "Mexican" 11 "English_US" 12 "Canadian" 13 "Russian" 14 "Chinese" 15 "Japanese" 16 "Korean" 17 "Arabic" 18 "Czech" 19 "Slovakian" 20 "Hungarian" 21 "Hindi";
VAL_ 1443 LDW_Intensity 0 "Low" 1 "Med" 2 "High";
VAL_ 1443 LDW_Sensibility 0 "Early" 1 "Med" 2 "Late";
VAL_ 1443 NavRepetition 0 "Absent" 1 "Present";
VAL_ 1443 New_Spd_Zone_Ind 0 "Off" 1 "Visual" 2 "Chime" 3 "Visual_Chime";
VAL_ 1443 Paddle_Shifter 0 "Off" 1 "On";
VAL_ 1443 PamChimeVolumeFront 0 "Low" 1 "Medium" 2 "High";
VAL_ 1443 PamChimeVolumeRear 0 "Low" 1 "Medium" 2 "High";
VAL_ 1443 PassiveEntry 0 "On" 1 "Off";
VAL_ 1443 Ped_EM_Brk_Warn_Act 0 "Off" 1 "On";
VAL_ 1443 PhoneRepetition 0 "Absent" 1 "Present";
VAL_ 1443 PLGAlert 0 "Off" 1 "On";
VAL_ 1443 Power_Side_Step 0 "Auto" 1 "Store";
VAL_ 1443 Proximity_WU 0 "Off" 1 "On";
VAL_ 1443 PwrLev 0 "Level1" 1 "Level2" 2 "Level3" 3 "Level4" 4 "Level5";
VAL_ 1443 RainSensorLevel 0 "Not_Enable" 1 "Enable";
VAL_ 1443 Rdy_To_Drive 0 "Off" 1 "On";
VAL_ 1443 Rear_Brk_Asst 0 "Warn" 1 "Warn_Braking";
VAL_ 1443 RemoteDoorUnlock 0 "Driver" 1 "All";
VAL_ 1443 RemStNrmlStEnbl 0 "Off" 1 "Remote_Start_Only" 2 "Remote_And_Normal_Start" 3 "Normal_Start_Only";
VAL_ 1443 RKEMemoryLinkEnable 0 "Off" 1 "On";
VAL_ 1443 SOC_Max_Lev 0 "Level1" 1 "Level2";
VAL_ 1443 SoundHornLock 0 "Off" 1 "1st Press" 2 "2nd Press";
VAL_ 1443 SoundHornRemoteStart 0 "On" 1 "Off";
VAL_ 1443 Speed_Unit 0 "mph" 1 "kph";
VAL_ 1443 SpeedLockDoorEnable 0 "Not_Enable" 1 "Enable";
VAL_ 1443 StaticGrid 0 "Static Gridlines OFF" 1 "Static Gridlines ON";
VAL_ 1443 Susp_Auto_Ent_Ext 0 "Off" 1 "On";
VAL_ 1443 Susp_Disp_Message 0 "All" 1 "Warnings_Only";
VAL_ 1443 Susp_Flsh_Lght_Low 0 "Off" 1 "On";
VAL_ 1443 Susp_Sound_Hrn_Low 0 "Off" 1 "On";
VAL_ 1443 Susp_Tire_Jack 0 "Off" 1 "On";
VAL_ 1443 SVC_Delay 0 "Off" 1 "On";
VAL_ 1443 SVC_Guidelines 0 "Off" 1 "On";
VAL_ 1443 TelematicSetupACK 0 "No_ACK_Required" 1 "ACK_KO" 3 "ACK_OK";
VAL_ 1443 Temp_Unit 0 "°C" 1 "°F";
VAL_ 1443 Tilt_Mirr_Rev 0 "Off" 1 "On";
VAL_ 1443 Tire_Fill_Alert 0 "Off" 1 "On";
VAL_ 1443 Torque_Unit 0 "Nm" 1 "lb_ft";
VAL_ 1443 Traffic_Sign_Info 0 "Off" 1 "On";
VAL_ 1443 Traffic_Sign_Warn 0 "Off" 1 "Visual" 2 "Visual_Chime";
VAL_ 1443 Trail_Brk_Type 0 "Light_Electric" 1 "Heavy_Electric" 2 "Light_Electric_Over_Hydraulic" 3 "Heavy_Electric_Over_Hydraulic";
VAL_ 1443 Trail_Name 0 "Trailer" 1 "Boat" 2 "Car" 3 "Cargo" 4 "Dump" 5 "Equipment" 6 "Flatbed" 7 "Gooseneck" 8 "Horse" 9 "Livestock" 10 "Motorcycle" 11 "Snow_Mobile" 12 "Travel" 13 "Utility" 14 "Fifth_Wheel";
VAL_ 1443 Trail_Num 0 "One" 1 "Two" 2 "Three" 3 "Four";
VAL_ 1443 Trailer_detection_blind_spot 0 "Auto" 1 "Max";
VAL_ 1443 TyrePress_Unit 0 "KPa" 1 "psi" 2 "bar";
