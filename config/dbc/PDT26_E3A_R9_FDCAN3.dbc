VERSION ""

NS_ :

BS_:

BU_: AGSM BCM BSM CADM DMSM DTCM ECM EVCU2 GNMM HCP IPC RFHM SGW TCM
BO_ 1478 TPM_FD_1: 32 BCM
 SG_ Number_of_Trl_Axles_TTPM : 159|3@0+ (1,0) [0|7] "" IPC
 SG_ Number_of_Trl_Tires_TTPM : 133|3@0+ (1,0) [0|7] "" IPC
 SG_ TPMTrailer_Number : 130|3@0+ (1,0) [0|7] "" IPC
 SG_ Trailer_Configured : 127|1@0+ (1,0) [0|1] "" IPC
 SG_ Trailer_Not_Configured : 143|1@0+ (1,0) [0|1] "" IPC
 SG_ Trailer_Sensor_Mismatch : 142|3@0+ (1,0) [0|7] "" IPC
 SG_ TrailerTirePress1 : 31|8@0+ (1,0) [0|254] "psi" IPC
 SG_ TrailerTirePress10 : 103|8@0+ (1,0) [0|254] "psi" IPC
 SG_ TrailerTirePress11 : 111|8@0+ (1,0) [0|254] "psi" IPC
 SG_ TrailerTirePress12 : 119|8@0+ (1,0) [0|254] "psi" IPC
 SG_ TrailerTirePress2 : 39|8@0+ (1,0) [0|254] "psi" IPC
 SG_ TrailerTirePress3 : 47|8@0+ (1,0) [0|254] "psi" IPC
 SG_ TrailerTirePress4 : 55|8@0+ (1,0) [0|254] "psi" IPC
 SG_ TrailerTirePress5 : 63|8@0+ (1,0) [0|254] "psi" IPC
 SG_ TrailerTirePress6 : 71|8@0+ (1,0) [0|254] "psi" IPC
 SG_ TrailerTirePress7 : 79|8@0+ (1,0) [0|254] "psi" IPC
 SG_ TrailerTirePress8 : 87|8@0+ (1,0) [0|254] "psi" IPC
 SG_ TrailerTirePress9 : 95|8@0+ (1,0) [0|254] "psi" IPC
 SG_ TrlTire1_Stat : 7|2@0+ (1,0) [0|0] "" IPC
 SG_ TrlTire10_Stat : 21|2@0+ (1,0) [0|0] "" IPC
 SG_ TrlTire11_Stat : 19|2@0+ (1,0) [0|0] "" IPC
 SG_ TrlTire12_Stat : 17|2@0+ (1,0) [0|0] "" IPC
 SG_ TrlTire2_Stat : 5|2@0+ (1,0) [0|0] "" IPC
 SG_ TrlTire3_Stat : 3|2@0+ (1,0) [0|0] "" IPC
 SG_ TrlTire4_Stat : 1|2@0+ (1,0) [0|0] "" IPC
 SG_ TrlTire5_Stat : 15|2@0+ (1,0) [0|0] "" IPC
 SG_ TrlTire6_Stat : 13|2@0+ (1,0) [0|0] "" IPC
 SG_ TrlTire7_Stat : 11|2@0+ (1,0) [0|0] "" IPC
 SG_ TrlTire8_Stat : 9|2@0+ (1,0) [0|0] "" IPC
 SG_ TrlTire9_Stat : 23|2@0+ (1,0) [0|0] "" IPC
 SG_ TrlTPM_ServiceReq : 126|1@0+ (1,0) [0|1] "" IPC
 SG_ TrlTPMSetPress_TTPM : 139|12@0+ (0.1,0) [0|409.4] "psi" IPC

BO_ 278 TRANSM_FD_1: 64 TCM
 SG_ CODE_CLR_TCM : 258|1@0+ (1,0) [0|0] "-" ECM
 SG_ CrankEnable_Fast : 211|1@0+ (1,0) [0|1] "-" ECM,RFHM
 SG_ CRC_TRANSM1 : 447|8@0+ (1,0) [0|255] "-" BCM,BSM,CADM,DTCM,ECM,HCP,SGW
 SG_ DriveLineRatio : 405|14@0+ (0.01,0) [0|163.83] "-" ECM
 SG_ EngTrq_Rq_TCM : 178|11@0+ (1,-500) [-500|1546] "Nm" BSM,ECM,HCP
 SG_ MaxTrqDes : 162|11@0+ (1,-500) [-500|1546] "Nm" ECM,HCP
 SG_ MessageCounter_TRANSM1 : 435|4@0+ (1,0) [0|15] "-" BCM,BSM,CADM,DTCM,ECM,HCP,SGW
 SG_ PaddleShiftRequest : 399|3@0+ (1,0) [0|6] "-" ECM
 SG_ REPRGD_PFC_CLR_TCM : 275|1@0+ (1,0) [0|0] "-" ECM
 SG_ Secure_Idle_Sts : 361|2@0+ (1,0) [0|3] "-" SGW
 SG_ TargetGear : 151|4@0+ (1,0) [0|15] "-" BCM,BSM,CADM,DTCM,ECM,HCP,IPC,SGW
 SG_ TCASERANGESTATUS_TCM : 407|2@0+ (1,0) [0|2] "-" ECM
 SG_ TCM_ActMode : 263|4@0+ (1,0) [0|0] "-" Vector__XXX
 SG_ TCMLnchCtrlAllowed : 393|2@0+ (1,0) [0|3] "-" Vector__XXX
 SG_ TorqueAmpTransmission : 330|11@0+ (0.01,0) [0|20.46] "-" BCM,BSM,CADM,DTCM,ECM,HCP,SGW
 SG_ TorqueConverterDisengageSpeed : 431|8@0+ (10,0) [0|2550] "rpm" HCP
 SG_ TorqueConverterSTO : 195|1@0+ (1,0) [0|1] "-" ECM,HCP,SGW
 SG_ TorqueConverterSts : 55|2@0+ (1,0) [0|3] "-" ECM,HCP,SGW
 SG_ TRANS_ADAS_Inhibit : 311|1@0+ (1,0) [0|1] "-" BCM,BSM
 SG_ TransLosses : 241|10@0+ (1,-500) [-500|522] "Nm" ECM
 SG_ TransmissionSailingSts : 119|4@0+ (1,0) [0|15] "-" BCM,CADM,ECM
 SG_ TrqCtrlModeReq : 23|2@0+ (1,0) [0|2] "-" BSM,ECM,HCP
 SG_ TrqCtrlModeReq_Slow : 39|2@0+ (1,0) [0|2] "-" HCP
 SG_ TxIdleRq : 351|8@0+ (8,0) [0|2032] "rpm" ECM
 SG_ Vehicle_Hold_Rq : 306|1@0+ (1,0) [0|1] "-" BSM

BO_ 520 TRANSM_FD_2: 32 TCM
 SG_ AirFlowRequest_TCM : 22|7@0+ (1,0) [0|100] "%" ECM
 SG_ APCM_Rq : 135|2@0+ (1,0) [0|2] "-" AGSM,ECM,SGW
 SG_ CRC_TRANSM2 : 191|8@0+ (1,0) [0|255] "-" AGSM,BCM,BSM,CADM,DTCM,ECM,GNMM,HCP,IPC,SGW
 SG_ EngShutOffRq_TCM : 123|1@0+ (1,0) [0|1] "-" ECM
 SG_ GearEngagedForDisplay : 15|5@0+ (1,0) [0|30] "-" AGSM,BCM,BSM,CADM,DTCM,ECM,GNMM,HCP,IPC,RFHM,SGW
 SG_ MessageCounter_TRANSM2 : 179|4@0+ (1,0) [0|15] "-" AGSM,BCM,BSM,CADM,DTCM,ECM,GNMM,HCP,IPC,SGW
 SG_ OUTPUT_SPEED : 87|16@0+ (1,0) [0|65534] "RPM" BSM,DTCM,ECM,HCP,SGW
 SG_ OutputSpdPolarity : 1|2@0+ (1,0) [0|2] "-" BSM,DTCM,ECM,HCP,SGW
 SG_ PaddlesModeSts : 122|2@0+ (1,0) [0|0] "-" HCP,SGW
 SG_ Trans_ESS_Inhibit : 2|1@0+ (1,0) [0|1] "-" ECM
 SG_ TransmissionTemperature : 103|6@0+ (3,-40) [-40|149] "°C" DTCM,ECM,IPC,SGW
 SG_ TransReadyForESS : 124|1@0+ (1,0) [0|1] "-" BCM,ECM
 SG_ Trns_EMCC_Achvd : 96|1@0+ (1,0) [0|1] "-" ECM,SGW
 SG_ TRNS_StpSt_FLT : 125|1@0+ (1,0) [0|1] "-" ECM
 SG_ TurbineSpeed : 111|16@0+ (1,0) [0|65534] "RPM" ECM,HCP,SGW

BO_ 1450 TRANSM_FD_4: 32 TCM
 SG_ CrankEnable : 113|1@0+ (1,0) [0|1] "-" SGW
 SG_ CRC_TRANSM4 : 191|8@0+ (1,0) [0|255] "-" AGSM,BCM,BSM,CADM,DTCM,ECM,HCP,IPC,SGW
 SG_ DriveModeSts : 83|4@0+ (1,0) [0|15] "-" BCM,BSM,ECM,HCP,IPC,SGW,TCM
 SG_ GearDisplayForCluster : 75|4@0+ (1,0) [0|14] "" BCM,CADM,IPC
 SG_ GearEngaged : 107|4@0+ (1,0) [0|15] "-" BCM,BSM,CADM,DTCM,ECM,HCP,IPC,RFHM,SGW
 SG_ GearIndicationSts : 95|1@0+ (1,0) [0|1] "-" AGSM,IPC
 SG_ HAS_SoH_TCM : 117|1@0+ (1,0) [0|1] "-" BCM,CADM
 SG_ LimpHomeSts : 112|1@0+ (1,0) [0|1] "-" BCM,CADM,ECM
 SG_ MessageCounter_TRANSM4 : 179|4@0+ (1,0) [0|15] "-" AGSM,BCM,BSM,CADM,DTCM,ECM,HCP,IPC,SGW
 SG_ MIReq : 127|1@0+ (1,0) [0|1] "-" ECM,SGW
 SG_ OilTemperatureSts : 86|1@0+ (1,0) [0|1] "-" IPC,SGW
 SG_ R_SHFT_LOCK : 116|1@0+ (1,0) [0|1] "-" AGSM
 SG_ Secure_Idle_HMI : 7|2@0+ (1,0) [0|3] "-" IPC
 SG_ ShiftInProgress : 114|1@0+ (1,0) [0|1] "-" BCM,BSM,ECM,HCP,SGW
 SG_ ShiftLeverLockReq : 101|1@0+ (1,0) [0|1] "-" AGSM
 SG_ ShiftLeverPosition : 111|4@0+ (1,0) [0|15] "-" AGSM,BCM,BSM,CADM,ECM,IPC,SGW
 SG_ ShiftMapNotAchieved : 121|1@0+ (1,0) [0|1] "-" ECM
 SG_ ShiftModeSts : 94|1@0+ (1,0) [0|1] "-" CADM,DTCM,HCP,IPC,SGW
 SG_ TransmissionFailSts : 87|1@0+ (1,0) [0|1] "-" AGSM,BCM,SGW
 SG_ TransmissionWarnings : 93|6@0+ (1,0) [0|63] "-" BCM,IPC,SGW
 SG_ TxDisengaged : 126|1@0+ (1,0) [0|1] "-" ECM
 SG_ TxDisengaged_Fault : 118|1@0+ (1,0) [0|1] "-" ECM

BO_ 1059 TRM_CODE_RESPONSE: 32 RFHM
 SG_ CodeCheckSts_TRM : 109|2@0+ (1,0) [0|3] "-" BCM
 SG_ ControlEncoding_TRM_Rsp : 87|8@0+ (1,0) [0|255] "-" BCM
 SG_ MiniCryptGCode_TRM_Rsp : 95|16@0+ (1,0) [0|65535] "-" BCM
 SG_ ProgrammedSts_TRM : 110|1@0+ (1,0) [0|1] "-" BCM
 SG_ TxpFound : 111|1@0+ (1,0) [0|1] "-" BCM
 SG_ TxpID3 : 15|7@0+ (1,0) [0|127] "-" BCM

BO_ 254 TRM_MKP_KEY: 32 RFHM
 SG_ DATA1 : 95|8@0+ (1,0) [0|255] "-" BCM
 SG_ DATA2 : 103|8@0+ (1,0) [0|255] "-" BCM
 SG_ DATA3 : 111|8@0+ (1,0) [0|255] "-" BCM
 SG_ DATA4 : 119|8@0+ (1,0) [0|255] "-" BCM
 SG_ DATA5 : 127|8@0+ (1,0) [0|255] "-" BCM
 SG_ DATA6 : 135|8@0+ (1,0) [0|255] "-" BCM
 SG_ DATA7 : 143|8@0+ (1,0) [0|255] "-" BCM
 SG_ FrameNumber : 87|4@0+ (1,0) [0|15] "-" BCM
 SG_ TotalFrameNumber : 83|4@0+ (1,0) [0|15] "-" BCM

BO_ 1472 TRSCM_FD_1: 32 BCM
 SG_ CRC_TRSCM1 : 191|8@0+ (1,0) [0|255] "-" BSM,ECM
 SG_ MessageCounter_TRSCM1 : 179|4@0+ (1,0) [0|15] "-" BSM,ECM
 SG_ THA_EPB_Req : 95|2@0+ (1,0) [0|3] "" BSM
 SG_ THA_Speed_Limit : 85|5@0+ (1,0) [0|31] "" BSM,ECM,EVCU2
 SG_ THA_SpeedLimit_Req : 52|2@0+ (1,0) [0|3] "" BSM,ECM,EVCU2
 SG_ THA_STAT : 55|3@0+ (1,0) [0|6] "" BSM,ECM,EVCU2
 SG_ TRSC_PopupDisp_Info2 : 103|6@0+ (1,0) [0|63] "" IPC
 SG_ TRSC_STAT : 7|3@0+ (1,0) [0|6] "" BSM,SGW

BO_ 951 U_CONN_REQ_TBM: 32 SGW
 SG_ UConnReq_TBM : 7|5@0+ (1,0) [0|31] "-" RFHM
 SG_ UConnReqAuthCode_TBM : 15|16@0+ (1,0) [0|65535] "-" RFHM
 SG_ UConnReqFOBNum_TBM : 31|4@0+ (1,0) [0|15] "-" RFHM

BO_ 1489 V2X_EVCU: 64 EVCU2
 SG_ V2H_Instant_Power_Draw : 47|12@0+ (0.1,0) [0|409.5] "kW" SGW
 SG_ V2H_mode_Sts : 7|1@0+ (1,0) [0|1] "" SGW
 SG_ V2H_Reserve_Battery_Sts : 100|5@0+ (5,0) [0|155] "%" SGW
 SG_ V2H_Status : 5|3@0+ (1,0) [0|7] "" EVCU2,SGW
 SG_ V2H_Total_Power_Time_days : 12|5@0+ (1,0) [0|31] "Days" SGW
 SG_ V2H_Total_Power_Time_hours : 20|5@0+ (1,0) [0|31] "Hours" SGW
 SG_ V2H_Total_Power_Time_minutes : 31|6@0+ (1,0) [0|63] "Minutes" SGW
 SG_ V2L_Frunk_Status : 15|3@0+ (1,0) [0|7] "" SGW
 SG_ V2L_Instant_Power_Draw_Frunk : 63|7@0+ (0.1,0) [0|12.70] "kW" SGW
 SG_ V2L_Instant_Power_Draw_Trunk : 70|7@0+ (0.1,0) [0|12.70] "kW" SGW
 SG_ V2L_mode_Sts : 56|1@0+ (1,0) [0|1] "" SGW
 SG_ V2L_Total_Power_Time_days : 84|5@0+ (1,0) [0|31] "Days" SGW
 SG_ V2L_Total_Power_Time_hours : 95|5@0+ (1,0) [0|31] "Hours" SGW
 SG_ V2L_Total_Power_Time_minutes : 117|6@0+ (1,0) [0|63] "Minutes" SGW
 SG_ V2L_Trunk_Status : 23|3@0+ (1,0) [0|7] "" SGW
 SG_ V2V_Instant_Power_Draw : 39|8@0+ (0.1,0) [0|25.5] "kW" SGW
 SG_ V2V_mode_Sts : 6|1@0+ (1,0) [0|1] "" SGW
 SG_ V2V_Status : 2|3@0+ (1,0) [0|7] "" SGW
 SG_ V2V_Total_Power_Time_days : 25|2@0+ (1,0) [0|3] "Days" SGW
 SG_ V2V_Total_Power_Time_hours : 79|5@0+ (1,0) [0|31] "Hours" SGW
 SG_ V2V_Total_Power_Time_minutes : 111|6@0+ (1,0) [0|63] "Minutes" SGW
 SG_ V2X_Info : 51|4@0+ (1,0) [0|15] "" SGW

BO_ 1490 V2X_HU: 64 SGW
 SG_ V2H_Mode_Req : 2|1@0+ (1,0) [0|1] "" EVCU2
 SG_ V2H_Req : 15|1@0+ (1,0) [0|1] "" EVCU2
 SG_ V2H_Reserve_Battery : 7|5@0+ (5,0) [0|155] "%" EVCU2
 SG_ V2H_Submit : 16|1@0+ (1,0) [0|1] "" EVCU2
 SG_ V2L_All_Req : 13|1@0+ (1,0) [0|1] "" EVCU2
 SG_ V2L_Frunk_Req : 18|1@0+ (1,0) [0|1] "" EVCU2
 SG_ V2L_Mode_Req : 0|1@0+ (1,0) [0|1] "" EVCU2
 SG_ V2L_Reserve_Battery : 23|5@0+ (5,0) [0|155] "%" EVCU2
 SG_ V2L_Submit : 30|1@0+ (1,0) [0|1] "" EVCU2
 SG_ V2L_Trunk_Req : 17|1@0+ (1,0) [0|1] "" EVCU2
 SG_ V2V_Mode_Req : 1|1@0+ (1,0) [0|1] "" EVCU2
 SG_ V2V_Req : 14|1@0+ (1,0) [0|1] "" EVCU2
 SG_ V2V_Reserve_Battery : 12|5@0+ (5,0) [0|155] "%" EVCU2
 SG_ V2V_Submit : 31|1@0+ (1,0) [0|1] "" EVCU2

BO_ 1426 VDCM_HMI: 32 EVCU2
 SG_ BatteryRunaway_Lamp_PT : 108|1@0+ (1,0) [0|1] "" BCM,IPC
 SG_ CRC_VDCM_HMI : 191|8@0+ (1,0) [0|255] "-" IPC
 SG_ DC_EstChargeTime1 : 47|8@0+ (1,0) [0|254] "min" IPC,SGW
 SG_ DC_EstChargeTime2 : 103|8@0+ (1,0) [0|254] "min" IPC,SGW
 SG_ Est_HVBatSOC_VDCM : 159|8@0+ (0.3922,0) [0|99.6188] "%" SGW
 SG_ Est_Range_ChrgStopTime : 162|11@0+ (1,0) [0|2046] "km" SGW
 SG_ EstRange : 18|11@0+ (1,0) [0|2046] "km" IPC
 SG_ HVBatteryTempForDisplay : 39|8@0+ (1,-40) [-40|214] "?C" IPC,SGW
 SG_ MessageCounter_VDCM_HMI : 179|4@0+ (1,0) [0|15] "-" IPC
 SG_ ServiceHVError : 126|1@0+ (1,0) [0|1] "" IPC
 SG_ ThermalRunaway_Alert : 107|1@0+ (1,0) [0|1] "" Vector__XXX
 SG_ VDCM_PopUpMessage5 : 55|3@0+ (1,0) [0|6] "" IPC
 SG_ VDCM_PopUpMessage7 : 87|1@0+ (1,0) [0|1] "" IPC

BO_ 1442 VDCM_HMI2: 64 EVCU2
 SG_ EstRange_Fuel : 98|11@0+ (1,0) [0|2046] "km" IPC
 SG_ EstRange_Total : 114|11@0+ (1,0) [0|2046] "km" IPC
 SG_ MaxComfortZoneHVBattTempForDisp : 7|8@0+ (1,-40) [-40|215] "°C" IPC,SGW
 SG_ MaxDeratingZoneHVBattTempForDis : 31|8@0+ (1,-40) [-40|215] "°C" IPC,SGW
 SG_ MinComfortZoneHVBattTempForDisp : 15|8@0+ (1,-40) [-40|215] "°C" IPC,SGW
 SG_ MinDeratingZoneHVBattTempForDis : 39|8@0+ (1,-40) [-40|215] "°C" IPC,SGW
 SG_ SugSpeedMax : 47|6@0+ (5,0) [0|315] "km/h" Vector__XXX
 SG_ SugSpeedMin : 41|6@0+ (5,0) [0|315] "km/h" Vector__XXX
 SG_ SugSpeedThreshold : 51|6@0+ (5,0) [0|315] "km/h" Vector__XXX
 SG_ Turtle_Speed_Limit : 183|8@0+ (1,0) [0|255] "" IPC

BO_ 105 VDCM_PWT3: 64 EVCU2
 SG_ LidClosingAck : 5|2@0+ (1,0) [0|2] "" Vector__XXX
 SG_ LidOpeningAck : 7|2@0+ (1,0) [0|2] "" Vector__XXX
 SG_ T4_Sensor_Temp : 378|11@0+ (0.1,-40) [-40|164.7] "°C" Vector__XXX

BO_ 1053 VIN: 32 BCM
 SG_ VIN_DATA : 87|56@0+ (1,0) [0|72057594037927900] "" AGSM,BSM,CADM,DMSM,DTCM,ECM,EVCU2,GNMM,HCP,IPC,RFHM,SGW,TCM
 SG_ VIN_MSG : 75|2@0+ (1,0) [0|3] "" AGSM,BSM,CADM,DMSM,DTCM,ECM,EVCU2,GNMM,HCP,IPC,RFHM,SGW,TCM

CM_ SG_ 1478 Number_of_Trl_Axles_TTPM "Number of Trailer Axles";
CM_ SG_ 1478 Number_of_Trl_Tires_TTPM "Number of Trailer Tires";
CM_ SG_ 1478 TPMTrailer_Number "Trailer Number Selected";
CM_ SG_ 1478 Trailer_Configured "Trailer Configured;FALSE =0 ,TRUE =1";
CM_ SG_ 1478 Trailer_Not_Configured "Trailer Not Configured;FALSE =0 ,TRUE =1";
CM_ SG_ 1478 Trailer_Sensor_Mismatch "TPM sensor IDs mismatched to trailer number";
CM_ SG_ 1478 TrailerTirePress1 "Trailer Tire Pressure 1";
CM_ SG_ 1478 TrailerTirePress10 "Trailer Tire Pressure 10";
CM_ SG_ 1478 TrailerTirePress11 "Trailer Tire Pressure 11";
CM_ SG_ 1478 TrailerTirePress12 "Trailer Tire Pressure 12";
CM_ SG_ 1478 TrailerTirePress2 "Trailer Tire Pressure 2";
CM_ SG_ 1478 TrailerTirePress3 "Trailer Tire Pressure 3";
CM_ SG_ 1478 TrailerTirePress4 "Trailer Tire Pressure 4";
CM_ SG_ 1478 TrailerTirePress5 "Trailer Tire Pressure 5";
CM_ SG_ 1478 TrailerTirePress6 "Trailer Tire Pressure 6";
CM_ SG_ 1478 TrailerTirePress7 "Trailer Tire Pressure 7";
CM_ SG_ 1478 TrailerTirePress8 "Trailer Tire Pressure 8";
CM_ SG_ 1478 TrailerTirePress9 "Trailer Tire Pressure 9";
CM_ SG_ 1478 TrlTire1_Stat "Trailer Tire 1 Status";
CM_ SG_ 1478 TrlTire10_Stat "Trailer Tire 10 Status";
CM_ SG_ 1478 TrlTire11_Stat "Trailer Tire 11 Status";
CM_ SG_ 1478 TrlTire12_Stat "Trailer Tire 12 Status";
CM_ SG_ 1478 TrlTire2_Stat "Trailer Tire 2 Status";
CM_ SG_ 1478 TrlTire3_Stat "Trailer Tire 3 Status";
CM_ SG_ 1478 TrlTire4_Stat "Trailer Tire 4 Status";
CM_ SG_ 1478 TrlTire5_Stat "Trailer Tire 5 Status";
CM_ SG_ 1478 TrlTire6_Stat "Trailer Tire 6 Status";
CM_ SG_ 1478 TrlTire7_Stat "Trailer Tire 7 Status";
CM_ SG_ 1478 TrlTire8_Stat "Trailer Tire 8 Status";
CM_ SG_ 1478 TrlTire9_Stat "Trailer Tire 9 Status";
CM_ SG_ 1478 TrlTPM_ServiceReq "Trailer TPM Service Required ; FALSE =0 ,TRUE =1";
CM_ SG_ 1478 TrlTPMSetPress_TTPM "Trailer TPM set pressure";
CM_ SG_ 278 CODE_CLR_TCM "Clear emission related faults";
CM_ SG_ 278 CrankEnable_Fast "This signal is used to enable the cranking in safety condition";
CM_ SG_ 278 CRC_TRANSM1 "CRC according to SAE J1850 standard at each frame transmission.";
CM_ SG_ 278 DriveLineRatio "Drive Line Ratio";
CM_ SG_ 278 EngTrq_Rq_TCM "Requested engine torque";
CM_ SG_ 278 MaxTrqDes "Maximum engine torque desired";
CM_ SG_ 278 MessageCounter_TRANSM1 "This signal is a counter used for safety checks strategies. This counter is incremented of 1 (one) unit at each frame transmission.";
CM_ SG_ 278 PaddleShiftRequest "Paddle shifter request by driver";
CM_ SG_ 278 REPRGD_PFC_CLR_TCM "Set readiness to incomplete";
CM_ SG_ 278 Secure_Idle_Sts "Secure Idle Status";
CM_ SG_ 278 TargetGear "Tells of the intended target gear that the transmission will be shifting to. Also includes an cancel shift that the DASM uses for better control.";
CM_ SG_ 278 TCASERANGESTATUS_TCM "Transfer case Range status from Transmission";
CM_ SG_ 278 TCM_ActMode "Hybrid transmission control function operational state.";
CM_ SG_ 278 TCMLnchCtrlAllowed "Launch Control Allowed for TCM";
CM_ SG_ 278 TorqueAmpTransmission "It is the torque transmission ratio from gearbox primary to wheels, calculated by gearbox . It is only used in Automatic Transmission application";
CM_ SG_ 278 TorqueConverterDisengageSpeed "Engine Speed at which the torque converter clutch will begin to disengage";
CM_ SG_ 278 TorqueConverterSTO "Conf. (torque converter lock-up) Starts to open";
CM_ SG_ 278 TorqueConverterSts "This signal indicates the control phase of lockup clutch.";
CM_ SG_ 278 TRANS_ADAS_Inhibit "TCM's ability to accept external gear shift requests";
CM_ SG_ 278 TransLosses "Transmission drag torques";
CM_ SG_ 278 TransmissionSailingSts "This signal indicates the status of the Sailing functionality";
CM_ SG_ 278 TrqCtrlModeReq "Torque control mode request";
CM_ SG_ 278 TrqCtrlModeReq_Slow "Slow path torque control mode request";
CM_ SG_ 278 TxIdleRq "-";
CM_ SG_ 278 Vehicle_Hold_Rq "Transmission vehicle hold request";
CM_ SG_ 520 AirFlowRequest_TCM "Request from TCM to activate AGS,Rad Fan";
CM_ SG_ 520 APCM_Rq "Auto position correction mode request";
CM_ SG_ 520 CRC_TRANSM2 "CRC according to SAE J1850 standard at each frame transmission.";
CM_ SG_ 520 EngShutOffRq_TCM "TCM request engine shut off";
CM_ SG_ 520 GearEngagedForDisplay "Transmission Gear engaged signal for Display on cluster.";
CM_ SG_ 520 MessageCounter_TRANSM2 "This signal is a counter used for safety checks strategies. This counter is incremented of 1 (one) unit at each frame transmission.";
CM_ SG_ 520 OUTPUT_SPEED "Activation request flag for P2 speed  profile";
CM_ SG_ 520 OutputSpdPolarity "Output shaft speed polarity";
CM_ SG_ 520 PaddlesModeSts "Status of paddle functionality";
CM_ SG_ 520 Trans_ESS_Inhibit "ESS inhibit flag from transmission related to temperature warnings.";
CM_ SG_ 520 TransmissionTemperature "-";
CM_ SG_ 520 TransReadyForESS "-";
CM_ SG_ 520 Trns_EMCC_Achvd "-";
CM_ SG_ 520 TRNS_StpSt_FLT "-";
CM_ SG_ 520 TurbineSpeed "-";
CM_ SG_ 1450 CrankEnable "This signal is used to enable the cranking in safety condition";
CM_ SG_ 1450 CRC_TRANSM4 "CRC according to SAE J1850 standard at each frame transmission.";
CM_ SG_ 1450 DriveModeSts "-";
CM_ SG_ 1450 GearDisplayForCluster "GearDisplayForCluster";
CM_ SG_ 1450 GearEngaged "Current engaged gear.";
CM_ SG_ 1450 GearIndicationSts "-";
CM_ SG_ 1450 HAS_SoH_TCM "HAS SoH TCM";
CM_ SG_ 1450 LimpHomeSts "This signal is used in case of those gearbox faults that limit the higher usable gear.";
CM_ SG_ 1450 MessageCounter_TRANSM4 "This signal is a counter used for safety checks strategies. This counter is incremented of 1 (one) unit at each frame transmission.";
CM_ SG_ 1450 MIReq "This signal indicates that the gearbox has any EOBD errors.";
CM_ SG_ 1450 OilTemperatureSts "-";
CM_ SG_ 1450 R_SHFT_LOCK "Shiftlock for reverse; locked = [1]";
CM_ SG_ 1450 Secure_Idle_HMI "-";
CM_ SG_ 1450 ShiftInProgress "Transmission shift in progress";
CM_ SG_ 1450 ShiftLeverLockReq "-";
CM_ SG_ 1450 ShiftLeverPosition "This signal indicates the executed shift lever position.";
CM_ SG_ 1450 ShiftMapNotAchieved "Transmission shift in progress";
CM_ SG_ 1450 ShiftModeSts "This signal indicates the gear selector modality selected by driver (Manual or Automatic).";
CM_ SG_ 1450 TransmissionFailSts "This signal indicates if the TCM currently detects the failure or not (for TCM)";
CM_ SG_ 1450 TransmissionWarnings "-";
CM_ SG_ 1450 TxDisengaged "Transmission is disengaged";
CM_ SG_ 1450 TxDisengaged_Fault "Transmission is disengaged";
CM_ SG_ 1059 CodeCheckSts_TRM "This signal is used to indicate the result of the code check.";
CM_ SG_ 1059 ControlEncoding_TRM_Rsp "-";
CM_ SG_ 1059 MiniCryptGCode_TRM_Rsp "-";
CM_ SG_ 1059 ProgrammedSts_TRM "This signal  is used to indicate if the TRM is programmed.";
CM_ SG_ 1059 TxpFound "This signal is used to give information about the presence of a transponder";
CM_ SG_ 1059 TxpID3 "Key ID's";
CM_ SG_ 254 DATA1 "-";
CM_ SG_ 254 DATA2 "-";
CM_ SG_ 254 DATA3 "-";
CM_ SG_ 254 DATA4 "-";
CM_ SG_ 254 DATA5 "-";
CM_ SG_ 254 DATA6 "-";
CM_ SG_ 254 DATA7 "-";
CM_ SG_ 254 FrameNumber "-";
CM_ SG_ 254 TotalFrameNumber "-";
CM_ SG_ 1472 CRC_TRSCM1 "CRC according to SAE J1850 standard at each frame transmission.";
CM_ SG_ 1472 MessageCounter_TRSCM1 "This signal is a counter used for safety checks strategies. This counter is incremented of 1 (one) unit at each frame transmission.";
CM_ SG_ 1472 THA_EPB_Req "THA EPB securement request";
CM_ SG_ 1472 THA_Speed_Limit "THA Speed Limiter Threshold";
CM_ SG_ 1472 THA_SpeedLimit_Req "THA requested speed limit";
CM_ SG_ 1472 THA_STAT "Current trailer hitch assist maneuver state";
CM_ SG_ 1472 TRSC_PopupDisp_Info2 "TRSC Cluster PopUp Request";
CM_ SG_ 1472 TRSC_STAT "Trailer Reverse steering status signal";
CM_ SG_ 951 UConnReq_TBM "Requests specific vehicle function";
CM_ SG_ 951 UConnReqAuthCode_TBM "Authenticates function requests";
CM_ SG_ 951 UConnReqFOBNum_TBM "Indicates Corresponding  FOB number 1-8";
CM_ SG_ 1489 V2H_Instant_Power_Draw "Instant power draw for V2H";
CM_ SG_ 1489 V2H_mode_Sts "V2H mode of operation";
CM_ SG_ 1489 V2H_Reserve_Battery_Sts "Percent of reserve battery selected from the user using V2H";
CM_ SG_ 1489 V2H_Status "Status of V2H power transfer";
CM_ SG_ 1489 V2H_Total_Power_Time_days "V2H Total power time (days)";
CM_ SG_ 1489 V2H_Total_Power_Time_hours "V2H Total power time (hours)";
CM_ SG_ 1489 V2H_Total_Power_Time_minutes "V2H Total power time (minutes)";
CM_ SG_ 1489 V2L_Frunk_Status "Status of V2L frunk power transfer";
CM_ SG_ 1489 V2L_Instant_Power_Draw_Frunk "Instant power draw for V2L frunk";
CM_ SG_ 1489 V2L_Instant_Power_Draw_Trunk "Instant power draw for V2L trunk";
CM_ SG_ 1489 V2L_mode_Sts "V2L mode of operation";
CM_ SG_ 1489 V2L_Total_Power_Time_days "V2L Total power time (days)";
CM_ SG_ 1489 V2L_Total_Power_Time_hours "V2L Total power time (hours)";
CM_ SG_ 1489 V2L_Total_Power_Time_minutes "V2L Total power time (minutes)";
CM_ SG_ 1489 V2L_Trunk_Status "Status of V2L trunk power transfer";
CM_ SG_ 1489 V2V_Instant_Power_Draw "Instant power draw for V2V";
CM_ SG_ 1489 V2V_mode_Sts "V2V mode of operation";
CM_ SG_ 1489 V2V_Status "Status of V2V power transfer";
CM_ SG_ 1489 V2V_Total_Power_Time_days "V2V Total power time (days)";
CM_ SG_ 1489 V2V_Total_Power_Time_hours "V2V Total power time (hours)";
CM_ SG_ 1489 V2V_Total_Power_Time_minutes "V2V Total power time (minutes)";
CM_ SG_ 1489 V2X_Info "V2X feature status info";
CM_ SG_ 1490 V2H_Mode_Req "Request V2H mode";
CM_ SG_ 1490 V2H_Req "Request to activate V2H feature";
CM_ SG_ 1490 V2H_Reserve_Battery "Percent of reserve battery selected from the user using V2H";
CM_ SG_ 1490 V2H_Submit "V2H Submit request";
CM_ SG_ 1490 V2L_All_Req "Request to activate V2L feature";
CM_ SG_ 1490 V2L_Frunk_Req "Request to activate V2L frunk feature";
CM_ SG_ 1490 V2L_Mode_Req "Request V2L mode";
CM_ SG_ 1490 V2L_Reserve_Battery "Percent of reserve battery selected from the user using V2L";
CM_ SG_ 1490 V2L_Submit "V2L Submit request";
CM_ SG_ 1490 V2L_Trunk_Req "Request to activate V2L trunk feature";
CM_ SG_ 1490 V2V_Mode_Req "Request V2V mode";
CM_ SG_ 1490 V2V_Req "Request to activate V2V feature";
CM_ SG_ 1490 V2V_Reserve_Battery "Percent of reserve battery selected from the user using V2V";
CM_ SG_ 1490 V2V_Submit "V2V Submit request";
CM_ SG_ 1426 BatteryRunaway_Lamp_PT "Thermal Runaway Indication";
CM_ SG_ 1426 CRC_VDCM_HMI "CRC according to SAE J1850 standard at each frame transmission.";
CM_ SG_ 1426 DC_EstChargeTime1 "DC remaining Charging time 1";
CM_ SG_ 1426 DC_EstChargeTime2 "DC remaining Charging time 2";
CM_ SG_ 1426 Est_HVBatSOC_VDCM "Estimated HV battery State of Charge (SOC) at the scheduled charge cycle stop time";
CM_ SG_ 1426 Est_Range_ChrgStopTime "Estimated EV range at the scheduled charge cycle stop time (based on SOC)";
CM_ SG_ 1426 EstRange "Estimated range due to HV battery";
CM_ SG_ 1426 HVBatteryTempForDisplay "High Voltage Battery Temperature For Display";
CM_ SG_ 1426 MessageCounter_VDCM_HMI "This signal is a counter used for safety checks strategies. This counter is incremented of 1 (one) unit at each frame transmission.";
CM_ SG_ 1426 ServiceHVError "In Service Procedure this signal activates a warning indication on the IPC during HV System Deactivation";
CM_ SG_ 1426 ThermalRunaway_Alert "Thermal runaway alert activation for non-driving conditions";
CM_ SG_ 1426 VDCM_PopUpMessage5 "VDCM Popup5";
CM_ SG_ 1426 VDCM_PopUpMessage7 "Request to keep the vehicle plugged";
CM_ SG_ 1442 EstRange_Fuel "Estimated range due to fuel";
CM_ SG_ 1442 EstRange_Total "Sum of electric range and fuel range";
CM_ SG_ 1442 MaxComfortZoneHVBattTempForDisp "This signal gives information about the upper limit of the comfort zone";
CM_ SG_ 1442 MaxDeratingZoneHVBattTempForDis "This signal gives information about the upper limit of the derating zone";
CM_ SG_ 1442 MinComfortZoneHVBattTempForDisp "V";
CM_ SG_ 1442 MinDeratingZoneHVBattTempForDis "This signal gives information about the bottom limit of the derating zone";
CM_ SG_ 1442 SugSpeedMax "Suggested Speed Limit upper boundary";
CM_ SG_ 1442 SugSpeedMin "Suggested Speed Limit lower boundary";
CM_ SG_ 1442 SugSpeedThreshold "Suggested Speed Limit shade boundary";
CM_ SG_ 1442 Turtle_Speed_Limit "Speed Limit To Be Displayed In Turtle Mode";
CM_ SG_ 105 LidClosingAck "Ack of e-Lid closing perfomed by VDCM";
CM_ SG_ 105 LidOpeningAck "Ack of e-Lid opening perfomed by VDCM";
CM_ SG_ 105 T4_Sensor_Temp "T4 Temperature sensor";
CM_ SG_ 1053 VIN_DATA "VIN Digits (8 bit ascii encoded)";
CM_ SG_ 1053 VIN_MSG "VIN Message Information";

BA_DEF_ SG_ "GenSigStartValue" INT 0 2147483647;
BA_DEF_ SG_ "GenSigInactiveValue" INT 0 2147483647;
BA_DEF_ SG_ "GenSigSendType" ENUM "NotUsed","OnWrite","OnWriteWithRepetition","OnChange","OnChangeWithRepetition","IfActive","IfActiveWithRepetition","NoSigSendType";
BA_DEF_ SG_ "SystemSignalLongSymbol" STRING ;
BA_DEF_ SG_ "GenSigTimeoutTime_AGSM" INT 0 65535;
BA_DEF_ SG_ "GenSigTimeoutTime_BCM" INT 0 65535;
BA_DEF_ SG_ "GenSigTimeoutTime_BSM" INT 0 65535;
BA_DEF_ SG_ "GenSigTimeoutTime_CADM" INT 0 65535;
BA_DEF_ SG_ "GenSigTimeoutTime_DMSM" INT 0 65535;
BA_DEF_ SG_ "GenSigTimeoutTime_DTCM" INT 0 65535;
BA_DEF_ SG_ "GenSigTimeoutTime_ECM" INT 0 65535;
BA_DEF_ SG_ "GenSigTimeoutTime_EVCU2" INT 0 65535;
BA_DEF_ SG_ "GenSigTimeoutTime_GNMM" INT 0 65535;
BA_DEF_ SG_ "GenSigTimeoutTime_HCP" INT 0 65535;
BA_DEF_ SG_ "GenSigTimeoutTime_IPC" INT 0 65535;
BA_DEF_ SG_ "GenSigTimeoutTime_RFHM" INT 0 65535;
BA_DEF_ SG_ "GenSigTimeoutTime_SGW" INT 0 65535;
BA_DEF_ SG_ "GenSigTimeoutTime_TCM" INT 0 65535;
BA_DEF_ BO_ "DiagRequest" ENUM "No","Yes";
BA_DEF_ BO_ "Type" ENUM "P","C","PE","COC","PE_Cntrl","E","E_Cntrl","OC","S","BAF","DC","EM","MM","ISO-TP","-";
BA_DEF_ BO_ "DiagResponse" ENUM "No","Yes";
BA_DEF_ BO_ "NmMessage" ENUM "No","Yes";
BA_DEF_ BO_ "GenMsgSendType" ENUM "Cyclic","NotUsed","NotUsed","NotUsed","NotUsed","NotUsed","NotUsed","NotUsed","NoMsgSendType";
BA_DEF_ BO_ "GenMsgNrOfRepetition" INT 0 255;
BA_DEF_ BO_ "GenMsgILSupport" ENUM "No","Yes";
BA_DEF_ BO_ "GenMsgStartDelayTime" INT 0 65535;
BA_DEF_ BO_ "GenMsgCycleTimeFast" INT 0 65535;
BA_DEF_ BO_ "GenMsgCycleTime" INT 0 65535;
BA_DEF_ BO_ "GenMsgDelayTime" INT 0 65535;
BA_DEF_ BO_ "NmAsrMessage" ENUM "No","Yes";
BA_DEF_ BO_ "DiagState" ENUM "No","Yes";
BA_DEF_ BO_ "DiagConnection" HEX 0 65535;
BA_DEF_ BO_ "VFrameFormat" ENUM "StandardCAN","ExtendedCAN","reserved","reserved","reserved","reserved","reserved","reserved","reserved","reserved","reserved","reserved","reserved","reserved","StandardCAN_FD","ExtendedCAN_FD";
BA_DEF_ BO_ "CANFD_BRS" ENUM "0","1";
BA_DEF_DEF_ "DiagRequest" "No";
BA_DEF_DEF_ "Type" "-";
BA_DEF_DEF_ "DiagResponse" "No";
BA_DEF_DEF_ "NmMessage" "No";
BA_DEF_DEF_ "GenMsgSendType" "NoMsgSendType";
BA_DEF_DEF_ "GenMsgNrOfRepetition" 0;
BA_DEF_DEF_ "GenMsgILSupport" "No";
BA_DEF_DEF_ "GenMsgStartDelayTime" 0;
BA_DEF_DEF_ "GenMsgCycleTimeFast" 0;
BA_DEF_DEF_ "GenMsgCycleTime" 0;
BA_DEF_DEF_ "GenMsgDelayTime" 0;
BA_DEF_DEF_ "NmAsrMessage" "No";
BA_DEF_DEF_ "DiagState" "No";
BA_DEF_DEF_ "DiagConnection" 0;
BA_DEF_DEF_ "VFrameFormat" "StandardCAN_FD";
BA_DEF_DEF_ "CANFD_BRS" "0";
BA_DEF_DEF_ "GenSigStartValue" 0;
BA_DEF_DEF_ "GenSigInactiveValue" 0;
BA_DEF_DEF_ "GenSigSendType" "NoSigSendType";
BA_DEF_DEF_ "SystemSignalLongSymbol" "";
BA_DEF_DEF_ "GenSigTimeoutTime_AGSM" 2500;
BA_DEF_DEF_ "GenSigTimeoutTime_BCM" 2500;
BA_DEF_DEF_ "GenSigTimeoutTime_BSM" 2500;
BA_DEF_DEF_ "GenSigTimeoutTime_CADM" 2500;
BA_DEF_DEF_ "GenSigTimeoutTime_DMSM" 2500;
BA_DEF_DEF_ "GenSigTimeoutTime_DTCM" 2500;
BA_DEF_DEF_ "GenSigTimeoutTime_ECM" 2500;
BA_DEF_DEF_ "GenSigTimeoutTime_EVCU2" 2500;
BA_DEF_DEF_ "GenSigTimeoutTime_GNMM" 2500;
BA_DEF_DEF_ "GenSigTimeoutTime_HCP" 2500;
BA_DEF_DEF_ "GenSigTimeoutTime_IPC" 2500;
BA_DEF_DEF_ "GenSigTimeoutTime_RFHM" 2500;
BA_DEF_DEF_ "GenSigTimeoutTime_SGW" 2500;
BA_DEF_DEF_ "GenSigTimeoutTime_TCM" 2500;
BA_ "Type" BO_ 1478 3;
BA_ "GenMsgSendType" BO_ 1478 0;
BA_ "GenMsgILSupport" BO_ 1478 1;
BA_ "GenMsgCycleTime" BO_ 1478 1000;
BA_ "CANFD_BRS" BO_ 1478 1;
BA_ "Type" BO_ 278 1;
BA_ "GenMsgSendType" BO_ 278 0;
BA_ "GenMsgILSupport" BO_ 278 1;
BA_ "GenMsgCycleTime" BO_ 278 10;
BA_ "CANFD_BRS" BO_ 278 1;
BA_ "Type" BO_ 520 1;
BA_ "GenMsgSendType" BO_ 520 0;
BA_ "GenMsgILSupport" BO_ 520 1;
BA_ "GenMsgCycleTime" BO_ 520 20;
BA_ "CANFD_BRS" BO_ 520 1;
BA_ "Type" BO_ 1450 3;
BA_ "GenMsgSendType" BO_ 1450 0;
BA_ "GenMsgNrOfRepetition" BO_ 1450 2;
BA_ "GenMsgILSupport" BO_ 1450 1;
BA_ "GenMsgCycleTimeFast" BO_ 1450 20;
BA_ "GenMsgCycleTime" BO_ 1450 1000;
BA_ "GenMsgDelayTime" BO_ 1450 20;
BA_ "CANFD_BRS" BO_ 1450 1;
BA_ "Type" BO_ 1059 8;
BA_ "GenMsgILSupport" BO_ 1059 1;
BA_ "CANFD_BRS" BO_ 1059 1;
BA_ "Type" BO_ 254 12;
BA_ "GenMsgILSupport" BO_ 254 1;
BA_ "CANFD_BRS" BO_ 254 1;
BA_ "Type" BO_ 1472 3;
BA_ "GenMsgSendType" BO_ 1472 0;
BA_ "GenMsgILSupport" BO_ 1472 1;
BA_ "GenMsgCycleTime" BO_ 1472 1000;
BA_ "GenMsgDelayTime" BO_ 1472 20;
BA_ "CANFD_BRS" BO_ 1472 1;
BA_ "Type" BO_ 951 9;
BA_ "GenMsgNrOfRepetition" BO_ 951 2;
BA_ "GenMsgILSupport" BO_ 951 1;
BA_ "GenMsgCycleTimeFast" BO_ 951 100;
BA_ "GenMsgDelayTime" BO_ 951 20;
BA_ "CANFD_BRS" BO_ 951 1;
BA_ "Type" BO_ 1489 1;
BA_ "GenMsgSendType" BO_ 1489 0;
BA_ "GenMsgILSupport" BO_ 1489 1;
BA_ "GenMsgCycleTime" BO_ 1489 1000;
BA_ "CANFD_BRS" BO_ 1489 1;
BA_ "Type" BO_ 1490 1;
BA_ "GenMsgSendType" BO_ 1490 0;
BA_ "GenMsgILSupport" BO_ 1490 1;
BA_ "GenMsgCycleTime" BO_ 1490 1000;
BA_ "CANFD_BRS" BO_ 1490 1;
BA_ "Type" BO_ 1426 3;
BA_ "GenMsgSendType" BO_ 1426 0;
BA_ "GenMsgNrOfRepetition" BO_ 1426 2;
BA_ "GenMsgILSupport" BO_ 1426 1;
BA_ "GenMsgCycleTimeFast" BO_ 1426 20;
BA_ "GenMsgCycleTime" BO_ 1426 1000;
BA_ "GenMsgDelayTime" BO_ 1426 20;
BA_ "CANFD_BRS" BO_ 1426 1;
BA_ "Type" BO_ 1442 3;
BA_ "GenMsgSendType" BO_ 1442 0;
BA_ "GenMsgNrOfRepetition" BO_ 1442 2;
BA_ "GenMsgILSupport" BO_ 1442 1;
BA_ "GenMsgCycleTimeFast" BO_ 1442 100;
BA_ "GenMsgCycleTime" BO_ 1442 1000;
BA_ "GenMsgDelayTime" BO_ 1442 100;
BA_ "CANFD_BRS" BO_ 1442 1;
BA_ "Type" BO_ 105 3;
BA_ "GenMsgSendType" BO_ 105 0;
BA_ "GenMsgILSupport" BO_ 105 1;
BA_ "GenMsgCycleTime" BO_ 105 1000;
BA_ "GenMsgDelayTime" BO_ 105 100;
BA_ "CANFD_BRS" BO_ 105 1;
BA_ "Type" BO_ 1053 1;
BA_ "GenMsgSendType" BO_ 1053 0;
BA_ "GenMsgILSupport" BO_ 1053 1;
BA_ "GenMsgStartDelayTime" BO_ 1053 95;
BA_ "GenMsgCycleTime" BO_ 1053 100;
BA_ "CANFD_BRS" BO_ 1053 1;
BA_ "GenSigSendType" SG_ 1478 Number_of_Trl_Axles_TTPM 3;
BA_ "GenSigTimeoutTime_AGSM" SG_ 1478 Number_of_Trl_Axles_TTPM 0;
BA_ "GenSigTimeoutTime_BCM" SG_ 1478 Number_of_Trl_Axles_TTPM 0;
BA_ "GenSigTimeoutTime_BSM" SG_ 1478 Number_of_Trl_Axles_TTPM 0;
BA_ "GenSigTimeoutTime_CADM" SG_ 1478 Number_of_Trl_Axles_TTPM 0;
BA_ "GenSigTimeoutTime_DMSM" SG_ 1478 Number_of_Trl_Axles_TTPM 0;
BA_ "GenSigTimeoutTime_DTCM" SG_ 1478 Number_of_Trl_Axles_TTPM 0;
BA_ "GenSigTimeoutTime_ECM" SG_ 1478 Number_of_Trl_Axles_TTPM 0;
BA_ "GenSigTimeoutTime_EVCU2" SG_ 1478 Number_of_Trl_Axles_TTPM 0;
BA_ "GenSigTimeoutTime_GNMM" SG_ 1478 Number_of_Trl_Axles_TTPM 0;
BA_ "GenSigTimeoutTime_HCP" SG_ 1478 Number_of_Trl_Axles_TTPM 0;
BA_ "GenSigTimeoutTime_RFHM" SG_ 1478 Number_of_Trl_Axles_TTPM 0;
BA_ "GenSigTimeoutTime_SGW" SG_ 1478 Number_of_Trl_Axles_TTPM 0;
BA_ "GenSigTimeoutTime_TCM" SG_ 1478 Number_of_Trl_Axles_TTPM 0;
BA_ "GenSigSendType" SG_ 1478 Number_of_Trl_Tires_TTPM 3;
BA_ "GenSigTimeoutTime_AGSM" SG_ 1478 Number_of_Trl_Tires_TTPM 0;
BA_ "GenSigTimeoutTime_BCM" SG_ 1478 Number_of_Trl_Tires_TTPM 0;
BA_ "GenSigTimeoutTime_BSM" SG_ 1478 Number_of_Trl_Tires_TTPM 0;
BA_ "GenSigTimeoutTime_CADM" SG_ 1478 Number_of_Trl_Tires_TTPM 0;
BA_ "GenSigTimeoutTime_DMSM" SG_ 1478 Number_of_Trl_Tires_TTPM 0;
BA_ "GenSigTimeoutTime_DTCM" SG_ 1478 Number_of_Trl_Tires_TTPM 0;
BA_ "GenSigTimeoutTime_ECM" SG_ 1478 Number_of_Trl_Tires_TTPM 0;
BA_ "GenSigTimeoutTime_EVCU2" SG_ 1478 Number_of_Trl_Tires_TTPM 0;
BA_ "GenSigTimeoutTime_GNMM" SG_ 1478 Number_of_Trl_Tires_TTPM 0;
BA_ "GenSigTimeoutTime_HCP" SG_ 1478 Number_of_Trl_Tires_TTPM 0;
BA_ "GenSigTimeoutTime_RFHM" SG_ 1478 Number_of_Trl_Tires_TTPM 0;
BA_ "GenSigTimeoutTime_SGW" SG_ 1478 Number_of_Trl_Tires_TTPM 0;
BA_ "GenSigTimeoutTime_TCM" SG_ 1478 Number_of_Trl_Tires_TTPM 0;
BA_ "GenSigSendType" SG_ 1478 TPMTrailer_Number 3;
BA_ "GenSigTimeoutTime_AGSM" SG_ 1478 TPMTrailer_Number 0;
BA_ "GenSigTimeoutTime_BCM" SG_ 1478 TPMTrailer_Number 0;
BA_ "GenSigTimeoutTime_BSM" SG_ 1478 TPMTrailer_Number 0;
BA_ "GenSigTimeoutTime_CADM" SG_ 1478 TPMTrailer_Number 0;
BA_ "GenSigTimeoutTime_DMSM" SG_ 1478 TPMTrailer_Number 0;
BA_ "GenSigTimeoutTime_DTCM" SG_ 1478 TPMTrailer_Number 0;
BA_ "GenSigTimeoutTime_ECM" SG_ 1478 TPMTrailer_Number 0;
BA_ "GenSigTimeoutTime_EVCU2" SG_ 1478 TPMTrailer_Number 0;
BA_ "GenSigTimeoutTime_GNMM" SG_ 1478 TPMTrailer_Number 0;
BA_ "GenSigTimeoutTime_HCP" SG_ 1478 TPMTrailer_Number 0;
BA_ "GenSigTimeoutTime_RFHM" SG_ 1478 TPMTrailer_Number 0;
BA_ "GenSigTimeoutTime_SGW" SG_ 1478 TPMTrailer_Number 0;
BA_ "GenSigTimeoutTime_TCM" SG_ 1478 TPMTrailer_Number 0;
BA_ "GenSigSendType" SG_ 1478 Trailer_Configured 3;
BA_ "GenSigTimeoutTime_AGSM" SG_ 1478 Trailer_Configured 0;
BA_ "GenSigTimeoutTime_BCM" SG_ 1478 Trailer_Configured 0;
BA_ "GenSigTimeoutTime_BSM" SG_ 1478 Trailer_Configured 0;
BA_ "GenSigTimeoutTime_CADM" SG_ 1478 Trailer_Configured 0;
BA_ "GenSigTimeoutTime_DMSM" SG_ 1478 Trailer_Configured 0;
BA_ "GenSigTimeoutTime_DTCM" SG_ 1478 Trailer_Configured 0;
BA_ "GenSigTimeoutTime_ECM" SG_ 1478 Trailer_Configured 0;
BA_ "GenSigTimeoutTime_EVCU2" SG_ 1478 Trailer_Configured 0;
BA_ "GenSigTimeoutTime_GNMM" SG_ 1478 Trailer_Configured 0;
BA_ "GenSigTimeoutTime_HCP" SG_ 1478 Trailer_Configured 0;
BA_ "GenSigTimeoutTime_RFHM" SG_ 1478 Trailer_Configured 0;
BA_ "GenSigTimeoutTime_SGW" SG_ 1478 Trailer_Configured 0;
BA_ "GenSigTimeoutTime_TCM" SG_ 1478 Trailer_Configured 0;
BA_ "GenSigSendType" SG_ 1478 Trailer_Not_Configured 3;
BA_ "GenSigTimeoutTime_AGSM" SG_ 1478 Trailer_Not_Configured 0;
BA_ "GenSigTimeoutTime_BCM" SG_ 1478 Trailer_Not_Configured 0;
BA_ "GenSigTimeoutTime_BSM" SG_ 1478 Trailer_Not_Configured 0;
BA_ "GenSigTimeoutTime_CADM" SG_ 1478 Trailer_Not_Configured 0;
BA_ "GenSigTimeoutTime_DMSM" SG_ 1478 Trailer_Not_Configured 0;
BA_ "GenSigTimeoutTime_DTCM" SG_ 1478 Trailer_Not_Configured 0;
BA_ "GenSigTimeoutTime_ECM" SG_ 1478 Trailer_Not_Configured 0;
BA_ "GenSigTimeoutTime_EVCU2" SG_ 1478 Trailer_Not_Configured 0;
BA_ "GenSigTimeoutTime_GNMM" SG_ 1478 Trailer_Not_Configured 0;
BA_ "GenSigTimeoutTime_HCP" SG_ 1478 Trailer_Not_Configured 0;
BA_ "GenSigTimeoutTime_RFHM" SG_ 1478 Trailer_Not_Configured 0;
BA_ "GenSigTimeoutTime_SGW" SG_ 1478 Trailer_Not_Configured 0;
BA_ "GenSigTimeoutTime_TCM" SG_ 1478 Trailer_Not_Configured 0;
BA_ "GenSigSendType" SG_ 1478 Trailer_Sensor_Mismatch 3;
BA_ "GenSigTimeoutTime_AGSM" SG_ 1478 Trailer_Sensor_Mismatch 0;
BA_ "GenSigTimeoutTime_BCM" SG_ 1478 Trailer_Sensor_Mismatch 0;
BA_ "GenSigTimeoutTime_BSM" SG_ 1478 Trailer_Sensor_Mismatch 0;
BA_ "GenSigTimeoutTime_CADM" SG_ 1478 Trailer_Sensor_Mismatch 0;
BA_ "GenSigTimeoutTime_DMSM" SG_ 1478 Trailer_Sensor_Mismatch 0;
BA_ "GenSigTimeoutTime_DTCM" SG_ 1478 Trailer_Sensor_Mismatch 0;
BA_ "GenSigTimeoutTime_ECM" SG_ 1478 Trailer_Sensor_Mismatch 0;
BA_ "GenSigTimeoutTime_EVCU2" SG_ 1478 Trailer_Sensor_Mismatch 0;
BA_ "GenSigTimeoutTime_GNMM" SG_ 1478 Trailer_Sensor_Mismatch 0;
BA_ "GenSigTimeoutTime_HCP" SG_ 1478 Trailer_Sensor_Mismatch 0;
BA_ "GenSigTimeoutTime_RFHM" SG_ 1478 Trailer_Sensor_Mismatch 0;
BA_ "GenSigTimeoutTime_SGW" SG_ 1478 Trailer_Sensor_Mismatch 0;
BA_ "GenSigTimeoutTime_TCM" SG_ 1478 Trailer_Sensor_Mismatch 0;
BA_ "GenSigStartValue" SG_ 1478 TrailerTirePress1 255;
BA_ "GenSigTimeoutTime_AGSM" SG_ 1478 TrailerTirePress1 0;
BA_ "GenSigTimeoutTime_BCM" SG_ 1478 TrailerTirePress1 0;
BA_ "GenSigTimeoutTime_BSM" SG_ 1478 TrailerTirePress1 0;
BA_ "GenSigTimeoutTime_CADM" SG_ 1478 TrailerTirePress1 0;
BA_ "GenSigTimeoutTime_DMSM" SG_ 1478 TrailerTirePress1 0;
BA_ "GenSigTimeoutTime_DTCM" SG_ 1478 TrailerTirePress1 0;
BA_ "GenSigTimeoutTime_ECM" SG_ 1478 TrailerTirePress1 0;
BA_ "GenSigTimeoutTime_EVCU2" SG_ 1478 TrailerTirePress1 0;
BA_ "GenSigTimeoutTime_GNMM" SG_ 1478 TrailerTirePress1 0;
BA_ "GenSigTimeoutTime_HCP" SG_ 1478 TrailerTirePress1 0;
BA_ "GenSigTimeoutTime_RFHM" SG_ 1478 TrailerTirePress1 0;
BA_ "GenSigTimeoutTime_SGW" SG_ 1478 TrailerTirePress1 0;
BA_ "GenSigTimeoutTime_TCM" SG_ 1478 TrailerTirePress1 0;
BA_ "GenSigStartValue" SG_ 1478 TrailerTirePress10 255;
BA_ "GenSigTimeoutTime_AGSM" SG_ 1478 TrailerTirePress10 0;
BA_ "GenSigTimeoutTime_BCM" SG_ 1478 TrailerTirePress10 0;
BA_ "GenSigTimeoutTime_BSM" SG_ 1478 TrailerTirePress10 0;
BA_ "GenSigTimeoutTime_CADM" SG_ 1478 TrailerTirePress10 0;
BA_ "GenSigTimeoutTime_DMSM" SG_ 1478 TrailerTirePress10 0;
BA_ "GenSigTimeoutTime_DTCM" SG_ 1478 TrailerTirePress10 0;
BA_ "GenSigTimeoutTime_ECM" SG_ 1478 TrailerTirePress10 0;
BA_ "GenSigTimeoutTime_EVCU2" SG_ 1478 TrailerTirePress10 0;
BA_ "GenSigTimeoutTime_GNMM" SG_ 1478 TrailerTirePress10 0;
BA_ "GenSigTimeoutTime_HCP" SG_ 1478 TrailerTirePress10 0;
BA_ "GenSigTimeoutTime_RFHM" SG_ 1478 TrailerTirePress10 0;
BA_ "GenSigTimeoutTime_SGW" SG_ 1478 TrailerTirePress10 0;
BA_ "GenSigTimeoutTime_TCM" SG_ 1478 TrailerTirePress10 0;
BA_ "GenSigStartValue" SG_ 1478 TrailerTirePress11 255;
BA_ "GenSigTimeoutTime_AGSM" SG_ 1478 TrailerTirePress11 0;
BA_ "GenSigTimeoutTime_BCM" SG_ 1478 TrailerTirePress11 0;
BA_ "GenSigTimeoutTime_BSM" SG_ 1478 TrailerTirePress11 0;
BA_ "GenSigTimeoutTime_CADM" SG_ 1478 TrailerTirePress11 0;
BA_ "GenSigTimeoutTime_DMSM" SG_ 1478 TrailerTirePress11 0;
BA_ "GenSigTimeoutTime_DTCM" SG_ 1478 TrailerTirePress11 0;
BA_ "GenSigTimeoutTime_ECM" SG_ 1478 TrailerTirePress11 0;
BA_ "GenSigTimeoutTime_EVCU2" SG_ 1478 TrailerTirePress11 0;
BA_ "GenSigTimeoutTime_GNMM" SG_ 1478 TrailerTirePress11 0;
BA_ "GenSigTimeoutTime_HCP" SG_ 1478 TrailerTirePress11 0;
BA_ "GenSigTimeoutTime_RFHM" SG_ 1478 TrailerTirePress11 0;
BA_ "GenSigTimeoutTime_SGW" SG_ 1478 TrailerTirePress11 0;
BA_ "GenSigTimeoutTime_TCM" SG_ 1478 TrailerTirePress11 0;
BA_ "GenSigStartValue" SG_ 1478 TrailerTirePress12 255;
BA_ "GenSigTimeoutTime_AGSM" SG_ 1478 TrailerTirePress12 0;
BA_ "GenSigTimeoutTime_BCM" SG_ 1478 TrailerTirePress12 0;
BA_ "GenSigTimeoutTime_BSM" SG_ 1478 TrailerTirePress12 0;
BA_ "GenSigTimeoutTime_CADM" SG_ 1478 TrailerTirePress12 0;
BA_ "GenSigTimeoutTime_DMSM" SG_ 1478 TrailerTirePress12 0;
BA_ "GenSigTimeoutTime_DTCM" SG_ 1478 TrailerTirePress12 0;
BA_ "GenSigTimeoutTime_ECM" SG_ 1478 TrailerTirePress12 0;
BA_ "GenSigTimeoutTime_EVCU2" SG_ 1478 TrailerTirePress12 0;
BA_ "GenSigTimeoutTime_GNMM" SG_ 1478 TrailerTirePress12 0;
BA_ "GenSigTimeoutTime_HCP" SG_ 1478 TrailerTirePress12 0;
BA_ "GenSigTimeoutTime_RFHM" SG_ 1478 TrailerTirePress12 0;
BA_ "GenSigTimeoutTime_SGW" SG_ 1478 TrailerTirePress12 0;
BA_ "GenSigTimeoutTime_TCM" SG_ 1478 TrailerTirePress12 0;
BA_ "GenSigStartValue" SG_ 1478 TrailerTirePress2 255;
BA_ "GenSigTimeoutTime_AGSM" SG_ 1478 TrailerTirePress2 0;
BA_ "GenSigTimeoutTime_BCM" SG_ 1478 TrailerTirePress2 0;
BA_ "GenSigTimeoutTime_BSM" SG_ 1478 TrailerTirePress2 0;
BA_ "GenSigTimeoutTime_CADM" SG_ 1478 TrailerTirePress2 0;
BA_ "GenSigTimeoutTime_DMSM" SG_ 1478 TrailerTirePress2 0;
BA_ "GenSigTimeoutTime_DTCM" SG_ 1478 TrailerTirePress2 0;
BA_ "GenSigTimeoutTime_ECM" SG_ 1478 TrailerTirePress2 0;
BA_ "GenSigTimeoutTime_EVCU2" SG_ 1478 TrailerTirePress2 0;
BA_ "GenSigTimeoutTime_GNMM" SG_ 1478 TrailerTirePress2 0;
BA_ "GenSigTimeoutTime_HCP" SG_ 1478 TrailerTirePress2 0;
BA_ "GenSigTimeoutTime_RFHM" SG_ 1478 TrailerTirePress2 0;
BA_ "GenSigTimeoutTime_SGW" SG_ 1478 TrailerTirePress2 0;
BA_ "GenSigTimeoutTime_TCM" SG_ 1478 TrailerTirePress2 0;
BA_ "GenSigStartValue" SG_ 1478 TrailerTirePress3 255;
BA_ "GenSigTimeoutTime_AGSM" SG_ 1478 TrailerTirePress3 0;
BA_ "GenSigTimeoutTime_BCM" SG_ 1478 TrailerTirePress3 0;
BA_ "GenSigTimeoutTime_BSM" SG_ 1478 TrailerTirePress3 0;
BA_ "GenSigTimeoutTime_CADM" SG_ 1478 TrailerTirePress3 0;
BA_ "GenSigTimeoutTime_DMSM" SG_ 1478 TrailerTirePress3 0;
BA_ "GenSigTimeoutTime_DTCM" SG_ 1478 TrailerTirePress3 0;
BA_ "GenSigTimeoutTime_ECM" SG_ 1478 TrailerTirePress3 0;
BA_ "GenSigTimeoutTime_EVCU2" SG_ 1478 TrailerTirePress3 0;
BA_ "GenSigTimeoutTime_GNMM" SG_ 1478 TrailerTirePress3 0;
BA_ "GenSigTimeoutTime_HCP" SG_ 1478 TrailerTirePress3 0;
BA_ "GenSigTimeoutTime_RFHM" SG_ 1478 TrailerTirePress3 0;
BA_ "GenSigTimeoutTime_SGW" SG_ 1478 TrailerTirePress3 0;
BA_ "GenSigTimeoutTime_TCM" SG_ 1478 TrailerTirePress3 0;
BA_ "GenSigStartValue" SG_ 1478 TrailerTirePress4 255;
BA_ "GenSigTimeoutTime_AGSM" SG_ 1478 TrailerTirePress4 0;
BA_ "GenSigTimeoutTime_BCM" SG_ 1478 TrailerTirePress4 0;
BA_ "GenSigTimeoutTime_BSM" SG_ 1478 TrailerTirePress4 0;
BA_ "GenSigTimeoutTime_CADM" SG_ 1478 TrailerTirePress4 0;
BA_ "GenSigTimeoutTime_DMSM" SG_ 1478 TrailerTirePress4 0;
BA_ "GenSigTimeoutTime_DTCM" SG_ 1478 TrailerTirePress4 0;
BA_ "GenSigTimeoutTime_ECM" SG_ 1478 TrailerTirePress4 0;
BA_ "GenSigTimeoutTime_EVCU2" SG_ 1478 TrailerTirePress4 0;
BA_ "GenSigTimeoutTime_GNMM" SG_ 1478 TrailerTirePress4 0;
BA_ "GenSigTimeoutTime_HCP" SG_ 1478 TrailerTirePress4 0;
BA_ "GenSigTimeoutTime_RFHM" SG_ 1478 TrailerTirePress4 0;
BA_ "GenSigTimeoutTime_SGW" SG_ 1478 TrailerTirePress4 0;
BA_ "GenSigTimeoutTime_TCM" SG_ 1478 TrailerTirePress4 0;
BA_ "GenSigStartValue" SG_ 1478 TrailerTirePress5 255;
BA_ "GenSigTimeoutTime_AGSM" SG_ 1478 TrailerTirePress5 0;
BA_ "GenSigTimeoutTime_BCM" SG_ 1478 TrailerTirePress5 0;
BA_ "GenSigTimeoutTime_BSM" SG_ 1478 TrailerTirePress5 0;
BA_ "GenSigTimeoutTime_CADM" SG_ 1478 TrailerTirePress5 0;
BA_ "GenSigTimeoutTime_DMSM" SG_ 1478 TrailerTirePress5 0;
BA_ "GenSigTimeoutTime_DTCM" SG_ 1478 TrailerTirePress5 0;
BA_ "GenSigTimeoutTime_ECM" SG_ 1478 TrailerTirePress5 0;
BA_ "GenSigTimeoutTime_EVCU2" SG_ 1478 TrailerTirePress5 0;
BA_ "GenSigTimeoutTime_GNMM" SG_ 1478 TrailerTirePress5 0;
BA_ "GenSigTimeoutTime_HCP" SG_ 1478 TrailerTirePress5 0;
BA_ "GenSigTimeoutTime_RFHM" SG_ 1478 TrailerTirePress5 0;
BA_ "GenSigTimeoutTime_SGW" SG_ 1478 TrailerTirePress5 0;
BA_ "GenSigTimeoutTime_TCM" SG_ 1478 TrailerTirePress5 0;
BA_ "GenSigStartValue" SG_ 1478 TrailerTirePress6 255;
BA_ "GenSigTimeoutTime_AGSM" SG_ 1478 TrailerTirePress6 0;
BA_ "GenSigTimeoutTime_BCM" SG_ 1478 TrailerTirePress6 0;
BA_ "GenSigTimeoutTime_BSM" SG_ 1478 TrailerTirePress6 0;
BA_ "GenSigTimeoutTime_CADM" SG_ 1478 TrailerTirePress6 0;
BA_ "GenSigTimeoutTime_DMSM" SG_ 1478 TrailerTirePress6 0;
BA_ "GenSigTimeoutTime_DTCM" SG_ 1478 TrailerTirePress6 0;
BA_ "GenSigTimeoutTime_ECM" SG_ 1478 TrailerTirePress6 0;
BA_ "GenSigTimeoutTime_EVCU2" SG_ 1478 TrailerTirePress6 0;
BA_ "GenSigTimeoutTime_GNMM" SG_ 1478 TrailerTirePress6 0;
BA_ "GenSigTimeoutTime_HCP" SG_ 1478 TrailerTirePress6 0;
BA_ "GenSigTimeoutTime_RFHM" SG_ 1478 TrailerTirePress6 0;
BA_ "GenSigTimeoutTime_SGW" SG_ 1478 TrailerTirePress6 0;
BA_ "GenSigTimeoutTime_TCM" SG_ 1478 TrailerTirePress6 0;
BA_ "GenSigStartValue" SG_ 1478 TrailerTirePress7 255;
BA_ "GenSigTimeoutTime_AGSM" SG_ 1478 TrailerTirePress7 0;
BA_ "GenSigTimeoutTime_BCM" SG_ 1478 TrailerTirePress7 0;
BA_ "GenSigTimeoutTime_BSM" SG_ 1478 TrailerTirePress7 0;
BA_ "GenSigTimeoutTime_CADM" SG_ 1478 TrailerTirePress7 0;
BA_ "GenSigTimeoutTime_DMSM" SG_ 1478 TrailerTirePress7 0;
BA_ "GenSigTimeoutTime_DTCM" SG_ 1478 TrailerTirePress7 0;
BA_ "GenSigTimeoutTime_ECM" SG_ 1478 TrailerTirePress7 0;
BA_ "GenSigTimeoutTime_EVCU2" SG_ 1478 TrailerTirePress7 0;
BA_ "GenSigTimeoutTime_GNMM" SG_ 1478 TrailerTirePress7 0;
BA_ "GenSigTimeoutTime_HCP" SG_ 1478 TrailerTirePress7 0;
BA_ "GenSigTimeoutTime_RFHM" SG_ 1478 TrailerTirePress7 0;
BA_ "GenSigTimeoutTime_SGW" SG_ 1478 TrailerTirePress7 0;
BA_ "GenSigTimeoutTime_TCM" SG_ 1478 TrailerTirePress7 0;
BA_ "GenSigStartValue" SG_ 1478 TrailerTirePress8 255;
BA_ "GenSigTimeoutTime_AGSM" SG_ 1478 TrailerTirePress8 0;
BA_ "GenSigTimeoutTime_BCM" SG_ 1478 TrailerTirePress8 0;
BA_ "GenSigTimeoutTime_BSM" SG_ 1478 TrailerTirePress8 0;
BA_ "GenSigTimeoutTime_CADM" SG_ 1478 TrailerTirePress8 0;
BA_ "GenSigTimeoutTime_DMSM" SG_ 1478 TrailerTirePress8 0;
BA_ "GenSigTimeoutTime_DTCM" SG_ 1478 TrailerTirePress8 0;
BA_ "GenSigTimeoutTime_ECM" SG_ 1478 TrailerTirePress8 0;
BA_ "GenSigTimeoutTime_EVCU2" SG_ 1478 TrailerTirePress8 0;
BA_ "GenSigTimeoutTime_GNMM" SG_ 1478 TrailerTirePress8 0;
BA_ "GenSigTimeoutTime_HCP" SG_ 1478 TrailerTirePress8 0;
BA_ "GenSigTimeoutTime_RFHM" SG_ 1478 TrailerTirePress8 0;
BA_ "GenSigTimeoutTime_SGW" SG_ 1478 TrailerTirePress8 0;
BA_ "GenSigTimeoutTime_TCM" SG_ 1478 TrailerTirePress8 0;
BA_ "GenSigStartValue" SG_ 1478 TrailerTirePress9 255;
BA_ "GenSigTimeoutTime_AGSM" SG_ 1478 TrailerTirePress9 0;
BA_ "GenSigTimeoutTime_BCM" SG_ 1478 TrailerTirePress9 0;
BA_ "GenSigTimeoutTime_BSM" SG_ 1478 TrailerTirePress9 0;
BA_ "GenSigTimeoutTime_CADM" SG_ 1478 TrailerTirePress9 0;
BA_ "GenSigTimeoutTime_DMSM" SG_ 1478 TrailerTirePress9 0;
BA_ "GenSigTimeoutTime_DTCM" SG_ 1478 TrailerTirePress9 0;
BA_ "GenSigTimeoutTime_ECM" SG_ 1478 TrailerTirePress9 0;
BA_ "GenSigTimeoutTime_EVCU2" SG_ 1478 TrailerTirePress9 0;
BA_ "GenSigTimeoutTime_GNMM" SG_ 1478 TrailerTirePress9 0;
BA_ "GenSigTimeoutTime_HCP" SG_ 1478 TrailerTirePress9 0;
BA_ "GenSigTimeoutTime_RFHM" SG_ 1478 TrailerTirePress9 0;
BA_ "GenSigTimeoutTime_SGW" SG_ 1478 TrailerTirePress9 0;
BA_ "GenSigTimeoutTime_TCM" SG_ 1478 TrailerTirePress9 0;
BA_ "GenSigTimeoutTime_AGSM" SG_ 1478 TrlTire1_Stat 0;
BA_ "GenSigTimeoutTime_BCM" SG_ 1478 TrlTire1_Stat 0;
BA_ "GenSigTimeoutTime_BSM" SG_ 1478 TrlTire1_Stat 0;
BA_ "GenSigTimeoutTime_CADM" SG_ 1478 TrlTire1_Stat 0;
BA_ "GenSigTimeoutTime_DMSM" SG_ 1478 TrlTire1_Stat 0;
BA_ "GenSigTimeoutTime_DTCM" SG_ 1478 TrlTire1_Stat 0;
BA_ "GenSigTimeoutTime_ECM" SG_ 1478 TrlTire1_Stat 0;
BA_ "GenSigTimeoutTime_EVCU2" SG_ 1478 TrlTire1_Stat 0;
BA_ "GenSigTimeoutTime_GNMM" SG_ 1478 TrlTire1_Stat 0;
BA_ "GenSigTimeoutTime_HCP" SG_ 1478 TrlTire1_Stat 0;
BA_ "GenSigTimeoutTime_RFHM" SG_ 1478 TrlTire1_Stat 0;
BA_ "GenSigTimeoutTime_SGW" SG_ 1478 TrlTire1_Stat 0;
BA_ "GenSigTimeoutTime_TCM" SG_ 1478 TrlTire1_Stat 0;
BA_ "GenSigTimeoutTime_AGSM" SG_ 1478 TrlTire10_Stat 0;
BA_ "GenSigTimeoutTime_BCM" SG_ 1478 TrlTire10_Stat 0;
BA_ "GenSigTimeoutTime_BSM" SG_ 1478 TrlTire10_Stat 0;
BA_ "GenSigTimeoutTime_CADM" SG_ 1478 TrlTire10_Stat 0;
BA_ "GenSigTimeoutTime_DMSM" SG_ 1478 TrlTire10_Stat 0;
BA_ "GenSigTimeoutTime_DTCM" SG_ 1478 TrlTire10_Stat 0;
BA_ "GenSigTimeoutTime_ECM" SG_ 1478 TrlTire10_Stat 0;
BA_ "GenSigTimeoutTime_EVCU2" SG_ 1478 TrlTire10_Stat 0;
BA_ "GenSigTimeoutTime_GNMM" SG_ 1478 TrlTire10_Stat 0;
BA_ "GenSigTimeoutTime_HCP" SG_ 1478 TrlTire10_Stat 0;
BA_ "GenSigTimeoutTime_RFHM" SG_ 1478 TrlTire10_Stat 0;
BA_ "GenSigTimeoutTime_SGW" SG_ 1478 TrlTire10_Stat 0;
BA_ "GenSigTimeoutTime_TCM" SG_ 1478 TrlTire10_Stat 0;
BA_ "GenSigTimeoutTime_AGSM" SG_ 1478 TrlTire11_Stat 0;
BA_ "GenSigTimeoutTime_BCM" SG_ 1478 TrlTire11_Stat 0;
BA_ "GenSigTimeoutTime_BSM" SG_ 1478 TrlTire11_Stat 0;
BA_ "GenSigTimeoutTime_CADM" SG_ 1478 TrlTire11_Stat 0;
BA_ "GenSigTimeoutTime_DMSM" SG_ 1478 TrlTire11_Stat 0;
BA_ "GenSigTimeoutTime_DTCM" SG_ 1478 TrlTire11_Stat 0;
BA_ "GenSigTimeoutTime_ECM" SG_ 1478 TrlTire11_Stat 0;
BA_ "GenSigTimeoutTime_EVCU2" SG_ 1478 TrlTire11_Stat 0;
BA_ "GenSigTimeoutTime_GNMM" SG_ 1478 TrlTire11_Stat 0;
BA_ "GenSigTimeoutTime_HCP" SG_ 1478 TrlTire11_Stat 0;
BA_ "GenSigTimeoutTime_RFHM" SG_ 1478 TrlTire11_Stat 0;
BA_ "GenSigTimeoutTime_SGW" SG_ 1478 TrlTire11_Stat 0;
BA_ "GenSigTimeoutTime_TCM" SG_ 1478 TrlTire11_Stat 0;
BA_ "GenSigTimeoutTime_AGSM" SG_ 1478 TrlTire12_Stat 0;
BA_ "GenSigTimeoutTime_BCM" SG_ 1478 TrlTire12_Stat 0;
BA_ "GenSigTimeoutTime_BSM" SG_ 1478 TrlTire12_Stat 0;
BA_ "GenSigTimeoutTime_CADM" SG_ 1478 TrlTire12_Stat 0;
BA_ "GenSigTimeoutTime_DMSM" SG_ 1478 TrlTire12_Stat 0;
BA_ "GenSigTimeoutTime_DTCM" SG_ 1478 TrlTire12_Stat 0;
BA_ "GenSigTimeoutTime_ECM" SG_ 1478 TrlTire12_Stat 0;
BA_ "GenSigTimeoutTime_EVCU2" SG_ 1478 TrlTire12_Stat 0;
BA_ "GenSigTimeoutTime_GNMM" SG_ 1478 TrlTire12_Stat 0;
BA_ "GenSigTimeoutTime_HCP" SG_ 1478 TrlTire12_Stat 0;
BA_ "GenSigTimeoutTime_RFHM" SG_ 1478 TrlTire12_Stat 0;
BA_ "GenSigTimeoutTime_SGW" SG_ 1478 TrlTire12_Stat 0;
BA_ "GenSigTimeoutTime_TCM" SG_ 1478 TrlTire12_Stat 0;
BA_ "GenSigTimeoutTime_AGSM" SG_ 1478 TrlTire2_Stat 0;
BA_ "GenSigTimeoutTime_BCM" SG_ 1478 TrlTire2_Stat 0;
BA_ "GenSigTimeoutTime_BSM" SG_ 1478 TrlTire2_Stat 0;
BA_ "GenSigTimeoutTime_CADM" SG_ 1478 TrlTire2_Stat 0;
BA_ "GenSigTimeoutTime_DMSM" SG_ 1478 TrlTire2_Stat 0;
BA_ "GenSigTimeoutTime_DTCM" SG_ 1478 TrlTire2_Stat 0;
BA_ "GenSigTimeoutTime_ECM" SG_ 1478 TrlTire2_Stat 0;
BA_ "GenSigTimeoutTime_EVCU2" SG_ 1478 TrlTire2_Stat 0;
BA_ "GenSigTimeoutTime_GNMM" SG_ 1478 TrlTire2_Stat 0;
BA_ "GenSigTimeoutTime_HCP" SG_ 1478 TrlTire2_Stat 0;
BA_ "GenSigTimeoutTime_RFHM" SG_ 1478 TrlTire2_Stat 0;
BA_ "GenSigTimeoutTime_SGW" SG_ 1478 TrlTire2_Stat 0;
BA_ "GenSigTimeoutTime_TCM" SG_ 1478 TrlTire2_Stat 0;
BA_ "GenSigTimeoutTime_AGSM" SG_ 1478 TrlTire3_Stat 0;
BA_ "GenSigTimeoutTime_BCM" SG_ 1478 TrlTire3_Stat 0;
BA_ "GenSigTimeoutTime_BSM" SG_ 1478 TrlTire3_Stat 0;
BA_ "GenSigTimeoutTime_CADM" SG_ 1478 TrlTire3_Stat 0;
BA_ "GenSigTimeoutTime_DMSM" SG_ 1478 TrlTire3_Stat 0;
BA_ "GenSigTimeoutTime_DTCM" SG_ 1478 TrlTire3_Stat 0;
BA_ "GenSigTimeoutTime_ECM" SG_ 1478 TrlTire3_Stat 0;
BA_ "GenSigTimeoutTime_EVCU2" SG_ 1478 TrlTire3_Stat 0;
BA_ "GenSigTimeoutTime_GNMM" SG_ 1478 TrlTire3_Stat 0;
BA_ "GenSigTimeoutTime_HCP" SG_ 1478 TrlTire3_Stat 0;
BA_ "GenSigTimeoutTime_RFHM" SG_ 1478 TrlTire3_Stat 0;
BA_ "GenSigTimeoutTime_SGW" SG_ 1478 TrlTire3_Stat 0;
BA_ "GenSigTimeoutTime_TCM" SG_ 1478 TrlTire3_Stat 0;
BA_ "GenSigTimeoutTime_AGSM" SG_ 1478 TrlTire4_Stat 0;
BA_ "GenSigTimeoutTime_BCM" SG_ 1478 TrlTire4_Stat 0;
BA_ "GenSigTimeoutTime_BSM" SG_ 1478 TrlTire4_Stat 0;
BA_ "GenSigTimeoutTime_CADM" SG_ 1478 TrlTire4_Stat 0;
BA_ "GenSigTimeoutTime_DMSM" SG_ 1478 TrlTire4_Stat 0;
BA_ "GenSigTimeoutTime_DTCM" SG_ 1478 TrlTire4_Stat 0;
BA_ "GenSigTimeoutTime_ECM" SG_ 1478 TrlTire4_Stat 0;
BA_ "GenSigTimeoutTime_EVCU2" SG_ 1478 TrlTire4_Stat 0;
BA_ "GenSigTimeoutTime_GNMM" SG_ 1478 TrlTire4_Stat 0;
BA_ "GenSigTimeoutTime_HCP" SG_ 1478 TrlTire4_Stat 0;
BA_ "GenSigTimeoutTime_RFHM" SG_ 1478 TrlTire4_Stat 0;
BA_ "GenSigTimeoutTime_SGW" SG_ 1478 TrlTire4_Stat 0;
BA_ "GenSigTimeoutTime_TCM" SG_ 1478 TrlTire4_Stat 0;
BA_ "GenSigTimeoutTime_AGSM" SG_ 1478 TrlTire5_Stat 0;
BA_ "GenSigTimeoutTime_BCM" SG_ 1478 TrlTire5_Stat 0;
BA_ "GenSigTimeoutTime_BSM" SG_ 1478 TrlTire5_Stat 0;
BA_ "GenSigTimeoutTime_CADM" SG_ 1478 TrlTire5_Stat 0;
BA_ "GenSigTimeoutTime_DMSM" SG_ 1478 TrlTire5_Stat 0;
BA_ "GenSigTimeoutTime_DTCM" SG_ 1478 TrlTire5_Stat 0;
BA_ "GenSigTimeoutTime_ECM" SG_ 1478 TrlTire5_Stat 0;
BA_ "GenSigTimeoutTime_EVCU2" SG_ 1478 TrlTire5_Stat 0;
BA_ "GenSigTimeoutTime_GNMM" SG_ 1478 TrlTire5_Stat 0;
BA_ "GenSigTimeoutTime_HCP" SG_ 1478 TrlTire5_Stat 0;
BA_ "GenSigTimeoutTime_RFHM" SG_ 1478 TrlTire5_Stat 0;
BA_ "GenSigTimeoutTime_SGW" SG_ 1478 TrlTire5_Stat 0;
BA_ "GenSigTimeoutTime_TCM" SG_ 1478 TrlTire5_Stat 0;
BA_ "GenSigTimeoutTime_AGSM" SG_ 1478 TrlTire6_Stat 0;
BA_ "GenSigTimeoutTime_BCM" SG_ 1478 TrlTire6_Stat 0;
BA_ "GenSigTimeoutTime_BSM" SG_ 1478 TrlTire6_Stat 0;
BA_ "GenSigTimeoutTime_CADM" SG_ 1478 TrlTire6_Stat 0;
BA_ "GenSigTimeoutTime_DMSM" SG_ 1478 TrlTire6_Stat 0;
BA_ "GenSigTimeoutTime_DTCM" SG_ 1478 TrlTire6_Stat 0;
BA_ "GenSigTimeoutTime_ECM" SG_ 1478 TrlTire6_Stat 0;
BA_ "GenSigTimeoutTime_EVCU2" SG_ 1478 TrlTire6_Stat 0;
BA_ "GenSigTimeoutTime_GNMM" SG_ 1478 TrlTire6_Stat 0;
BA_ "GenSigTimeoutTime_HCP" SG_ 1478 TrlTire6_Stat 0;
BA_ "GenSigTimeoutTime_RFHM" SG_ 1478 TrlTire6_Stat 0;
BA_ "GenSigTimeoutTime_SGW" SG_ 1478 TrlTire6_Stat 0;
BA_ "GenSigTimeoutTime_TCM" SG_ 1478 TrlTire6_Stat 0;
BA_ "GenSigTimeoutTime_AGSM" SG_ 1478 TrlTire7_Stat 0;
BA_ "GenSigTimeoutTime_BCM" SG_ 1478 TrlTire7_Stat 0;
BA_ "GenSigTimeoutTime_BSM" SG_ 1478 TrlTire7_Stat 0;
BA_ "GenSigTimeoutTime_CADM" SG_ 1478 TrlTire7_Stat 0;
BA_ "GenSigTimeoutTime_DMSM" SG_ 1478 TrlTire7_Stat 0;
BA_ "GenSigTimeoutTime_DTCM" SG_ 1478 TrlTire7_Stat 0;
BA_ "GenSigTimeoutTime_ECM" SG_ 1478 TrlTire7_Stat 0;
BA_ "GenSigTimeoutTime_EVCU2" SG_ 1478 TrlTire7_Stat 0;
BA_ "GenSigTimeoutTime_GNMM" SG_ 1478 TrlTire7_Stat 0;
BA_ "GenSigTimeoutTime_HCP" SG_ 1478 TrlTire7_Stat 0;
BA_ "GenSigTimeoutTime_RFHM" SG_ 1478 TrlTire7_Stat 0;
BA_ "GenSigTimeoutTime_SGW" SG_ 1478 TrlTire7_Stat 0;
BA_ "GenSigTimeoutTime_TCM" SG_ 1478 TrlTire7_Stat 0;
BA_ "GenSigTimeoutTime_AGSM" SG_ 1478 TrlTire8_Stat 0;
BA_ "GenSigTimeoutTime_BCM" SG_ 1478 TrlTire8_Stat 0;
BA_ "GenSigTimeoutTime_BSM" SG_ 1478 TrlTire8_Stat 0;
BA_ "GenSigTimeoutTime_CADM" SG_ 1478 TrlTire8_Stat 0;
BA_ "GenSigTimeoutTime_DMSM" SG_ 1478 TrlTire8_Stat 0;
BA_ "GenSigTimeoutTime_DTCM" SG_ 1478 TrlTire8_Stat 0;
BA_ "GenSigTimeoutTime_ECM" SG_ 1478 TrlTire8_Stat 0;
BA_ "GenSigTimeoutTime_EVCU2" SG_ 1478 TrlTire8_Stat 0;
BA_ "GenSigTimeoutTime_GNMM" SG_ 1478 TrlTire8_Stat 0;
BA_ "GenSigTimeoutTime_HCP" SG_ 1478 TrlTire8_Stat 0;
BA_ "GenSigTimeoutTime_RFHM" SG_ 1478 TrlTire8_Stat 0;
BA_ "GenSigTimeoutTime_SGW" SG_ 1478 TrlTire8_Stat 0;
BA_ "GenSigTimeoutTime_TCM" SG_ 1478 TrlTire8_Stat 0;
BA_ "GenSigTimeoutTime_AGSM" SG_ 1478 TrlTire9_Stat 0;
BA_ "GenSigTimeoutTime_BCM" SG_ 1478 TrlTire9_Stat 0;
BA_ "GenSigTimeoutTime_BSM" SG_ 1478 TrlTire9_Stat 0;
BA_ "GenSigTimeoutTime_CADM" SG_ 1478 TrlTire9_Stat 0;
BA_ "GenSigTimeoutTime_DMSM" SG_ 1478 TrlTire9_Stat 0;
BA_ "GenSigTimeoutTime_DTCM" SG_ 1478 TrlTire9_Stat 0;
BA_ "GenSigTimeoutTime_ECM" SG_ 1478 TrlTire9_Stat 0;
BA_ "GenSigTimeoutTime_EVCU2" SG_ 1478 TrlTire9_Stat 0;
BA_ "GenSigTimeoutTime_GNMM" SG_ 1478 TrlTire9_Stat 0;
BA_ "GenSigTimeoutTime_HCP" SG_ 1478 TrlTire9_Stat 0;
BA_ "GenSigTimeoutTime_RFHM" SG_ 1478 TrlTire9_Stat 0;
BA_ "GenSigTimeoutTime_SGW" SG_ 1478 TrlTire9_Stat 0;
BA_ "GenSigTimeoutTime_TCM" SG_ 1478 TrlTire9_Stat 0;
BA_ "GenSigSendType" SG_ 1478 TrlTPM_ServiceReq 3;
BA_ "GenSigTimeoutTime_AGSM" SG_ 1478 TrlTPM_ServiceReq 0;
BA_ "GenSigTimeoutTime_BCM" SG_ 1478 TrlTPM_ServiceReq 0;
BA_ "GenSigTimeoutTime_BSM" SG_ 1478 TrlTPM_ServiceReq 0;
BA_ "GenSigTimeoutTime_CADM" SG_ 1478 TrlTPM_ServiceReq 0;
BA_ "GenSigTimeoutTime_DMSM" SG_ 1478 TrlTPM_ServiceReq 0;
BA_ "GenSigTimeoutTime_DTCM" SG_ 1478 TrlTPM_ServiceReq 0;
BA_ "GenSigTimeoutTime_ECM" SG_ 1478 TrlTPM_ServiceReq 0;
BA_ "GenSigTimeoutTime_EVCU2" SG_ 1478 TrlTPM_ServiceReq 0;
BA_ "GenSigTimeoutTime_GNMM" SG_ 1478 TrlTPM_ServiceReq 0;
BA_ "GenSigTimeoutTime_HCP" SG_ 1478 TrlTPM_ServiceReq 0;
BA_ "GenSigTimeoutTime_RFHM" SG_ 1478 TrlTPM_ServiceReq 0;
BA_ "GenSigTimeoutTime_SGW" SG_ 1478 TrlTPM_ServiceReq 0;
BA_ "GenSigTimeoutTime_TCM" SG_ 1478 TrlTPM_ServiceReq 0;
BA_ "GenSigStartValue" SG_ 1478 TrlTPMSetPress_TTPM 500;
BA_ "GenSigSendType" SG_ 1478 TrlTPMSetPress_TTPM 3;
BA_ "GenSigTimeoutTime_AGSM" SG_ 1478 TrlTPMSetPress_TTPM 0;
BA_ "GenSigTimeoutTime_BCM" SG_ 1478 TrlTPMSetPress_TTPM 0;
BA_ "GenSigTimeoutTime_BSM" SG_ 1478 TrlTPMSetPress_TTPM 0;
BA_ "GenSigTimeoutTime_CADM" SG_ 1478 TrlTPMSetPress_TTPM 0;
BA_ "GenSigTimeoutTime_DMSM" SG_ 1478 TrlTPMSetPress_TTPM 0;
BA_ "GenSigTimeoutTime_DTCM" SG_ 1478 TrlTPMSetPress_TTPM 0;
BA_ "GenSigTimeoutTime_ECM" SG_ 1478 TrlTPMSetPress_TTPM 0;
BA_ "GenSigTimeoutTime_EVCU2" SG_ 1478 TrlTPMSetPress_TTPM 0;
BA_ "GenSigTimeoutTime_GNMM" SG_ 1478 TrlTPMSetPress_TTPM 0;
BA_ "GenSigTimeoutTime_HCP" SG_ 1478 TrlTPMSetPress_TTPM 0;
BA_ "GenSigTimeoutTime_RFHM" SG_ 1478 TrlTPMSetPress_TTPM 0;
BA_ "GenSigTimeoutTime_SGW" SG_ 1478 TrlTPMSetPress_TTPM 0;
BA_ "GenSigTimeoutTime_TCM" SG_ 1478 TrlTPMSetPress_TTPM 0;
BA_ "GenSigTimeoutTime_AGSM" SG_ 278 CODE_CLR_TCM 0;
BA_ "GenSigTimeoutTime_BCM" SG_ 278 CODE_CLR_TCM 0;
BA_ "GenSigTimeoutTime_BSM" SG_ 278 CODE_CLR_TCM 0;
BA_ "GenSigTimeoutTime_CADM" SG_ 278 CODE_CLR_TCM 0;
BA_ "GenSigTimeoutTime_DMSM" SG_ 278 CODE_CLR_TCM 0;
BA_ "GenSigTimeoutTime_DTCM" SG_ 278 CODE_CLR_TCM 0;
BA_ "GenSigTimeoutTime_EVCU2" SG_ 278 CODE_CLR_TCM 0;
BA_ "GenSigTimeoutTime_GNMM" SG_ 278 CODE_CLR_TCM 0;
BA_ "GenSigTimeoutTime_HCP" SG_ 278 CODE_CLR_TCM 0;
BA_ "GenSigTimeoutTime_IPC" SG_ 278 CODE_CLR_TCM 0;
BA_ "GenSigTimeoutTime_RFHM" SG_ 278 CODE_CLR_TCM 0;
BA_ "GenSigTimeoutTime_SGW" SG_ 278 CODE_CLR_TCM 0;
BA_ "GenSigTimeoutTime_TCM" SG_ 278 CODE_CLR_TCM 0;
BA_ "GenSigTimeoutTime_AGSM" SG_ 278 CrankEnable_Fast 0;
BA_ "GenSigTimeoutTime_BCM" SG_ 278 CrankEnable_Fast 0;
BA_ "GenSigTimeoutTime_BSM" SG_ 278 CrankEnable_Fast 0;
BA_ "GenSigTimeoutTime_CADM" SG_ 278 CrankEnable_Fast 0;
BA_ "GenSigTimeoutTime_DMSM" SG_ 278 CrankEnable_Fast 0;
BA_ "GenSigTimeoutTime_DTCM" SG_ 278 CrankEnable_Fast 0;
BA_ "GenSigTimeoutTime_EVCU2" SG_ 278 CrankEnable_Fast 0;
BA_ "GenSigTimeoutTime_GNMM" SG_ 278 CrankEnable_Fast 0;
BA_ "GenSigTimeoutTime_HCP" SG_ 278 CrankEnable_Fast 0;
BA_ "GenSigTimeoutTime_IPC" SG_ 278 CrankEnable_Fast 0;
BA_ "GenSigTimeoutTime_SGW" SG_ 278 CrankEnable_Fast 0;
BA_ "GenSigTimeoutTime_TCM" SG_ 278 CrankEnable_Fast 0;
BA_ "GenSigTimeoutTime_AGSM" SG_ 278 CRC_TRANSM1 0;
BA_ "GenSigTimeoutTime_DMSM" SG_ 278 CRC_TRANSM1 0;
BA_ "GenSigTimeoutTime_EVCU2" SG_ 278 CRC_TRANSM1 0;
BA_ "GenSigTimeoutTime_GNMM" SG_ 278 CRC_TRANSM1 0;
BA_ "GenSigTimeoutTime_IPC" SG_ 278 CRC_TRANSM1 0;
BA_ "GenSigTimeoutTime_RFHM" SG_ 278 CRC_TRANSM1 0;
BA_ "GenSigTimeoutTime_TCM" SG_ 278 CRC_TRANSM1 0;
BA_ "GenSigTimeoutTime_AGSM" SG_ 278 DriveLineRatio 0;
BA_ "GenSigTimeoutTime_BCM" SG_ 278 DriveLineRatio 0;
BA_ "GenSigTimeoutTime_BSM" SG_ 278 DriveLineRatio 0;
BA_ "GenSigTimeoutTime_CADM" SG_ 278 DriveLineRatio 0;
BA_ "GenSigTimeoutTime_DMSM" SG_ 278 DriveLineRatio 0;
BA_ "GenSigTimeoutTime_DTCM" SG_ 278 DriveLineRatio 0;
BA_ "GenSigTimeoutTime_EVCU2" SG_ 278 DriveLineRatio 0;
BA_ "GenSigTimeoutTime_GNMM" SG_ 278 DriveLineRatio 0;
BA_ "GenSigTimeoutTime_HCP" SG_ 278 DriveLineRatio 0;
BA_ "GenSigTimeoutTime_IPC" SG_ 278 DriveLineRatio 0;
BA_ "GenSigTimeoutTime_RFHM" SG_ 278 DriveLineRatio 0;
BA_ "GenSigTimeoutTime_SGW" SG_ 278 DriveLineRatio 0;
BA_ "GenSigTimeoutTime_TCM" SG_ 278 DriveLineRatio 0;
BA_ "GenSigStartValue" SG_ 278 EngTrq_Rq_TCM 2047;
BA_ "GenSigTimeoutTime_AGSM" SG_ 278 EngTrq_Rq_TCM 0;
BA_ "GenSigTimeoutTime_BCM" SG_ 278 EngTrq_Rq_TCM 0;
BA_ "GenSigTimeoutTime_CADM" SG_ 278 EngTrq_Rq_TCM 0;
BA_ "GenSigTimeoutTime_DMSM" SG_ 278 EngTrq_Rq_TCM 0;
BA_ "GenSigTimeoutTime_DTCM" SG_ 278 EngTrq_Rq_TCM 0;
BA_ "GenSigTimeoutTime_EVCU2" SG_ 278 EngTrq_Rq_TCM 0;
BA_ "GenSigTimeoutTime_GNMM" SG_ 278 EngTrq_Rq_TCM 0;
BA_ "GenSigTimeoutTime_IPC" SG_ 278 EngTrq_Rq_TCM 0;
BA_ "GenSigTimeoutTime_RFHM" SG_ 278 EngTrq_Rq_TCM 0;
BA_ "GenSigTimeoutTime_SGW" SG_ 278 EngTrq_Rq_TCM 0;
BA_ "GenSigTimeoutTime_TCM" SG_ 278 EngTrq_Rq_TCM 0;
BA_ "GenSigStartValue" SG_ 278 MaxTrqDes 2047;
BA_ "GenSigTimeoutTime_AGSM" SG_ 278 MaxTrqDes 0;
BA_ "GenSigTimeoutTime_BCM" SG_ 278 MaxTrqDes 0;
BA_ "GenSigTimeoutTime_BSM" SG_ 278 MaxTrqDes 0;
BA_ "GenSigTimeoutTime_CADM" SG_ 278 MaxTrqDes 0;
BA_ "GenSigTimeoutTime_DMSM" SG_ 278 MaxTrqDes 0;
BA_ "GenSigTimeoutTime_DTCM" SG_ 278 MaxTrqDes 0;
BA_ "GenSigTimeoutTime_EVCU2" SG_ 278 MaxTrqDes 0;
BA_ "GenSigTimeoutTime_GNMM" SG_ 278 MaxTrqDes 0;
BA_ "GenSigTimeoutTime_IPC" SG_ 278 MaxTrqDes 0;
BA_ "GenSigTimeoutTime_RFHM" SG_ 278 MaxTrqDes 0;
BA_ "GenSigTimeoutTime_SGW" SG_ 278 MaxTrqDes 0;
BA_ "GenSigTimeoutTime_TCM" SG_ 278 MaxTrqDes 0;
BA_ "GenSigTimeoutTime_AGSM" SG_ 278 MessageCounter_TRANSM1 0;
BA_ "GenSigTimeoutTime_DMSM" SG_ 278 MessageCounter_TRANSM1 0;
BA_ "GenSigTimeoutTime_EVCU2" SG_ 278 MessageCounter_TRANSM1 0;
BA_ "GenSigTimeoutTime_GNMM" SG_ 278 MessageCounter_TRANSM1 0;
BA_ "GenSigTimeoutTime_IPC" SG_ 278 MessageCounter_TRANSM1 0;
BA_ "GenSigTimeoutTime_RFHM" SG_ 278 MessageCounter_TRANSM1 0;
BA_ "GenSigTimeoutTime_TCM" SG_ 278 MessageCounter_TRANSM1 0;
BA_ "GenSigTimeoutTime_AGSM" SG_ 278 PaddleShiftRequest 0;
BA_ "GenSigTimeoutTime_BCM" SG_ 278 PaddleShiftRequest 0;
BA_ "GenSigTimeoutTime_BSM" SG_ 278 PaddleShiftRequest 0;
BA_ "GenSigTimeoutTime_CADM" SG_ 278 PaddleShiftRequest 0;
BA_ "GenSigTimeoutTime_DMSM" SG_ 278 PaddleShiftRequest 0;
BA_ "GenSigTimeoutTime_DTCM" SG_ 278 PaddleShiftRequest 0;
BA_ "GenSigTimeoutTime_EVCU2" SG_ 278 PaddleShiftRequest 0;
BA_ "GenSigTimeoutTime_GNMM" SG_ 278 PaddleShiftRequest 0;
BA_ "GenSigTimeoutTime_HCP" SG_ 278 PaddleShiftRequest 0;
BA_ "GenSigTimeoutTime_IPC" SG_ 278 PaddleShiftRequest 0;
BA_ "GenSigTimeoutTime_RFHM" SG_ 278 PaddleShiftRequest 0;
BA_ "GenSigTimeoutTime_SGW" SG_ 278 PaddleShiftRequest 0;
BA_ "GenSigTimeoutTime_TCM" SG_ 278 PaddleShiftRequest 0;
BA_ "GenSigTimeoutTime_AGSM" SG_ 278 REPRGD_PFC_CLR_TCM 0;
BA_ "GenSigTimeoutTime_BCM" SG_ 278 REPRGD_PFC_CLR_TCM 0;
BA_ "GenSigTimeoutTime_BSM" SG_ 278 REPRGD_PFC_CLR_TCM 0;
BA_ "GenSigTimeoutTime_CADM" SG_ 278 REPRGD_PFC_CLR_TCM 0;
BA_ "GenSigTimeoutTime_DMSM" SG_ 278 REPRGD_PFC_CLR_TCM 0;
BA_ "GenSigTimeoutTime_DTCM" SG_ 278 REPRGD_PFC_CLR_TCM 0;
BA_ "GenSigTimeoutTime_EVCU2" SG_ 278 REPRGD_PFC_CLR_TCM 0;
BA_ "GenSigTimeoutTime_GNMM" SG_ 278 REPRGD_PFC_CLR_TCM 0;
BA_ "GenSigTimeoutTime_HCP" SG_ 278 REPRGD_PFC_CLR_TCM 0;
BA_ "GenSigTimeoutTime_IPC" SG_ 278 REPRGD_PFC_CLR_TCM 0;
BA_ "GenSigTimeoutTime_RFHM" SG_ 278 REPRGD_PFC_CLR_TCM 0;
BA_ "GenSigTimeoutTime_SGW" SG_ 278 REPRGD_PFC_CLR_TCM 0;
BA_ "GenSigTimeoutTime_TCM" SG_ 278 REPRGD_PFC_CLR_TCM 0;
BA_ "GenSigTimeoutTime_AGSM" SG_ 278 Secure_Idle_Sts 0;
BA_ "GenSigTimeoutTime_BCM" SG_ 278 Secure_Idle_Sts 0;
BA_ "GenSigTimeoutTime_BSM" SG_ 278 Secure_Idle_Sts 0;
BA_ "GenSigTimeoutTime_CADM" SG_ 278 Secure_Idle_Sts 0;
BA_ "GenSigTimeoutTime_DMSM" SG_ 278 Secure_Idle_Sts 0;
BA_ "GenSigTimeoutTime_DTCM" SG_ 278 Secure_Idle_Sts 0;
BA_ "GenSigTimeoutTime_ECM" SG_ 278 Secure_Idle_Sts 0;
BA_ "GenSigTimeoutTime_EVCU2" SG_ 278 Secure_Idle_Sts 0;
BA_ "GenSigTimeoutTime_GNMM" SG_ 278 Secure_Idle_Sts 0;
BA_ "GenSigTimeoutTime_HCP" SG_ 278 Secure_Idle_Sts 0;
BA_ "GenSigTimeoutTime_IPC" SG_ 278 Secure_Idle_Sts 0;
BA_ "GenSigTimeoutTime_RFHM" SG_ 278 Secure_Idle_Sts 0;
BA_ "GenSigTimeoutTime_TCM" SG_ 278 Secure_Idle_Sts 0;
BA_ "GenSigStartValue" SG_ 278 TargetGear 15;
BA_ "GenSigTimeoutTime_AGSM" SG_ 278 TargetGear 0;
BA_ "GenSigTimeoutTime_DMSM" SG_ 278 TargetGear 0;
BA_ "GenSigTimeoutTime_EVCU2" SG_ 278 TargetGear 0;
BA_ "GenSigTimeoutTime_GNMM" SG_ 278 TargetGear 0;
BA_ "GenSigTimeoutTime_RFHM" SG_ 278 TargetGear 0;
BA_ "GenSigTimeoutTime_TCM" SG_ 278 TargetGear 0;
BA_ "GenSigTimeoutTime_AGSM" SG_ 278 TCASERANGESTATUS_TCM 0;
BA_ "GenSigTimeoutTime_BCM" SG_ 278 TCASERANGESTATUS_TCM 0;
BA_ "GenSigTimeoutTime_BSM" SG_ 278 TCASERANGESTATUS_TCM 0;
BA_ "GenSigTimeoutTime_CADM" SG_ 278 TCASERANGESTATUS_TCM 0;
BA_ "GenSigTimeoutTime_DMSM" SG_ 278 TCASERANGESTATUS_TCM 0;
BA_ "GenSigTimeoutTime_DTCM" SG_ 278 TCASERANGESTATUS_TCM 0;
BA_ "GenSigTimeoutTime_EVCU2" SG_ 278 TCASERANGESTATUS_TCM 0;
BA_ "GenSigTimeoutTime_GNMM" SG_ 278 TCASERANGESTATUS_TCM 0;
BA_ "GenSigTimeoutTime_HCP" SG_ 278 TCASERANGESTATUS_TCM 0;
BA_ "GenSigTimeoutTime_IPC" SG_ 278 TCASERANGESTATUS_TCM 0;
BA_ "GenSigTimeoutTime_RFHM" SG_ 278 TCASERANGESTATUS_TCM 0;
BA_ "GenSigTimeoutTime_SGW" SG_ 278 TCASERANGESTATUS_TCM 0;
BA_ "GenSigTimeoutTime_TCM" SG_ 278 TCASERANGESTATUS_TCM 0;
BA_ "GenSigStartValue" SG_ 278 TCM_ActMode 14;
BA_ "GenSigTimeoutTime_AGSM" SG_ 278 TCM_ActMode 0;
BA_ "GenSigTimeoutTime_BCM" SG_ 278 TCM_ActMode 0;
BA_ "GenSigTimeoutTime_BSM" SG_ 278 TCM_ActMode 0;
BA_ "GenSigTimeoutTime_CADM" SG_ 278 TCM_ActMode 0;
BA_ "GenSigTimeoutTime_DMSM" SG_ 278 TCM_ActMode 0;
BA_ "GenSigTimeoutTime_DTCM" SG_ 278 TCM_ActMode 0;
BA_ "GenSigTimeoutTime_ECM" SG_ 278 TCM_ActMode 0;
BA_ "GenSigTimeoutTime_EVCU2" SG_ 278 TCM_ActMode 0;
BA_ "GenSigTimeoutTime_GNMM" SG_ 278 TCM_ActMode 0;
BA_ "GenSigTimeoutTime_HCP" SG_ 278 TCM_ActMode 0;
BA_ "GenSigTimeoutTime_IPC" SG_ 278 TCM_ActMode 0;
BA_ "GenSigTimeoutTime_RFHM" SG_ 278 TCM_ActMode 0;
BA_ "GenSigTimeoutTime_SGW" SG_ 278 TCM_ActMode 0;
BA_ "GenSigTimeoutTime_TCM" SG_ 278 TCM_ActMode 0;
BA_ "GenSigTimeoutTime_AGSM" SG_ 278 TCMLnchCtrlAllowed 0;
BA_ "GenSigTimeoutTime_BCM" SG_ 278 TCMLnchCtrlAllowed 0;
BA_ "GenSigTimeoutTime_BSM" SG_ 278 TCMLnchCtrlAllowed 0;
BA_ "GenSigTimeoutTime_CADM" SG_ 278 TCMLnchCtrlAllowed 0;
BA_ "GenSigTimeoutTime_DMSM" SG_ 278 TCMLnchCtrlAllowed 0;
BA_ "GenSigTimeoutTime_DTCM" SG_ 278 TCMLnchCtrlAllowed 0;
BA_ "GenSigTimeoutTime_ECM" SG_ 278 TCMLnchCtrlAllowed 0;
BA_ "GenSigTimeoutTime_EVCU2" SG_ 278 TCMLnchCtrlAllowed 0;
BA_ "GenSigTimeoutTime_GNMM" SG_ 278 TCMLnchCtrlAllowed 0;
BA_ "GenSigTimeoutTime_HCP" SG_ 278 TCMLnchCtrlAllowed 0;
BA_ "GenSigTimeoutTime_IPC" SG_ 278 TCMLnchCtrlAllowed 0;
BA_ "GenSigTimeoutTime_RFHM" SG_ 278 TCMLnchCtrlAllowed 0;
BA_ "GenSigTimeoutTime_SGW" SG_ 278 TCMLnchCtrlAllowed 0;
BA_ "GenSigTimeoutTime_TCM" SG_ 278 TCMLnchCtrlAllowed 0;
BA_ "GenSigTimeoutTime_AGSM" SG_ 278 TorqueAmpTransmission 0;
BA_ "GenSigTimeoutTime_DMSM" SG_ 278 TorqueAmpTransmission 0;
BA_ "GenSigTimeoutTime_EVCU2" SG_ 278 TorqueAmpTransmission 0;
BA_ "GenSigTimeoutTime_GNMM" SG_ 278 TorqueAmpTransmission 0;
BA_ "GenSigTimeoutTime_IPC" SG_ 278 TorqueAmpTransmission 0;
BA_ "GenSigTimeoutTime_RFHM" SG_ 278 TorqueAmpTransmission 0;
BA_ "GenSigTimeoutTime_TCM" SG_ 278 TorqueAmpTransmission 0;
BA_ "GenSigTimeoutTime_AGSM" SG_ 278 TorqueConverterDisengageSpeed 0;
BA_ "GenSigTimeoutTime_BCM" SG_ 278 TorqueConverterDisengageSpeed 0;
BA_ "GenSigTimeoutTime_BSM" SG_ 278 TorqueConverterDisengageSpeed 0;
BA_ "GenSigTimeoutTime_CADM" SG_ 278 TorqueConverterDisengageSpeed 0;
BA_ "GenSigTimeoutTime_DMSM" SG_ 278 TorqueConverterDisengageSpeed 0;
BA_ "GenSigTimeoutTime_DTCM" SG_ 278 TorqueConverterDisengageSpeed 0;
BA_ "GenSigTimeoutTime_ECM" SG_ 278 TorqueConverterDisengageSpeed 0;
BA_ "GenSigTimeoutTime_EVCU2" SG_ 278 TorqueConverterDisengageSpeed 0;
BA_ "GenSigTimeoutTime_GNMM" SG_ 278 TorqueConverterDisengageSpeed 0;
BA_ "GenSigTimeoutTime_IPC" SG_ 278 TorqueConverterDisengageSpeed 0;
BA_ "GenSigTimeoutTime_RFHM" SG_ 278 TorqueConverterDisengageSpeed 0;
BA_ "GenSigTimeoutTime_SGW" SG_ 278 TorqueConverterDisengageSpeed 0;
BA_ "GenSigTimeoutTime_TCM" SG_ 278 TorqueConverterDisengageSpeed 0;
BA_ "GenSigTimeoutTime_AGSM" SG_ 278 TorqueConverterSTO 0;
BA_ "GenSigTimeoutTime_BCM" SG_ 278 TorqueConverterSTO 0;
BA_ "GenSigTimeoutTime_BSM" SG_ 278 TorqueConverterSTO 0;
BA_ "GenSigTimeoutTime_CADM" SG_ 278 TorqueConverterSTO 0;
BA_ "GenSigTimeoutTime_DMSM" SG_ 278 TorqueConverterSTO 0;
BA_ "GenSigTimeoutTime_DTCM" SG_ 278 TorqueConverterSTO 0;
BA_ "GenSigTimeoutTime_EVCU2" SG_ 278 TorqueConverterSTO 0;
BA_ "GenSigTimeoutTime_GNMM" SG_ 278 TorqueConverterSTO 0;
BA_ "GenSigTimeoutTime_IPC" SG_ 278 TorqueConverterSTO 0;
BA_ "GenSigTimeoutTime_RFHM" SG_ 278 TorqueConverterSTO 0;
BA_ "GenSigTimeoutTime_TCM" SG_ 278 TorqueConverterSTO 0;
BA_ "GenSigTimeoutTime_AGSM" SG_ 278 TorqueConverterSts 0;
BA_ "GenSigTimeoutTime_BCM" SG_ 278 TorqueConverterSts 0;
BA_ "GenSigTimeoutTime_BSM" SG_ 278 TorqueConverterSts 0;
BA_ "GenSigTimeoutTime_CADM" SG_ 278 TorqueConverterSts 0;
BA_ "GenSigTimeoutTime_DMSM" SG_ 278 TorqueConverterSts 0;
BA_ "GenSigTimeoutTime_DTCM" SG_ 278 TorqueConverterSts 0;
BA_ "GenSigTimeoutTime_EVCU2" SG_ 278 TorqueConverterSts 0;
BA_ "GenSigTimeoutTime_GNMM" SG_ 278 TorqueConverterSts 0;
BA_ "GenSigTimeoutTime_IPC" SG_ 278 TorqueConverterSts 0;
BA_ "GenSigTimeoutTime_RFHM" SG_ 278 TorqueConverterSts 0;
BA_ "GenSigTimeoutTime_TCM" SG_ 278 TorqueConverterSts 0;
BA_ "GenSigTimeoutTime_AGSM" SG_ 278 TRANS_ADAS_Inhibit 0;
BA_ "GenSigTimeoutTime_CADM" SG_ 278 TRANS_ADAS_Inhibit 0;
BA_ "GenSigTimeoutTime_DMSM" SG_ 278 TRANS_ADAS_Inhibit 0;
BA_ "GenSigTimeoutTime_DTCM" SG_ 278 TRANS_ADAS_Inhibit 0;
BA_ "GenSigTimeoutTime_ECM" SG_ 278 TRANS_ADAS_Inhibit 0;
BA_ "GenSigTimeoutTime_EVCU2" SG_ 278 TRANS_ADAS_Inhibit 0;
BA_ "GenSigTimeoutTime_GNMM" SG_ 278 TRANS_ADAS_Inhibit 0;
BA_ "GenSigTimeoutTime_HCP" SG_ 278 TRANS_ADAS_Inhibit 0;
BA_ "GenSigTimeoutTime_IPC" SG_ 278 TRANS_ADAS_Inhibit 0;
BA_ "GenSigTimeoutTime_RFHM" SG_ 278 TRANS_ADAS_Inhibit 0;
BA_ "GenSigTimeoutTime_SGW" SG_ 278 TRANS_ADAS_Inhibit 0;
BA_ "GenSigTimeoutTime_TCM" SG_ 278 TRANS_ADAS_Inhibit 0;
BA_ "GenSigTimeoutTime_AGSM" SG_ 278 TransLosses 0;
BA_ "GenSigTimeoutTime_BCM" SG_ 278 TransLosses 0;
BA_ "GenSigTimeoutTime_BSM" SG_ 278 TransLosses 0;
BA_ "GenSigTimeoutTime_CADM" SG_ 278 TransLosses 0;
BA_ "GenSigTimeoutTime_DMSM" SG_ 278 TransLosses 0;
BA_ "GenSigTimeoutTime_DTCM" SG_ 278 TransLosses 0;
BA_ "GenSigTimeoutTime_EVCU2" SG_ 278 TransLosses 0;
BA_ "GenSigTimeoutTime_GNMM" SG_ 278 TransLosses 0;
BA_ "GenSigTimeoutTime_HCP" SG_ 278 TransLosses 0;
BA_ "GenSigTimeoutTime_IPC" SG_ 278 TransLosses 0;
BA_ "GenSigTimeoutTime_RFHM" SG_ 278 TransLosses 0;
BA_ "GenSigTimeoutTime_SGW" SG_ 278 TransLosses 0;
BA_ "GenSigTimeoutTime_TCM" SG_ 278 TransLosses 0;
BA_ "GenSigTimeoutTime_AGSM" SG_ 278 TransmissionSailingSts 0;
BA_ "GenSigTimeoutTime_BSM" SG_ 278 TransmissionSailingSts 0;
BA_ "GenSigTimeoutTime_DMSM" SG_ 278 TransmissionSailingSts 0;
BA_ "GenSigTimeoutTime_DTCM" SG_ 278 TransmissionSailingSts 0;
BA_ "GenSigTimeoutTime_EVCU2" SG_ 278 TransmissionSailingSts 0;
BA_ "GenSigTimeoutTime_GNMM" SG_ 278 TransmissionSailingSts 0;
BA_ "GenSigTimeoutTime_HCP" SG_ 278 TransmissionSailingSts 0;
BA_ "GenSigTimeoutTime_IPC" SG_ 278 TransmissionSailingSts 0;
BA_ "GenSigTimeoutTime_RFHM" SG_ 278 TransmissionSailingSts 0;
BA_ "GenSigTimeoutTime_SGW" SG_ 278 TransmissionSailingSts 0;
BA_ "GenSigTimeoutTime_TCM" SG_ 278 TransmissionSailingSts 0;
BA_ "GenSigTimeoutTime_AGSM" SG_ 278 TrqCtrlModeReq 0;
BA_ "GenSigTimeoutTime_BCM" SG_ 278 TrqCtrlModeReq 0;
BA_ "GenSigTimeoutTime_CADM" SG_ 278 TrqCtrlModeReq 0;
BA_ "GenSigTimeoutTime_DMSM" SG_ 278 TrqCtrlModeReq 0;
BA_ "GenSigTimeoutTime_DTCM" SG_ 278 TrqCtrlModeReq 0;
BA_ "GenSigTimeoutTime_EVCU2" SG_ 278 TrqCtrlModeReq 0;
BA_ "GenSigTimeoutTime_GNMM" SG_ 278 TrqCtrlModeReq 0;
BA_ "GenSigTimeoutTime_IPC" SG_ 278 TrqCtrlModeReq 0;
BA_ "GenSigTimeoutTime_RFHM" SG_ 278 TrqCtrlModeReq 0;
BA_ "GenSigTimeoutTime_SGW" SG_ 278 TrqCtrlModeReq 0;
BA_ "GenSigTimeoutTime_TCM" SG_ 278 TrqCtrlModeReq 0;
BA_ "GenSigTimeoutTime_AGSM" SG_ 278 TrqCtrlModeReq_Slow 0;
BA_ "GenSigTimeoutTime_BCM" SG_ 278 TrqCtrlModeReq_Slow 0;
BA_ "GenSigTimeoutTime_BSM" SG_ 278 TrqCtrlModeReq_Slow 0;
BA_ "GenSigTimeoutTime_CADM" SG_ 278 TrqCtrlModeReq_Slow 0;
BA_ "GenSigTimeoutTime_DMSM" SG_ 278 TrqCtrlModeReq_Slow 0;
BA_ "GenSigTimeoutTime_DTCM" SG_ 278 TrqCtrlModeReq_Slow 0;
BA_ "GenSigTimeoutTime_ECM" SG_ 278 TrqCtrlModeReq_Slow 0;
BA_ "GenSigTimeoutTime_EVCU2" SG_ 278 TrqCtrlModeReq_Slow 0;
BA_ "GenSigTimeoutTime_GNMM" SG_ 278 TrqCtrlModeReq_Slow 0;
BA_ "GenSigTimeoutTime_IPC" SG_ 278 TrqCtrlModeReq_Slow 0;
BA_ "GenSigTimeoutTime_RFHM" SG_ 278 TrqCtrlModeReq_Slow 0;
BA_ "GenSigTimeoutTime_SGW" SG_ 278 TrqCtrlModeReq_Slow 0;
BA_ "GenSigTimeoutTime_TCM" SG_ 278 TrqCtrlModeReq_Slow 0;
BA_ "GenSigTimeoutTime_AGSM" SG_ 278 TxIdleRq 0;
BA_ "GenSigTimeoutTime_BCM" SG_ 278 TxIdleRq 0;
BA_ "GenSigTimeoutTime_BSM" SG_ 278 TxIdleRq 0;
BA_ "GenSigTimeoutTime_CADM" SG_ 278 TxIdleRq 0;
BA_ "GenSigTimeoutTime_DMSM" SG_ 278 TxIdleRq 0;
BA_ "GenSigTimeoutTime_DTCM" SG_ 278 TxIdleRq 0;
BA_ "GenSigTimeoutTime_EVCU2" SG_ 278 TxIdleRq 0;
BA_ "GenSigTimeoutTime_GNMM" SG_ 278 TxIdleRq 0;
BA_ "GenSigTimeoutTime_HCP" SG_ 278 TxIdleRq 0;
BA_ "GenSigTimeoutTime_IPC" SG_ 278 TxIdleRq 0;
BA_ "GenSigTimeoutTime_RFHM" SG_ 278 TxIdleRq 0;
BA_ "GenSigTimeoutTime_SGW" SG_ 278 TxIdleRq 0;
BA_ "GenSigTimeoutTime_TCM" SG_ 278 TxIdleRq 0;
BA_ "GenSigSendType" SG_ 278 Vehicle_Hold_Rq 5;
BA_ "GenSigTimeoutTime_AGSM" SG_ 278 Vehicle_Hold_Rq 0;
BA_ "GenSigTimeoutTime_BCM" SG_ 278 Vehicle_Hold_Rq 0;
BA_ "GenSigTimeoutTime_CADM" SG_ 278 Vehicle_Hold_Rq 0;
BA_ "GenSigTimeoutTime_DMSM" SG_ 278 Vehicle_Hold_Rq 0;
BA_ "GenSigTimeoutTime_DTCM" SG_ 278 Vehicle_Hold_Rq 0;
BA_ "GenSigTimeoutTime_ECM" SG_ 278 Vehicle_Hold_Rq 0;
BA_ "GenSigTimeoutTime_EVCU2" SG_ 278 Vehicle_Hold_Rq 0;
BA_ "GenSigTimeoutTime_GNMM" SG_ 278 Vehicle_Hold_Rq 0;
BA_ "GenSigTimeoutTime_HCP" SG_ 278 Vehicle_Hold_Rq 0;
BA_ "GenSigTimeoutTime_IPC" SG_ 278 Vehicle_Hold_Rq 0;
BA_ "GenSigTimeoutTime_RFHM" SG_ 278 Vehicle_Hold_Rq 0;
BA_ "GenSigTimeoutTime_SGW" SG_ 278 Vehicle_Hold_Rq 0;
BA_ "GenSigTimeoutTime_TCM" SG_ 278 Vehicle_Hold_Rq 0;
BA_ "GenSigStartValue" SG_ 520 AirFlowRequest_TCM 127;
BA_ "GenSigTimeoutTime_AGSM" SG_ 520 AirFlowRequest_TCM 0;
BA_ "GenSigTimeoutTime_BCM" SG_ 520 AirFlowRequest_TCM 0;
BA_ "GenSigTimeoutTime_BSM" SG_ 520 AirFlowRequest_TCM 0;
BA_ "GenSigTimeoutTime_CADM" SG_ 520 AirFlowRequest_TCM 0;
BA_ "GenSigTimeoutTime_DMSM" SG_ 520 AirFlowRequest_TCM 0;
BA_ "GenSigTimeoutTime_DTCM" SG_ 520 AirFlowRequest_TCM 0;
BA_ "GenSigTimeoutTime_EVCU2" SG_ 520 AirFlowRequest_TCM 0;
BA_ "GenSigTimeoutTime_GNMM" SG_ 520 AirFlowRequest_TCM 0;
BA_ "GenSigTimeoutTime_HCP" SG_ 520 AirFlowRequest_TCM 0;
BA_ "GenSigTimeoutTime_IPC" SG_ 520 AirFlowRequest_TCM 0;
BA_ "GenSigTimeoutTime_RFHM" SG_ 520 AirFlowRequest_TCM 0;
BA_ "GenSigTimeoutTime_SGW" SG_ 520 AirFlowRequest_TCM 0;
BA_ "GenSigTimeoutTime_TCM" SG_ 520 AirFlowRequest_TCM 0;
BA_ "GenSigTimeoutTime_BCM" SG_ 520 APCM_Rq 0;
BA_ "GenSigTimeoutTime_BSM" SG_ 520 APCM_Rq 0;
BA_ "GenSigTimeoutTime_CADM" SG_ 520 APCM_Rq 0;
BA_ "GenSigTimeoutTime_DMSM" SG_ 520 APCM_Rq 0;
BA_ "GenSigTimeoutTime_DTCM" SG_ 520 APCM_Rq 0;
BA_ "GenSigTimeoutTime_EVCU2" SG_ 520 APCM_Rq 0;
BA_ "GenSigTimeoutTime_GNMM" SG_ 520 APCM_Rq 0;
BA_ "GenSigTimeoutTime_HCP" SG_ 520 APCM_Rq 0;
BA_ "GenSigTimeoutTime_IPC" SG_ 520 APCM_Rq 0;
BA_ "GenSigTimeoutTime_RFHM" SG_ 520 APCM_Rq 0;
BA_ "GenSigTimeoutTime_TCM" SG_ 520 APCM_Rq 0;
BA_ "GenSigTimeoutTime_DMSM" SG_ 520 CRC_TRANSM2 0;
BA_ "GenSigTimeoutTime_EVCU2" SG_ 520 CRC_TRANSM2 0;
BA_ "GenSigTimeoutTime_RFHM" SG_ 520 CRC_TRANSM2 0;
BA_ "GenSigTimeoutTime_TCM" SG_ 520 CRC_TRANSM2 0;
BA_ "GenSigTimeoutTime_AGSM" SG_ 520 EngShutOffRq_TCM 0;
BA_ "GenSigTimeoutTime_BCM" SG_ 520 EngShutOffRq_TCM 0;
BA_ "GenSigTimeoutTime_BSM" SG_ 520 EngShutOffRq_TCM 0;
BA_ "GenSigTimeoutTime_CADM" SG_ 520 EngShutOffRq_TCM 0;
BA_ "GenSigTimeoutTime_DMSM" SG_ 520 EngShutOffRq_TCM 0;
BA_ "GenSigTimeoutTime_DTCM" SG_ 520 EngShutOffRq_TCM 0;
BA_ "GenSigTimeoutTime_EVCU2" SG_ 520 EngShutOffRq_TCM 0;
BA_ "GenSigTimeoutTime_GNMM" SG_ 520 EngShutOffRq_TCM 0;
BA_ "GenSigTimeoutTime_HCP" SG_ 520 EngShutOffRq_TCM 0;
BA_ "GenSigTimeoutTime_IPC" SG_ 520 EngShutOffRq_TCM 0;
BA_ "GenSigTimeoutTime_RFHM" SG_ 520 EngShutOffRq_TCM 0;
BA_ "GenSigTimeoutTime_SGW" SG_ 520 EngShutOffRq_TCM 0;
BA_ "GenSigTimeoutTime_TCM" SG_ 520 EngShutOffRq_TCM 0;
BA_ "GenSigStartValue" SG_ 520 GearEngagedForDisplay 31;
BA_ "GenSigTimeoutTime_DMSM" SG_ 520 GearEngagedForDisplay 0;
BA_ "GenSigTimeoutTime_EVCU2" SG_ 520 GearEngagedForDisplay 0;
BA_ "GenSigTimeoutTime_TCM" SG_ 520 GearEngagedForDisplay 0;
BA_ "GenSigTimeoutTime_DMSM" SG_ 520 MessageCounter_TRANSM2 0;
BA_ "GenSigTimeoutTime_EVCU2" SG_ 520 MessageCounter_TRANSM2 0;
BA_ "GenSigTimeoutTime_RFHM" SG_ 520 MessageCounter_TRANSM2 0;
BA_ "GenSigTimeoutTime_TCM" SG_ 520 MessageCounter_TRANSM2 0;
BA_ "GenSigStartValue" SG_ 520 OUTPUT_SPEED 65535;
BA_ "GenSigTimeoutTime_AGSM" SG_ 520 OUTPUT_SPEED 0;
BA_ "GenSigTimeoutTime_BCM" SG_ 520 OUTPUT_SPEED 0;
BA_ "GenSigTimeoutTime_CADM" SG_ 520 OUTPUT_SPEED 0;
BA_ "GenSigTimeoutTime_DMSM" SG_ 520 OUTPUT_SPEED 0;
BA_ "GenSigTimeoutTime_EVCU2" SG_ 520 OUTPUT_SPEED 0;
BA_ "GenSigTimeoutTime_GNMM" SG_ 520 OUTPUT_SPEED 0;
BA_ "GenSigTimeoutTime_IPC" SG_ 520 OUTPUT_SPEED 0;
BA_ "GenSigTimeoutTime_RFHM" SG_ 520 OUTPUT_SPEED 0;
BA_ "GenSigTimeoutTime_TCM" SG_ 520 OUTPUT_SPEED 0;
BA_ "GenSigTimeoutTime_AGSM" SG_ 520 OutputSpdPolarity 0;
BA_ "GenSigTimeoutTime_BCM" SG_ 520 OutputSpdPolarity 0;
BA_ "GenSigTimeoutTime_CADM" SG_ 520 OutputSpdPolarity 0;
BA_ "GenSigTimeoutTime_DMSM" SG_ 520 OutputSpdPolarity 0;
BA_ "GenSigTimeoutTime_EVCU2" SG_ 520 OutputSpdPolarity 0;
BA_ "GenSigTimeoutTime_GNMM" SG_ 520 OutputSpdPolarity 0;
BA_ "GenSigTimeoutTime_IPC" SG_ 520 OutputSpdPolarity 0;
BA_ "GenSigTimeoutTime_RFHM" SG_ 520 OutputSpdPolarity 0;
BA_ "GenSigTimeoutTime_TCM" SG_ 520 OutputSpdPolarity 0;
BA_ "GenSigTimeoutTime_AGSM" SG_ 520 PaddlesModeSts 0;
BA_ "GenSigTimeoutTime_BCM" SG_ 520 PaddlesModeSts 0;
BA_ "GenSigTimeoutTime_BSM" SG_ 520 PaddlesModeSts 0;
BA_ "GenSigTimeoutTime_CADM" SG_ 520 PaddlesModeSts 0;
BA_ "GenSigTimeoutTime_DMSM" SG_ 520 PaddlesModeSts 0;
BA_ "GenSigTimeoutTime_DTCM" SG_ 520 PaddlesModeSts 0;
BA_ "GenSigTimeoutTime_ECM" SG_ 520 PaddlesModeSts 0;
BA_ "GenSigTimeoutTime_EVCU2" SG_ 520 PaddlesModeSts 0;
BA_ "GenSigTimeoutTime_GNMM" SG_ 520 PaddlesModeSts 0;
BA_ "GenSigTimeoutTime_IPC" SG_ 520 PaddlesModeSts 0;
BA_ "GenSigTimeoutTime_RFHM" SG_ 520 PaddlesModeSts 0;
BA_ "GenSigTimeoutTime_TCM" SG_ 520 PaddlesModeSts 0;
BA_ "GenSigTimeoutTime_AGSM" SG_ 520 Trans_ESS_Inhibit 0;
BA_ "GenSigTimeoutTime_BCM" SG_ 520 Trans_ESS_Inhibit 0;
BA_ "GenSigTimeoutTime_BSM" SG_ 520 Trans_ESS_Inhibit 0;
BA_ "GenSigTimeoutTime_CADM" SG_ 520 Trans_ESS_Inhibit 0;
BA_ "GenSigTimeoutTime_DMSM" SG_ 520 Trans_ESS_Inhibit 0;
BA_ "GenSigTimeoutTime_DTCM" SG_ 520 Trans_ESS_Inhibit 0;
BA_ "GenSigTimeoutTime_EVCU2" SG_ 520 Trans_ESS_Inhibit 0;
BA_ "GenSigTimeoutTime_GNMM" SG_ 520 Trans_ESS_Inhibit 0;
BA_ "GenSigTimeoutTime_HCP" SG_ 520 Trans_ESS_Inhibit 0;
BA_ "GenSigTimeoutTime_IPC" SG_ 520 Trans_ESS_Inhibit 0;
BA_ "GenSigTimeoutTime_RFHM" SG_ 520 Trans_ESS_Inhibit 0;
BA_ "GenSigTimeoutTime_SGW" SG_ 520 Trans_ESS_Inhibit 0;
BA_ "GenSigTimeoutTime_TCM" SG_ 520 Trans_ESS_Inhibit 0;
BA_ "GenSigTimeoutTime_AGSM" SG_ 520 TransmissionTemperature 0;
BA_ "GenSigTimeoutTime_BCM" SG_ 520 TransmissionTemperature 0;
BA_ "GenSigTimeoutTime_BSM" SG_ 520 TransmissionTemperature 0;
BA_ "GenSigTimeoutTime_CADM" SG_ 520 TransmissionTemperature 0;
BA_ "GenSigTimeoutTime_DMSM" SG_ 520 TransmissionTemperature 0;
BA_ "GenSigTimeoutTime_EVCU2" SG_ 520 TransmissionTemperature 0;
BA_ "GenSigTimeoutTime_GNMM" SG_ 520 TransmissionTemperature 0;
BA_ "GenSigTimeoutTime_HCP" SG_ 520 TransmissionTemperature 0;
BA_ "GenSigTimeoutTime_RFHM" SG_ 520 TransmissionTemperature 0;
BA_ "GenSigTimeoutTime_TCM" SG_ 520 TransmissionTemperature 0;
BA_ "GenSigTimeoutTime_AGSM" SG_ 520 TransReadyForESS 0;
BA_ "GenSigTimeoutTime_BSM" SG_ 520 TransReadyForESS 0;
BA_ "GenSigTimeoutTime_CADM" SG_ 520 TransReadyForESS 0;
BA_ "GenSigTimeoutTime_DMSM" SG_ 520 TransReadyForESS 0;
BA_ "GenSigTimeoutTime_DTCM" SG_ 520 TransReadyForESS 0;
BA_ "GenSigTimeoutTime_EVCU2" SG_ 520 TransReadyForESS 0;
BA_ "GenSigTimeoutTime_GNMM" SG_ 520 TransReadyForESS 0;
BA_ "GenSigTimeoutTime_HCP" SG_ 520 TransReadyForESS 0;
BA_ "GenSigTimeoutTime_IPC" SG_ 520 TransReadyForESS 0;
BA_ "GenSigTimeoutTime_RFHM" SG_ 520 TransReadyForESS 0;
BA_ "GenSigTimeoutTime_SGW" SG_ 520 TransReadyForESS 0;
BA_ "GenSigTimeoutTime_TCM" SG_ 520 TransReadyForESS 0;
BA_ "GenSigTimeoutTime_AGSM" SG_ 520 Trns_EMCC_Achvd 0;
BA_ "GenSigTimeoutTime_BCM" SG_ 520 Trns_EMCC_Achvd 0;
BA_ "GenSigTimeoutTime_BSM" SG_ 520 Trns_EMCC_Achvd 0;
BA_ "GenSigTimeoutTime_CADM" SG_ 520 Trns_EMCC_Achvd 0;
BA_ "GenSigTimeoutTime_DMSM" SG_ 520 Trns_EMCC_Achvd 0;
BA_ "GenSigTimeoutTime_DTCM" SG_ 520 Trns_EMCC_Achvd 0;
BA_ "GenSigTimeoutTime_EVCU2" SG_ 520 Trns_EMCC_Achvd 0;
BA_ "GenSigTimeoutTime_GNMM" SG_ 520 Trns_EMCC_Achvd 0;
BA_ "GenSigTimeoutTime_HCP" SG_ 520 Trns_EMCC_Achvd 0;
BA_ "GenSigTimeoutTime_IPC" SG_ 520 Trns_EMCC_Achvd 0;
BA_ "GenSigTimeoutTime_RFHM" SG_ 520 Trns_EMCC_Achvd 0;
BA_ "GenSigTimeoutTime_TCM" SG_ 520 Trns_EMCC_Achvd 0;
BA_ "GenSigStartValue" SG_ 520 TRNS_StpSt_FLT 1;
BA_ "GenSigTimeoutTime_AGSM" SG_ 520 TRNS_StpSt_FLT 0;
BA_ "GenSigTimeoutTime_BCM" SG_ 520 TRNS_StpSt_FLT 0;
BA_ "GenSigTimeoutTime_BSM" SG_ 520 TRNS_StpSt_FLT 0;
BA_ "GenSigTimeoutTime_CADM" SG_ 520 TRNS_StpSt_FLT 0;
BA_ "GenSigTimeoutTime_DMSM" SG_ 520 TRNS_StpSt_FLT 0;
BA_ "GenSigTimeoutTime_DTCM" SG_ 520 TRNS_StpSt_FLT 0;
BA_ "GenSigTimeoutTime_EVCU2" SG_ 520 TRNS_StpSt_FLT 0;
BA_ "GenSigTimeoutTime_GNMM" SG_ 520 TRNS_StpSt_FLT 0;
BA_ "GenSigTimeoutTime_HCP" SG_ 520 TRNS_StpSt_FLT 0;
BA_ "GenSigTimeoutTime_IPC" SG_ 520 TRNS_StpSt_FLT 0;
BA_ "GenSigTimeoutTime_RFHM" SG_ 520 TRNS_StpSt_FLT 0;
BA_ "GenSigTimeoutTime_SGW" SG_ 520 TRNS_StpSt_FLT 0;
BA_ "GenSigTimeoutTime_TCM" SG_ 520 TRNS_StpSt_FLT 0;
BA_ "GenSigStartValue" SG_ 520 TurbineSpeed 65535;
BA_ "GenSigTimeoutTime_AGSM" SG_ 520 TurbineSpeed 0;
BA_ "GenSigTimeoutTime_BCM" SG_ 520 TurbineSpeed 0;
BA_ "GenSigTimeoutTime_BSM" SG_ 520 TurbineSpeed 0;
BA_ "GenSigTimeoutTime_CADM" SG_ 520 TurbineSpeed 0;
BA_ "GenSigTimeoutTime_DMSM" SG_ 520 TurbineSpeed 0;
BA_ "GenSigTimeoutTime_DTCM" SG_ 520 TurbineSpeed 0;
BA_ "GenSigTimeoutTime_EVCU2" SG_ 520 TurbineSpeed 0;
BA_ "GenSigTimeoutTime_GNMM" SG_ 520 TurbineSpeed 0;
BA_ "GenSigTimeoutTime_IPC" SG_ 520 TurbineSpeed 0;
BA_ "GenSigTimeoutTime_RFHM" SG_ 520 TurbineSpeed 0;
BA_ "GenSigTimeoutTime_TCM" SG_ 520 TurbineSpeed 0;
BA_ "GenSigSendType" SG_ 1450 CrankEnable 3;
BA_ "GenSigTimeoutTime_AGSM" SG_ 1450 CrankEnable 0;
BA_ "GenSigTimeoutTime_BCM" SG_ 1450 CrankEnable 0;
BA_ "GenSigTimeoutTime_BSM" SG_ 1450 CrankEnable 0;
BA_ "GenSigTimeoutTime_CADM" SG_ 1450 CrankEnable 0;
BA_ "GenSigTimeoutTime_DMSM" SG_ 1450 CrankEnable 0;
BA_ "GenSigTimeoutTime_DTCM" SG_ 1450 CrankEnable 0;
BA_ "GenSigTimeoutTime_ECM" SG_ 1450 CrankEnable 0;
BA_ "GenSigTimeoutTime_EVCU2" SG_ 1450 CrankEnable 0;
BA_ "GenSigTimeoutTime_GNMM" SG_ 1450 CrankEnable 0;
BA_ "GenSigTimeoutTime_HCP" SG_ 1450 CrankEnable 0;
BA_ "GenSigTimeoutTime_IPC" SG_ 1450 CrankEnable 0;
BA_ "GenSigTimeoutTime_RFHM" SG_ 1450 CrankEnable 0;
BA_ "GenSigTimeoutTime_TCM" SG_ 1450 CrankEnable 0;
BA_ "GenSigTimeoutTime_DMSM" SG_ 1450 CRC_TRANSM4 0;
BA_ "GenSigTimeoutTime_EVCU2" SG_ 1450 CRC_TRANSM4 0;
BA_ "GenSigTimeoutTime_GNMM" SG_ 1450 CRC_TRANSM4 0;
BA_ "GenSigTimeoutTime_RFHM" SG_ 1450 CRC_TRANSM4 0;
BA_ "GenSigTimeoutTime_TCM" SG_ 1450 CRC_TRANSM4 0;
BA_ "GenSigSendType" SG_ 1450 DriveModeSts 3;
BA_ "GenSigTimeoutTime_AGSM" SG_ 1450 DriveModeSts 0;
BA_ "GenSigTimeoutTime_CADM" SG_ 1450 DriveModeSts 0;
BA_ "GenSigTimeoutTime_DMSM" SG_ 1450 DriveModeSts 0;
BA_ "GenSigTimeoutTime_DTCM" SG_ 1450 DriveModeSts 0;
BA_ "GenSigTimeoutTime_EVCU2" SG_ 1450 DriveModeSts 0;
BA_ "GenSigTimeoutTime_GNMM" SG_ 1450 DriveModeSts 0;
BA_ "GenSigTimeoutTime_RFHM" SG_ 1450 DriveModeSts 0;
BA_ "GenSigSendType" SG_ 1450 GearDisplayForCluster 3;
BA_ "GenSigTimeoutTime_AGSM" SG_ 1450 GearDisplayForCluster 0;
BA_ "GenSigTimeoutTime_BSM" SG_ 1450 GearDisplayForCluster 0;
BA_ "GenSigTimeoutTime_DMSM" SG_ 1450 GearDisplayForCluster 0;
BA_ "GenSigTimeoutTime_DTCM" SG_ 1450 GearDisplayForCluster 0;
BA_ "GenSigTimeoutTime_ECM" SG_ 1450 GearDisplayForCluster 0;
BA_ "GenSigTimeoutTime_EVCU2" SG_ 1450 GearDisplayForCluster 0;
BA_ "GenSigTimeoutTime_GNMM" SG_ 1450 GearDisplayForCluster 0;
BA_ "GenSigTimeoutTime_HCP" SG_ 1450 GearDisplayForCluster 0;
BA_ "GenSigTimeoutTime_RFHM" SG_ 1450 GearDisplayForCluster 0;
BA_ "GenSigTimeoutTime_SGW" SG_ 1450 GearDisplayForCluster 0;
BA_ "GenSigTimeoutTime_TCM" SG_ 1450 GearDisplayForCluster 0;
BA_ "GenSigSendType" SG_ 1450 GearEngaged 3;
BA_ "GenSigTimeoutTime_AGSM" SG_ 1450 GearEngaged 0;
BA_ "GenSigTimeoutTime_DMSM" SG_ 1450 GearEngaged 0;
BA_ "GenSigTimeoutTime_EVCU2" SG_ 1450 GearEngaged 0;
BA_ "GenSigTimeoutTime_GNMM" SG_ 1450 GearEngaged 0;
BA_ "GenSigTimeoutTime_TCM" SG_ 1450 GearEngaged 0;
BA_ "GenSigSendType" SG_ 1450 GearIndicationSts 3;
BA_ "GenSigTimeoutTime_BCM" SG_ 1450 GearIndicationSts 0;
BA_ "GenSigTimeoutTime_BSM" SG_ 1450 GearIndicationSts 0;
BA_ "GenSigTimeoutTime_CADM" SG_ 1450 GearIndicationSts 0;
BA_ "GenSigTimeoutTime_DMSM" SG_ 1450 GearIndicationSts 0;
BA_ "GenSigTimeoutTime_DTCM" SG_ 1450 GearIndicationSts 0;
BA_ "GenSigTimeoutTime_ECM" SG_ 1450 GearIndicationSts 0;
BA_ "GenSigTimeoutTime_EVCU2" SG_ 1450 GearIndicationSts 0;
BA_ "GenSigTimeoutTime_GNMM" SG_ 1450 GearIndicationSts 0;
BA_ "GenSigTimeoutTime_HCP" SG_ 1450 GearIndicationSts 0;
BA_ "GenSigTimeoutTime_RFHM" SG_ 1450 GearIndicationSts 0;
BA_ "GenSigTimeoutTime_SGW" SG_ 1450 GearIndicationSts 0;
BA_ "GenSigTimeoutTime_TCM" SG_ 1450 GearIndicationSts 0;
BA_ "GenSigSendType" SG_ 1450 HAS_SoH_TCM 3;
BA_ "GenSigTimeoutTime_AGSM" SG_ 1450 HAS_SoH_TCM 0;
BA_ "GenSigTimeoutTime_BSM" SG_ 1450 HAS_SoH_TCM 0;
BA_ "GenSigTimeoutTime_DMSM" SG_ 1450 HAS_SoH_TCM 0;
BA_ "GenSigTimeoutTime_DTCM" SG_ 1450 HAS_SoH_TCM 0;
BA_ "GenSigTimeoutTime_ECM" SG_ 1450 HAS_SoH_TCM 0;
BA_ "GenSigTimeoutTime_EVCU2" SG_ 1450 HAS_SoH_TCM 0;
BA_ "GenSigTimeoutTime_GNMM" SG_ 1450 HAS_SoH_TCM 0;
BA_ "GenSigTimeoutTime_HCP" SG_ 1450 HAS_SoH_TCM 0;
BA_ "GenSigTimeoutTime_IPC" SG_ 1450 HAS_SoH_TCM 0;
BA_ "GenSigTimeoutTime_RFHM" SG_ 1450 HAS_SoH_TCM 0;
BA_ "GenSigTimeoutTime_SGW" SG_ 1450 HAS_SoH_TCM 0;
BA_ "GenSigTimeoutTime_TCM" SG_ 1450 HAS_SoH_TCM 0;
BA_ "GenSigSendType" SG_ 1450 LimpHomeSts 3;
BA_ "GenSigTimeoutTime_AGSM" SG_ 1450 LimpHomeSts 0;
BA_ "GenSigTimeoutTime_BSM" SG_ 1450 LimpHomeSts 0;
BA_ "GenSigTimeoutTime_DMSM" SG_ 1450 LimpHomeSts 0;
BA_ "GenSigTimeoutTime_DTCM" SG_ 1450 LimpHomeSts 0;
BA_ "GenSigTimeoutTime_EVCU2" SG_ 1450 LimpHomeSts 0;
BA_ "GenSigTimeoutTime_GNMM" SG_ 1450 LimpHomeSts 0;
BA_ "GenSigTimeoutTime_HCP" SG_ 1450 LimpHomeSts 0;
BA_ "GenSigTimeoutTime_IPC" SG_ 1450 LimpHomeSts 0;
BA_ "GenSigTimeoutTime_RFHM" SG_ 1450 LimpHomeSts 0;
BA_ "GenSigTimeoutTime_SGW" SG_ 1450 LimpHomeSts 0;
BA_ "GenSigTimeoutTime_TCM" SG_ 1450 LimpHomeSts 0;
BA_ "GenSigTimeoutTime_DMSM" SG_ 1450 MessageCounter_TRANSM4 0;
BA_ "GenSigTimeoutTime_EVCU2" SG_ 1450 MessageCounter_TRANSM4 0;
BA_ "GenSigTimeoutTime_GNMM" SG_ 1450 MessageCounter_TRANSM4 0;
BA_ "GenSigTimeoutTime_RFHM" SG_ 1450 MessageCounter_TRANSM4 0;
BA_ "GenSigTimeoutTime_TCM" SG_ 1450 MessageCounter_TRANSM4 0;
BA_ "GenSigSendType" SG_ 1450 MIReq 3;
BA_ "GenSigTimeoutTime_AGSM" SG_ 1450 MIReq 0;
BA_ "GenSigTimeoutTime_BCM" SG_ 1450 MIReq 0;
BA_ "GenSigTimeoutTime_BSM" SG_ 1450 MIReq 0;
BA_ "GenSigTimeoutTime_CADM" SG_ 1450 MIReq 0;
BA_ "GenSigTimeoutTime_DMSM" SG_ 1450 MIReq 0;
BA_ "GenSigTimeoutTime_DTCM" SG_ 1450 MIReq 0;
BA_ "GenSigTimeoutTime_EVCU2" SG_ 1450 MIReq 0;
BA_ "GenSigTimeoutTime_GNMM" SG_ 1450 MIReq 0;
BA_ "GenSigTimeoutTime_HCP" SG_ 1450 MIReq 0;
BA_ "GenSigTimeoutTime_IPC" SG_ 1450 MIReq 0;
BA_ "GenSigTimeoutTime_RFHM" SG_ 1450 MIReq 0;
BA_ "GenSigTimeoutTime_TCM" SG_ 1450 MIReq 0;
BA_ "GenSigSendType" SG_ 1450 OilTemperatureSts 3;
BA_ "GenSigTimeoutTime_AGSM" SG_ 1450 OilTemperatureSts 0;
BA_ "GenSigTimeoutTime_BCM" SG_ 1450 OilTemperatureSts 0;
BA_ "GenSigTimeoutTime_BSM" SG_ 1450 OilTemperatureSts 0;
BA_ "GenSigTimeoutTime_CADM" SG_ 1450 OilTemperatureSts 0;
BA_ "GenSigTimeoutTime_DMSM" SG_ 1450 OilTemperatureSts 0;
BA_ "GenSigTimeoutTime_DTCM" SG_ 1450 OilTemperatureSts 0;
BA_ "GenSigTimeoutTime_ECM" SG_ 1450 OilTemperatureSts 0;
BA_ "GenSigTimeoutTime_EVCU2" SG_ 1450 OilTemperatureSts 0;
BA_ "GenSigTimeoutTime_GNMM" SG_ 1450 OilTemperatureSts 0;
BA_ "GenSigTimeoutTime_HCP" SG_ 1450 OilTemperatureSts 0;
BA_ "GenSigTimeoutTime_RFHM" SG_ 1450 OilTemperatureSts 0;
BA_ "GenSigTimeoutTime_TCM" SG_ 1450 OilTemperatureSts 0;
BA_ "GenSigSendType" SG_ 1450 R_SHFT_LOCK 3;
BA_ "GenSigTimeoutTime_BCM" SG_ 1450 R_SHFT_LOCK 0;
BA_ "GenSigTimeoutTime_BSM" SG_ 1450 R_SHFT_LOCK 0;
BA_ "GenSigTimeoutTime_CADM" SG_ 1450 R_SHFT_LOCK 0;
BA_ "GenSigTimeoutTime_DMSM" SG_ 1450 R_SHFT_LOCK 0;
BA_ "GenSigTimeoutTime_DTCM" SG_ 1450 R_SHFT_LOCK 0;
BA_ "GenSigTimeoutTime_ECM" SG_ 1450 R_SHFT_LOCK 0;
BA_ "GenSigTimeoutTime_EVCU2" SG_ 1450 R_SHFT_LOCK 0;
BA_ "GenSigTimeoutTime_GNMM" SG_ 1450 R_SHFT_LOCK 0;
BA_ "GenSigTimeoutTime_HCP" SG_ 1450 R_SHFT_LOCK 0;
BA_ "GenSigTimeoutTime_IPC" SG_ 1450 R_SHFT_LOCK 0;
BA_ "GenSigTimeoutTime_RFHM" SG_ 1450 R_SHFT_LOCK 0;
BA_ "GenSigTimeoutTime_SGW" SG_ 1450 R_SHFT_LOCK 0;
BA_ "GenSigTimeoutTime_TCM" SG_ 1450 R_SHFT_LOCK 0;
BA_ "GenSigSendType" SG_ 1450 Secure_Idle_HMI 3;
BA_ "GenSigTimeoutTime_AGSM" SG_ 1450 Secure_Idle_HMI 0;
BA_ "GenSigTimeoutTime_BCM" SG_ 1450 Secure_Idle_HMI 0;
BA_ "GenSigTimeoutTime_BSM" SG_ 1450 Secure_Idle_HMI 0;
BA_ "GenSigTimeoutTime_CADM" SG_ 1450 Secure_Idle_HMI 0;
BA_ "GenSigTimeoutTime_DMSM" SG_ 1450 Secure_Idle_HMI 0;
BA_ "GenSigTimeoutTime_DTCM" SG_ 1450 Secure_Idle_HMI 0;
BA_ "GenSigTimeoutTime_ECM" SG_ 1450 Secure_Idle_HMI 0;
BA_ "GenSigTimeoutTime_EVCU2" SG_ 1450 Secure_Idle_HMI 0;
BA_ "GenSigTimeoutTime_GNMM" SG_ 1450 Secure_Idle_HMI 0;
BA_ "GenSigTimeoutTime_HCP" SG_ 1450 Secure_Idle_HMI 0;
BA_ "GenSigTimeoutTime_RFHM" SG_ 1450 Secure_Idle_HMI 0;
BA_ "GenSigTimeoutTime_SGW" SG_ 1450 Secure_Idle_HMI 0;
BA_ "GenSigTimeoutTime_TCM" SG_ 1450 Secure_Idle_HMI 0;
BA_ "GenSigSendType" SG_ 1450 ShiftInProgress 3;
BA_ "GenSigTimeoutTime_AGSM" SG_ 1450 ShiftInProgress 0;
BA_ "GenSigTimeoutTime_CADM" SG_ 1450 ShiftInProgress 0;
BA_ "GenSigTimeoutTime_DMSM" SG_ 1450 ShiftInProgress 0;
BA_ "GenSigTimeoutTime_DTCM" SG_ 1450 ShiftInProgress 0;
BA_ "GenSigTimeoutTime_EVCU2" SG_ 1450 ShiftInProgress 0;
BA_ "GenSigTimeoutTime_GNMM" SG_ 1450 ShiftInProgress 0;
BA_ "GenSigTimeoutTime_IPC" SG_ 1450 ShiftInProgress 0;
BA_ "GenSigTimeoutTime_RFHM" SG_ 1450 ShiftInProgress 0;
BA_ "GenSigTimeoutTime_TCM" SG_ 1450 ShiftInProgress 0;
BA_ "GenSigSendType" SG_ 1450 ShiftLeverLockReq 3;
BA_ "GenSigTimeoutTime_BCM" SG_ 1450 ShiftLeverLockReq 0;
BA_ "GenSigTimeoutTime_BSM" SG_ 1450 ShiftLeverLockReq 0;
BA_ "GenSigTimeoutTime_CADM" SG_ 1450 ShiftLeverLockReq 0;
BA_ "GenSigTimeoutTime_DMSM" SG_ 1450 ShiftLeverLockReq 0;
BA_ "GenSigTimeoutTime_DTCM" SG_ 1450 ShiftLeverLockReq 0;
BA_ "GenSigTimeoutTime_ECM" SG_ 1450 ShiftLeverLockReq 0;
BA_ "GenSigTimeoutTime_EVCU2" SG_ 1450 ShiftLeverLockReq 0;
BA_ "GenSigTimeoutTime_GNMM" SG_ 1450 ShiftLeverLockReq 0;
BA_ "GenSigTimeoutTime_HCP" SG_ 1450 ShiftLeverLockReq 0;
BA_ "GenSigTimeoutTime_IPC" SG_ 1450 ShiftLeverLockReq 0;
BA_ "GenSigTimeoutTime_RFHM" SG_ 1450 ShiftLeverLockReq 0;
BA_ "GenSigTimeoutTime_SGW" SG_ 1450 ShiftLeverLockReq 0;
BA_ "GenSigTimeoutTime_TCM" SG_ 1450 ShiftLeverLockReq 0;
BA_ "GenSigSendType" SG_ 1450 ShiftLeverPosition 3;
BA_ "GenSigTimeoutTime_DMSM" SG_ 1450 ShiftLeverPosition 0;
BA_ "GenSigTimeoutTime_DTCM" SG_ 1450 ShiftLeverPosition 0;
BA_ "GenSigTimeoutTime_EVCU2" SG_ 1450 ShiftLeverPosition 0;
BA_ "GenSigTimeoutTime_GNMM" SG_ 1450 ShiftLeverPosition 0;
BA_ "GenSigTimeoutTime_HCP" SG_ 1450 ShiftLeverPosition 0;
BA_ "GenSigTimeoutTime_RFHM" SG_ 1450 ShiftLeverPosition 0;
BA_ "GenSigTimeoutTime_TCM" SG_ 1450 ShiftLeverPosition 0;
BA_ "GenSigSendType" SG_ 1450 ShiftMapNotAchieved 3;
BA_ "GenSigTimeoutTime_AGSM" SG_ 1450 ShiftMapNotAchieved 0;
BA_ "GenSigTimeoutTime_BCM" SG_ 1450 ShiftMapNotAchieved 0;
BA_ "GenSigTimeoutTime_BSM" SG_ 1450 ShiftMapNotAchieved 0;
BA_ "GenSigTimeoutTime_CADM" SG_ 1450 ShiftMapNotAchieved 0;
BA_ "GenSigTimeoutTime_DMSM" SG_ 1450 ShiftMapNotAchieved 0;
BA_ "GenSigTimeoutTime_DTCM" SG_ 1450 ShiftMapNotAchieved 0;
BA_ "GenSigTimeoutTime_EVCU2" SG_ 1450 ShiftMapNotAchieved 0;
BA_ "GenSigTimeoutTime_GNMM" SG_ 1450 ShiftMapNotAchieved 0;
BA_ "GenSigTimeoutTime_HCP" SG_ 1450 ShiftMapNotAchieved 0;
BA_ "GenSigTimeoutTime_IPC" SG_ 1450 ShiftMapNotAchieved 0;
BA_ "GenSigTimeoutTime_RFHM" SG_ 1450 ShiftMapNotAchieved 0;
BA_ "GenSigTimeoutTime_SGW" SG_ 1450 ShiftMapNotAchieved 0;
BA_ "GenSigTimeoutTime_TCM" SG_ 1450 ShiftMapNotAchieved 0;
BA_ "GenSigSendType" SG_ 1450 ShiftModeSts 3;
BA_ "GenSigTimeoutTime_AGSM" SG_ 1450 ShiftModeSts 0;
BA_ "GenSigTimeoutTime_BCM" SG_ 1450 ShiftModeSts 0;
BA_ "GenSigTimeoutTime_BSM" SG_ 1450 ShiftModeSts 0;
BA_ "GenSigTimeoutTime_DMSM" SG_ 1450 ShiftModeSts 0;
BA_ "GenSigTimeoutTime_ECM" SG_ 1450 ShiftModeSts 0;
BA_ "GenSigTimeoutTime_EVCU2" SG_ 1450 ShiftModeSts 0;
BA_ "GenSigTimeoutTime_GNMM" SG_ 1450 ShiftModeSts 0;
BA_ "GenSigTimeoutTime_RFHM" SG_ 1450 ShiftModeSts 0;
BA_ "GenSigTimeoutTime_TCM" SG_ 1450 ShiftModeSts 0;
BA_ "GenSigSendType" SG_ 1450 TransmissionFailSts 3;
BA_ "GenSigTimeoutTime_BSM" SG_ 1450 TransmissionFailSts 0;
BA_ "GenSigTimeoutTime_CADM" SG_ 1450 TransmissionFailSts 0;
BA_ "GenSigTimeoutTime_DMSM" SG_ 1450 TransmissionFailSts 0;
BA_ "GenSigTimeoutTime_DTCM" SG_ 1450 TransmissionFailSts 0;
BA_ "GenSigTimeoutTime_ECM" SG_ 1450 TransmissionFailSts 0;
BA_ "GenSigTimeoutTime_EVCU2" SG_ 1450 TransmissionFailSts 0;
BA_ "GenSigTimeoutTime_GNMM" SG_ 1450 TransmissionFailSts 0;
BA_ "GenSigTimeoutTime_HCP" SG_ 1450 TransmissionFailSts 0;
BA_ "GenSigTimeoutTime_IPC" SG_ 1450 TransmissionFailSts 0;
BA_ "GenSigTimeoutTime_RFHM" SG_ 1450 TransmissionFailSts 0;
BA_ "GenSigTimeoutTime_TCM" SG_ 1450 TransmissionFailSts 0;
BA_ "GenSigSendType" SG_ 1450 TransmissionWarnings 3;
BA_ "GenSigTimeoutTime_AGSM" SG_ 1450 TransmissionWarnings 0;
BA_ "GenSigTimeoutTime_BSM" SG_ 1450 TransmissionWarnings 0;
BA_ "GenSigTimeoutTime_CADM" SG_ 1450 TransmissionWarnings 0;
BA_ "GenSigTimeoutTime_DMSM" SG_ 1450 TransmissionWarnings 0;
BA_ "GenSigTimeoutTime_DTCM" SG_ 1450 TransmissionWarnings 0;
BA_ "GenSigTimeoutTime_ECM" SG_ 1450 TransmissionWarnings 0;
BA_ "GenSigTimeoutTime_EVCU2" SG_ 1450 TransmissionWarnings 0;
BA_ "GenSigTimeoutTime_GNMM" SG_ 1450 TransmissionWarnings 0;
BA_ "GenSigTimeoutTime_HCP" SG_ 1450 TransmissionWarnings 0;
BA_ "GenSigTimeoutTime_RFHM" SG_ 1450 TransmissionWarnings 0;
BA_ "GenSigTimeoutTime_TCM" SG_ 1450 TransmissionWarnings 0;
BA_ "GenSigSendType" SG_ 1450 TxDisengaged 3;
BA_ "GenSigTimeoutTime_AGSM" SG_ 1450 TxDisengaged 0;
BA_ "GenSigTimeoutTime_BCM" SG_ 1450 TxDisengaged 0;
BA_ "GenSigTimeoutTime_BSM" SG_ 1450 TxDisengaged 0;
BA_ "GenSigTimeoutTime_CADM" SG_ 1450 TxDisengaged 0;
BA_ "GenSigTimeoutTime_DMSM" SG_ 1450 TxDisengaged 0;
BA_ "GenSigTimeoutTime_DTCM" SG_ 1450 TxDisengaged 0;
BA_ "GenSigTimeoutTime_EVCU2" SG_ 1450 TxDisengaged 0;
BA_ "GenSigTimeoutTime_GNMM" SG_ 1450 TxDisengaged 0;
BA_ "GenSigTimeoutTime_HCP" SG_ 1450 TxDisengaged 0;
BA_ "GenSigTimeoutTime_IPC" SG_ 1450 TxDisengaged 0;
BA_ "GenSigTimeoutTime_RFHM" SG_ 1450 TxDisengaged 0;
BA_ "GenSigTimeoutTime_SGW" SG_ 1450 TxDisengaged 0;
BA_ "GenSigTimeoutTime_TCM" SG_ 1450 TxDisengaged 0;
BA_ "GenSigSendType" SG_ 1450 TxDisengaged_Fault 3;
BA_ "GenSigTimeoutTime_AGSM" SG_ 1450 TxDisengaged_Fault 0;
BA_ "GenSigTimeoutTime_BCM" SG_ 1450 TxDisengaged_Fault 0;
BA_ "GenSigTimeoutTime_BSM" SG_ 1450 TxDisengaged_Fault 0;
BA_ "GenSigTimeoutTime_CADM" SG_ 1450 TxDisengaged_Fault 0;
BA_ "GenSigTimeoutTime_DMSM" SG_ 1450 TxDisengaged_Fault 0;
BA_ "GenSigTimeoutTime_DTCM" SG_ 1450 TxDisengaged_Fault 0;
BA_ "GenSigTimeoutTime_EVCU2" SG_ 1450 TxDisengaged_Fault 0;
BA_ "GenSigTimeoutTime_GNMM" SG_ 1450 TxDisengaged_Fault 0;
BA_ "GenSigTimeoutTime_HCP" SG_ 1450 TxDisengaged_Fault 0;
BA_ "GenSigTimeoutTime_IPC" SG_ 1450 TxDisengaged_Fault 0;
BA_ "GenSigTimeoutTime_RFHM" SG_ 1450 TxDisengaged_Fault 0;
BA_ "GenSigTimeoutTime_SGW" SG_ 1450 TxDisengaged_Fault 0;
BA_ "GenSigTimeoutTime_TCM" SG_ 1450 TxDisengaged_Fault 0;
BA_ "GenSigTimeoutTime_AGSM" SG_ 1059 CodeCheckSts_TRM 0;
BA_ "GenSigTimeoutTime_BSM" SG_ 1059 CodeCheckSts_TRM 0;
BA_ "GenSigTimeoutTime_CADM" SG_ 1059 CodeCheckSts_TRM 0;
BA_ "GenSigTimeoutTime_DMSM" SG_ 1059 CodeCheckSts_TRM 0;
BA_ "GenSigTimeoutTime_DTCM" SG_ 1059 CodeCheckSts_TRM 0;
BA_ "GenSigTimeoutTime_ECM" SG_ 1059 CodeCheckSts_TRM 0;
BA_ "GenSigTimeoutTime_EVCU2" SG_ 1059 CodeCheckSts_TRM 0;
BA_ "GenSigTimeoutTime_GNMM" SG_ 1059 CodeCheckSts_TRM 0;
BA_ "GenSigTimeoutTime_HCP" SG_ 1059 CodeCheckSts_TRM 0;
BA_ "GenSigTimeoutTime_IPC" SG_ 1059 CodeCheckSts_TRM 0;
BA_ "GenSigTimeoutTime_RFHM" SG_ 1059 CodeCheckSts_TRM 0;
BA_ "GenSigTimeoutTime_SGW" SG_ 1059 CodeCheckSts_TRM 0;
BA_ "GenSigTimeoutTime_TCM" SG_ 1059 CodeCheckSts_TRM 0;
BA_ "GenSigSendType" SG_ 1059 ControlEncoding_TRM_Rsp 3;
BA_ "GenSigTimeoutTime_AGSM" SG_ 1059 ControlEncoding_TRM_Rsp 0;
BA_ "GenSigTimeoutTime_BSM" SG_ 1059 ControlEncoding_TRM_Rsp 0;
BA_ "GenSigTimeoutTime_CADM" SG_ 1059 ControlEncoding_TRM_Rsp 0;
BA_ "GenSigTimeoutTime_DMSM" SG_ 1059 ControlEncoding_TRM_Rsp 0;
BA_ "GenSigTimeoutTime_DTCM" SG_ 1059 ControlEncoding_TRM_Rsp 0;
BA_ "GenSigTimeoutTime_ECM" SG_ 1059 ControlEncoding_TRM_Rsp 0;
BA_ "GenSigTimeoutTime_EVCU2" SG_ 1059 ControlEncoding_TRM_Rsp 0;
BA_ "GenSigTimeoutTime_GNMM" SG_ 1059 ControlEncoding_TRM_Rsp 0;
BA_ "GenSigTimeoutTime_HCP" SG_ 1059 ControlEncoding_TRM_Rsp 0;
BA_ "GenSigTimeoutTime_IPC" SG_ 1059 ControlEncoding_TRM_Rsp 0;
BA_ "GenSigTimeoutTime_RFHM" SG_ 1059 ControlEncoding_TRM_Rsp 0;
BA_ "GenSigTimeoutTime_SGW" SG_ 1059 ControlEncoding_TRM_Rsp 0;
BA_ "GenSigTimeoutTime_TCM" SG_ 1059 ControlEncoding_TRM_Rsp 0;
BA_ "GenSigTimeoutTime_AGSM" SG_ 1059 MiniCryptGCode_TRM_Rsp 0;
BA_ "GenSigTimeoutTime_BSM" SG_ 1059 MiniCryptGCode_TRM_Rsp 0;
BA_ "GenSigTimeoutTime_CADM" SG_ 1059 MiniCryptGCode_TRM_Rsp 0;
BA_ "GenSigTimeoutTime_DMSM" SG_ 1059 MiniCryptGCode_TRM_Rsp 0;
BA_ "GenSigTimeoutTime_DTCM" SG_ 1059 MiniCryptGCode_TRM_Rsp 0;
BA_ "GenSigTimeoutTime_ECM" SG_ 1059 MiniCryptGCode_TRM_Rsp 0;
BA_ "GenSigTimeoutTime_EVCU2" SG_ 1059 MiniCryptGCode_TRM_Rsp 0;
BA_ "GenSigTimeoutTime_GNMM" SG_ 1059 MiniCryptGCode_TRM_Rsp 0;
BA_ "GenSigTimeoutTime_HCP" SG_ 1059 MiniCryptGCode_TRM_Rsp 0;
BA_ "GenSigTimeoutTime_IPC" SG_ 1059 MiniCryptGCode_TRM_Rsp 0;
BA_ "GenSigTimeoutTime_RFHM" SG_ 1059 MiniCryptGCode_TRM_Rsp 0;
BA_ "GenSigTimeoutTime_SGW" SG_ 1059 MiniCryptGCode_TRM_Rsp 0;
BA_ "GenSigTimeoutTime_TCM" SG_ 1059 MiniCryptGCode_TRM_Rsp 0;
BA_ "GenSigTimeoutTime_AGSM" SG_ 1059 ProgrammedSts_TRM 0;
BA_ "GenSigTimeoutTime_BSM" SG_ 1059 ProgrammedSts_TRM 0;
BA_ "GenSigTimeoutTime_CADM" SG_ 1059 ProgrammedSts_TRM 0;
BA_ "GenSigTimeoutTime_DMSM" SG_ 1059 ProgrammedSts_TRM 0;
BA_ "GenSigTimeoutTime_DTCM" SG_ 1059 ProgrammedSts_TRM 0;
BA_ "GenSigTimeoutTime_ECM" SG_ 1059 ProgrammedSts_TRM 0;
BA_ "GenSigTimeoutTime_EVCU2" SG_ 1059 ProgrammedSts_TRM 0;
BA_ "GenSigTimeoutTime_GNMM" SG_ 1059 ProgrammedSts_TRM 0;
BA_ "GenSigTimeoutTime_HCP" SG_ 1059 ProgrammedSts_TRM 0;
BA_ "GenSigTimeoutTime_IPC" SG_ 1059 ProgrammedSts_TRM 0;
BA_ "GenSigTimeoutTime_RFHM" SG_ 1059 ProgrammedSts_TRM 0;
BA_ "GenSigTimeoutTime_SGW" SG_ 1059 ProgrammedSts_TRM 0;
BA_ "GenSigTimeoutTime_TCM" SG_ 1059 ProgrammedSts_TRM 0;
BA_ "GenSigStartValue" SG_ 1059 TxpFound 1;
BA_ "GenSigTimeoutTime_AGSM" SG_ 1059 TxpFound 0;
BA_ "GenSigTimeoutTime_BSM" SG_ 1059 TxpFound 0;
BA_ "GenSigTimeoutTime_CADM" SG_ 1059 TxpFound 0;
BA_ "GenSigTimeoutTime_DMSM" SG_ 1059 TxpFound 0;
BA_ "GenSigTimeoutTime_DTCM" SG_ 1059 TxpFound 0;
BA_ "GenSigTimeoutTime_ECM" SG_ 1059 TxpFound 0;
BA_ "GenSigTimeoutTime_EVCU2" SG_ 1059 TxpFound 0;
BA_ "GenSigTimeoutTime_GNMM" SG_ 1059 TxpFound 0;
BA_ "GenSigTimeoutTime_HCP" SG_ 1059 TxpFound 0;
BA_ "GenSigTimeoutTime_IPC" SG_ 1059 TxpFound 0;
BA_ "GenSigTimeoutTime_RFHM" SG_ 1059 TxpFound 0;
BA_ "GenSigTimeoutTime_SGW" SG_ 1059 TxpFound 0;
BA_ "GenSigTimeoutTime_TCM" SG_ 1059 TxpFound 0;
BA_ "GenSigSendType" SG_ 1059 TxpID3 3;
BA_ "GenSigTimeoutTime_AGSM" SG_ 1059 TxpID3 0;
BA_ "GenSigTimeoutTime_BSM" SG_ 1059 TxpID3 0;
BA_ "GenSigTimeoutTime_CADM" SG_ 1059 TxpID3 0;
BA_ "GenSigTimeoutTime_DMSM" SG_ 1059 TxpID3 0;
BA_ "GenSigTimeoutTime_DTCM" SG_ 1059 TxpID3 0;
BA_ "GenSigTimeoutTime_ECM" SG_ 1059 TxpID3 0;
BA_ "GenSigTimeoutTime_EVCU2" SG_ 1059 TxpID3 0;
BA_ "GenSigTimeoutTime_GNMM" SG_ 1059 TxpID3 0;
BA_ "GenSigTimeoutTime_HCP" SG_ 1059 TxpID3 0;
BA_ "GenSigTimeoutTime_IPC" SG_ 1059 TxpID3 0;
BA_ "GenSigTimeoutTime_RFHM" SG_ 1059 TxpID3 0;
BA_ "GenSigTimeoutTime_SGW" SG_ 1059 TxpID3 0;
BA_ "GenSigTimeoutTime_TCM" SG_ 1059 TxpID3 0;
BA_ "GenSigTimeoutTime_AGSM" SG_ 254 DATA1 0;
BA_ "GenSigTimeoutTime_BSM" SG_ 254 DATA1 0;
BA_ "GenSigTimeoutTime_CADM" SG_ 254 DATA1 0;
BA_ "GenSigTimeoutTime_DMSM" SG_ 254 DATA1 0;
BA_ "GenSigTimeoutTime_DTCM" SG_ 254 DATA1 0;
BA_ "GenSigTimeoutTime_ECM" SG_ 254 DATA1 0;
BA_ "GenSigTimeoutTime_EVCU2" SG_ 254 DATA1 0;
BA_ "GenSigTimeoutTime_GNMM" SG_ 254 DATA1 0;
BA_ "GenSigTimeoutTime_HCP" SG_ 254 DATA1 0;
BA_ "GenSigTimeoutTime_IPC" SG_ 254 DATA1 0;
BA_ "GenSigTimeoutTime_RFHM" SG_ 254 DATA1 0;
BA_ "GenSigTimeoutTime_SGW" SG_ 254 DATA1 0;
BA_ "GenSigTimeoutTime_TCM" SG_ 254 DATA1 0;
BA_ "GenSigTimeoutTime_AGSM" SG_ 254 DATA2 0;
BA_ "GenSigTimeoutTime_BSM" SG_ 254 DATA2 0;
BA_ "GenSigTimeoutTime_CADM" SG_ 254 DATA2 0;
BA_ "GenSigTimeoutTime_DMSM" SG_ 254 DATA2 0;
BA_ "GenSigTimeoutTime_DTCM" SG_ 254 DATA2 0;
BA_ "GenSigTimeoutTime_ECM" SG_ 254 DATA2 0;
BA_ "GenSigTimeoutTime_EVCU2" SG_ 254 DATA2 0;
BA_ "GenSigTimeoutTime_GNMM" SG_ 254 DATA2 0;
BA_ "GenSigTimeoutTime_HCP" SG_ 254 DATA2 0;
BA_ "GenSigTimeoutTime_IPC" SG_ 254 DATA2 0;
BA_ "GenSigTimeoutTime_RFHM" SG_ 254 DATA2 0;
BA_ "GenSigTimeoutTime_SGW" SG_ 254 DATA2 0;
BA_ "GenSigTimeoutTime_TCM" SG_ 254 DATA2 0;
BA_ "GenSigTimeoutTime_AGSM" SG_ 254 DATA3 0;
BA_ "GenSigTimeoutTime_BSM" SG_ 254 DATA3 0;
BA_ "GenSigTimeoutTime_CADM" SG_ 254 DATA3 0;
BA_ "GenSigTimeoutTime_DMSM" SG_ 254 DATA3 0;
BA_ "GenSigTimeoutTime_DTCM" SG_ 254 DATA3 0;
BA_ "GenSigTimeoutTime_ECM" SG_ 254 DATA3 0;
BA_ "GenSigTimeoutTime_EVCU2" SG_ 254 DATA3 0;
BA_ "GenSigTimeoutTime_GNMM" SG_ 254 DATA3 0;
BA_ "GenSigTimeoutTime_HCP" SG_ 254 DATA3 0;
BA_ "GenSigTimeoutTime_IPC" SG_ 254 DATA3 0;
BA_ "GenSigTimeoutTime_RFHM" SG_ 254 DATA3 0;
BA_ "GenSigTimeoutTime_SGW" SG_ 254 DATA3 0;
BA_ "GenSigTimeoutTime_TCM" SG_ 254 DATA3 0;
BA_ "GenSigTimeoutTime_AGSM" SG_ 254 DATA4 0;
BA_ "GenSigTimeoutTime_BSM" SG_ 254 DATA4 0;
BA_ "GenSigTimeoutTime_CADM" SG_ 254 DATA4 0;
BA_ "GenSigTimeoutTime_DMSM" SG_ 254 DATA4 0;
BA_ "GenSigTimeoutTime_DTCM" SG_ 254 DATA4 0;
BA_ "GenSigTimeoutTime_ECM" SG_ 254 DATA4 0;
BA_ "GenSigTimeoutTime_EVCU2" SG_ 254 DATA4 0;
BA_ "GenSigTimeoutTime_GNMM" SG_ 254 DATA4 0;
BA_ "GenSigTimeoutTime_HCP" SG_ 254 DATA4 0;
BA_ "GenSigTimeoutTime_IPC" SG_ 254 DATA4 0;
BA_ "GenSigTimeoutTime_RFHM" SG_ 254 DATA4 0;
BA_ "GenSigTimeoutTime_SGW" SG_ 254 DATA4 0;
BA_ "GenSigTimeoutTime_TCM" SG_ 254 DATA4 0;
BA_ "GenSigTimeoutTime_AGSM" SG_ 254 DATA5 0;
BA_ "GenSigTimeoutTime_BSM" SG_ 254 DATA5 0;
BA_ "GenSigTimeoutTime_CADM" SG_ 254 DATA5 0;
BA_ "GenSigTimeoutTime_DMSM" SG_ 254 DATA5 0;
BA_ "GenSigTimeoutTime_DTCM" SG_ 254 DATA5 0;
BA_ "GenSigTimeoutTime_ECM" SG_ 254 DATA5 0;
BA_ "GenSigTimeoutTime_EVCU2" SG_ 254 DATA5 0;
BA_ "GenSigTimeoutTime_GNMM" SG_ 254 DATA5 0;
BA_ "GenSigTimeoutTime_HCP" SG_ 254 DATA5 0;
BA_ "GenSigTimeoutTime_IPC" SG_ 254 DATA5 0;
BA_ "GenSigTimeoutTime_RFHM" SG_ 254 DATA5 0;
BA_ "GenSigTimeoutTime_SGW" SG_ 254 DATA5 0;
BA_ "GenSigTimeoutTime_TCM" SG_ 254 DATA5 0;
BA_ "GenSigTimeoutTime_AGSM" SG_ 254 DATA6 0;
BA_ "GenSigTimeoutTime_BSM" SG_ 254 DATA6 0;
BA_ "GenSigTimeoutTime_CADM" SG_ 254 DATA6 0;
BA_ "GenSigTimeoutTime_DMSM" SG_ 254 DATA6 0;
BA_ "GenSigTimeoutTime_DTCM" SG_ 254 DATA6 0;
BA_ "GenSigTimeoutTime_ECM" SG_ 254 DATA6 0;
BA_ "GenSigTimeoutTime_EVCU2" SG_ 254 DATA6 0;
BA_ "GenSigTimeoutTime_GNMM" SG_ 254 DATA6 0;
BA_ "GenSigTimeoutTime_HCP" SG_ 254 DATA6 0;
BA_ "GenSigTimeoutTime_IPC" SG_ 254 DATA6 0;
BA_ "GenSigTimeoutTime_RFHM" SG_ 254 DATA6 0;
BA_ "GenSigTimeoutTime_SGW" SG_ 254 DATA6 0;
BA_ "GenSigTimeoutTime_TCM" SG_ 254 DATA6 0;
BA_ "GenSigTimeoutTime_AGSM" SG_ 254 DATA7 0;
BA_ "GenSigTimeoutTime_BSM" SG_ 254 DATA7 0;
BA_ "GenSigTimeoutTime_CADM" SG_ 254 DATA7 0;
BA_ "GenSigTimeoutTime_DMSM" SG_ 254 DATA7 0;
BA_ "GenSigTimeoutTime_DTCM" SG_ 254 DATA7 0;
BA_ "GenSigTimeoutTime_ECM" SG_ 254 DATA7 0;
BA_ "GenSigTimeoutTime_EVCU2" SG_ 254 DATA7 0;
BA_ "GenSigTimeoutTime_GNMM" SG_ 254 DATA7 0;
BA_ "GenSigTimeoutTime_HCP" SG_ 254 DATA7 0;
BA_ "GenSigTimeoutTime_IPC" SG_ 254 DATA7 0;
BA_ "GenSigTimeoutTime_RFHM" SG_ 254 DATA7 0;
BA_ "GenSigTimeoutTime_SGW" SG_ 254 DATA7 0;
BA_ "GenSigTimeoutTime_TCM" SG_ 254 DATA7 0;
BA_ "GenSigSendType" SG_ 254 FrameNumber 1;
BA_ "GenSigTimeoutTime_AGSM" SG_ 254 FrameNumber 0;
BA_ "GenSigTimeoutTime_BSM" SG_ 254 FrameNumber 0;
BA_ "GenSigTimeoutTime_CADM" SG_ 254 FrameNumber 0;
BA_ "GenSigTimeoutTime_DMSM" SG_ 254 FrameNumber 0;
BA_ "GenSigTimeoutTime_DTCM" SG_ 254 FrameNumber 0;
BA_ "GenSigTimeoutTime_ECM" SG_ 254 FrameNumber 0;
BA_ "GenSigTimeoutTime_EVCU2" SG_ 254 FrameNumber 0;
BA_ "GenSigTimeoutTime_GNMM" SG_ 254 FrameNumber 0;
BA_ "GenSigTimeoutTime_HCP" SG_ 254 FrameNumber 0;
BA_ "GenSigTimeoutTime_IPC" SG_ 254 FrameNumber 0;
BA_ "GenSigTimeoutTime_RFHM" SG_ 254 FrameNumber 0;
BA_ "GenSigTimeoutTime_SGW" SG_ 254 FrameNumber 0;
BA_ "GenSigTimeoutTime_TCM" SG_ 254 FrameNumber 0;
BA_ "GenSigTimeoutTime_AGSM" SG_ 254 TotalFrameNumber 0;
BA_ "GenSigTimeoutTime_BSM" SG_ 254 TotalFrameNumber 0;
BA_ "GenSigTimeoutTime_CADM" SG_ 254 TotalFrameNumber 0;
BA_ "GenSigTimeoutTime_DMSM" SG_ 254 TotalFrameNumber 0;
BA_ "GenSigTimeoutTime_DTCM" SG_ 254 TotalFrameNumber 0;
BA_ "GenSigTimeoutTime_ECM" SG_ 254 TotalFrameNumber 0;
BA_ "GenSigTimeoutTime_EVCU2" SG_ 254 TotalFrameNumber 0;
BA_ "GenSigTimeoutTime_GNMM" SG_ 254 TotalFrameNumber 0;
BA_ "GenSigTimeoutTime_HCP" SG_ 254 TotalFrameNumber 0;
BA_ "GenSigTimeoutTime_IPC" SG_ 254 TotalFrameNumber 0;
BA_ "GenSigTimeoutTime_RFHM" SG_ 254 TotalFrameNumber 0;
BA_ "GenSigTimeoutTime_SGW" SG_ 254 TotalFrameNumber 0;
BA_ "GenSigTimeoutTime_TCM" SG_ 254 TotalFrameNumber 0;
BA_ "GenSigTimeoutTime_AGSM" SG_ 1472 CRC_TRSCM1 0;
BA_ "GenSigTimeoutTime_BCM" SG_ 1472 CRC_TRSCM1 0;
BA_ "GenSigTimeoutTime_CADM" SG_ 1472 CRC_TRSCM1 0;
BA_ "GenSigTimeoutTime_DMSM" SG_ 1472 CRC_TRSCM1 0;
BA_ "GenSigTimeoutTime_DTCM" SG_ 1472 CRC_TRSCM1 0;
BA_ "GenSigTimeoutTime_EVCU2" SG_ 1472 CRC_TRSCM1 0;
BA_ "GenSigTimeoutTime_GNMM" SG_ 1472 CRC_TRSCM1 0;
BA_ "GenSigTimeoutTime_HCP" SG_ 1472 CRC_TRSCM1 0;
BA_ "GenSigTimeoutTime_IPC" SG_ 1472 CRC_TRSCM1 0;
BA_ "GenSigTimeoutTime_RFHM" SG_ 1472 CRC_TRSCM1 0;
BA_ "GenSigTimeoutTime_SGW" SG_ 1472 CRC_TRSCM1 0;
BA_ "GenSigTimeoutTime_TCM" SG_ 1472 CRC_TRSCM1 0;
BA_ "GenSigTimeoutTime_AGSM" SG_ 1472 MessageCounter_TRSCM1 0;
BA_ "GenSigTimeoutTime_BCM" SG_ 1472 MessageCounter_TRSCM1 0;
BA_ "GenSigTimeoutTime_CADM" SG_ 1472 MessageCounter_TRSCM1 0;
BA_ "GenSigTimeoutTime_DMSM" SG_ 1472 MessageCounter_TRSCM1 0;
BA_ "GenSigTimeoutTime_DTCM" SG_ 1472 MessageCounter_TRSCM1 0;
BA_ "GenSigTimeoutTime_EVCU2" SG_ 1472 MessageCounter_TRSCM1 0;
BA_ "GenSigTimeoutTime_GNMM" SG_ 1472 MessageCounter_TRSCM1 0;
BA_ "GenSigTimeoutTime_HCP" SG_ 1472 MessageCounter_TRSCM1 0;
BA_ "GenSigTimeoutTime_IPC" SG_ 1472 MessageCounter_TRSCM1 0;
BA_ "GenSigTimeoutTime_RFHM" SG_ 1472 MessageCounter_TRSCM1 0;
BA_ "GenSigTimeoutTime_SGW" SG_ 1472 MessageCounter_TRSCM1 0;
BA_ "GenSigTimeoutTime_TCM" SG_ 1472 MessageCounter_TRSCM1 0;
BA_ "GenSigSendType" SG_ 1472 THA_EPB_Req 4;
BA_ "GenSigTimeoutTime_AGSM" SG_ 1472 THA_EPB_Req 0;
BA_ "GenSigTimeoutTime_BCM" SG_ 1472 THA_EPB_Req 0;
BA_ "GenSigTimeoutTime_CADM" SG_ 1472 THA_EPB_Req 0;
BA_ "GenSigTimeoutTime_DMSM" SG_ 1472 THA_EPB_Req 0;
BA_ "GenSigTimeoutTime_DTCM" SG_ 1472 THA_EPB_Req 0;
BA_ "GenSigTimeoutTime_ECM" SG_ 1472 THA_EPB_Req 0;
BA_ "GenSigTimeoutTime_EVCU2" SG_ 1472 THA_EPB_Req 0;
BA_ "GenSigTimeoutTime_GNMM" SG_ 1472 THA_EPB_Req 0;
BA_ "GenSigTimeoutTime_HCP" SG_ 1472 THA_EPB_Req 0;
BA_ "GenSigTimeoutTime_IPC" SG_ 1472 THA_EPB_Req 0;
BA_ "GenSigTimeoutTime_RFHM" SG_ 1472 THA_EPB_Req 0;
BA_ "GenSigTimeoutTime_SGW" SG_ 1472 THA_EPB_Req 0;
BA_ "GenSigTimeoutTime_TCM" SG_ 1472 THA_EPB_Req 0;
BA_ "GenSigSendType" SG_ 1472 THA_Speed_Limit 4;
BA_ "GenSigTimeoutTime_AGSM" SG_ 1472 THA_Speed_Limit 0;
BA_ "GenSigTimeoutTime_BCM" SG_ 1472 THA_Speed_Limit 0;
BA_ "GenSigTimeoutTime_CADM" SG_ 1472 THA_Speed_Limit 0;
BA_ "GenSigTimeoutTime_DMSM" SG_ 1472 THA_Speed_Limit 0;
BA_ "GenSigTimeoutTime_DTCM" SG_ 1472 THA_Speed_Limit 0;
BA_ "GenSigTimeoutTime_GNMM" SG_ 1472 THA_Speed_Limit 0;
BA_ "GenSigTimeoutTime_HCP" SG_ 1472 THA_Speed_Limit 0;
BA_ "GenSigTimeoutTime_IPC" SG_ 1472 THA_Speed_Limit 0;
BA_ "GenSigTimeoutTime_RFHM" SG_ 1472 THA_Speed_Limit 0;
BA_ "GenSigTimeoutTime_SGW" SG_ 1472 THA_Speed_Limit 0;
BA_ "GenSigTimeoutTime_TCM" SG_ 1472 THA_Speed_Limit 0;
BA_ "GenSigSendType" SG_ 1472 THA_SpeedLimit_Req 4;
BA_ "GenSigTimeoutTime_AGSM" SG_ 1472 THA_SpeedLimit_Req 0;
BA_ "GenSigTimeoutTime_BCM" SG_ 1472 THA_SpeedLimit_Req 0;
BA_ "GenSigTimeoutTime_CADM" SG_ 1472 THA_SpeedLimit_Req 0;
BA_ "GenSigTimeoutTime_DMSM" SG_ 1472 THA_SpeedLimit_Req 0;
BA_ "GenSigTimeoutTime_DTCM" SG_ 1472 THA_SpeedLimit_Req 0;
BA_ "GenSigTimeoutTime_GNMM" SG_ 1472 THA_SpeedLimit_Req 0;
BA_ "GenSigTimeoutTime_HCP" SG_ 1472 THA_SpeedLimit_Req 0;
BA_ "GenSigTimeoutTime_IPC" SG_ 1472 THA_SpeedLimit_Req 0;
BA_ "GenSigTimeoutTime_RFHM" SG_ 1472 THA_SpeedLimit_Req 0;
BA_ "GenSigTimeoutTime_SGW" SG_ 1472 THA_SpeedLimit_Req 0;
BA_ "GenSigTimeoutTime_TCM" SG_ 1472 THA_SpeedLimit_Req 0;
BA_ "GenSigSendType" SG_ 1472 THA_STAT 4;
BA_ "GenSigTimeoutTime_AGSM" SG_ 1472 THA_STAT 0;
BA_ "GenSigTimeoutTime_BCM" SG_ 1472 THA_STAT 0;
BA_ "GenSigTimeoutTime_CADM" SG_ 1472 THA_STAT 0;
BA_ "GenSigTimeoutTime_DMSM" SG_ 1472 THA_STAT 0;
BA_ "GenSigTimeoutTime_DTCM" SG_ 1472 THA_STAT 0;
BA_ "GenSigTimeoutTime_GNMM" SG_ 1472 THA_STAT 0;
BA_ "GenSigTimeoutTime_HCP" SG_ 1472 THA_STAT 0;
BA_ "GenSigTimeoutTime_IPC" SG_ 1472 THA_STAT 0;
BA_ "GenSigTimeoutTime_RFHM" SG_ 1472 THA_STAT 0;
BA_ "GenSigTimeoutTime_SGW" SG_ 1472 THA_STAT 0;
BA_ "GenSigTimeoutTime_TCM" SG_ 1472 THA_STAT 0;
BA_ "GenSigSendType" SG_ 1472 TRSC_PopupDisp_Info2 3;
BA_ "GenSigTimeoutTime_AGSM" SG_ 1472 TRSC_PopupDisp_Info2 0;
BA_ "GenSigTimeoutTime_BCM" SG_ 1472 TRSC_PopupDisp_Info2 0;
BA_ "GenSigTimeoutTime_BSM" SG_ 1472 TRSC_PopupDisp_Info2 0;
BA_ "GenSigTimeoutTime_CADM" SG_ 1472 TRSC_PopupDisp_Info2 0;
BA_ "GenSigTimeoutTime_DMSM" SG_ 1472 TRSC_PopupDisp_Info2 0;
BA_ "GenSigTimeoutTime_DTCM" SG_ 1472 TRSC_PopupDisp_Info2 0;
BA_ "GenSigTimeoutTime_ECM" SG_ 1472 TRSC_PopupDisp_Info2 0;
BA_ "GenSigTimeoutTime_EVCU2" SG_ 1472 TRSC_PopupDisp_Info2 0;
BA_ "GenSigTimeoutTime_GNMM" SG_ 1472 TRSC_PopupDisp_Info2 0;
BA_ "GenSigTimeoutTime_HCP" SG_ 1472 TRSC_PopupDisp_Info2 0;
BA_ "GenSigTimeoutTime_RFHM" SG_ 1472 TRSC_PopupDisp_Info2 0;
BA_ "GenSigTimeoutTime_SGW" SG_ 1472 TRSC_PopupDisp_Info2 0;
BA_ "GenSigTimeoutTime_TCM" SG_ 1472 TRSC_PopupDisp_Info2 0;
BA_ "GenSigStartValue" SG_ 1472 TRSC_STAT 1;
BA_ "GenSigSendType" SG_ 1472 TRSC_STAT 3;
BA_ "GenSigTimeoutTime_AGSM" SG_ 1472 TRSC_STAT 0;
BA_ "GenSigTimeoutTime_BCM" SG_ 1472 TRSC_STAT 0;
BA_ "GenSigTimeoutTime_CADM" SG_ 1472 TRSC_STAT 0;
BA_ "GenSigTimeoutTime_DMSM" SG_ 1472 TRSC_STAT 0;
BA_ "GenSigTimeoutTime_DTCM" SG_ 1472 TRSC_STAT 0;
BA_ "GenSigTimeoutTime_ECM" SG_ 1472 TRSC_STAT 0;
BA_ "GenSigTimeoutTime_EVCU2" SG_ 1472 TRSC_STAT 0;
BA_ "GenSigTimeoutTime_GNMM" SG_ 1472 TRSC_STAT 0;
BA_ "GenSigTimeoutTime_HCP" SG_ 1472 TRSC_STAT 0;
BA_ "GenSigTimeoutTime_IPC" SG_ 1472 TRSC_STAT 0;
BA_ "GenSigTimeoutTime_RFHM" SG_ 1472 TRSC_STAT 0;
BA_ "GenSigTimeoutTime_TCM" SG_ 1472 TRSC_STAT 0;
BA_ "GenSigSendType" SG_ 951 UConnReq_TBM 6;
BA_ "GenSigTimeoutTime_AGSM" SG_ 951 UConnReq_TBM 0;
BA_ "GenSigTimeoutTime_BCM" SG_ 951 UConnReq_TBM 0;
BA_ "GenSigTimeoutTime_BSM" SG_ 951 UConnReq_TBM 0;
BA_ "GenSigTimeoutTime_CADM" SG_ 951 UConnReq_TBM 0;
BA_ "GenSigTimeoutTime_DMSM" SG_ 951 UConnReq_TBM 0;
BA_ "GenSigTimeoutTime_DTCM" SG_ 951 UConnReq_TBM 0;
BA_ "GenSigTimeoutTime_ECM" SG_ 951 UConnReq_TBM 0;
BA_ "GenSigTimeoutTime_EVCU2" SG_ 951 UConnReq_TBM 0;
BA_ "GenSigTimeoutTime_GNMM" SG_ 951 UConnReq_TBM 0;
BA_ "GenSigTimeoutTime_HCP" SG_ 951 UConnReq_TBM 0;
BA_ "GenSigTimeoutTime_IPC" SG_ 951 UConnReq_TBM 0;
BA_ "GenSigTimeoutTime_SGW" SG_ 951 UConnReq_TBM 0;
BA_ "GenSigTimeoutTime_TCM" SG_ 951 UConnReq_TBM 0;
BA_ "GenSigTimeoutTime_AGSM" SG_ 951 UConnReqAuthCode_TBM 0;
BA_ "GenSigTimeoutTime_BCM" SG_ 951 UConnReqAuthCode_TBM 0;
BA_ "GenSigTimeoutTime_BSM" SG_ 951 UConnReqAuthCode_TBM 0;
BA_ "GenSigTimeoutTime_CADM" SG_ 951 UConnReqAuthCode_TBM 0;
BA_ "GenSigTimeoutTime_DMSM" SG_ 951 UConnReqAuthCode_TBM 0;
BA_ "GenSigTimeoutTime_DTCM" SG_ 951 UConnReqAuthCode_TBM 0;
BA_ "GenSigTimeoutTime_ECM" SG_ 951 UConnReqAuthCode_TBM 0;
BA_ "GenSigTimeoutTime_EVCU2" SG_ 951 UConnReqAuthCode_TBM 0;
BA_ "GenSigTimeoutTime_GNMM" SG_ 951 UConnReqAuthCode_TBM 0;
BA_ "GenSigTimeoutTime_HCP" SG_ 951 UConnReqAuthCode_TBM 0;
BA_ "GenSigTimeoutTime_IPC" SG_ 951 UConnReqAuthCode_TBM 0;
BA_ "GenSigTimeoutTime_SGW" SG_ 951 UConnReqAuthCode_TBM 0;
BA_ "GenSigTimeoutTime_TCM" SG_ 951 UConnReqAuthCode_TBM 0;
BA_ "GenSigTimeoutTime_AGSM" SG_ 951 UConnReqFOBNum_TBM 0;
BA_ "GenSigTimeoutTime_BCM" SG_ 951 UConnReqFOBNum_TBM 0;
BA_ "GenSigTimeoutTime_BSM" SG_ 951 UConnReqFOBNum_TBM 0;
BA_ "GenSigTimeoutTime_CADM" SG_ 951 UConnReqFOBNum_TBM 0;
BA_ "GenSigTimeoutTime_DMSM" SG_ 951 UConnReqFOBNum_TBM 0;
BA_ "GenSigTimeoutTime_DTCM" SG_ 951 UConnReqFOBNum_TBM 0;
BA_ "GenSigTimeoutTime_ECM" SG_ 951 UConnReqFOBNum_TBM 0;
BA_ "GenSigTimeoutTime_EVCU2" SG_ 951 UConnReqFOBNum_TBM 0;
BA_ "GenSigTimeoutTime_GNMM" SG_ 951 UConnReqFOBNum_TBM 0;
BA_ "GenSigTimeoutTime_HCP" SG_ 951 UConnReqFOBNum_TBM 0;
BA_ "GenSigTimeoutTime_IPC" SG_ 951 UConnReqFOBNum_TBM 0;
BA_ "GenSigTimeoutTime_SGW" SG_ 951 UConnReqFOBNum_TBM 0;
BA_ "GenSigTimeoutTime_TCM" SG_ 951 UConnReqFOBNum_TBM 0;
BA_ "GenSigTimeoutTime_AGSM" SG_ 1489 V2H_Instant_Power_Draw 0;
BA_ "GenSigTimeoutTime_BCM" SG_ 1489 V2H_Instant_Power_Draw 0;
BA_ "GenSigTimeoutTime_BSM" SG_ 1489 V2H_Instant_Power_Draw 0;
BA_ "GenSigTimeoutTime_CADM" SG_ 1489 V2H_Instant_Power_Draw 0;
BA_ "GenSigTimeoutTime_DMSM" SG_ 1489 V2H_Instant_Power_Draw 0;
BA_ "GenSigTimeoutTime_DTCM" SG_ 1489 V2H_Instant_Power_Draw 0;
BA_ "GenSigTimeoutTime_ECM" SG_ 1489 V2H_Instant_Power_Draw 0;
BA_ "GenSigTimeoutTime_EVCU2" SG_ 1489 V2H_Instant_Power_Draw 0;
BA_ "GenSigTimeoutTime_GNMM" SG_ 1489 V2H_Instant_Power_Draw 0;
BA_ "GenSigTimeoutTime_HCP" SG_ 1489 V2H_Instant_Power_Draw 0;
BA_ "GenSigTimeoutTime_IPC" SG_ 1489 V2H_Instant_Power_Draw 0;
BA_ "GenSigTimeoutTime_RFHM" SG_ 1489 V2H_Instant_Power_Draw 0;
BA_ "GenSigTimeoutTime_TCM" SG_ 1489 V2H_Instant_Power_Draw 0;
BA_ "GenSigTimeoutTime_AGSM" SG_ 1489 V2H_mode_Sts 0;
BA_ "GenSigTimeoutTime_BCM" SG_ 1489 V2H_mode_Sts 0;
BA_ "GenSigTimeoutTime_BSM" SG_ 1489 V2H_mode_Sts 0;
BA_ "GenSigTimeoutTime_CADM" SG_ 1489 V2H_mode_Sts 0;
BA_ "GenSigTimeoutTime_DMSM" SG_ 1489 V2H_mode_Sts 0;
BA_ "GenSigTimeoutTime_DTCM" SG_ 1489 V2H_mode_Sts 0;
BA_ "GenSigTimeoutTime_ECM" SG_ 1489 V2H_mode_Sts 0;
BA_ "GenSigTimeoutTime_EVCU2" SG_ 1489 V2H_mode_Sts 0;
BA_ "GenSigTimeoutTime_GNMM" SG_ 1489 V2H_mode_Sts 0;
BA_ "GenSigTimeoutTime_HCP" SG_ 1489 V2H_mode_Sts 0;
BA_ "GenSigTimeoutTime_IPC" SG_ 1489 V2H_mode_Sts 0;
BA_ "GenSigTimeoutTime_RFHM" SG_ 1489 V2H_mode_Sts 0;
BA_ "GenSigTimeoutTime_TCM" SG_ 1489 V2H_mode_Sts 0;
BA_ "GenSigTimeoutTime_AGSM" SG_ 1489 V2H_Reserve_Battery_Sts 0;
BA_ "GenSigTimeoutTime_BCM" SG_ 1489 V2H_Reserve_Battery_Sts 0;
BA_ "GenSigTimeoutTime_BSM" SG_ 1489 V2H_Reserve_Battery_Sts 0;
BA_ "GenSigTimeoutTime_CADM" SG_ 1489 V2H_Reserve_Battery_Sts 0;
BA_ "GenSigTimeoutTime_DMSM" SG_ 1489 V2H_Reserve_Battery_Sts 0;
BA_ "GenSigTimeoutTime_DTCM" SG_ 1489 V2H_Reserve_Battery_Sts 0;
BA_ "GenSigTimeoutTime_ECM" SG_ 1489 V2H_Reserve_Battery_Sts 0;
BA_ "GenSigTimeoutTime_EVCU2" SG_ 1489 V2H_Reserve_Battery_Sts 0;
BA_ "GenSigTimeoutTime_GNMM" SG_ 1489 V2H_Reserve_Battery_Sts 0;
BA_ "GenSigTimeoutTime_HCP" SG_ 1489 V2H_Reserve_Battery_Sts 0;
BA_ "GenSigTimeoutTime_IPC" SG_ 1489 V2H_Reserve_Battery_Sts 0;
BA_ "GenSigTimeoutTime_RFHM" SG_ 1489 V2H_Reserve_Battery_Sts 0;
BA_ "GenSigTimeoutTime_TCM" SG_ 1489 V2H_Reserve_Battery_Sts 0;
BA_ "GenSigTimeoutTime_AGSM" SG_ 1489 V2H_Status 0;
BA_ "GenSigTimeoutTime_BCM" SG_ 1489 V2H_Status 0;
BA_ "GenSigTimeoutTime_BSM" SG_ 1489 V2H_Status 0;
BA_ "GenSigTimeoutTime_CADM" SG_ 1489 V2H_Status 0;
BA_ "GenSigTimeoutTime_DMSM" SG_ 1489 V2H_Status 0;
BA_ "GenSigTimeoutTime_DTCM" SG_ 1489 V2H_Status 0;
BA_ "GenSigTimeoutTime_ECM" SG_ 1489 V2H_Status 0;
BA_ "GenSigTimeoutTime_GNMM" SG_ 1489 V2H_Status 0;
BA_ "GenSigTimeoutTime_HCP" SG_ 1489 V2H_Status 0;
BA_ "GenSigTimeoutTime_IPC" SG_ 1489 V2H_Status 0;
BA_ "GenSigTimeoutTime_RFHM" SG_ 1489 V2H_Status 0;
BA_ "GenSigTimeoutTime_TCM" SG_ 1489 V2H_Status 0;
BA_ "GenSigTimeoutTime_AGSM" SG_ 1489 V2H_Total_Power_Time_days 0;
BA_ "GenSigTimeoutTime_BCM" SG_ 1489 V2H_Total_Power_Time_days 0;
BA_ "GenSigTimeoutTime_BSM" SG_ 1489 V2H_Total_Power_Time_days 0;
BA_ "GenSigTimeoutTime_CADM" SG_ 1489 V2H_Total_Power_Time_days 0;
BA_ "GenSigTimeoutTime_DMSM" SG_ 1489 V2H_Total_Power_Time_days 0;
BA_ "GenSigTimeoutTime_DTCM" SG_ 1489 V2H_Total_Power_Time_days 0;
BA_ "GenSigTimeoutTime_ECM" SG_ 1489 V2H_Total_Power_Time_days 0;
BA_ "GenSigTimeoutTime_EVCU2" SG_ 1489 V2H_Total_Power_Time_days 0;
BA_ "GenSigTimeoutTime_GNMM" SG_ 1489 V2H_Total_Power_Time_days 0;
BA_ "GenSigTimeoutTime_HCP" SG_ 1489 V2H_Total_Power_Time_days 0;
BA_ "GenSigTimeoutTime_IPC" SG_ 1489 V2H_Total_Power_Time_days 0;
BA_ "GenSigTimeoutTime_RFHM" SG_ 1489 V2H_Total_Power_Time_days 0;
BA_ "GenSigTimeoutTime_TCM" SG_ 1489 V2H_Total_Power_Time_days 0;
BA_ "GenSigTimeoutTime_AGSM" SG_ 1489 V2H_Total_Power_Time_hours 0;
BA_ "GenSigTimeoutTime_BCM" SG_ 1489 V2H_Total_Power_Time_hours 0;
BA_ "GenSigTimeoutTime_BSM" SG_ 1489 V2H_Total_Power_Time_hours 0;
BA_ "GenSigTimeoutTime_CADM" SG_ 1489 V2H_Total_Power_Time_hours 0;
BA_ "GenSigTimeoutTime_DMSM" SG_ 1489 V2H_Total_Power_Time_hours 0;
BA_ "GenSigTimeoutTime_DTCM" SG_ 1489 V2H_Total_Power_Time_hours 0;
BA_ "GenSigTimeoutTime_ECM" SG_ 1489 V2H_Total_Power_Time_hours 0;
BA_ "GenSigTimeoutTime_EVCU2" SG_ 1489 V2H_Total_Power_Time_hours 0;
BA_ "GenSigTimeoutTime_GNMM" SG_ 1489 V2H_Total_Power_Time_hours 0;
BA_ "GenSigTimeoutTime_HCP" SG_ 1489 V2H_Total_Power_Time_hours 0;
BA_ "GenSigTimeoutTime_IPC" SG_ 1489 V2H_Total_Power_Time_hours 0;
BA_ "GenSigTimeoutTime_RFHM" SG_ 1489 V2H_Total_Power_Time_hours 0;
BA_ "GenSigTimeoutTime_TCM" SG_ 1489 V2H_Total_Power_Time_hours 0;
BA_ "GenSigTimeoutTime_AGSM" SG_ 1489 V2H_Total_Power_Time_minutes 0;
BA_ "GenSigTimeoutTime_BCM" SG_ 1489 V2H_Total_Power_Time_minutes 0;
BA_ "GenSigTimeoutTime_BSM" SG_ 1489 V2H_Total_Power_Time_minutes 0;
BA_ "GenSigTimeoutTime_CADM" SG_ 1489 V2H_Total_Power_Time_minutes 0;
BA_ "GenSigTimeoutTime_DMSM" SG_ 1489 V2H_Total_Power_Time_minutes 0;
BA_ "GenSigTimeoutTime_DTCM" SG_ 1489 V2H_Total_Power_Time_minutes 0;
BA_ "GenSigTimeoutTime_ECM" SG_ 1489 V2H_Total_Power_Time_minutes 0;
BA_ "GenSigTimeoutTime_EVCU2" SG_ 1489 V2H_Total_Power_Time_minutes 0;
BA_ "GenSigTimeoutTime_GNMM" SG_ 1489 V2H_Total_Power_Time_minutes 0;
BA_ "GenSigTimeoutTime_HCP" SG_ 1489 V2H_Total_Power_Time_minutes 0;
BA_ "GenSigTimeoutTime_IPC" SG_ 1489 V2H_Total_Power_Time_minutes 0;
BA_ "GenSigTimeoutTime_RFHM" SG_ 1489 V2H_Total_Power_Time_minutes 0;
BA_ "GenSigTimeoutTime_TCM" SG_ 1489 V2H_Total_Power_Time_minutes 0;
BA_ "GenSigTimeoutTime_AGSM" SG_ 1489 V2L_Frunk_Status 0;
BA_ "GenSigTimeoutTime_BCM" SG_ 1489 V2L_Frunk_Status 0;
BA_ "GenSigTimeoutTime_BSM" SG_ 1489 V2L_Frunk_Status 0;
BA_ "GenSigTimeoutTime_CADM" SG_ 1489 V2L_Frunk_Status 0;
BA_ "GenSigTimeoutTime_DMSM" SG_ 1489 V2L_Frunk_Status 0;
BA_ "GenSigTimeoutTime_DTCM" SG_ 1489 V2L_Frunk_Status 0;
BA_ "GenSigTimeoutTime_ECM" SG_ 1489 V2L_Frunk_Status 0;
BA_ "GenSigTimeoutTime_EVCU2" SG_ 1489 V2L_Frunk_Status 0;
BA_ "GenSigTimeoutTime_GNMM" SG_ 1489 V2L_Frunk_Status 0;
BA_ "GenSigTimeoutTime_HCP" SG_ 1489 V2L_Frunk_Status 0;
BA_ "GenSigTimeoutTime_IPC" SG_ 1489 V2L_Frunk_Status 0;
BA_ "GenSigTimeoutTime_RFHM" SG_ 1489 V2L_Frunk_Status 0;
BA_ "GenSigTimeoutTime_TCM" SG_ 1489 V2L_Frunk_Status 0;
BA_ "GenSigTimeoutTime_AGSM" SG_ 1489 V2L_Instant_Power_Draw_Frunk 0;
BA_ "GenSigTimeoutTime_BCM" SG_ 1489 V2L_Instant_Power_Draw_Frunk 0;
BA_ "GenSigTimeoutTime_BSM" SG_ 1489 V2L_Instant_Power_Draw_Frunk 0;
BA_ "GenSigTimeoutTime_CADM" SG_ 1489 V2L_Instant_Power_Draw_Frunk 0;
BA_ "GenSigTimeoutTime_DMSM" SG_ 1489 V2L_Instant_Power_Draw_Frunk 0;
BA_ "GenSigTimeoutTime_DTCM" SG_ 1489 V2L_Instant_Power_Draw_Frunk 0;
BA_ "GenSigTimeoutTime_ECM" SG_ 1489 V2L_Instant_Power_Draw_Frunk 0;
BA_ "GenSigTimeoutTime_EVCU2" SG_ 1489 V2L_Instant_Power_Draw_Frunk 0;
BA_ "GenSigTimeoutTime_GNMM" SG_ 1489 V2L_Instant_Power_Draw_Frunk 0;
BA_ "GenSigTimeoutTime_HCP" SG_ 1489 V2L_Instant_Power_Draw_Frunk 0;
BA_ "GenSigTimeoutTime_IPC" SG_ 1489 V2L_Instant_Power_Draw_Frunk 0;
BA_ "GenSigTimeoutTime_RFHM" SG_ 1489 V2L_Instant_Power_Draw_Frunk 0;
BA_ "GenSigTimeoutTime_TCM" SG_ 1489 V2L_Instant_Power_Draw_Frunk 0;
BA_ "GenSigTimeoutTime_AGSM" SG_ 1489 V2L_Instant_Power_Draw_Trunk 0;
BA_ "GenSigTimeoutTime_BCM" SG_ 1489 V2L_Instant_Power_Draw_Trunk 0;
BA_ "GenSigTimeoutTime_BSM" SG_ 1489 V2L_Instant_Power_Draw_Trunk 0;
BA_ "GenSigTimeoutTime_CADM" SG_ 1489 V2L_Instant_Power_Draw_Trunk 0;
BA_ "GenSigTimeoutTime_DMSM" SG_ 1489 V2L_Instant_Power_Draw_Trunk 0;
BA_ "GenSigTimeoutTime_DTCM" SG_ 1489 V2L_Instant_Power_Draw_Trunk 0;
BA_ "GenSigTimeoutTime_ECM" SG_ 1489 V2L_Instant_Power_Draw_Trunk 0;
BA_ "GenSigTimeoutTime_EVCU2" SG_ 1489 V2L_Instant_Power_Draw_Trunk 0;
BA_ "GenSigTimeoutTime_GNMM" SG_ 1489 V2L_Instant_Power_Draw_Trunk 0;
BA_ "GenSigTimeoutTime_HCP" SG_ 1489 V2L_Instant_Power_Draw_Trunk 0;
BA_ "GenSigTimeoutTime_IPC" SG_ 1489 V2L_Instant_Power_Draw_Trunk 0;
BA_ "GenSigTimeoutTime_RFHM" SG_ 1489 V2L_Instant_Power_Draw_Trunk 0;
BA_ "GenSigTimeoutTime_TCM" SG_ 1489 V2L_Instant_Power_Draw_Trunk 0;
BA_ "GenSigTimeoutTime_AGSM" SG_ 1489 V2L_mode_Sts 0;
BA_ "GenSigTimeoutTime_BCM" SG_ 1489 V2L_mode_Sts 0;
BA_ "GenSigTimeoutTime_BSM" SG_ 1489 V2L_mode_Sts 0;
BA_ "GenSigTimeoutTime_CADM" SG_ 1489 V2L_mode_Sts 0;
BA_ "GenSigTimeoutTime_DMSM" SG_ 1489 V2L_mode_Sts 0;
BA_ "GenSigTimeoutTime_DTCM" SG_ 1489 V2L_mode_Sts 0;
BA_ "GenSigTimeoutTime_ECM" SG_ 1489 V2L_mode_Sts 0;
BA_ "GenSigTimeoutTime_EVCU2" SG_ 1489 V2L_mode_Sts 0;
BA_ "GenSigTimeoutTime_GNMM" SG_ 1489 V2L_mode_Sts 0;
BA_ "GenSigTimeoutTime_HCP" SG_ 1489 V2L_mode_Sts 0;
BA_ "GenSigTimeoutTime_IPC" SG_ 1489 V2L_mode_Sts 0;
BA_ "GenSigTimeoutTime_RFHM" SG_ 1489 V2L_mode_Sts 0;
BA_ "GenSigTimeoutTime_TCM" SG_ 1489 V2L_mode_Sts 0;
BA_ "GenSigTimeoutTime_AGSM" SG_ 1489 V2L_Total_Power_Time_days 0;
BA_ "GenSigTimeoutTime_BCM" SG_ 1489 V2L_Total_Power_Time_days 0;
BA_ "GenSigTimeoutTime_BSM" SG_ 1489 V2L_Total_Power_Time_days 0;
BA_ "GenSigTimeoutTime_CADM" SG_ 1489 V2L_Total_Power_Time_days 0;
BA_ "GenSigTimeoutTime_DMSM" SG_ 1489 V2L_Total_Power_Time_days 0;
BA_ "GenSigTimeoutTime_DTCM" SG_ 1489 V2L_Total_Power_Time_days 0;
BA_ "GenSigTimeoutTime_ECM" SG_ 1489 V2L_Total_Power_Time_days 0;
BA_ "GenSigTimeoutTime_EVCU2" SG_ 1489 V2L_Total_Power_Time_days 0;
BA_ "GenSigTimeoutTime_GNMM" SG_ 1489 V2L_Total_Power_Time_days 0;
BA_ "GenSigTimeoutTime_HCP" SG_ 1489 V2L_Total_Power_Time_days 0;
BA_ "GenSigTimeoutTime_IPC" SG_ 1489 V2L_Total_Power_Time_days 0;
BA_ "GenSigTimeoutTime_RFHM" SG_ 1489 V2L_Total_Power_Time_days 0;
BA_ "GenSigTimeoutTime_TCM" SG_ 1489 V2L_Total_Power_Time_days 0;
BA_ "GenSigTimeoutTime_AGSM" SG_ 1489 V2L_Total_Power_Time_hours 0;
BA_ "GenSigTimeoutTime_BCM" SG_ 1489 V2L_Total_Power_Time_hours 0;
BA_ "GenSigTimeoutTime_BSM" SG_ 1489 V2L_Total_Power_Time_hours 0;
BA_ "GenSigTimeoutTime_CADM" SG_ 1489 V2L_Total_Power_Time_hours 0;
BA_ "GenSigTimeoutTime_DMSM" SG_ 1489 V2L_Total_Power_Time_hours 0;
BA_ "GenSigTimeoutTime_DTCM" SG_ 1489 V2L_Total_Power_Time_hours 0;
BA_ "GenSigTimeoutTime_ECM" SG_ 1489 V2L_Total_Power_Time_hours 0;
BA_ "GenSigTimeoutTime_EVCU2" SG_ 1489 V2L_Total_Power_Time_hours 0;
BA_ "GenSigTimeoutTime_GNMM" SG_ 1489 V2L_Total_Power_Time_hours 0;
BA_ "GenSigTimeoutTime_HCP" SG_ 1489 V2L_Total_Power_Time_hours 0;
BA_ "GenSigTimeoutTime_IPC" SG_ 1489 V2L_Total_Power_Time_hours 0;
BA_ "GenSigTimeoutTime_RFHM" SG_ 1489 V2L_Total_Power_Time_hours 0;
BA_ "GenSigTimeoutTime_TCM" SG_ 1489 V2L_Total_Power_Time_hours 0;
BA_ "GenSigTimeoutTime_AGSM" SG_ 1489 V2L_Total_Power_Time_minutes 0;
BA_ "GenSigTimeoutTime_BCM" SG_ 1489 V2L_Total_Power_Time_minutes 0;
BA_ "GenSigTimeoutTime_BSM" SG_ 1489 V2L_Total_Power_Time_minutes 0;
BA_ "GenSigTimeoutTime_CADM" SG_ 1489 V2L_Total_Power_Time_minutes 0;
BA_ "GenSigTimeoutTime_DMSM" SG_ 1489 V2L_Total_Power_Time_minutes 0;
BA_ "GenSigTimeoutTime_DTCM" SG_ 1489 V2L_Total_Power_Time_minutes 0;
BA_ "GenSigTimeoutTime_ECM" SG_ 1489 V2L_Total_Power_Time_minutes 0;
BA_ "GenSigTimeoutTime_EVCU2" SG_ 1489 V2L_Total_Power_Time_minutes 0;
BA_ "GenSigTimeoutTime_GNMM" SG_ 1489 V2L_Total_Power_Time_minutes 0;
BA_ "GenSigTimeoutTime_HCP" SG_ 1489 V2L_Total_Power_Time_minutes 0;
BA_ "GenSigTimeoutTime_IPC" SG_ 1489 V2L_Total_Power_Time_minutes 0;
BA_ "GenSigTimeoutTime_RFHM" SG_ 1489 V2L_Total_Power_Time_minutes 0;
BA_ "GenSigTimeoutTime_TCM" SG_ 1489 V2L_Total_Power_Time_minutes 0;
BA_ "GenSigTimeoutTime_AGSM" SG_ 1489 V2L_Trunk_Status 0;
BA_ "GenSigTimeoutTime_BCM" SG_ 1489 V2L_Trunk_Status 0;
BA_ "GenSigTimeoutTime_BSM" SG_ 1489 V2L_Trunk_Status 0;
BA_ "GenSigTimeoutTime_CADM" SG_ 1489 V2L_Trunk_Status 0;
BA_ "GenSigTimeoutTime_DMSM" SG_ 1489 V2L_Trunk_Status 0;
BA_ "GenSigTimeoutTime_DTCM" SG_ 1489 V2L_Trunk_Status 0;
BA_ "GenSigTimeoutTime_ECM" SG_ 1489 V2L_Trunk_Status 0;
BA_ "GenSigTimeoutTime_EVCU2" SG_ 1489 V2L_Trunk_Status 0;
BA_ "GenSigTimeoutTime_GNMM" SG_ 1489 V2L_Trunk_Status 0;
BA_ "GenSigTimeoutTime_HCP" SG_ 1489 V2L_Trunk_Status 0;
BA_ "GenSigTimeoutTime_IPC" SG_ 1489 V2L_Trunk_Status 0;
BA_ "GenSigTimeoutTime_RFHM" SG_ 1489 V2L_Trunk_Status 0;
BA_ "GenSigTimeoutTime_TCM" SG_ 1489 V2L_Trunk_Status 0;
BA_ "GenSigTimeoutTime_AGSM" SG_ 1489 V2V_Instant_Power_Draw 0;
BA_ "GenSigTimeoutTime_BCM" SG_ 1489 V2V_Instant_Power_Draw 0;
BA_ "GenSigTimeoutTime_BSM" SG_ 1489 V2V_Instant_Power_Draw 0;
BA_ "GenSigTimeoutTime_CADM" SG_ 1489 V2V_Instant_Power_Draw 0;
BA_ "GenSigTimeoutTime_DMSM" SG_ 1489 V2V_Instant_Power_Draw 0;
BA_ "GenSigTimeoutTime_DTCM" SG_ 1489 V2V_Instant_Power_Draw 0;
BA_ "GenSigTimeoutTime_ECM" SG_ 1489 V2V_Instant_Power_Draw 0;
BA_ "GenSigTimeoutTime_EVCU2" SG_ 1489 V2V_Instant_Power_Draw 0;
BA_ "GenSigTimeoutTime_GNMM" SG_ 1489 V2V_Instant_Power_Draw 0;
BA_ "GenSigTimeoutTime_HCP" SG_ 1489 V2V_Instant_Power_Draw 0;
BA_ "GenSigTimeoutTime_IPC" SG_ 1489 V2V_Instant_Power_Draw 0;
BA_ "GenSigTimeoutTime_RFHM" SG_ 1489 V2V_Instant_Power_Draw 0;
BA_ "GenSigTimeoutTime_TCM" SG_ 1489 V2V_Instant_Power_Draw 0;
BA_ "GenSigTimeoutTime_AGSM" SG_ 1489 V2V_mode_Sts 0;
BA_ "GenSigTimeoutTime_BCM" SG_ 1489 V2V_mode_Sts 0;
BA_ "GenSigTimeoutTime_BSM" SG_ 1489 V2V_mode_Sts 0;
BA_ "GenSigTimeoutTime_CADM" SG_ 1489 V2V_mode_Sts 0;
BA_ "GenSigTimeoutTime_DMSM" SG_ 1489 V2V_mode_Sts 0;
BA_ "GenSigTimeoutTime_DTCM" SG_ 1489 V2V_mode_Sts 0;
BA_ "GenSigTimeoutTime_ECM" SG_ 1489 V2V_mode_Sts 0;
BA_ "GenSigTimeoutTime_EVCU2" SG_ 1489 V2V_mode_Sts 0;
BA_ "GenSigTimeoutTime_GNMM" SG_ 1489 V2V_mode_Sts 0;
BA_ "GenSigTimeoutTime_HCP" SG_ 1489 V2V_mode_Sts 0;
BA_ "GenSigTimeoutTime_IPC" SG_ 1489 V2V_mode_Sts 0;
BA_ "GenSigTimeoutTime_RFHM" SG_ 1489 V2V_mode_Sts 0;
BA_ "GenSigTimeoutTime_TCM" SG_ 1489 V2V_mode_Sts 0;
BA_ "GenSigTimeoutTime_AGSM" SG_ 1489 V2V_Status 0;
BA_ "GenSigTimeoutTime_BCM" SG_ 1489 V2V_Status 0;
BA_ "GenSigTimeoutTime_BSM" SG_ 1489 V2V_Status 0;
BA_ "GenSigTimeoutTime_CADM" SG_ 1489 V2V_Status 0;
BA_ "GenSigTimeoutTime_DMSM" SG_ 1489 V2V_Status 0;
BA_ "GenSigTimeoutTime_DTCM" SG_ 1489 V2V_Status 0;
BA_ "GenSigTimeoutTime_ECM" SG_ 1489 V2V_Status 0;
BA_ "GenSigTimeoutTime_EVCU2" SG_ 1489 V2V_Status 0;
BA_ "GenSigTimeoutTime_GNMM" SG_ 1489 V2V_Status 0;
BA_ "GenSigTimeoutTime_HCP" SG_ 1489 V2V_Status 0;
BA_ "GenSigTimeoutTime_IPC" SG_ 1489 V2V_Status 0;
BA_ "GenSigTimeoutTime_RFHM" SG_ 1489 V2V_Status 0;
BA_ "GenSigTimeoutTime_TCM" SG_ 1489 V2V_Status 0;
BA_ "GenSigTimeoutTime_AGSM" SG_ 1489 V2V_Total_Power_Time_days 0;
BA_ "GenSigTimeoutTime_BCM" SG_ 1489 V2V_Total_Power_Time_days 0;
BA_ "GenSigTimeoutTime_BSM" SG_ 1489 V2V_Total_Power_Time_days 0;
BA_ "GenSigTimeoutTime_CADM" SG_ 1489 V2V_Total_Power_Time_days 0;
BA_ "GenSigTimeoutTime_DMSM" SG_ 1489 V2V_Total_Power_Time_days 0;
BA_ "GenSigTimeoutTime_DTCM" SG_ 1489 V2V_Total_Power_Time_days 0;
BA_ "GenSigTimeoutTime_ECM" SG_ 1489 V2V_Total_Power_Time_days 0;
BA_ "GenSigTimeoutTime_EVCU2" SG_ 1489 V2V_Total_Power_Time_days 0;
BA_ "GenSigTimeoutTime_GNMM" SG_ 1489 V2V_Total_Power_Time_days 0;
BA_ "GenSigTimeoutTime_HCP" SG_ 1489 V2V_Total_Power_Time_days 0;
BA_ "GenSigTimeoutTime_IPC" SG_ 1489 V2V_Total_Power_Time_days 0;
BA_ "GenSigTimeoutTime_RFHM" SG_ 1489 V2V_Total_Power_Time_days 0;
BA_ "GenSigTimeoutTime_TCM" SG_ 1489 V2V_Total_Power_Time_days 0;
BA_ "GenSigTimeoutTime_AGSM" SG_ 1489 V2V_Total_Power_Time_hours 0;
BA_ "GenSigTimeoutTime_BCM" SG_ 1489 V2V_Total_Power_Time_hours 0;
BA_ "GenSigTimeoutTime_BSM" SG_ 1489 V2V_Total_Power_Time_hours 0;
BA_ "GenSigTimeoutTime_CADM" SG_ 1489 V2V_Total_Power_Time_hours 0;
BA_ "GenSigTimeoutTime_DMSM" SG_ 1489 V2V_Total_Power_Time_hours 0;
BA_ "GenSigTimeoutTime_DTCM" SG_ 1489 V2V_Total_Power_Time_hours 0;
BA_ "GenSigTimeoutTime_ECM" SG_ 1489 V2V_Total_Power_Time_hours 0;
BA_ "GenSigTimeoutTime_EVCU2" SG_ 1489 V2V_Total_Power_Time_hours 0;
BA_ "GenSigTimeoutTime_GNMM" SG_ 1489 V2V_Total_Power_Time_hours 0;
BA_ "GenSigTimeoutTime_HCP" SG_ 1489 V2V_Total_Power_Time_hours 0;
BA_ "GenSigTimeoutTime_IPC" SG_ 1489 V2V_Total_Power_Time_hours 0;
BA_ "GenSigTimeoutTime_RFHM" SG_ 1489 V2V_Total_Power_Time_hours 0;
BA_ "GenSigTimeoutTime_TCM" SG_ 1489 V2V_Total_Power_Time_hours 0;
BA_ "GenSigTimeoutTime_AGSM" SG_ 1489 V2V_Total_Power_Time_minutes 0;
BA_ "GenSigTimeoutTime_BCM" SG_ 1489 V2V_Total_Power_Time_minutes 0;
BA_ "GenSigTimeoutTime_BSM" SG_ 1489 V2V_Total_Power_Time_minutes 0;
BA_ "GenSigTimeoutTime_CADM" SG_ 1489 V2V_Total_Power_Time_minutes 0;
BA_ "GenSigTimeoutTime_DMSM" SG_ 1489 V2V_Total_Power_Time_minutes 0;
BA_ "GenSigTimeoutTime_DTCM" SG_ 1489 V2V_Total_Power_Time_minutes 0;
BA_ "GenSigTimeoutTime_ECM" SG_ 1489 V2V_Total_Power_Time_minutes 0;
BA_ "GenSigTimeoutTime_EVCU2" SG_ 1489 V2V_Total_Power_Time_minutes 0;
BA_ "GenSigTimeoutTime_GNMM" SG_ 1489 V2V_Total_Power_Time_minutes 0;
BA_ "GenSigTimeoutTime_HCP" SG_ 1489 V2V_Total_Power_Time_minutes 0;
BA_ "GenSigTimeoutTime_IPC" SG_ 1489 V2V_Total_Power_Time_minutes 0;
BA_ "GenSigTimeoutTime_RFHM" SG_ 1489 V2V_Total_Power_Time_minutes 0;
BA_ "GenSigTimeoutTime_TCM" SG_ 1489 V2V_Total_Power_Time_minutes 0;
BA_ "GenSigTimeoutTime_AGSM" SG_ 1489 V2X_Info 0;
BA_ "GenSigTimeoutTime_BCM" SG_ 1489 V2X_Info 0;
BA_ "GenSigTimeoutTime_BSM" SG_ 1489 V2X_Info 0;
BA_ "GenSigTimeoutTime_CADM" SG_ 1489 V2X_Info 0;
BA_ "GenSigTimeoutTime_DMSM" SG_ 1489 V2X_Info 0;
BA_ "GenSigTimeoutTime_DTCM" SG_ 1489 V2X_Info 0;
BA_ "GenSigTimeoutTime_ECM" SG_ 1489 V2X_Info 0;
BA_ "GenSigTimeoutTime_EVCU2" SG_ 1489 V2X_Info 0;
BA_ "GenSigTimeoutTime_GNMM" SG_ 1489 V2X_Info 0;
BA_ "GenSigTimeoutTime_HCP" SG_ 1489 V2X_Info 0;
BA_ "GenSigTimeoutTime_IPC" SG_ 1489 V2X_Info 0;
BA_ "GenSigTimeoutTime_RFHM" SG_ 1489 V2X_Info 0;
BA_ "GenSigTimeoutTime_TCM" SG_ 1489 V2X_Info 0;
BA_ "GenSigTimeoutTime_AGSM" SG_ 1490 V2H_Mode_Req 0;
BA_ "GenSigTimeoutTime_BCM" SG_ 1490 V2H_Mode_Req 0;
BA_ "GenSigTimeoutTime_BSM" SG_ 1490 V2H_Mode_Req 0;
BA_ "GenSigTimeoutTime_CADM" SG_ 1490 V2H_Mode_Req 0;
BA_ "GenSigTimeoutTime_DMSM" SG_ 1490 V2H_Mode_Req 0;
BA_ "GenSigTimeoutTime_DTCM" SG_ 1490 V2H_Mode_Req 0;
BA_ "GenSigTimeoutTime_ECM" SG_ 1490 V2H_Mode_Req 0;
BA_ "GenSigTimeoutTime_GNMM" SG_ 1490 V2H_Mode_Req 0;
BA_ "GenSigTimeoutTime_HCP" SG_ 1490 V2H_Mode_Req 0;
BA_ "GenSigTimeoutTime_IPC" SG_ 1490 V2H_Mode_Req 0;
BA_ "GenSigTimeoutTime_RFHM" SG_ 1490 V2H_Mode_Req 0;
BA_ "GenSigTimeoutTime_SGW" SG_ 1490 V2H_Mode_Req 0;
BA_ "GenSigTimeoutTime_TCM" SG_ 1490 V2H_Mode_Req 0;
BA_ "GenSigTimeoutTime_AGSM" SG_ 1490 V2H_Req 0;
BA_ "GenSigTimeoutTime_BCM" SG_ 1490 V2H_Req 0;
BA_ "GenSigTimeoutTime_BSM" SG_ 1490 V2H_Req 0;
BA_ "GenSigTimeoutTime_CADM" SG_ 1490 V2H_Req 0;
BA_ "GenSigTimeoutTime_DMSM" SG_ 1490 V2H_Req 0;
BA_ "GenSigTimeoutTime_DTCM" SG_ 1490 V2H_Req 0;
BA_ "GenSigTimeoutTime_ECM" SG_ 1490 V2H_Req 0;
BA_ "GenSigTimeoutTime_GNMM" SG_ 1490 V2H_Req 0;
BA_ "GenSigTimeoutTime_HCP" SG_ 1490 V2H_Req 0;
BA_ "GenSigTimeoutTime_IPC" SG_ 1490 V2H_Req 0;
BA_ "GenSigTimeoutTime_RFHM" SG_ 1490 V2H_Req 0;
BA_ "GenSigTimeoutTime_SGW" SG_ 1490 V2H_Req 0;
BA_ "GenSigTimeoutTime_TCM" SG_ 1490 V2H_Req 0;
BA_ "GenSigTimeoutTime_AGSM" SG_ 1490 V2H_Reserve_Battery 0;
BA_ "GenSigTimeoutTime_BCM" SG_ 1490 V2H_Reserve_Battery 0;
BA_ "GenSigTimeoutTime_BSM" SG_ 1490 V2H_Reserve_Battery 0;
BA_ "GenSigTimeoutTime_CADM" SG_ 1490 V2H_Reserve_Battery 0;
BA_ "GenSigTimeoutTime_DMSM" SG_ 1490 V2H_Reserve_Battery 0;
BA_ "GenSigTimeoutTime_DTCM" SG_ 1490 V2H_Reserve_Battery 0;
BA_ "GenSigTimeoutTime_ECM" SG_ 1490 V2H_Reserve_Battery 0;
BA_ "GenSigTimeoutTime_GNMM" SG_ 1490 V2H_Reserve_Battery 0;
BA_ "GenSigTimeoutTime_HCP" SG_ 1490 V2H_Reserve_Battery 0;
BA_ "GenSigTimeoutTime_IPC" SG_ 1490 V2H_Reserve_Battery 0;
BA_ "GenSigTimeoutTime_RFHM" SG_ 1490 V2H_Reserve_Battery 0;
BA_ "GenSigTimeoutTime_SGW" SG_ 1490 V2H_Reserve_Battery 0;
BA_ "GenSigTimeoutTime_TCM" SG_ 1490 V2H_Reserve_Battery 0;
BA_ "GenSigTimeoutTime_AGSM" SG_ 1490 V2H_Submit 0;
BA_ "GenSigTimeoutTime_BCM" SG_ 1490 V2H_Submit 0;
BA_ "GenSigTimeoutTime_BSM" SG_ 1490 V2H_Submit 0;
BA_ "GenSigTimeoutTime_CADM" SG_ 1490 V2H_Submit 0;
BA_ "GenSigTimeoutTime_DMSM" SG_ 1490 V2H_Submit 0;
BA_ "GenSigTimeoutTime_DTCM" SG_ 1490 V2H_Submit 0;
BA_ "GenSigTimeoutTime_ECM" SG_ 1490 V2H_Submit 0;
BA_ "GenSigTimeoutTime_GNMM" SG_ 1490 V2H_Submit 0;
BA_ "GenSigTimeoutTime_HCP" SG_ 1490 V2H_Submit 0;
BA_ "GenSigTimeoutTime_IPC" SG_ 1490 V2H_Submit 0;
BA_ "GenSigTimeoutTime_RFHM" SG_ 1490 V2H_Submit 0;
BA_ "GenSigTimeoutTime_SGW" SG_ 1490 V2H_Submit 0;
BA_ "GenSigTimeoutTime_TCM" SG_ 1490 V2H_Submit 0;
BA_ "GenSigTimeoutTime_AGSM" SG_ 1490 V2L_All_Req 0;
BA_ "GenSigTimeoutTime_BCM" SG_ 1490 V2L_All_Req 0;
BA_ "GenSigTimeoutTime_BSM" SG_ 1490 V2L_All_Req 0;
BA_ "GenSigTimeoutTime_CADM" SG_ 1490 V2L_All_Req 0;
BA_ "GenSigTimeoutTime_DMSM" SG_ 1490 V2L_All_Req 0;
BA_ "GenSigTimeoutTime_DTCM" SG_ 1490 V2L_All_Req 0;
BA_ "GenSigTimeoutTime_ECM" SG_ 1490 V2L_All_Req 0;
BA_ "GenSigTimeoutTime_GNMM" SG_ 1490 V2L_All_Req 0;
BA_ "GenSigTimeoutTime_HCP" SG_ 1490 V2L_All_Req 0;
BA_ "GenSigTimeoutTime_IPC" SG_ 1490 V2L_All_Req 0;
BA_ "GenSigTimeoutTime_RFHM" SG_ 1490 V2L_All_Req 0;
BA_ "GenSigTimeoutTime_SGW" SG_ 1490 V2L_All_Req 0;
BA_ "GenSigTimeoutTime_TCM" SG_ 1490 V2L_All_Req 0;
BA_ "GenSigTimeoutTime_AGSM" SG_ 1490 V2L_Frunk_Req 0;
BA_ "GenSigTimeoutTime_BCM" SG_ 1490 V2L_Frunk_Req 0;
BA_ "GenSigTimeoutTime_BSM" SG_ 1490 V2L_Frunk_Req 0;
BA_ "GenSigTimeoutTime_CADM" SG_ 1490 V2L_Frunk_Req 0;
BA_ "GenSigTimeoutTime_DMSM" SG_ 1490 V2L_Frunk_Req 0;
BA_ "GenSigTimeoutTime_DTCM" SG_ 1490 V2L_Frunk_Req 0;
BA_ "GenSigTimeoutTime_ECM" SG_ 1490 V2L_Frunk_Req 0;
BA_ "GenSigTimeoutTime_GNMM" SG_ 1490 V2L_Frunk_Req 0;
BA_ "GenSigTimeoutTime_HCP" SG_ 1490 V2L_Frunk_Req 0;
BA_ "GenSigTimeoutTime_IPC" SG_ 1490 V2L_Frunk_Req 0;
BA_ "GenSigTimeoutTime_RFHM" SG_ 1490 V2L_Frunk_Req 0;
BA_ "GenSigTimeoutTime_SGW" SG_ 1490 V2L_Frunk_Req 0;
BA_ "GenSigTimeoutTime_TCM" SG_ 1490 V2L_Frunk_Req 0;
BA_ "GenSigTimeoutTime_AGSM" SG_ 1490 V2L_Mode_Req 0;
BA_ "GenSigTimeoutTime_BCM" SG_ 1490 V2L_Mode_Req 0;
BA_ "GenSigTimeoutTime_BSM" SG_ 1490 V2L_Mode_Req 0;
BA_ "GenSigTimeoutTime_CADM" SG_ 1490 V2L_Mode_Req 0;
BA_ "GenSigTimeoutTime_DMSM" SG_ 1490 V2L_Mode_Req 0;
BA_ "GenSigTimeoutTime_DTCM" SG_ 1490 V2L_Mode_Req 0;
BA_ "GenSigTimeoutTime_ECM" SG_ 1490 V2L_Mode_Req 0;
BA_ "GenSigTimeoutTime_GNMM" SG_ 1490 V2L_Mode_Req 0;
BA_ "GenSigTimeoutTime_HCP" SG_ 1490 V2L_Mode_Req 0;
BA_ "GenSigTimeoutTime_IPC" SG_ 1490 V2L_Mode_Req 0;
BA_ "GenSigTimeoutTime_RFHM" SG_ 1490 V2L_Mode_Req 0;
BA_ "GenSigTimeoutTime_SGW" SG_ 1490 V2L_Mode_Req 0;
BA_ "GenSigTimeoutTime_TCM" SG_ 1490 V2L_Mode_Req 0;
BA_ "GenSigTimeoutTime_AGSM" SG_ 1490 V2L_Reserve_Battery 0;
BA_ "GenSigTimeoutTime_BCM" SG_ 1490 V2L_Reserve_Battery 0;
BA_ "GenSigTimeoutTime_BSM" SG_ 1490 V2L_Reserve_Battery 0;
BA_ "GenSigTimeoutTime_CADM" SG_ 1490 V2L_Reserve_Battery 0;
BA_ "GenSigTimeoutTime_DMSM" SG_ 1490 V2L_Reserve_Battery 0;
BA_ "GenSigTimeoutTime_DTCM" SG_ 1490 V2L_Reserve_Battery 0;
BA_ "GenSigTimeoutTime_ECM" SG_ 1490 V2L_Reserve_Battery 0;
BA_ "GenSigTimeoutTime_GNMM" SG_ 1490 V2L_Reserve_Battery 0;
BA_ "GenSigTimeoutTime_HCP" SG_ 1490 V2L_Reserve_Battery 0;
BA_ "GenSigTimeoutTime_IPC" SG_ 1490 V2L_Reserve_Battery 0;
BA_ "GenSigTimeoutTime_RFHM" SG_ 1490 V2L_Reserve_Battery 0;
BA_ "GenSigTimeoutTime_SGW" SG_ 1490 V2L_Reserve_Battery 0;
BA_ "GenSigTimeoutTime_TCM" SG_ 1490 V2L_Reserve_Battery 0;
BA_ "GenSigTimeoutTime_AGSM" SG_ 1490 V2L_Submit 0;
BA_ "GenSigTimeoutTime_BCM" SG_ 1490 V2L_Submit 0;
BA_ "GenSigTimeoutTime_BSM" SG_ 1490 V2L_Submit 0;
BA_ "GenSigTimeoutTime_CADM" SG_ 1490 V2L_Submit 0;
BA_ "GenSigTimeoutTime_DMSM" SG_ 1490 V2L_Submit 0;
BA_ "GenSigTimeoutTime_DTCM" SG_ 1490 V2L_Submit 0;
BA_ "GenSigTimeoutTime_ECM" SG_ 1490 V2L_Submit 0;
BA_ "GenSigTimeoutTime_GNMM" SG_ 1490 V2L_Submit 0;
BA_ "GenSigTimeoutTime_HCP" SG_ 1490 V2L_Submit 0;
BA_ "GenSigTimeoutTime_IPC" SG_ 1490 V2L_Submit 0;
BA_ "GenSigTimeoutTime_RFHM" SG_ 1490 V2L_Submit 0;
BA_ "GenSigTimeoutTime_SGW" SG_ 1490 V2L_Submit 0;
BA_ "GenSigTimeoutTime_TCM" SG_ 1490 V2L_Submit 0;
BA_ "GenSigTimeoutTime_AGSM" SG_ 1490 V2L_Trunk_Req 0;
BA_ "GenSigTimeoutTime_BCM" SG_ 1490 V2L_Trunk_Req 0;
BA_ "GenSigTimeoutTime_BSM" SG_ 1490 V2L_Trunk_Req 0;
BA_ "GenSigTimeoutTime_CADM" SG_ 1490 V2L_Trunk_Req 0;
BA_ "GenSigTimeoutTime_DMSM" SG_ 1490 V2L_Trunk_Req 0;
BA_ "GenSigTimeoutTime_DTCM" SG_ 1490 V2L_Trunk_Req 0;
BA_ "GenSigTimeoutTime_ECM" SG_ 1490 V2L_Trunk_Req 0;
BA_ "GenSigTimeoutTime_GNMM" SG_ 1490 V2L_Trunk_Req 0;
BA_ "GenSigTimeoutTime_HCP" SG_ 1490 V2L_Trunk_Req 0;
BA_ "GenSigTimeoutTime_IPC" SG_ 1490 V2L_Trunk_Req 0;
BA_ "GenSigTimeoutTime_RFHM" SG_ 1490 V2L_Trunk_Req 0;
BA_ "GenSigTimeoutTime_SGW" SG_ 1490 V2L_Trunk_Req 0;
BA_ "GenSigTimeoutTime_TCM" SG_ 1490 V2L_Trunk_Req 0;
BA_ "GenSigTimeoutTime_AGSM" SG_ 1490 V2V_Mode_Req 0;
BA_ "GenSigTimeoutTime_BCM" SG_ 1490 V2V_Mode_Req 0;
BA_ "GenSigTimeoutTime_BSM" SG_ 1490 V2V_Mode_Req 0;
BA_ "GenSigTimeoutTime_CADM" SG_ 1490 V2V_Mode_Req 0;
BA_ "GenSigTimeoutTime_DMSM" SG_ 1490 V2V_Mode_Req 0;
BA_ "GenSigTimeoutTime_DTCM" SG_ 1490 V2V_Mode_Req 0;
BA_ "GenSigTimeoutTime_ECM" SG_ 1490 V2V_Mode_Req 0;
BA_ "GenSigTimeoutTime_GNMM" SG_ 1490 V2V_Mode_Req 0;
BA_ "GenSigTimeoutTime_HCP" SG_ 1490 V2V_Mode_Req 0;
BA_ "GenSigTimeoutTime_IPC" SG_ 1490 V2V_Mode_Req 0;
BA_ "GenSigTimeoutTime_RFHM" SG_ 1490 V2V_Mode_Req 0;
BA_ "GenSigTimeoutTime_SGW" SG_ 1490 V2V_Mode_Req 0;
BA_ "GenSigTimeoutTime_TCM" SG_ 1490 V2V_Mode_Req 0;
BA_ "GenSigTimeoutTime_AGSM" SG_ 1490 V2V_Req 0;
BA_ "GenSigTimeoutTime_BCM" SG_ 1490 V2V_Req 0;
BA_ "GenSigTimeoutTime_BSM" SG_ 1490 V2V_Req 0;
BA_ "GenSigTimeoutTime_CADM" SG_ 1490 V2V_Req 0;
BA_ "GenSigTimeoutTime_DMSM" SG_ 1490 V2V_Req 0;
BA_ "GenSigTimeoutTime_DTCM" SG_ 1490 V2V_Req 0;
BA_ "GenSigTimeoutTime_ECM" SG_ 1490 V2V_Req 0;
BA_ "GenSigTimeoutTime_GNMM" SG_ 1490 V2V_Req 0;
BA_ "GenSigTimeoutTime_HCP" SG_ 1490 V2V_Req 0;
BA_ "GenSigTimeoutTime_IPC" SG_ 1490 V2V_Req 0;
BA_ "GenSigTimeoutTime_RFHM" SG_ 1490 V2V_Req 0;
BA_ "GenSigTimeoutTime_SGW" SG_ 1490 V2V_Req 0;
BA_ "GenSigTimeoutTime_TCM" SG_ 1490 V2V_Req 0;
BA_ "GenSigTimeoutTime_AGSM" SG_ 1490 V2V_Reserve_Battery 0;
BA_ "GenSigTimeoutTime_BCM" SG_ 1490 V2V_Reserve_Battery 0;
BA_ "GenSigTimeoutTime_BSM" SG_ 1490 V2V_Reserve_Battery 0;
BA_ "GenSigTimeoutTime_CADM" SG_ 1490 V2V_Reserve_Battery 0;
BA_ "GenSigTimeoutTime_DMSM" SG_ 1490 V2V_Reserve_Battery 0;
BA_ "GenSigTimeoutTime_DTCM" SG_ 1490 V2V_Reserve_Battery 0;
BA_ "GenSigTimeoutTime_ECM" SG_ 1490 V2V_Reserve_Battery 0;
BA_ "GenSigTimeoutTime_GNMM" SG_ 1490 V2V_Reserve_Battery 0;
BA_ "GenSigTimeoutTime_HCP" SG_ 1490 V2V_Reserve_Battery 0;
BA_ "GenSigTimeoutTime_IPC" SG_ 1490 V2V_Reserve_Battery 0;
BA_ "GenSigTimeoutTime_RFHM" SG_ 1490 V2V_Reserve_Battery 0;
BA_ "GenSigTimeoutTime_SGW" SG_ 1490 V2V_Reserve_Battery 0;
BA_ "GenSigTimeoutTime_TCM" SG_ 1490 V2V_Reserve_Battery 0;
BA_ "GenSigTimeoutTime_AGSM" SG_ 1490 V2V_Submit 0;
BA_ "GenSigTimeoutTime_BCM" SG_ 1490 V2V_Submit 0;
BA_ "GenSigTimeoutTime_BSM" SG_ 1490 V2V_Submit 0;
BA_ "GenSigTimeoutTime_CADM" SG_ 1490 V2V_Submit 0;
BA_ "GenSigTimeoutTime_DMSM" SG_ 1490 V2V_Submit 0;
BA_ "GenSigTimeoutTime_DTCM" SG_ 1490 V2V_Submit 0;
BA_ "GenSigTimeoutTime_ECM" SG_ 1490 V2V_Submit 0;
BA_ "GenSigTimeoutTime_GNMM" SG_ 1490 V2V_Submit 0;
BA_ "GenSigTimeoutTime_HCP" SG_ 1490 V2V_Submit 0;
BA_ "GenSigTimeoutTime_IPC" SG_ 1490 V2V_Submit 0;
BA_ "GenSigTimeoutTime_RFHM" SG_ 1490 V2V_Submit 0;
BA_ "GenSigTimeoutTime_SGW" SG_ 1490 V2V_Submit 0;
BA_ "GenSigTimeoutTime_TCM" SG_ 1490 V2V_Submit 0;
BA_ "GenSigTimeoutTime_AGSM" SG_ 1426 BatteryRunaway_Lamp_PT 0;
BA_ "GenSigTimeoutTime_BSM" SG_ 1426 BatteryRunaway_Lamp_PT 0;
BA_ "GenSigTimeoutTime_CADM" SG_ 1426 BatteryRunaway_Lamp_PT 0;
BA_ "GenSigTimeoutTime_DMSM" SG_ 1426 BatteryRunaway_Lamp_PT 0;
BA_ "GenSigTimeoutTime_DTCM" SG_ 1426 BatteryRunaway_Lamp_PT 0;
BA_ "GenSigTimeoutTime_ECM" SG_ 1426 BatteryRunaway_Lamp_PT 0;
BA_ "GenSigTimeoutTime_EVCU2" SG_ 1426 BatteryRunaway_Lamp_PT 0;
BA_ "GenSigTimeoutTime_GNMM" SG_ 1426 BatteryRunaway_Lamp_PT 0;
BA_ "GenSigTimeoutTime_HCP" SG_ 1426 BatteryRunaway_Lamp_PT 0;
BA_ "GenSigTimeoutTime_RFHM" SG_ 1426 BatteryRunaway_Lamp_PT 0;
BA_ "GenSigTimeoutTime_SGW" SG_ 1426 BatteryRunaway_Lamp_PT 0;
BA_ "GenSigTimeoutTime_TCM" SG_ 1426 BatteryRunaway_Lamp_PT 0;
BA_ "GenSigTimeoutTime_AGSM" SG_ 1426 CRC_VDCM_HMI 0;
BA_ "GenSigTimeoutTime_BCM" SG_ 1426 CRC_VDCM_HMI 0;
BA_ "GenSigTimeoutTime_BSM" SG_ 1426 CRC_VDCM_HMI 0;
BA_ "GenSigTimeoutTime_CADM" SG_ 1426 CRC_VDCM_HMI 0;
BA_ "GenSigTimeoutTime_DMSM" SG_ 1426 CRC_VDCM_HMI 0;
BA_ "GenSigTimeoutTime_DTCM" SG_ 1426 CRC_VDCM_HMI 0;
BA_ "GenSigTimeoutTime_ECM" SG_ 1426 CRC_VDCM_HMI 0;
BA_ "GenSigTimeoutTime_EVCU2" SG_ 1426 CRC_VDCM_HMI 0;
BA_ "GenSigTimeoutTime_GNMM" SG_ 1426 CRC_VDCM_HMI 0;
BA_ "GenSigTimeoutTime_HCP" SG_ 1426 CRC_VDCM_HMI 0;
BA_ "GenSigTimeoutTime_RFHM" SG_ 1426 CRC_VDCM_HMI 0;
BA_ "GenSigTimeoutTime_SGW" SG_ 1426 CRC_VDCM_HMI 0;
BA_ "GenSigTimeoutTime_TCM" SG_ 1426 CRC_VDCM_HMI 0;
BA_ "GenSigSendType" SG_ 1426 DC_EstChargeTime1 3;
BA_ "GenSigTimeoutTime_AGSM" SG_ 1426 DC_EstChargeTime1 0;
BA_ "GenSigTimeoutTime_BCM" SG_ 1426 DC_EstChargeTime1 0;
BA_ "GenSigTimeoutTime_BSM" SG_ 1426 DC_EstChargeTime1 0;
BA_ "GenSigTimeoutTime_CADM" SG_ 1426 DC_EstChargeTime1 0;
BA_ "GenSigTimeoutTime_DMSM" SG_ 1426 DC_EstChargeTime1 0;
BA_ "GenSigTimeoutTime_DTCM" SG_ 1426 DC_EstChargeTime1 0;
BA_ "GenSigTimeoutTime_ECM" SG_ 1426 DC_EstChargeTime1 0;
BA_ "GenSigTimeoutTime_EVCU2" SG_ 1426 DC_EstChargeTime1 0;
BA_ "GenSigTimeoutTime_GNMM" SG_ 1426 DC_EstChargeTime1 0;
BA_ "GenSigTimeoutTime_HCP" SG_ 1426 DC_EstChargeTime1 0;
BA_ "GenSigTimeoutTime_RFHM" SG_ 1426 DC_EstChargeTime1 0;
BA_ "GenSigTimeoutTime_TCM" SG_ 1426 DC_EstChargeTime1 0;
BA_ "GenSigSendType" SG_ 1426 DC_EstChargeTime2 3;
BA_ "GenSigTimeoutTime_AGSM" SG_ 1426 DC_EstChargeTime2 0;
BA_ "GenSigTimeoutTime_BCM" SG_ 1426 DC_EstChargeTime2 0;
BA_ "GenSigTimeoutTime_BSM" SG_ 1426 DC_EstChargeTime2 0;
BA_ "GenSigTimeoutTime_CADM" SG_ 1426 DC_EstChargeTime2 0;
BA_ "GenSigTimeoutTime_DMSM" SG_ 1426 DC_EstChargeTime2 0;
BA_ "GenSigTimeoutTime_DTCM" SG_ 1426 DC_EstChargeTime2 0;
BA_ "GenSigTimeoutTime_ECM" SG_ 1426 DC_EstChargeTime2 0;
BA_ "GenSigTimeoutTime_EVCU2" SG_ 1426 DC_EstChargeTime2 0;
BA_ "GenSigTimeoutTime_GNMM" SG_ 1426 DC_EstChargeTime2 0;
BA_ "GenSigTimeoutTime_HCP" SG_ 1426 DC_EstChargeTime2 0;
BA_ "GenSigTimeoutTime_RFHM" SG_ 1426 DC_EstChargeTime2 0;
BA_ "GenSigTimeoutTime_TCM" SG_ 1426 DC_EstChargeTime2 0;
BA_ "GenSigSendType" SG_ 1426 Est_HVBatSOC_VDCM 3;
BA_ "GenSigTimeoutTime_AGSM" SG_ 1426 Est_HVBatSOC_VDCM 0;
BA_ "GenSigTimeoutTime_BCM" SG_ 1426 Est_HVBatSOC_VDCM 0;
BA_ "GenSigTimeoutTime_BSM" SG_ 1426 Est_HVBatSOC_VDCM 0;
BA_ "GenSigTimeoutTime_CADM" SG_ 1426 Est_HVBatSOC_VDCM 0;
BA_ "GenSigTimeoutTime_DMSM" SG_ 1426 Est_HVBatSOC_VDCM 0;
BA_ "GenSigTimeoutTime_DTCM" SG_ 1426 Est_HVBatSOC_VDCM 0;
BA_ "GenSigTimeoutTime_ECM" SG_ 1426 Est_HVBatSOC_VDCM 0;
BA_ "GenSigTimeoutTime_EVCU2" SG_ 1426 Est_HVBatSOC_VDCM 0;
BA_ "GenSigTimeoutTime_GNMM" SG_ 1426 Est_HVBatSOC_VDCM 0;
BA_ "GenSigTimeoutTime_HCP" SG_ 1426 Est_HVBatSOC_VDCM 0;
BA_ "GenSigTimeoutTime_IPC" SG_ 1426 Est_HVBatSOC_VDCM 0;
BA_ "GenSigTimeoutTime_RFHM" SG_ 1426 Est_HVBatSOC_VDCM 0;
BA_ "GenSigTimeoutTime_TCM" SG_ 1426 Est_HVBatSOC_VDCM 0;
BA_ "GenSigSendType" SG_ 1426 Est_Range_ChrgStopTime 3;
BA_ "GenSigTimeoutTime_AGSM" SG_ 1426 Est_Range_ChrgStopTime 0;
BA_ "GenSigTimeoutTime_BCM" SG_ 1426 Est_Range_ChrgStopTime 0;
BA_ "GenSigTimeoutTime_BSM" SG_ 1426 Est_Range_ChrgStopTime 0;
BA_ "GenSigTimeoutTime_CADM" SG_ 1426 Est_Range_ChrgStopTime 0;
BA_ "GenSigTimeoutTime_DMSM" SG_ 1426 Est_Range_ChrgStopTime 0;
BA_ "GenSigTimeoutTime_DTCM" SG_ 1426 Est_Range_ChrgStopTime 0;
BA_ "GenSigTimeoutTime_ECM" SG_ 1426 Est_Range_ChrgStopTime 0;
BA_ "GenSigTimeoutTime_EVCU2" SG_ 1426 Est_Range_ChrgStopTime 0;
BA_ "GenSigTimeoutTime_GNMM" SG_ 1426 Est_Range_ChrgStopTime 0;
BA_ "GenSigTimeoutTime_HCP" SG_ 1426 Est_Range_ChrgStopTime 0;
BA_ "GenSigTimeoutTime_IPC" SG_ 1426 Est_Range_ChrgStopTime 0;
BA_ "GenSigTimeoutTime_RFHM" SG_ 1426 Est_Range_ChrgStopTime 0;
BA_ "GenSigTimeoutTime_TCM" SG_ 1426 Est_Range_ChrgStopTime 0;
BA_ "GenSigStartValue" SG_ 1426 EstRange 2047;
BA_ "GenSigSendType" SG_ 1426 EstRange 3;
BA_ "GenSigTimeoutTime_AGSM" SG_ 1426 EstRange 0;
BA_ "GenSigTimeoutTime_BCM" SG_ 1426 EstRange 0;
BA_ "GenSigTimeoutTime_BSM" SG_ 1426 EstRange 0;
BA_ "GenSigTimeoutTime_CADM" SG_ 1426 EstRange 0;
BA_ "GenSigTimeoutTime_DMSM" SG_ 1426 EstRange 0;
BA_ "GenSigTimeoutTime_DTCM" SG_ 1426 EstRange 0;
BA_ "GenSigTimeoutTime_ECM" SG_ 1426 EstRange 0;
BA_ "GenSigTimeoutTime_EVCU2" SG_ 1426 EstRange 0;
BA_ "GenSigTimeoutTime_GNMM" SG_ 1426 EstRange 0;
BA_ "GenSigTimeoutTime_HCP" SG_ 1426 EstRange 0;
BA_ "GenSigTimeoutTime_RFHM" SG_ 1426 EstRange 0;
BA_ "GenSigTimeoutTime_SGW" SG_ 1426 EstRange 0;
BA_ "GenSigTimeoutTime_TCM" SG_ 1426 EstRange 0;
BA_ "GenSigStartValue" SG_ 1426 HVBatteryTempForDisplay 255;
BA_ "GenSigSendType" SG_ 1426 HVBatteryTempForDisplay 3;
BA_ "GenSigTimeoutTime_AGSM" SG_ 1426 HVBatteryTempForDisplay 0;
BA_ "GenSigTimeoutTime_BCM" SG_ 1426 HVBatteryTempForDisplay 0;
BA_ "GenSigTimeoutTime_BSM" SG_ 1426 HVBatteryTempForDisplay 0;
BA_ "GenSigTimeoutTime_CADM" SG_ 1426 HVBatteryTempForDisplay 0;
BA_ "GenSigTimeoutTime_DMSM" SG_ 1426 HVBatteryTempForDisplay 0;
BA_ "GenSigTimeoutTime_DTCM" SG_ 1426 HVBatteryTempForDisplay 0;
BA_ "GenSigTimeoutTime_ECM" SG_ 1426 HVBatteryTempForDisplay 0;
BA_ "GenSigTimeoutTime_EVCU2" SG_ 1426 HVBatteryTempForDisplay 0;
BA_ "GenSigTimeoutTime_GNMM" SG_ 1426 HVBatteryTempForDisplay 0;
BA_ "GenSigTimeoutTime_HCP" SG_ 1426 HVBatteryTempForDisplay 0;
BA_ "GenSigTimeoutTime_RFHM" SG_ 1426 HVBatteryTempForDisplay 0;
BA_ "GenSigTimeoutTime_TCM" SG_ 1426 HVBatteryTempForDisplay 0;
BA_ "GenSigTimeoutTime_AGSM" SG_ 1426 MessageCounter_VDCM_HMI 0;
BA_ "GenSigTimeoutTime_BCM" SG_ 1426 MessageCounter_VDCM_HMI 0;
BA_ "GenSigTimeoutTime_BSM" SG_ 1426 MessageCounter_VDCM_HMI 0;
BA_ "GenSigTimeoutTime_CADM" SG_ 1426 MessageCounter_VDCM_HMI 0;
BA_ "GenSigTimeoutTime_DMSM" SG_ 1426 MessageCounter_VDCM_HMI 0;
BA_ "GenSigTimeoutTime_DTCM" SG_ 1426 MessageCounter_VDCM_HMI 0;
BA_ "GenSigTimeoutTime_ECM" SG_ 1426 MessageCounter_VDCM_HMI 0;
BA_ "GenSigTimeoutTime_EVCU2" SG_ 1426 MessageCounter_VDCM_HMI 0;
BA_ "GenSigTimeoutTime_GNMM" SG_ 1426 MessageCounter_VDCM_HMI 0;
BA_ "GenSigTimeoutTime_HCP" SG_ 1426 MessageCounter_VDCM_HMI 0;
BA_ "GenSigTimeoutTime_RFHM" SG_ 1426 MessageCounter_VDCM_HMI 0;
BA_ "GenSigTimeoutTime_SGW" SG_ 1426 MessageCounter_VDCM_HMI 0;
BA_ "GenSigTimeoutTime_TCM" SG_ 1426 MessageCounter_VDCM_HMI 0;
BA_ "GenSigSendType" SG_ 1426 ServiceHVError 3;
BA_ "GenSigTimeoutTime_AGSM" SG_ 1426 ServiceHVError 0;
BA_ "GenSigTimeoutTime_BCM" SG_ 1426 ServiceHVError 0;
BA_ "GenSigTimeoutTime_BSM" SG_ 1426 ServiceHVError 0;
BA_ "GenSigTimeoutTime_CADM" SG_ 1426 ServiceHVError 0;
BA_ "GenSigTimeoutTime_DMSM" SG_ 1426 ServiceHVError 0;
BA_ "GenSigTimeoutTime_DTCM" SG_ 1426 ServiceHVError 0;
BA_ "GenSigTimeoutTime_ECM" SG_ 1426 ServiceHVError 0;
BA_ "GenSigTimeoutTime_EVCU2" SG_ 1426 ServiceHVError 0;
BA_ "GenSigTimeoutTime_GNMM" SG_ 1426 ServiceHVError 0;
BA_ "GenSigTimeoutTime_HCP" SG_ 1426 ServiceHVError 0;
BA_ "GenSigTimeoutTime_RFHM" SG_ 1426 ServiceHVError 0;
BA_ "GenSigTimeoutTime_SGW" SG_ 1426 ServiceHVError 0;
BA_ "GenSigTimeoutTime_TCM" SG_ 1426 ServiceHVError 0;
BA_ "GenSigSendType" SG_ 1426 ThermalRunaway_Alert 3;
BA_ "GenSigTimeoutTime_AGSM" SG_ 1426 ThermalRunaway_Alert 0;
BA_ "GenSigTimeoutTime_BCM" SG_ 1426 ThermalRunaway_Alert 0;
BA_ "GenSigTimeoutTime_BSM" SG_ 1426 ThermalRunaway_Alert 0;
BA_ "GenSigTimeoutTime_CADM" SG_ 1426 ThermalRunaway_Alert 0;
BA_ "GenSigTimeoutTime_DMSM" SG_ 1426 ThermalRunaway_Alert 0;
BA_ "GenSigTimeoutTime_DTCM" SG_ 1426 ThermalRunaway_Alert 0;
BA_ "GenSigTimeoutTime_ECM" SG_ 1426 ThermalRunaway_Alert 0;
BA_ "GenSigTimeoutTime_EVCU2" SG_ 1426 ThermalRunaway_Alert 0;
BA_ "GenSigTimeoutTime_GNMM" SG_ 1426 ThermalRunaway_Alert 0;
BA_ "GenSigTimeoutTime_HCP" SG_ 1426 ThermalRunaway_Alert 0;
BA_ "GenSigTimeoutTime_IPC" SG_ 1426 ThermalRunaway_Alert 0;
BA_ "GenSigTimeoutTime_RFHM" SG_ 1426 ThermalRunaway_Alert 0;
BA_ "GenSigTimeoutTime_SGW" SG_ 1426 ThermalRunaway_Alert 0;
BA_ "GenSigTimeoutTime_TCM" SG_ 1426 ThermalRunaway_Alert 0;
BA_ "GenSigSendType" SG_ 1426 VDCM_PopUpMessage5 3;
BA_ "GenSigTimeoutTime_AGSM" SG_ 1426 VDCM_PopUpMessage5 0;
BA_ "GenSigTimeoutTime_BCM" SG_ 1426 VDCM_PopUpMessage5 0;
BA_ "GenSigTimeoutTime_BSM" SG_ 1426 VDCM_PopUpMessage5 0;
BA_ "GenSigTimeoutTime_CADM" SG_ 1426 VDCM_PopUpMessage5 0;
BA_ "GenSigTimeoutTime_DMSM" SG_ 1426 VDCM_PopUpMessage5 0;
BA_ "GenSigTimeoutTime_DTCM" SG_ 1426 VDCM_PopUpMessage5 0;
BA_ "GenSigTimeoutTime_ECM" SG_ 1426 VDCM_PopUpMessage5 0;
BA_ "GenSigTimeoutTime_EVCU2" SG_ 1426 VDCM_PopUpMessage5 0;
BA_ "GenSigTimeoutTime_GNMM" SG_ 1426 VDCM_PopUpMessage5 0;
BA_ "GenSigTimeoutTime_HCP" SG_ 1426 VDCM_PopUpMessage5 0;
BA_ "GenSigTimeoutTime_RFHM" SG_ 1426 VDCM_PopUpMessage5 0;
BA_ "GenSigTimeoutTime_SGW" SG_ 1426 VDCM_PopUpMessage5 0;
BA_ "GenSigTimeoutTime_TCM" SG_ 1426 VDCM_PopUpMessage5 0;
BA_ "GenSigSendType" SG_ 1426 VDCM_PopUpMessage7 3;
BA_ "GenSigTimeoutTime_AGSM" SG_ 1426 VDCM_PopUpMessage7 0;
BA_ "GenSigTimeoutTime_BCM" SG_ 1426 VDCM_PopUpMessage7 0;
BA_ "GenSigTimeoutTime_BSM" SG_ 1426 VDCM_PopUpMessage7 0;
BA_ "GenSigTimeoutTime_CADM" SG_ 1426 VDCM_PopUpMessage7 0;
BA_ "GenSigTimeoutTime_DMSM" SG_ 1426 VDCM_PopUpMessage7 0;
BA_ "GenSigTimeoutTime_DTCM" SG_ 1426 VDCM_PopUpMessage7 0;
BA_ "GenSigTimeoutTime_ECM" SG_ 1426 VDCM_PopUpMessage7 0;
BA_ "GenSigTimeoutTime_EVCU2" SG_ 1426 VDCM_PopUpMessage7 0;
BA_ "GenSigTimeoutTime_GNMM" SG_ 1426 VDCM_PopUpMessage7 0;
BA_ "GenSigTimeoutTime_HCP" SG_ 1426 VDCM_PopUpMessage7 0;
BA_ "GenSigTimeoutTime_RFHM" SG_ 1426 VDCM_PopUpMessage7 0;
BA_ "GenSigTimeoutTime_SGW" SG_ 1426 VDCM_PopUpMessage7 0;
BA_ "GenSigTimeoutTime_TCM" SG_ 1426 VDCM_PopUpMessage7 0;
BA_ "GenSigStartValue" SG_ 1442 EstRange_Fuel 2047;
BA_ "GenSigSendType" SG_ 1442 EstRange_Fuel 3;
BA_ "GenSigTimeoutTime_AGSM" SG_ 1442 EstRange_Fuel 0;
BA_ "GenSigTimeoutTime_BCM" SG_ 1442 EstRange_Fuel 0;
BA_ "GenSigTimeoutTime_BSM" SG_ 1442 EstRange_Fuel 0;
BA_ "GenSigTimeoutTime_CADM" SG_ 1442 EstRange_Fuel 0;
BA_ "GenSigTimeoutTime_DMSM" SG_ 1442 EstRange_Fuel 0;
BA_ "GenSigTimeoutTime_DTCM" SG_ 1442 EstRange_Fuel 0;
BA_ "GenSigTimeoutTime_ECM" SG_ 1442 EstRange_Fuel 0;
BA_ "GenSigTimeoutTime_EVCU2" SG_ 1442 EstRange_Fuel 0;
BA_ "GenSigTimeoutTime_GNMM" SG_ 1442 EstRange_Fuel 0;
BA_ "GenSigTimeoutTime_HCP" SG_ 1442 EstRange_Fuel 0;
BA_ "GenSigTimeoutTime_RFHM" SG_ 1442 EstRange_Fuel 0;
BA_ "GenSigTimeoutTime_SGW" SG_ 1442 EstRange_Fuel 0;
BA_ "GenSigTimeoutTime_TCM" SG_ 1442 EstRange_Fuel 0;
BA_ "GenSigStartValue" SG_ 1442 EstRange_Total 2047;
BA_ "GenSigSendType" SG_ 1442 EstRange_Total 3;
BA_ "GenSigTimeoutTime_AGSM" SG_ 1442 EstRange_Total 0;
BA_ "GenSigTimeoutTime_BCM" SG_ 1442 EstRange_Total 0;
BA_ "GenSigTimeoutTime_BSM" SG_ 1442 EstRange_Total 0;
BA_ "GenSigTimeoutTime_CADM" SG_ 1442 EstRange_Total 0;
BA_ "GenSigTimeoutTime_DMSM" SG_ 1442 EstRange_Total 0;
BA_ "GenSigTimeoutTime_DTCM" SG_ 1442 EstRange_Total 0;
BA_ "GenSigTimeoutTime_ECM" SG_ 1442 EstRange_Total 0;
BA_ "GenSigTimeoutTime_EVCU2" SG_ 1442 EstRange_Total 0;
BA_ "GenSigTimeoutTime_GNMM" SG_ 1442 EstRange_Total 0;
BA_ "GenSigTimeoutTime_HCP" SG_ 1442 EstRange_Total 0;
BA_ "GenSigTimeoutTime_RFHM" SG_ 1442 EstRange_Total 0;
BA_ "GenSigTimeoutTime_SGW" SG_ 1442 EstRange_Total 0;
BA_ "GenSigTimeoutTime_TCM" SG_ 1442 EstRange_Total 0;
BA_ "GenSigStartValue" SG_ 1442 MaxComfortZoneHVBattTempForDisp 255;
BA_ "GenSigSendType" SG_ 1442 MaxComfortZoneHVBattTempForDisp 3;
BA_ "SystemSignalLongSymbol" SG_ 1442 MaxComfortZoneHVBattTempForDisp "MaxComfortZoneHVBattTempForDisplay";
BA_ "GenSigTimeoutTime_AGSM" SG_ 1442 MaxComfortZoneHVBattTempForDisp 0;
BA_ "GenSigTimeoutTime_BCM" SG_ 1442 MaxComfortZoneHVBattTempForDisp 0;
BA_ "GenSigTimeoutTime_BSM" SG_ 1442 MaxComfortZoneHVBattTempForDisp 0;
BA_ "GenSigTimeoutTime_CADM" SG_ 1442 MaxComfortZoneHVBattTempForDisp 0;
BA_ "GenSigTimeoutTime_DMSM" SG_ 1442 MaxComfortZoneHVBattTempForDisp 0;
BA_ "GenSigTimeoutTime_DTCM" SG_ 1442 MaxComfortZoneHVBattTempForDisp 0;
BA_ "GenSigTimeoutTime_ECM" SG_ 1442 MaxComfortZoneHVBattTempForDisp 0;
BA_ "GenSigTimeoutTime_EVCU2" SG_ 1442 MaxComfortZoneHVBattTempForDisp 0;
BA_ "GenSigTimeoutTime_GNMM" SG_ 1442 MaxComfortZoneHVBattTempForDisp 0;
BA_ "GenSigTimeoutTime_HCP" SG_ 1442 MaxComfortZoneHVBattTempForDisp 0;
BA_ "GenSigTimeoutTime_RFHM" SG_ 1442 MaxComfortZoneHVBattTempForDisp 0;
BA_ "GenSigTimeoutTime_TCM" SG_ 1442 MaxComfortZoneHVBattTempForDisp 0;
BA_ "GenSigStartValue" SG_ 1442 MaxDeratingZoneHVBattTempForDis 255;
BA_ "GenSigSendType" SG_ 1442 MaxDeratingZoneHVBattTempForDis 3;
BA_ "SystemSignalLongSymbol" SG_ 1442 MaxDeratingZoneHVBattTempForDis "MaxDeratingZoneHVBattTempForDisplay";
BA_ "GenSigTimeoutTime_AGSM" SG_ 1442 MaxDeratingZoneHVBattTempForDis 0;
BA_ "GenSigTimeoutTime_BCM" SG_ 1442 MaxDeratingZoneHVBattTempForDis 0;
BA_ "GenSigTimeoutTime_BSM" SG_ 1442 MaxDeratingZoneHVBattTempForDis 0;
BA_ "GenSigTimeoutTime_CADM" SG_ 1442 MaxDeratingZoneHVBattTempForDis 0;
BA_ "GenSigTimeoutTime_DMSM" SG_ 1442 MaxDeratingZoneHVBattTempForDis 0;
BA_ "GenSigTimeoutTime_DTCM" SG_ 1442 MaxDeratingZoneHVBattTempForDis 0;
BA_ "GenSigTimeoutTime_ECM" SG_ 1442 MaxDeratingZoneHVBattTempForDis 0;
BA_ "GenSigTimeoutTime_EVCU2" SG_ 1442 MaxDeratingZoneHVBattTempForDis 0;
BA_ "GenSigTimeoutTime_GNMM" SG_ 1442 MaxDeratingZoneHVBattTempForDis 0;
BA_ "GenSigTimeoutTime_HCP" SG_ 1442 MaxDeratingZoneHVBattTempForDis 0;
BA_ "GenSigTimeoutTime_RFHM" SG_ 1442 MaxDeratingZoneHVBattTempForDis 0;
BA_ "GenSigTimeoutTime_TCM" SG_ 1442 MaxDeratingZoneHVBattTempForDis 0;
BA_ "GenSigStartValue" SG_ 1442 MinComfortZoneHVBattTempForDisp 255;
BA_ "GenSigSendType" SG_ 1442 MinComfortZoneHVBattTempForDisp 3;
BA_ "SystemSignalLongSymbol" SG_ 1442 MinComfortZoneHVBattTempForDisp "MinComfortZoneHVBattTempForDisplay";
BA_ "GenSigTimeoutTime_AGSM" SG_ 1442 MinComfortZoneHVBattTempForDisp 0;
BA_ "GenSigTimeoutTime_BCM" SG_ 1442 MinComfortZoneHVBattTempForDisp 0;
BA_ "GenSigTimeoutTime_BSM" SG_ 1442 MinComfortZoneHVBattTempForDisp 0;
BA_ "GenSigTimeoutTime_CADM" SG_ 1442 MinComfortZoneHVBattTempForDisp 0;
BA_ "GenSigTimeoutTime_DMSM" SG_ 1442 MinComfortZoneHVBattTempForDisp 0;
BA_ "GenSigTimeoutTime_DTCM" SG_ 1442 MinComfortZoneHVBattTempForDisp 0;
BA_ "GenSigTimeoutTime_ECM" SG_ 1442 MinComfortZoneHVBattTempForDisp 0;
BA_ "GenSigTimeoutTime_EVCU2" SG_ 1442 MinComfortZoneHVBattTempForDisp 0;
BA_ "GenSigTimeoutTime_GNMM" SG_ 1442 MinComfortZoneHVBattTempForDisp 0;
BA_ "GenSigTimeoutTime_HCP" SG_ 1442 MinComfortZoneHVBattTempForDisp 0;
BA_ "GenSigTimeoutTime_RFHM" SG_ 1442 MinComfortZoneHVBattTempForDisp 0;
BA_ "GenSigTimeoutTime_TCM" SG_ 1442 MinComfortZoneHVBattTempForDisp 0;
BA_ "GenSigStartValue" SG_ 1442 MinDeratingZoneHVBattTempForDis 255;
BA_ "GenSigSendType" SG_ 1442 MinDeratingZoneHVBattTempForDis 3;
BA_ "SystemSignalLongSymbol" SG_ 1442 MinDeratingZoneHVBattTempForDis "MinDeratingZoneHVBattTempForDisplay";
BA_ "GenSigTimeoutTime_AGSM" SG_ 1442 MinDeratingZoneHVBattTempForDis 0;
BA_ "GenSigTimeoutTime_BCM" SG_ 1442 MinDeratingZoneHVBattTempForDis 0;
BA_ "GenSigTimeoutTime_BSM" SG_ 1442 MinDeratingZoneHVBattTempForDis 0;
BA_ "GenSigTimeoutTime_CADM" SG_ 1442 MinDeratingZoneHVBattTempForDis 0;
BA_ "GenSigTimeoutTime_DMSM" SG_ 1442 MinDeratingZoneHVBattTempForDis 0;
BA_ "GenSigTimeoutTime_DTCM" SG_ 1442 MinDeratingZoneHVBattTempForDis 0;
BA_ "GenSigTimeoutTime_ECM" SG_ 1442 MinDeratingZoneHVBattTempForDis 0;
BA_ "GenSigTimeoutTime_EVCU2" SG_ 1442 MinDeratingZoneHVBattTempForDis 0;
BA_ "GenSigTimeoutTime_GNMM" SG_ 1442 MinDeratingZoneHVBattTempForDis 0;
BA_ "GenSigTimeoutTime_HCP" SG_ 1442 MinDeratingZoneHVBattTempForDis 0;
BA_ "GenSigTimeoutTime_RFHM" SG_ 1442 MinDeratingZoneHVBattTempForDis 0;
BA_ "GenSigTimeoutTime_TCM" SG_ 1442 MinDeratingZoneHVBattTempForDis 0;
BA_ "GenSigSendType" SG_ 1442 SugSpeedMax 3;
BA_ "GenSigTimeoutTime_AGSM" SG_ 1442 SugSpeedMax 0;
BA_ "GenSigTimeoutTime_BCM" SG_ 1442 SugSpeedMax 0;
BA_ "GenSigTimeoutTime_BSM" SG_ 1442 SugSpeedMax 0;
BA_ "GenSigTimeoutTime_CADM" SG_ 1442 SugSpeedMax 0;
BA_ "GenSigTimeoutTime_DMSM" SG_ 1442 SugSpeedMax 0;
BA_ "GenSigTimeoutTime_DTCM" SG_ 1442 SugSpeedMax 0;
BA_ "GenSigTimeoutTime_ECM" SG_ 1442 SugSpeedMax 0;
BA_ "GenSigTimeoutTime_EVCU2" SG_ 1442 SugSpeedMax 0;
BA_ "GenSigTimeoutTime_GNMM" SG_ 1442 SugSpeedMax 0;
BA_ "GenSigTimeoutTime_HCP" SG_ 1442 SugSpeedMax 0;
BA_ "GenSigTimeoutTime_IPC" SG_ 1442 SugSpeedMax 0;
BA_ "GenSigTimeoutTime_RFHM" SG_ 1442 SugSpeedMax 0;
BA_ "GenSigTimeoutTime_SGW" SG_ 1442 SugSpeedMax 0;
BA_ "GenSigTimeoutTime_TCM" SG_ 1442 SugSpeedMax 0;
BA_ "GenSigSendType" SG_ 1442 SugSpeedMin 3;
BA_ "GenSigTimeoutTime_AGSM" SG_ 1442 SugSpeedMin 0;
BA_ "GenSigTimeoutTime_BCM" SG_ 1442 SugSpeedMin 0;
BA_ "GenSigTimeoutTime_BSM" SG_ 1442 SugSpeedMin 0;
BA_ "GenSigTimeoutTime_CADM" SG_ 1442 SugSpeedMin 0;
BA_ "GenSigTimeoutTime_DMSM" SG_ 1442 SugSpeedMin 0;
BA_ "GenSigTimeoutTime_DTCM" SG_ 1442 SugSpeedMin 0;
BA_ "GenSigTimeoutTime_ECM" SG_ 1442 SugSpeedMin 0;
BA_ "GenSigTimeoutTime_EVCU2" SG_ 1442 SugSpeedMin 0;
BA_ "GenSigTimeoutTime_GNMM" SG_ 1442 SugSpeedMin 0;
BA_ "GenSigTimeoutTime_HCP" SG_ 1442 SugSpeedMin 0;
BA_ "GenSigTimeoutTime_IPC" SG_ 1442 SugSpeedMin 0;
BA_ "GenSigTimeoutTime_RFHM" SG_ 1442 SugSpeedMin 0;
BA_ "GenSigTimeoutTime_SGW" SG_ 1442 SugSpeedMin 0;
BA_ "GenSigTimeoutTime_TCM" SG_ 1442 SugSpeedMin 0;
BA_ "GenSigSendType" SG_ 1442 SugSpeedThreshold 3;
BA_ "GenSigTimeoutTime_AGSM" SG_ 1442 SugSpeedThreshold 0;
BA_ "GenSigTimeoutTime_BCM" SG_ 1442 SugSpeedThreshold 0;
BA_ "GenSigTimeoutTime_BSM" SG_ 1442 SugSpeedThreshold 0;
BA_ "GenSigTimeoutTime_CADM" SG_ 1442 SugSpeedThreshold 0;
BA_ "GenSigTimeoutTime_DMSM" SG_ 1442 SugSpeedThreshold 0;
BA_ "GenSigTimeoutTime_DTCM" SG_ 1442 SugSpeedThreshold 0;
BA_ "GenSigTimeoutTime_ECM" SG_ 1442 SugSpeedThreshold 0;
BA_ "GenSigTimeoutTime_EVCU2" SG_ 1442 SugSpeedThreshold 0;
BA_ "GenSigTimeoutTime_GNMM" SG_ 1442 SugSpeedThreshold 0;
BA_ "GenSigTimeoutTime_HCP" SG_ 1442 SugSpeedThreshold 0;
BA_ "GenSigTimeoutTime_IPC" SG_ 1442 SugSpeedThreshold 0;
BA_ "GenSigTimeoutTime_RFHM" SG_ 1442 SugSpeedThreshold 0;
BA_ "GenSigTimeoutTime_SGW" SG_ 1442 SugSpeedThreshold 0;
BA_ "GenSigTimeoutTime_TCM" SG_ 1442 SugSpeedThreshold 0;
BA_ "GenSigStartValue" SG_ 1442 Turtle_Speed_Limit 255;
BA_ "GenSigSendType" SG_ 1442 Turtle_Speed_Limit 3;
BA_ "GenSigTimeoutTime_AGSM" SG_ 1442 Turtle_Speed_Limit 0;
BA_ "GenSigTimeoutTime_BCM" SG_ 1442 Turtle_Speed_Limit 0;
BA_ "GenSigTimeoutTime_BSM" SG_ 1442 Turtle_Speed_Limit 0;
BA_ "GenSigTimeoutTime_CADM" SG_ 1442 Turtle_Speed_Limit 0;
BA_ "GenSigTimeoutTime_DMSM" SG_ 1442 Turtle_Speed_Limit 0;
BA_ "GenSigTimeoutTime_DTCM" SG_ 1442 Turtle_Speed_Limit 0;
BA_ "GenSigTimeoutTime_ECM" SG_ 1442 Turtle_Speed_Limit 0;
BA_ "GenSigTimeoutTime_EVCU2" SG_ 1442 Turtle_Speed_Limit 0;
BA_ "GenSigTimeoutTime_GNMM" SG_ 1442 Turtle_Speed_Limit 0;
BA_ "GenSigTimeoutTime_HCP" SG_ 1442 Turtle_Speed_Limit 0;
BA_ "GenSigTimeoutTime_RFHM" SG_ 1442 Turtle_Speed_Limit 0;
BA_ "GenSigTimeoutTime_SGW" SG_ 1442 Turtle_Speed_Limit 0;
BA_ "GenSigTimeoutTime_TCM" SG_ 1442 Turtle_Speed_Limit 0;
BA_ "GenSigSendType" SG_ 105 LidClosingAck 3;
BA_ "GenSigTimeoutTime_AGSM" SG_ 105 LidClosingAck 0;
BA_ "GenSigTimeoutTime_BCM" SG_ 105 LidClosingAck 0;
BA_ "GenSigTimeoutTime_BSM" SG_ 105 LidClosingAck 0;
BA_ "GenSigTimeoutTime_CADM" SG_ 105 LidClosingAck 0;
BA_ "GenSigTimeoutTime_DMSM" SG_ 105 LidClosingAck 0;
BA_ "GenSigTimeoutTime_DTCM" SG_ 105 LidClosingAck 0;
BA_ "GenSigTimeoutTime_ECM" SG_ 105 LidClosingAck 0;
BA_ "GenSigTimeoutTime_EVCU2" SG_ 105 LidClosingAck 0;
BA_ "GenSigTimeoutTime_GNMM" SG_ 105 LidClosingAck 0;
BA_ "GenSigTimeoutTime_HCP" SG_ 105 LidClosingAck 0;
BA_ "GenSigTimeoutTime_IPC" SG_ 105 LidClosingAck 0;
BA_ "GenSigTimeoutTime_RFHM" SG_ 105 LidClosingAck 0;
BA_ "GenSigTimeoutTime_SGW" SG_ 105 LidClosingAck 0;
BA_ "GenSigTimeoutTime_TCM" SG_ 105 LidClosingAck 0;
BA_ "GenSigSendType" SG_ 105 LidOpeningAck 3;
BA_ "GenSigTimeoutTime_AGSM" SG_ 105 LidOpeningAck 0;
BA_ "GenSigTimeoutTime_BCM" SG_ 105 LidOpeningAck 0;
BA_ "GenSigTimeoutTime_BSM" SG_ 105 LidOpeningAck 0;
BA_ "GenSigTimeoutTime_CADM" SG_ 105 LidOpeningAck 0;
BA_ "GenSigTimeoutTime_DMSM" SG_ 105 LidOpeningAck 0;
BA_ "GenSigTimeoutTime_DTCM" SG_ 105 LidOpeningAck 0;
BA_ "GenSigTimeoutTime_ECM" SG_ 105 LidOpeningAck 0;
BA_ "GenSigTimeoutTime_EVCU2" SG_ 105 LidOpeningAck 0;
BA_ "GenSigTimeoutTime_GNMM" SG_ 105 LidOpeningAck 0;
BA_ "GenSigTimeoutTime_HCP" SG_ 105 LidOpeningAck 0;
BA_ "GenSigTimeoutTime_IPC" SG_ 105 LidOpeningAck 0;
BA_ "GenSigTimeoutTime_RFHM" SG_ 105 LidOpeningAck 0;
BA_ "GenSigTimeoutTime_SGW" SG_ 105 LidOpeningAck 0;
BA_ "GenSigTimeoutTime_TCM" SG_ 105 LidOpeningAck 0;
BA_ "GenSigSendType" SG_ 105 T4_Sensor_Temp 3;
BA_ "GenSigTimeoutTime_AGSM" SG_ 105 T4_Sensor_Temp 0;
BA_ "GenSigTimeoutTime_BCM" SG_ 105 T4_Sensor_Temp 0;
BA_ "GenSigTimeoutTime_BSM" SG_ 105 T4_Sensor_Temp 0;
BA_ "GenSigTimeoutTime_CADM" SG_ 105 T4_Sensor_Temp 0;
BA_ "GenSigTimeoutTime_DMSM" SG_ 105 T4_Sensor_Temp 0;
BA_ "GenSigTimeoutTime_DTCM" SG_ 105 T4_Sensor_Temp 0;
BA_ "GenSigTimeoutTime_ECM" SG_ 105 T4_Sensor_Temp 0;
BA_ "GenSigTimeoutTime_EVCU2" SG_ 105 T4_Sensor_Temp 0;
BA_ "GenSigTimeoutTime_GNMM" SG_ 105 T4_Sensor_Temp 0;
BA_ "GenSigTimeoutTime_HCP" SG_ 105 T4_Sensor_Temp 0;
BA_ "GenSigTimeoutTime_IPC" SG_ 105 T4_Sensor_Temp 0;
BA_ "GenSigTimeoutTime_RFHM" SG_ 105 T4_Sensor_Temp 0;
BA_ "GenSigTimeoutTime_SGW" SG_ 105 T4_Sensor_Temp 0;
BA_ "GenSigTimeoutTime_TCM" SG_ 105 T4_Sensor_Temp 0;
BA_ "GenSigTimeoutTime_BCM" SG_ 1053 VIN_DATA 0;
BA_ "GenSigStartValue" SG_ 1053 VIN_MSG 3;
BA_ "GenSigTimeoutTime_BCM" SG_ 1053 VIN_MSG 0;
VAL_ 1478 Number_of_Trl_Axles_TTPM 0 "TRL_AXLE_NOT_SELECTED" 1 "ONE_AXLE" 2 "TWO_AXLES" 3 "THREE_AXLES";
VAL_ 1478 Number_of_Trl_Tires_TTPM 0 "TRL_TIRE_NOT_SELECTED" 1 "TWO_TIRES" 2 "FOUR_TIRES" 3 "SIX_TIRES" 4 "EIGHT_TIRES" 5 "TWELVE_TIRES";
VAL_ 1478 TPMTrailer_Number 0 "TRAILER_NOT_SELECTED" 1 "TRAILER_1" 2 "TRAILER_2" 3 "TRAILER_3" 4 "TRAILER_4";
VAL_ 1478 Trailer_Sensor_Mismatch 0 "TRAILER_NOT_SELECTED" 1 "TRAILER_1" 2 "TRAILER_2" 3 "TRAILER_3" 4 "TRAILER_4";
VAL_ 1478 TrailerTirePress1 255 "SNA";
VAL_ 1478 TrailerTirePress10 255 "SNA";
VAL_ 1478 TrailerTirePress11 255 "SNA";
VAL_ 1478 TrailerTirePress12 255 "SNA";
VAL_ 1478 TrailerTirePress2 255 "SNA";
VAL_ 1478 TrailerTirePress3 255 "SNA";
VAL_ 1478 TrailerTirePress4 255 "SNA";
VAL_ 1478 TrailerTirePress5 255 "SNA";
VAL_ 1478 TrailerTirePress6 255 "SNA";
VAL_ 1478 TrailerTirePress7 255 "SNA";
VAL_ 1478 TrailerTirePress8 255 "SNA";
VAL_ 1478 TrailerTirePress9 255 "SNA";
VAL_ 1478 TrlTire1_Stat 0 "NORMAL" 1 "LOW" 2 "HIGH" 3 "SNA";
VAL_ 1478 TrlTire10_Stat 0 "NORMAL" 1 "LOW" 2 "HIGH" 3 "SNA";
VAL_ 1478 TrlTire11_Stat 0 "NORMAL" 1 "LOW" 2 "HIGH" 3 "SNA";
VAL_ 1478 TrlTire12_Stat 0 "NORMAL" 1 "LOW" 2 "HIGH" 3 "SNA";
VAL_ 1478 TrlTire2_Stat 0 "NORMAL" 1 "LOW" 2 "HIGH" 3 "SNA";
VAL_ 1478 TrlTire3_Stat 0 "NORMAL" 1 "LOW" 2 "HIGH" 3 "SNA";
VAL_ 1478 TrlTire4_Stat 0 "NORMAL" 1 "LOW" 2 "HIGH" 3 "SNA";
VAL_ 1478 TrlTire5_Stat 0 "NORMAL" 1 "LOW" 2 "HIGH" 3 "SNA";
VAL_ 1478 TrlTire6_Stat 0 "NORMAL" 1 "LOW" 2 "HIGH" 3 "SNA";
VAL_ 1478 TrlTire7_Stat 0 "NORMAL" 1 "LOW" 2 "HIGH" 3 "SNA";
VAL_ 1478 TrlTire8_Stat 0 "NORMAL" 1 "LOW" 2 "HIGH" 3 "SNA";
VAL_ 1478 TrlTire9_Stat 0 "NORMAL" 1 "LOW" 2 "HIGH" 3 "SNA";
VAL_ 1478 TrlTPMSetPress_TTPM 4095 "SNA";
VAL_ 278 CODE_CLR_TCM 0 "Not Clear" 1 "Clear";
VAL_ 278 CrankEnable_Fast 0 "Disabled" 1 "Enabled";
VAL_ 278 DriveLineRatio 16383 "SNA";
VAL_ 278 EngTrq_Rq_TCM 2047 "SNA";
VAL_ 278 MaxTrqDes 2047 "SNA";
VAL_ 278 PaddleShiftRequest 0 "PS_OFF" 1 "PS_RIGHT" 2 "PS_LEFT" 3 "PS_BOTH" 7 "SNA";
VAL_ 278 REPRGD_PFC_CLR_TCM 0 "Do Nothing" 1 "Set Incomplete";
VAL_ 278 Secure_Idle_Sts 0 "DISABLED" 1 "ENABLED" 3 "SNA";
VAL_ 278 TargetGear 0 "Neutral" 1 "ForwardGear_1" 2 "ForwardGear_2" 3 "ForwardGear_3" 4 "ForwardGear_4" 5 "ForwardGear_5" 6 "ForwardGear_6" 7 "ForwardGear_7" 8 "ForwardGear_8" 9 "ForwardGear_9" 13 "Parking" 14 "ReverseGear" 15 "SNA";
VAL_ 278 TCASERANGESTATUS_TCM 0 "High" 1 "Neutral" 2 "Low" 3 "SNA";
VAL_ 278 TCM_ActMode 0 "Trans_disengaged_Engine_OFF" 1 "Trans_disengaged_Engine_ON" 2 "Trans_engaged_Engine_ON" 15 "SNA";
VAL_ 278 TCMLnchCtrlAllowed 0 "Not_Allowed_GenReas" 1 "Not_Allowed_Reas1" 2 "Not_Allowed_Reas2" 3 "Allowed";
VAL_ 278 TorqueAmpTransmission 2047 "SNA";
VAL_ 278 TorqueConverterDisengageSpeed 255 "SNA";
VAL_ 278 TorqueConverterSTO 0 "Not_Active" 1 "Active";
VAL_ 278 TorqueConverterSts 0 "Lock_up_clutch_opened" 1 "Lock_up_clutch_is_slipping" 2 "Lock_up_clutch_closed" 3 "SNA";
VAL_ 278 TRANS_ADAS_Inhibit 0 "Faulted" 1 "Available";
VAL_ 278 TransLosses 1023 "SNA";
VAL_ 278 TransmissionSailingSts 0 "Sailing_Not Possible" 1 "Sailing_Possible_Passive" 2 "Transition_To_Sailing" 3 "Sailing_Active" 4 "Transition_Out_Of_Sailing" 5 "Sailing_Not_Available" 15 "SNA";
VAL_ 278 TrqCtrlModeReq 0 "None" 1 "TRQ_INC" 2 "TRQ_DEC" 3 "SNA";
VAL_ 278 TrqCtrlModeReq_Slow 0 "NONE" 1 "TRQ_INC" 2 "TRQ_DEC" 3 "SNA";
VAL_ 278 TxIdleRq 255 "SNA";
VAL_ 278 Vehicle_Hold_Rq 0 "Not_Active" 1 "Active";
VAL_ 520 AirFlowRequest_TCM 127 "SNA";
VAL_ 520 APCM_Rq 0 "OFF" 1 "ON" 2 "PENDING" 3 "SNA";
VAL_ 520 EngShutOffRq_TCM 0 "FALSE" 1 "TRUE";
VAL_ 520 GearEngagedForDisplay 0 "Initialize" 1 "1st_gear" 2 "2nd_gear" 3 "3rd_gear" 4 "4th_gear" 5 "5th_gear" 6 "6th_gear" 7 "7th_gear" 8 "8th_gear " 9 "9th_gear" 10 "Not_used1" 11 "Not_Used2" 12 "P" 13 "N" 14 "R" 15 "D" 16 "L" 17 "M" 18 "S" 31 "SNA";
VAL_ 520 OUTPUT_SPEED 65535 "SNA";
VAL_ 520 OutputSpdPolarity 0 "DND" 1 "DF" 2 "DB" 3 "SNA";
VAL_ 520 PaddlesModeSts 0 "NONE" 1 "DIS" 2 "EN" 3 "SNA";
VAL_ 520 Trans_ESS_Inhibit 0 "False" 1 "True";
VAL_ 520 TransmissionTemperature 63 "SNA";
VAL_ 520 TransReadyForESS 0 "Not_Ready" 1 "Ready";
VAL_ 520 Trns_EMCC_Achvd 0 "False" 1 "True";
VAL_ 520 TRNS_StpSt_FLT 0 "Not_Present" 1 "Present";
VAL_ 520 TurbineSpeed 65535 "SNA";
VAL_ 1450 CrankEnable 0 "Disabled" 1 "Enabled";
VAL_ 1450 DriveModeSts 0 "No_programs_available_selected" 1 "Eco" 2 "Sport" 3 "Valet" 4 "Ice_Winter" 5 "Tow_Haul" 6 "Track" 7 "4LowMode" 8 "HDC/SSC" 9 "Rock" 10 "Sand" 11 "Mud" 12 "Normal" 13 "Mud_Sand" 14 "RRCC" 15 "Drag";
VAL_ 1450 GearDisplayForCluster 0 "Blank" 1 "Current_gear_1" 2 "Current_gear_2" 3 "Current_gear_3" 4 "Current_gear_4" 5 "Current_gear_5" 6 "Current_gear_6" 7 "Current_gear_7" 8 "Current_gear_8" 9 "Current_gear_9" 10 "Current_gear_P" 11 "Current_gear_N" 12 "Current_gear_R" 15 "SNA";
VAL_ 1450 GearEngaged 0 "Neutral" 1 "ForwardGear_1" 2 "ForwardGear_2" 3 "ForwardGear_3" 4 "ForwardGear_4" 5 "ForwardGear_5" 6 "ForwardGear_6" 7 "ForwardGear_7" 8 "ForwardGear_8" 9 "ForwardGear_9" 13 "Parking" 14 "ReverseGear" 15 "SNA";
VAL_ 1450 GearIndicationSts 0 "Normal" 1 "Blinking";
VAL_ 1450 HAS_SoH_TCM 0 "No Fault" 1 "Fault";
VAL_ 1450 LimpHomeSts 0 "NotActive" 1 "Active";
VAL_ 1450 MIReq 0 "No_EOBD_error" 1 "EOBD_error";
VAL_ 1450 OilTemperatureSts 0 "Normal" 1 "High";
VAL_ 1450 R_SHFT_LOCK 0 "Unlocked" 1 "Locked";
VAL_ 1450 Secure_Idle_HMI 0 "MSG_DEFAULT" 1 "MSG_ACTIVE" 3 "SNA";
VAL_ 1450 ShiftInProgress 0 "No Shift in progress" 1 "Shift in progress";
VAL_ 1450 ShiftLeverLockReq 0 "Not_Active" 1 "Active";
VAL_ 1450 ShiftLeverPosition 0 "No_Selection_Active_Or_Available" 1 "P" 2 "R" 3 "N" 4 "D" 5 "L" 6 "TIP_Autostick" 7 "Plus" 8 "Minus" 9 "Sport" 10 "Not_Used" 11 "Not_Used" 12 "Not_Used" 13 "Not_Used" 14 "Not_Used" 15 "SNA";
VAL_ 1450 ShiftMapNotAchieved 0 "Achieved" 1 "Not_Achieved";
VAL_ 1450 ShiftModeSts 0 "Manual" 1 "Automatic";
VAL_ 1450 TransmissionFailSts 0 "Fail_not_present" 1 "Fail_present";
VAL_ 1450 TransmissionWarnings 0 "No_Warning" 1 "Press_Brake_Pedal" 2 "Tip_Not_Available" 3 "Lower_Gear_Shifts" 4 "Manual_Mode_Not_Available" 5 "Insert_N" 6 "Automatic_Mode_Not_Available" 7 "Press_Brake_Delayed_Startup_Warning" 8 "Clutch_Overtemperature" 9 "Manoeuvre_Not_Allowed" 10 "Press_Brake_Pedal_Repeat" 11 "Gear_Not_Available" 12 "Shift_Not_Allowed" 13 "Shift_to_Neutral_Then_DR" 14 "Reduce_Gear_Changes" 15 "Clutch_Overheater_Must_Cool" 16 "Service_Transmission" 17 "Service_Shifter" 18 "Engage_Park_Brake" 19 "Trans_Too_Cold_Pls_Wait" 20 "Push_Button_to_Shift" 21 "Return_Shifter_To_Home" 22 "Press_Brake_Push_Button_Shift" 23 "Service_Trans_Shut_Off" 24 "Already_in_Des_Gear" 25 "Start_Engine_to_Shift" 26 "Service_Trans_Use_Pk_Brk" 27 "Vehicle_Speed_Too_High" 28 "Tow_Haul_Not_available" 29 "Tow_Haul_Disengaged" 30 "Trans_Cool_Ready_to_Drive" 31 "Vehicle_Speed_Too_High_to_Shift_P" 32 "Vehicle_Speed_Too_High_to_Shift_R" 33 "Vehicle_Speed_Too_High_to_Shift_D" 34 "Manual_Shift_Temp_Not_Available" 35 "Vehicle_Speed_Too_High_to_Shift_L/S" 36 "Shift_to_Park_to_ obtain_drivability" 37 "Shift_to_Park_to_Start" 38 "APCM_in_Progress" 39 "Stop Vehicle to Shift" 40 "Service Transmission_Stop Vehicle to Shift " 41 "Service Transmission__Stop Vehicle_Restart Vehicle in P to Continue Driving" 42 "Service Transmission_Stop Vehicle to Shift _Restart Vehicle in P to Continue Driving" 43 "Press Brake To Prevent Vehicle From Rolling" 44 "Clutch_Too_Hot_Performance_Limited_Part_1" 45 "Trans_Recover_Mode_Warning" 46 "Press_Brake_To_Start" 47 "Unintentional park disengagement" 48 "paddles_shift_not_available " 49 "manual_mode_exit_hold_right_paddles" 50 "Vehicle_Speed_Too_High_to_Shift_Manual_gate" 51 "Manual_Mode_Active_Hold_Plus_to_Exit" 52 "Paddles_Disabled_by_User_Selection" 53 "Launch_Clutch_Over_Temp" 54 "Pull_Over_Safely" 55 "Clutch_Too_Hot_Performance_Limited_Part_2" 56 "Shift_To_D_To_Engage_L_Mode" 57 "Low_Mode_Not_Available";
VAL_ 1450 TxDisengaged 0 "Engaged" 1 "Disengaged";
VAL_ 1450 TxDisengaged_Fault 0 "No_Fault" 1 "Fault";
VAL_ 1059 CodeCheckSts_TRM 0 "No_Code" 1 "CodeCheck_OK" 2 "CodeCheck_Fault" 3 "Not_Used";
VAL_ 1059 ProgrammedSts_TRM 0 "Not_Programmed" 1 "Programmed";
VAL_ 1059 TxpFound 0 "Transponder_Read" 1 "Transponder_Absent";
VAL_ 1059 TxpID3 0 "Transponder_Not_Authenticated" 1 "Transponder_1_Authenticated" 2 "Transponder_2_Authenticated" 3 "Transponder_3_Authenticated" 4 "Transponder_4_Authenticated" 5 "Transponder_5_Authenticated" 6 "Transponder_6_Authenticated" 7 "Transponder_7_Authenticated" 8 "Transponder_8_Authenticated" 9 "Transponder_9_Authenticated" 10 "Transponder_10_Authenticated" 11 "Transponder_11_Authenticated" 12 "Transponder_12_Authenticated" 13 "Transponder_13_Authenticated" 14 "Transponder_14_Authenticated" 15 "Transponder_15_Authenticated" 16 "Transponder_16_Authenticated" 17 "Transponder_17_Authenticated" 18 "Transponder_18_Authenticated" 19 "Transponder_19_Authenticated" 20 "Transponder_20_Authenticated" 21 "Transponder_21_Authenticated" 22 "Transponder_22_Authenticated" 23 "Transponder_23_Authenticated" 24 "Transponder_24_Authenticated" 25 "Transponder_25_Authenticated" 26 "Transponder_26_Authenticated" 27 "Transponder_27_Authenticated" 28 "Transponder_28_Authenticated" 29 "Transponder_29_Authenticated" 30 "Transponder_30_Authenticated" 31 "Transponder_31_Authenticated" 32 "Transponder_32_Authenticated" 33 "Transponder_33_Authenticated" 34 "Transponder_34_Authenticated" 35 "Transponder_35_Authenticated" 36 "Transponder_36_Authenticated" 37 "Transponder_37_Authenticated" 38 "Transponder_38_Authenticated" 39 "Transponder_39_Authenticated" 40 "Transponder_40_Authenticated" 41 "Transponder_41_Authenticated" 42 "Transponder_42_Authenticated" 43 "Transponder_43_Authenticated" 44 "Transponder_44_Authenticated" 45 "Transponder_45_Authenticated" 46 "Transponder_46_Authenticated" 47 "Transponder_47_Authenticated" 48 "Transponder_48_Authenticated" 49 "Transponder_49_Authenticated" 50 "Transponder_50_Authenticated" 51 "Transponder_51_Authenticated" 52 "Transponder_52_Authenticated" 53 "Transponder_53_Authenticated" 54 "Transponder_54_Authenticated" 55 "Transponder_55_Authenticated" 56 "Transponder_56_Authenticated" 57 "Transponder_57_Authenticated" 58 "Transponder_58_Authenticated" 59 "Transponder_59_Authenticated" 60 "Transponder_60_Authenticated" 61 "Transponder_61_Authenticated" 62 "Transponder_62_Authenticated" 63 "Transponder_63_Authenticated" 64 "Transponder_64_Authenticated" 65 "Transponder_65_Authenticated" 66 "Transponder_66_Authenticated" 67 "Transponder_67_Authenticated" 68 "Transponder_68_Authenticated" 69 "Transponder_69_Authenticated" 70 "Transponder_70_Authenticated" 71 "Transponder_71_Authenticated" 72 "Transponder_72_Authenticated" 73 "Transponder_73_Authenticated" 74 "Transponder_74_Authenticated" 75 "Transponder_75_Authenticated" 76 "Transponder_76_Authenticated" 77 "Transponder_77_Authenticated" 78 "Transponder_78_Authenticated" 79 "Transponder_79_Authenticated" 80 "Transponder_80_Authenticated" 81 "Transponder_81_Authenticated" 82 "Transponder_82_Authenticated" 83 "Transponder_83_Authenticated" 84 "Transponder_84_Authenticated" 85 "Transponder_85_Authenticated" 86 "Transponder_86_Authenticated" 87 "Transponder_87_Authenticated" 88 "Transponder_88_Authenticated" 89 "Transponder_89_Authenticated" 90 "Transponder_90_Authenticated" 91 "Transponder_91_Authenticated" 92 "Transponder_92_Authenticated" 93 "Transponder_93_Authenticated" 94 "Transponder_94_Authenticated" 95 "Transponder_95_Authenticated" 96 "Transponder_96_Authenticated" 97 "Transponder_97_Authenticated" 98 "Transponder_98_Authenticated" 99 "Transponder_99_Authenticated" 100 "Transponder_100_Authenticated" 101 "Transponder_101_Authenticated";
VAL_ 254 FrameNumber 0 "Frame_1" 1 "Frame_2" 2 "Frame_3" 3 "Frame_4" 4 "Frame_5" 5 "Frame_6" 6 "Frame_7" 7 "Frame_8" 8 "Frame_9" 9 "Frame_10" 10 "Frame_11" 11 "Frame_12" 12 "Frame_13" 13 "Frame_14" 14 "Frame_15" 15 "Frame_16";
VAL_ 254 TotalFrameNumber 0 "One_Frame" 1 "Two_Frames" 2 "Three_Frames" 3 "Four_Frames" 4 "Five_Frames" 5 "Six_Frames" 6 "Seven_Frames" 7 "Eight_Frame" 8 "Nine_Frames" 9 "Ten_Frames" 10 "Eleven_Frames" 11 "Twelve_Frames" 12 "Thirteen_Frames" 13 "Fourteen_Frames" 14 "Fifteen_Frames" 15 "Sixteen_Frames";
VAL_ 1472 THA_EPB_Req 0 "No_Request" 1 "EPB_Requested" 3 "SNA";
VAL_ 1472 THA_Speed_Limit 0 "No_Request" 1 "kph_1" 2 "kph_2" 3 "kph_3" 4 "kph_4" 5 "kph_5" 6 "kph_6" 7 "kph_7" 8 "kph_8" 9 "kph_9" 10 "kph_10" 31 "SNA";
VAL_ 1472 THA_SpeedLimit_Req 0 "No_Request" 1 "Requested" 3 "SNA";
VAL_ 1472 THA_STAT 0 "Initial" 1 "Idle" 2 "Enabled" 3 "Engaged" 4 "Complete" 5 "Faulted " 7 "SNA";
VAL_ 1472 TRSC_PopupDisp_Info2 0 "DISP_0" 1 "DISP_1" 2 "DISP_2" 3 "DISP_3" 4 "DISP_4" 5 "DISP_5" 6 "DISP_6" 7 "DISP_7" 8 "DISP_8" 9 "DISP_9" 10 "DISP_10" 11 "DISP_11" 12 "DISP_12" 13 "DISP_13" 14 "DISP_14" 15 "DISP_15" 16 "DISP_16" 17 "DISP_17" 18 "DISP_18" 19 "DISP_19" 20 "DISP_20" 21 "DISP_21" 22 "DISP_22" 23 "DISP_23" 24 "DISP_24" 25 "DISP_25" 26 "DISP_26" 27 "DISP_27" 28 "DISP_28" 29 "DISP_29" 30 "DISP_30" 31 "DISP_31" 32 "DISP_32" 33 "DISP_33" 34 "DISP_34" 35 "DISP_35" 36 "DISP_36" 37 "DISP_37" 38 "DISP_38" 39 "DISP_39" 40 "DISP_40" 41 "DISP_41" 42 "DISP_42" 43 "DISP_43" 44 "DISP_44" 45 "DISP_45" 46 "DISP_46" 47 "DISP_47" 48 "DISP_48" 49 "DISP_49" 50 "DISP_50" 51 "DISP_51" 52 "DISP_52" 53 "DISP_53" 54 "DISP_54" 55 "DISP_55" 56 "DISP_56" 57 "DISP_57" 58 "DISP_58" 59 "DISP_59" 60 "DISP_60" 61 "DISP_61" 62 "DISP_62" 63 "SNA";
VAL_ 1472 TRSC_STAT 0 "Standby" 1 "Calibrating" 2 "PreActive" 3 "Active" 4 "OFF" 7 "SNA";
VAL_ 951 UConnReq_TBM 0 "NO_BASIC_REQUEST" 1 "LOCK_REQUEST" 2 "RELOCK_REQUEST" 3 "DRIVER_UNLOCK_REQUEST" 4 "ALL_UNLOCK_REQUEST" 5 "TRUNK_PLG_TOGGLE_REQUEST" 6 "LEFT_SLIDER_TOGGLE_REQUEST" 7 "RIGHT_SLIDER_TOGGLE_REQUEST" 8 "FLIPPER_GLASS_REQUEST" 9 "REMOTE_START_ON" 10 "REMOTE_START_OFF" 11 "GLOBAL_WINDOW_DOWN_REQUEST" 12 "OPEN_CONVERTIBLE_TOP" 13 "CLOSE_CONVERTIBLE_TOP" 14 "PANIC_TOGGLE_REQUEST" 15 "DRIVER_TOGGLE_REQUEST" 16 "PASSENGER_TOGGLE_REQUEST" 17 "ExtLightReq" 18 "AirSuspReq" 19 "AirSuspCancel" 20 "GLBL_WIN_UP_RQ" 21 "CAR_FINDER_REQUEST" 22 "TRUNK_PLG_BTN_PRESSED" 23 "TRUNK_PLG_STOP_REQUEST" 24 "TRUNK_PLG_OPEN_REQUEST" 25 "TRUNK_PLG_CLOSE_REQUEST" 26 "VTA_RQ" 27 "RAP_UNLOCK_REQUEST" 28 "ABORT_CRANKING_ON_REQUEST" 29 "ABORT_CRANKING_OFF_REQUEST" 30 "Remote_Headlights" 31 "SNA";
VAL_ 951 UConnReqFOBNum_TBM 0 "FOB_DEFAULT" 1 "FOB_1" 2 "FOB_2" 3 "FOB_3" 4 "FOB_4" 5 "FOB_5" 6 "FOB_6" 7 "FOB_7" 8 "FOB_8" 15 "SNA";
VAL_ 1489 V2H_mode_Sts 0 "Battery_Only" 1 "Battery_and_Engine";
VAL_ 1489 V2H_Status 0 "Inactive" 1 "Active" 2 "Active_and_Ready" 3 "Transferring_Power" 4 "Transfer_Interrupted" 5 "Transfer_Complete" 6 "Transfer_Requested" 7 "Reserved_for_future_use";
VAL_ 1489 V2L_Frunk_Status 0 "Inactive" 1 "Active" 2 "Active_and_Ready" 3 "Transferring_Power" 4 "Transfer_Interrupted" 5 "Transfer_Complete" 6 "Transfer_Requested" 7 "Fault";
VAL_ 1489 V2L_mode_Sts 0 "Battery_Only" 1 "Battery_and_Engine";
VAL_ 1489 V2L_Trunk_Status 0 "Inactive" 1 "Active" 2 "Active_and_Ready" 3 "Transferring_Power" 4 "Transfer_Interrupted" 5 "Transfer_Complete" 6 "Transfer_Requested" 7 "Fault";
VAL_ 1489 V2V_mode_Sts 0 "Battery_Only" 1 "Battery_and_Engine";
VAL_ 1489 V2V_Status 0 "Inactive" 1 "Active" 2 "Active_and_Ready" 3 "Transferring_Power" 4 "Transfer_Interrupted" 5 "Transfer_Complete" 6 "Transfer_Requested" 7 "Reserved_for_future_use";
VAL_ 1489 V2X_Info 0 "Init" 1 "Low_battery_level" 2 "Low_Fuel_level" 3 "System_Fault" 4 "High_Power_Draw" 5 "Power_Panel_disabled" 6 "Power_Panel_temp_unavailable" 7 "Reserved" 15 "SNA";
VAL_ 1490 V2H_Mode_Req 0 "Battery_Only" 1 "Battery_and_Engine";
VAL_ 1490 V2H_Req 0 "Disable" 1 "Enable";
VAL_ 1490 V2H_Submit 0 "No_submit_request" 1 "Submit_request";
VAL_ 1490 V2L_All_Req 0 "Disable" 1 "Enable";
VAL_ 1490 V2L_Frunk_Req 0 "Disable" 1 "Enable";
VAL_ 1490 V2L_Mode_Req 0 "Battery_Only" 1 "Battery_and_Engine";
VAL_ 1490 V2L_Submit 0 "No_submit_request" 1 "Submit_request";
VAL_ 1490 V2L_Trunk_Req 0 "Disable" 1 "Enable";
VAL_ 1490 V2V_Mode_Req 0 "Battery_Only" 1 "Battery_and_Engine";
VAL_ 1490 V2V_Req 0 "Disable" 1 "Enable";
VAL_ 1490 V2V_Submit 0 "No_submit_request" 1 "Submit_request";
VAL_ 1426 BatteryRunaway_Lamp_PT 0 "Lamp_not_active" 1 "Lamp_active";
VAL_ 1426 DC_EstChargeTime1 255 "SNA";
VAL_ 1426 DC_EstChargeTime2 255 "SNA";
VAL_ 1426 Est_HVBatSOC_VDCM 255 "SNA";
VAL_ 1426 Est_Range_ChrgStopTime 2047 "SNA";
VAL_ 1426 EstRange 2047 "SNA";
VAL_ 1426 HVBatteryTempForDisplay 255 "SNA";
VAL_ 1426 ServiceHVError 0 "No_Error" 1 "Error";
VAL_ 1426 ThermalRunaway_Alert 0 "do_not_activate" 1 "activate";
VAL_ 1426 VDCM_PopUpMessage5 0 "Not Available" 1 "level 1" 2 "level 2" 3 "level 3" 4 "level 4" 5 "level 5" 6 "level 0" 7 "SNA";
VAL_ 1426 VDCM_PopUpMessage7 0 "Not_Active" 1 "Active";
VAL_ 1442 EstRange_Fuel 2047 "SNA";
VAL_ 1442 EstRange_Total 2047 "SNA";
VAL_ 1442 MaxComfortZoneHVBattTempForDisp 255 "Not_Display";
VAL_ 1442 MaxDeratingZoneHVBattTempForDis 255 "Not_Display";
VAL_ 1442 MinComfortZoneHVBattTempForDisp 255 "Not_Display";
VAL_ 1442 MinDeratingZoneHVBattTempForDis 255 "Not_Display";
VAL_ 1442 SugSpeedMax 63 "SNA";
VAL_ 1442 SugSpeedMin 63 "SNA";
VAL_ 1442 SugSpeedThreshold 63 "SNA";
VAL_ 1442 Turtle_Speed_Limit 255 "SNA";
VAL_ 105 LidClosingAck 0 "INIT" 1 "OK" 2 "KO" 3 "SNA";
VAL_ 105 LidOpeningAck 0 "INIT" 1 "OK" 2 "KO" 3 "SNA";
VAL_ 1053 VIN_MSG 0 "VIN_LO" 1 "VIN_MID" 2 "VIN_HI" 3 "SNA";
