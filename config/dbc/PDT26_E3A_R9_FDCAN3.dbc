VERSION ""

NS_ :

BS_:

BU_: AGSM BCM BSM CADM DMSM DTCM ECM EVCU2 GNMM HCP IPC RFHM SGW TCM
BO_ 519 RFHUB_FD_1: 32 RFHM
 SG_ CRC_RFHUB1 : 191|8@0+ (1,0) [0|255] "-" TCM
 SG_ CustKeyInIgnSts : 87|2@0+ (1,0) [0|2] "-" BCM,SGW
 SG_ DriverEngineOffRequest : 95|1@0+ (1,0) [0|1] "-" BCM,EVCU2,TCM
 SG_ EcoTimer : 141|1@0+ (1,0) [0|1] "" BCM
 SG_ FobSearchResult : 103|8@0+ (1,0) [0|255] "-" BCM
 SG_ FSRExteriorFront : 135|1@0+ (1,0) [0|1] "" BCM
 SG_ FSRFrontTrunk : 143|1@0+ (1,0) [0|1] "" BCM
 SG_ IgnPosSts : 85|3@0+ (1,0) [0|6] "-" BCM,SGW
 SG_ KeyAuth_Status : 94|2@0+ (1,0) [0|3] "-" IPC
 SG_ MessageCounter_RFHUB1 : 179|4@0+ (1,0) [0|15] "-" TCM
 SG_ RFCfgReq : 111|3@0+ (1,0) [0|6] "-" IPC,SGW
 SG_ RFFobNum3 : 134|7@0+ (1,0) [0|127] "-" BCM,SGW
 SG_ RFFuncReq : 92|5@0+ (1,0) [0|30] "" BCM,IPC,SGW
 SG_ RFReq : 119|3@0+ (1,0) [0|6] "-" BCM,IPC,SGW
 SG_ ValetMode_SPAAK : 180|1@0+ (1,0) [0|1] "" SGW

BO_ 1449 RFHUB_FD_2: 32 RFHM
 SG_ BatteryLow : 61|2@0+ (1,0) [0|3] "" IPC
 SG_ FOBSearchActive : 85|1@0+ (1,0) [0|1] "" Vector__XXX
 SG_ FtTrPlacardPress : 15|16@0+ (0.0145,0) [0|950.2575] "psi" IPC
 SG_ KeyFob_Present : 4|1@0+ (1,0) [0|1] "-" BCM,SGW
 SG_ KeyProgramSts : 83|4@0+ (1,0) [0|15] "-" IPC
 SG_ MemRq_FobNum3 : 110|7@0+ (1,0) [0|127] "" BCM
 SG_ MsgFOBLeftVeh : 95|2@0+ (1,0) [0|2] "-" BCM,EVCU2,IPC,TCM
 SG_ MsgFOBNotFnd : 93|2@0+ (1,0) [0|2] "-" IPC
 SG_ MsgKeyNotFnd : 63|2@0+ (1,0) [0|3] "-" IPC
 SG_ MsgNotInPark : 91|2@0+ (1,0) [0|3] "-" IPC
 SG_ MsgPushBtnKey : 2|2@0+ (1,0) [0|2] "-" IPC
 SG_ RFMemRq : 96|1@0+ (1,0) [0|1] "-" BCM
 SG_ RrTrPlacardPress : 31|16@0+ (0.0145,0) [0|950.2575] "psi" IPC
 SG_ TPMHazardFlash : 7|1@0+ (1,0) [0|1] "-" BCM,IPC
 SG_ TPMHornChirp : 6|2@0+ (1,0) [0|3] "-" BCM

BO_ 1876 RFHUB_FD_3: 32 RFHM
 SG_ CRC_RFHUB3 : 191|8@0+ (1,0) [0|255] "-" EVCU2,IPC
 SG_ InflationState_LHF_Tyre : 83|3@0+ (1,0) [0|4] "-" BCM,IPC,SGW
 SG_ InflationState_LHR_Tyre : 92|3@0+ (1,0) [0|4] "-" BCM,IPC,SGW
 SG_ InflationState_RHF_Tyre : 86|3@0+ (1,0) [0|4] "-" BCM,IPC,SGW
 SG_ InflationState_RHR_Tyre : 95|3@0+ (1,0) [0|4] "-" BCM,IPC,SGW
 SG_ MessageCounter_RFHUB3 : 179|4@0+ (1,0) [0|15] "-" EVCU2,IPC
 SG_ PressureValue_LHF_Tyre : 119|8@0+ (0.03529,0) [0|8.96366] "bar" BCM,CADM,IPC,SGW
 SG_ PressureValue_LHR_Tyre : 135|8@0+ (0.03529,0) [0|8.96366] "bar" BCM,CADM,IPC,SGW
 SG_ PressureValue_RHF_Tyre : 111|8@0+ (0.03529,0) [0|8.96366] "bar" BCM,CADM,IPC,SGW
 SG_ PressureValue_RHR_Tyre : 127|8@0+ (0.03529,0) [0|8.96366] "bar" BCM,CADM,IPC,SGW
 SG_ TPMActivitySts : 87|1@0+ (1,0) [0|1] "-" IPC
 SG_ TyrePressureSysProgrammedSts : 89|1@0+ (1,0) [0|1] "-" IPC
 SG_ TyrePressureSystemFailSts : 88|1@0+ (1,0) [0|1] "-" BCM,IPC,SGW

BO_ 160 RFHUB_FD_4: 32 RFHM
 SG_ UConnSeed1 : 87|8@0+ (1,0) [0|255] "" SGW
 SG_ UConnSeed2 : 95|8@0+ (1,0) [0|255] "" SGW
 SG_ UConnSeed3 : 103|8@0+ (1,0) [0|255] "" SGW
 SG_ UConnSeed4 : 111|8@0+ (1,0) [0|255] "" SGW

BO_ 612 SCCM_FD_3: 32 BCM
 SG_ WprWashSw_Psd : 85|2@0+ (1,0) [0|2] "-" CADM

BO_ 1026 SLML_STATUS_FD: 32 BCM
 SG_ CRC_SLML_STATUS_FD : 191|8@0+ (1,0) [0|255] "-" CADM
 SG_ DRLPositionSts_L : 20|2@0+ (1,0) [0|3] "-" IPC
 SG_ HighBeamSts_L : 5|2@0+ (1,0) [0|3] "-" IPC
 SG_ LowBeamSts_L : 7|2@0+ (1,0) [0|3] "-" CADM,IPC,SGW
 SG_ MessageCounter_SLML_STATUS_FD : 179|4@0+ (1,0) [0|15] "-" CADM
 SG_ PositionLampSts_L : 13|2@0+ (1,0) [0|3] "-" IPC,SGW
 SG_ SideMarkerLampSts_L : 11|2@0+ (1,0) [0|3] "-" IPC
 SG_ SLMLSts : 9|2@0+ (1,0) [0|3] "-" IPC
 SG_ TurnSignalSts_L : 3|2@0+ (1,0) [0|3] "-" Vector__XXX

BO_ 1028 SLMR_STATUS_FD: 32 BCM
 SG_ CRC_SLMR_STATUS_FD : 191|8@0+ (1,0) [0|255] "-" CADM
 SG_ DRLPositionSts_R : 20|2@0+ (1,0) [0|3] "-" IPC
 SG_ HighBeamSts_R : 5|2@0+ (1,0) [0|3] "-" IPC
 SG_ LowBeamSts_R : 7|2@0+ (1,0) [0|3] "-" CADM,IPC,SGW
 SG_ MessageCounter_SLMR_STATUS_FD : 179|4@0+ (1,0) [0|15] "-" CADM
 SG_ PositionLampSts_R : 13|2@0+ (1,0) [0|3] "-" IPC,SGW
 SG_ SideMarkerLampSts_R : 11|2@0+ (1,0) [0|3] "-" IPC
 SG_ SLMRSts : 9|2@0+ (1,0) [0|3] "-" IPC
 SG_ TurnSignalSts_R : 3|2@0+ (1,0) [0|3] "-" Vector__XXX

BO_ 151 SWSM_1: 32 BCM
 SG_ Calc_Threshold : 7|8@0+ (1,0) [0|255] "-" CADM
 SG_ CRC_SWSM_1 : 63|8@0+ (1,0) [0|255] "-" CADM
 SG_ ERR_ST_HOD : 43|4@0+ (1,0) [0|14] "-" CADM
 SG_ HOFF_RCOG_SEN : 51|4@0+ (1,0) [0|14] "-" CADM
 SG_ Immag_Impedence : 23|8@0+ (1,0) [0|255] "-" CADM
 SG_ MC_SWSM_1 : 55|4@0+ (1,0) [0|15] "-" CADM
 SG_ Real_Impedence : 15|8@0+ (1,0) [0|255] "-" CADM
 SG_ RsErr_SWSM : 24|1@0+ (1,0) [0|1] "-" CADM

BO_ 577 SYNCHRO_DC_GLOBAL: 32 ECM
 SG_ QualifyDriveCycle : 7|1@0+ (1,0) [0|1] "" AGSM,BSM,EVCU2,TCM

BO_ 1488 TBM_COOP_CHARGING: 64 SGW
 SG_ Cooperative_Vehicle_Location : 4|1@0+ (1,0) [0|1] "" EVCU2
 SG_ Remote_Chargeport_Command : 6|2@0+ (1,0) [0|3] "" EVCU2
 SG_ TBM_Cooperative_Charge_Command : 3|2@0+ (1,0) [0|3] "" EVCU2
 SG_ TBM_StopCharge : 7|1@0+ (1,0) [0|1] "" EVCU2

BO_ 1429 TBM_FD_1: 32 SGW
 SG_ ACV_Request : 149|1@0+ (1,0) [0|1] "" BCM
 SG_ Disarm_Mobile_App_Req : 6|1@0+ (1,0) [0|1] "" BCM
 SG_ SOSCallStatus : 75|4@0+ (1,0) [0|15] "-" IPC
 SG_ U_CONN_REQ_BCM_FOA_ALERT_FB : 2|1@0+ (1,0) [0|1] "" BCM
 SG_ UCONREQ_TBM_TrailerLightCheck : 5|2@0+ (1,0) [0|3] "" BCM

BO_ 1451 TBM_SCHEDULE_FD_1: 32 SGW
 SG_ SOC_Max_Lev_Rem_Req : 120|2@0+ (1,0) [0|3] "" IPC
 SG_ TBM_Charge_Now : 42|1@0+ (1,0) [0|1] "-" EVCU2
 SG_ TBM_ChargeSchedule_Type1_Req : 134|2@0+ (1,0) [0|3] "" EVCU2
 SG_ TBM_ChargeSchedule_Type2_Req : 132|2@0+ (1,0) [0|3] "" EVCU2
 SG_ TBM_ChargeUntilFull1 : 13|1@0+ (1,0) [0|1] "-" EVCU2
 SG_ TBM_ChargeUntilFull2 : 24|1@0+ (1,0) [0|1] "-" EVCU2
 SG_ TBM_Enable_Schedule1 : 16|1@0+ (1,0) [0|1] "-" EVCU2
 SG_ TBM_Enable_Schedule2 : 32|1@0+ (1,0) [0|1] "-" EVCU2
 SG_ TBM_End_Time_Hr1 : 31|5@0+ (1,0) [0|23] "Hours" EVCU2
 SG_ TBM_End_Time_Hr2 : 79|5@0+ (1,0) [0|23] "Hours" EVCU2
 SG_ TBM_End_Time_Min1 : 39|4@0+ (5,0) [0|55] "min" EVCU2
 SG_ TBM_End_Time_Min2 : 67|4@0+ (5,0) [0|55] "min" EVCU2
 SG_ TBM_External_ChargeTarget1 : 151|4@0+ (5,50) [50|125] "%" EVCU2
 SG_ TBM_External_ChargeTarget2 : 147|4@0+ (5,50) [50|125] "%" EVCU2
 SG_ TBM_Immediate_ChargeTarget1 : 143|4@0+ (5,0) [0|75] "%" EVCU2
 SG_ TBM_Immediate_ChargeTarget2 : 139|4@0+ (5,0) [0|75] "%" EVCU2
 SG_ TBM_PowerLevel_Req : 98|3@0+ (1,0) [0|7] "-" IPC
 SG_ TBM_Schedule_Day1 : 7|8@0+ (1,0) [0|255] "-" EVCU2
 SG_ TBM_Schedule_Day2 : 55|8@0+ (1,0) [0|255] "-" EVCU2
 SG_ TBM_Start_Time_Hr1 : 23|5@0+ (1,0) [0|23] "Hours" EVCU2
 SG_ TBM_Start_Time_Hr2 : 63|5@0+ (1,0) [0|23] "Hours" EVCU2
 SG_ TBM_Start_Time_Min1 : 11|4@0+ (5,0) [0|55] "min" EVCU2
 SG_ TBM_Start_Time_Min2 : 71|4@0+ (5,0) [0|55] "min" EVCU2
 SG_ TBM_Submit_Schedule1 : 17|1@0+ (1,0) [0|1] "-" EVCU2
 SG_ TBM_Submit_Schedule2 : 33|1@0+ (1,0) [0|1] "-" EVCU2

BO_ 1452 TBM_SCHEDULE_FD_2: 32 SGW
 SG_ E_Call_Stat_TBM : 130|3@0+ (1,0) [0|7] "-" BCM
 SG_ PrivacyMode : 134|1@0+ (1,0) [0|1] "-" CADM
 SG_ U_Call_Stat_TBM : 143|3@0+ (1,0) [0|7] "-" BCM

BO_ 2654814219 TCM_APPL1: 8 TCM
 SG_ TCM_to_AZG1 : 7|64@0+ (1,0) [0|0] "" SGW

BO_ 2654814262 TCM_APPL2: 8 TCM
 SG_ TCM_to_AZG2 : 7|64@0+ (1,0) [0|0] "" SGW

BO_ 2654814263 TCM_APPL3: 8 TCM
 SG_ TCM_to_AZG3 : 7|64@0+ (1,0) [0|0] "" SGW

BO_ 2654814264 TCM_APPL4: 8 TCM
 SG_ TRANSMISSION_APPL : 7|64@0+ (1,0) [0|0] "" SGW

BO_ 156 TELEMATIC_FD_1: 32 SGW
 SG_ AUX1_HLEnbl_Req : 31|1@0+ (1,0) [0|1] "" IPC
 SG_ AUX1_PWRMD_Req : 23|1@0+ (1,0) [0|1] "" IPC
 SG_ AUX1_TYPE_Req : 19|1@0+ (1,0) [0|1] "" IPC
 SG_ AUX2_HLEnbl_Req : 30|1@0+ (1,0) [0|1] "" IPC
 SG_ AUX2_PWRMD_Req : 22|1@0+ (1,0) [0|1] "" IPC
 SG_ AUX2_TYPE_Req : 18|1@0+ (1,0) [0|1] "" IPC
 SG_ AUX3_HLEnbl_Req : 29|1@0+ (1,0) [0|1] "" IPC
 SG_ AUX3_PWRMD_Req : 21|1@0+ (1,0) [0|1] "" IPC
 SG_ AUX3_TYPE_Req : 17|1@0+ (1,0) [0|1] "" IPC
 SG_ AUX4_HLEnbl_Req : 28|1@0+ (1,0) [0|1] "" IPC
 SG_ AUX4_PWRMD_Req : 20|1@0+ (1,0) [0|1] "" IPC
 SG_ AUX4_TYPE_Req : 16|1@0+ (1,0) [0|1] "" IPC
 SG_ AUX5_HLEnbl_Req : 182|1@0+ (1,0) [0|1] "" IPC
 SG_ AUX5_PWRMD_Req : 138|1@0+ (1,0) [0|1] "" IPC
 SG_ AUX5_TYPE_Req : 136|1@0+ (1,0) [0|1] "" IPC
 SG_ AUX6_HLEnbl_Req : 181|1@0+ (1,0) [0|1] "" IPC
 SG_ AUX6_PWRMD_Req : 137|1@0+ (1,0) [0|1] "" IPC
 SG_ AUX6_TYPE_Req : 183|1@0+ (1,0) [0|1] "" IPC
 SG_ Day1_TLM : 75|4@0+ (1,0) [0|3] "-" ECM,EVCU2,RFHM
 SG_ Day2_TLM : 87|4@0+ (1,0) [0|9] "-" ECM,EVCU2,RFHM
 SG_ Default_Ride_Height_Req : 139|1@0+ (1,0) [0|1] "" IPC
 SG_ Display_Synch_Req : 180|1@0+ (1,0) [0|1] "" IPC
 SG_ Fuel_Saver_Display_Req : 25|1@0+ (1,0) [0|1] "" IPC
 SG_ GPS_Date_Day : 63|8@0+ (1,0) [1|31] "Days" DMSM,EVCU2,RFHM
 SG_ GPS_Date_Month : 71|8@0+ (1,0) [1|12] "Months" DMSM,EVCU2,RFHM
 SG_ GPS_Date_Year : 167|16@0+ (1,0) [0|65534] "Years" DMSM,EVCU2,RFHM
 SG_ GPS_UTC_Hour : 55|8@0+ (1,0) [0|23] "h" DMSM,EVCU2
 SG_ GPS_UTC_Minute : 47|8@0+ (1,0) [0|59] "min" DMSM,EVCU2
 SG_ GPS_UTC_Second : 151|16@0+ (0.01,0) [0|59.99] "s" DMSM,EVCU2
 SG_ Hour1_TLM : 83|4@0+ (1,0) [0|2] "-" ECM,EVCU2,IPC,RFHM
 SG_ Hour2_TLM : 95|4@0+ (1,0) [0|9] "-" ECM,EVCU2,IPC,RFHM
 SG_ Minute1_TLM : 91|4@0+ (1,0) [0|5] "-" ECM,EVCU2,IPC,RFHM
 SG_ Minute2_TLM : 103|4@0+ (1,0) [0|9] "-" ECM,EVCU2,IPC,RFHM
 SG_ Month1_TLM : 99|4@0+ (1,0) [0|1] "-" ECM,EVCU2,RFHM
 SG_ Month2_TLM : 111|4@0+ (1,0) [0|9] "-" ECM,EVCU2,RFHM
 SG_ ParkSenseSignalView_Req : 34|1@0+ (1,0) [0|1] "" IPC
 SG_ PFTM_Alert_Req : 32|1@0+ (1,0) [0|1] "" IPC
 SG_ PFTM_Enable_Req : 33|1@0+ (1,0) [0|1] "" IPC
 SG_ Rear_G_LGT_with_Cargo_Lights_Req : 142|1@0+ (1,0) [0|1] "" IPC
 SG_ TSI_Offset_Kph_Req : 131|4@0+ (1,0) [0|15] "-" IPC
 SG_ TSI_Offset_Mph_Req : 135|4@0+ (1,0) [0|15] "-" IPC
 SG_ TurnSignalView_Req : 36|2@0+ (1,0) [0|3] "" IPC
 SG_ Year1_TLM : 107|4@0+ (1,0) [0|2] "-" ECM,EVCU2,RFHM
 SG_ Year2_TLM : 119|4@0+ (1,0) [0|9] "-" ECM,EVCU2,RFHM
 SG_ Year3_TLM : 115|4@0+ (1,0) [0|9] "-" ECM,EVCU2,RFHM
 SG_ Year4_TLM : 127|4@0+ (1,0) [0|9] "-" ECM,EVCU2,RFHM

BO_ 608 TELEMATIC_FD_11: 32 SGW
 SG_ BuiltUpArea_CS : 92|2@0+ (1,0) [0|3] "-" CADM
 SG_ CountryCode : 113|10@0+ (1,0) [0|1023] "-" CADM
 SG_ CRC_Telematic11 : 191|8@0+ (1,0) [0|255] "-" CADM
 SG_ DrvSide : 88|1@0+ (1,0) [0|1] "-" CADM
 SG_ EffSpdLmt_CS : 111|5@0+ (1,0) [0|31] "-" CADM,IPC
 SG_ EffSpdLmtType_CS : 116|3@0+ (1,0) [0|7] "-" CADM
 SG_ ETM_ADS_MODE_REQ : 29|3@1+ (1,0) [0|6] "" BCM
 SG_ ETM_EPS_MODE_REQ : 45|3@1+ (1,0) [0|6] "" BCM
 SG_ ETM_PaddlesModeReq : 17|2@0+ (1,0) [0|2] "-" BCM
 SG_ FormOfWay_CS : 103|4@0+ (1,0) [0|15] "-" CADM
 SG_ FuncRoadClass_CS : 95|3@0+ (1,0) [0|7] "-" CADM
 SG_ HU_Front_PAMRequestSts : 63|1@0+ (1,0) [0|1] "-" BCM
 SG_ HU_Iterate_Gain_Down : 44|1@0+ (1,0) [0|1] "-" BCM
 SG_ HU_Iterate_Gain_Up : 1|1@0+ (1,0) [0|1] "-" BCM
 SG_ HU_Rear_PAMRequestSts : 62|1@0+ (1,0) [0|1] "-" BCM
 SG_ Launch_RPM_Selected_Setting2 : 23|6@0+ (100,900) [900|7100] "rpm" BSM
 SG_ Launch_Sft_Btn_status : 2|1@0+ (1,0) [0|1] "-" BSM
 SG_ MessageCounter_Telematic11 : 179|4@0+ (1,0) [0|15] "-" CADM
 SG_ NavDataAvailable_CS : 81|1@0+ (1,0) [0|1] "-" CADM
 SG_ PathIdx_CS : 87|6@0+ (1,0) [0|63] "-" CADM
 SG_ SpdUnits : 80|1@0+ (1,0) [0|1] "-" CADM

CM_ SG_ 519 CRC_RFHUB1 "CRC according to SAE J1850 standard at each frame transmission.";
CM_ SG_ 519 CustKeyInIgnSts "-";
CM_ SG_ 519 DriverEngineOffRequest "The signal is used to inform that an engine shut off is requried by the driver";
CM_ SG_ 519 EcoTimer "EcoMode Timer Status";
CM_ SG_ 519 FobSearchResult "FOB search result";
CM_ SG_ 519 FSRExteriorFront "Exterior Front Zone Signal";
CM_ SG_ 519 FSRFrontTrunk "Front Trunk Zone Signal";
CM_ SG_ 519 IgnPosSts "-";
CM_ SG_ 519 KeyAuth_Status "Key Authentication Status";
CM_ SG_ 519 MessageCounter_RFHUB1 "This signal is a counter used for safety checks strategies. This counter is incremented of 1 (one) unit at each frame transmission.";
CM_ SG_ 519 RFCfgReq "-";
CM_ SG_ 519 RFFobNum3 "Key ID information";
CM_ SG_ 519 RFFuncReq "-";
CM_ SG_ 519 RFReq "-";
CM_ SG_ 519 ValetMode_SPAAK "Valet Mode Information";
CM_ SG_ 1449 BatteryLow "The signal provide the turn off vehicle information to user on Thermal and Hybrid Vehicles";
CM_ SG_ 1449 FOBSearchActive "Signal informing that the RFHM is performing a FOB search.";
CM_ SG_ 1449 FtTrPlacardPress "FtTrPlacardPress";
CM_ SG_ 1449 KeyFob_Present "Active entry polling feature reports whether key fob is in detection zone or not.";
CM_ SG_ 1449 KeyProgramSts "-";
CM_ SG_ 1449 MemRq_FobNum3 "FOB/SPAAK device number making the request";
CM_ SG_ 1449 MsgFOBLeftVeh "FOB left vehicle";
CM_ SG_ 1449 MsgFOBNotFnd "FOB Not Detected.";
CM_ SG_ 1449 MsgKeyNotFnd "Keyfob or Digital Key Presence Status";
CM_ SG_ 1449 MsgNotInPark "-";
CM_ SG_ 1449 MsgPushBtnKey "MsgPushBtnKey.";
CM_ SG_ 1449 RFMemRq "RF memory request";
CM_ SG_ 1449 RrTrPlacardPress "RrTrPlacardPress";
CM_ SG_ 1449 TPMHazardFlash "TPM hazard flash;  true = [1]";
CM_ SG_ 1449 TPMHornChirp "TPM horn chirp";
CM_ SG_ 1876 CRC_RFHUB3 "CRC according to SAE J1850 standard at each frame transmission.";
CM_ SG_ 1876 InflationState_LHF_Tyre "It signal indicated the state for the pressure of the wheel identified";
CM_ SG_ 1876 InflationState_LHR_Tyre "It signal indicated the state for the pressure of the wheel identified";
CM_ SG_ 1876 InflationState_RHF_Tyre "It signal indicated the state for the pressure of the wheel identified";
CM_ SG_ 1876 InflationState_RHR_Tyre "It signal indicated the state for the pressure of the wheel identified";
CM_ SG_ 1876 MessageCounter_RFHUB3 "This signal is a counter used for safety checks strategies. This counter is incremented of 1 (one) unit at each frame transmission.";
CM_ SG_ 1876 PressureValue_LHF_Tyre "It is the value of indicated tyre wheel [bar]";
CM_ SG_ 1876 PressureValue_LHR_Tyre "It is the value of indicated tyre wheel [bar]";
CM_ SG_ 1876 PressureValue_RHF_Tyre "It is the value of indicated tyre wheel [bar]";
CM_ SG_ 1876 PressureValue_RHR_Tyre "It is the value of indicated tyre wheel [bar]";
CM_ SG_ 1876 TPMActivitySts "It indicates whether the TPMS ECU is enabled or disabled.";
CM_ SG_ 1876 TyrePressureSysProgrammedSts "It indicates the TPMS ECU programming status.";
CM_ SG_ 1876 TyrePressureSystemFailSts "It indicates that the TPM System is in Fault or not";
CM_ SG_ 160 UConnSeed1 "random # for security, Character 1";
CM_ SG_ 160 UConnSeed2 "random # for security, Character 2";
CM_ SG_ 160 UConnSeed3 "random # for security, Character 3";
CM_ SG_ 160 UConnSeed4 "random # for security, Character 4";
CM_ SG_ 612 WprWashSw_Psd "Front wiper switch pressed";
CM_ SG_ 1026 CRC_SLML_STATUS_FD "CRC according to SAE J1850 standard at each frame transmission.";
CM_ SG_ 1026 DRLPositionSts_L "Combined DRL and Position Status Left";
CM_ SG_ 1026 HighBeamSts_L "High Beam Status Left";
CM_ SG_ 1026 LowBeamSts_L "Low Beam Status Left";
CM_ SG_ 1026 MessageCounter_SLML_STATUS_FD "This signal is a counter used for safety checks strategies. This counter is incremented of 1 (one) unit at each frame transmission.";
CM_ SG_ 1026 PositionLampSts_L "Position Lamp Status Left";
CM_ SG_ 1026 SideMarkerLampSts_L "Side Marker Lamp Status Left";
CM_ SG_ 1026 SLMLSts "Smart Lighting Module Left Status";
CM_ SG_ 1026 TurnSignalSts_L "Turn Signal Status Left";
CM_ SG_ 1028 CRC_SLMR_STATUS_FD "CRC according to SAE J1850 standard at each frame transmission.";
CM_ SG_ 1028 DRLPositionSts_R "Combined DRL and Position Status Right";
CM_ SG_ 1028 HighBeamSts_R "High Beam Status Right";
CM_ SG_ 1028 LowBeamSts_R "Low Beam Status Right";
CM_ SG_ 1028 MessageCounter_SLMR_STATUS_FD "This signal is a counter used for safety checks strategies. This counter is incremented of 1 (one) unit at each frame transmission.";
CM_ SG_ 1028 PositionLampSts_R "Position Lamp Status Right";
CM_ SG_ 1028 SideMarkerLampSts_R "Side Marker Lamp Status Right";
CM_ SG_ 1028 SLMRSts "Smart Lighting Module Right Status";
CM_ SG_ 1028 TurnSignalSts_R "Turn Signal Status Right";
CM_ SG_ 151 Calc_Threshold "Calc_Threshold";
CM_ SG_ 151 CRC_SWSM_1 "CRC-checksum byte 1 to 2 according to SAE J1850";
CM_ SG_ 151 ERR_ST_HOD "Hands Off Status";
CM_ SG_ 151 HOFF_RCOG_SEN "Hands Off Status";
CM_ SG_ 151 Immag_Impedence "Immag_Impedence";
CM_ SG_ 151 MC_SWSM_1 "Message counter";
CM_ SG_ 151 Real_Impedence "Real_Impedence";
CM_ SG_ 151 RsErr_SWSM "RsErr_SWSM";
CM_ SG_ 577 QualifyDriveCycle "Qualified Drive Cycle";
CM_ SG_ 1488 Cooperative_Vehicle_Location "Vehicle at Cooperative enabled location.";
CM_ SG_ 1488 Remote_Chargeport_Command "Remote Charge port lock/unlock command";
CM_ SG_ 1488 TBM_Cooperative_Charge_Command "Remote cooperative charging command";
CM_ SG_ 1488 TBM_StopCharge "Remote Stop HV Charging Command";
CM_ SG_ 1429 ACV_Request "Active Cabin Ventilation Request";
CM_ SG_ 1429 Disarm_Mobile_App_Req "Forgotten Object Alert mobile alert request";
CM_ SG_ 1429 SOSCallStatus "SOS call function status";
CM_ SG_ 1429 U_CONN_REQ_BCM_FOA_ALERT_FB "Forgotten Object Alert Uconnect Feedback";
CM_ SG_ 1429 UCONREQ_TBM_TrailerLightCheck "Uconnect Trailer Light Check Request";
CM_ SG_ 1451 SOC_Max_Lev_Rem_Req "Customer top of SOC selection remote request";
CM_ SG_ 1451 TBM_Charge_Now "TBM Charge now";
CM_ SG_ 1451 TBM_ChargeSchedule_Type1_Req "Request for Charge Schedule - Type 1";
CM_ SG_ 1451 TBM_ChargeSchedule_Type2_Req "Request for Charge Schedule - Type 2";
CM_ SG_ 1451 TBM_ChargeUntilFull1 "Charge until battery is fully charged with schedule 1";
CM_ SG_ 1451 TBM_ChargeUntilFull2 "Charge until battery is fully charged with schedule 2";
CM_ SG_ 1451 TBM_Enable_Schedule1 "Schedule 1 checkbox enabled";
CM_ SG_ 1451 TBM_Enable_Schedule2 "Schedule 2 checkbox enabled";
CM_ SG_ 1451 TBM_End_Time_Hr1 "End Time of schedule 1 (hours in 24 hrs. format)";
CM_ SG_ 1451 TBM_End_Time_Hr2 "End Time of schedule  2 (hours in 24 hrs. format)";
CM_ SG_ 1451 TBM_End_Time_Min1 "End Time of schedule 1(Minutes)";
CM_ SG_ 1451 TBM_End_Time_Min2 "End Time of schedule  2(Minutes)";
CM_ SG_ 1451 TBM_External_ChargeTarget1 "Request for Target State of Charge - Type 1";
CM_ SG_ 1451 TBM_External_ChargeTarget2 "Request for Target State of Charge - Type 2";
CM_ SG_ 1451 TBM_Immediate_ChargeTarget1 "Request for Minimum State of Charge - Type 1";
CM_ SG_ 1451 TBM_Immediate_ChargeTarget2 "Request for Minimum State of Charge - Type 2";
CM_ SG_ 1451 TBM_PowerLevel_Req "This signal is menaged when the driver requests the Power Level setting";
CM_ SG_ 1451 TBM_Schedule_Day1 "Schedule#1 Day for charging or cabin conditioning";
CM_ SG_ 1451 TBM_Schedule_Day2 "Schedule#2 Day for charging or cabin conditioning";
CM_ SG_ 1451 TBM_Start_Time_Hr1 "Start Time of schedule  1 (hours in 24 hrs. format)";
CM_ SG_ 1451 TBM_Start_Time_Hr2 "Start Time of schedule  2(hours in 24 hrs. format)";
CM_ SG_ 1451 TBM_Start_Time_Min1 "Start Time of schedule  1 (minutes)";
CM_ SG_ 1451 TBM_Start_Time_Min2 "Start Time of schedule  2 (minutes)";
CM_ SG_ 1451 TBM_Submit_Schedule1 "Schedule 1 submitted";
CM_ SG_ 1451 TBM_Submit_Schedule2 "Schedule 2 submitted";
CM_ SG_ 1452 E_Call_Stat_TBM "E-Call Status";
CM_ SG_ 1452 PrivacyMode "It is used to give information about  the Privacy Mode functionality.";
CM_ SG_ 1452 U_Call_Stat_TBM "U-Call Status";
CM_ SG_ 2654814264 TRANSMISSION_APPL "External application to ECU";
CM_ SG_ 156 AUX1_HLEnbl_Req "AUX Switch 1 Hold Last State";
CM_ SG_ 156 AUX1_PWRMD_Req "AUX Switch 1 Power Mode Req";
CM_ SG_ 156 AUX1_TYPE_Req "AUX Switch 1 Type Req";
CM_ SG_ 156 AUX2_HLEnbl_Req "AUX Switch 2 Hold Last State";
CM_ SG_ 156 AUX2_PWRMD_Req "AUX Switch 2 Power Mode Req";
CM_ SG_ 156 AUX2_TYPE_Req "AUX Switch 2 Type Req";
CM_ SG_ 156 AUX3_HLEnbl_Req "AUX Switch 3 Hold Last State";
CM_ SG_ 156 AUX3_PWRMD_Req "AUX Switch 3 Power Mode Req";
CM_ SG_ 156 AUX3_TYPE_Req "AUX Switch 3 Type Req";
CM_ SG_ 156 AUX4_HLEnbl_Req "AUX Switch 4 Hold Last State";
CM_ SG_ 156 AUX4_PWRMD_Req "AUX Switch 4 Power Mode Req";
CM_ SG_ 156 AUX4_TYPE_Req "AUX Switch 4 Type Req";
CM_ SG_ 156 AUX5_HLEnbl_Req "AUX Switch 5 Hold Last State";
CM_ SG_ 156 AUX5_PWRMD_Req "Aux switch 5 power mode; ignition = [0], battery = [1]";
CM_ SG_ 156 AUX5_TYPE_Req "AUX Switch 5 Type Req";
CM_ SG_ 156 AUX6_HLEnbl_Req "Aux switch 6 enable holding last state; enabled = [1]";
CM_ SG_ 156 AUX6_PWRMD_Req "Aux switch 6 power mode; ignition = [0], battery = [1]";
CM_ SG_ 156 AUX6_TYPE_Req "AUX Switch 6 Type Req";
CM_ SG_ 156 Default_Ride_Height_Req "Default Ride Height setting; Enable Default Ride Height mode = [1]";
CM_ SG_ 156 Display_Synch_Req "Display Synch Customer Setting; ON = [1]";
CM_ SG_ 156 Fuel_Saver_Display_Req "Fuel saver display indicator status (1=enabled)";
CM_ SG_ 156 GPS_Date_Day "GPS date day";
CM_ SG_ 156 GPS_Date_Month "GPS date month";
CM_ SG_ 156 GPS_Date_Year "GPS date year";
CM_ SG_ 156 GPS_UTC_Hour "GPS UTC hour";
CM_ SG_ 156 GPS_UTC_Minute "GPS UTC minute";
CM_ SG_ 156 GPS_UTC_Second "GPS UTC second";
CM_ SG_ 156 ParkSenseSignalView_Req "ParkSense Based Camera Activation settings";
CM_ SG_ 156 PFTM_Alert_Req "Power Front Trunk Audible Alert Enable request, enabled =[1]";
CM_ SG_ 156 PFTM_Enable_Req "Power Front Trunk Enable request, enabled =[1]";
CM_ SG_ 156 Rear_G_LGT_with_Cargo_Lights_Req "Rear Guidance Lights status information, Enable= 1";
CM_ SG_ 156 TSI_Offset_Kph_Req "TSI_Offset_Kph_Req";
CM_ SG_ 156 TSI_Offset_Mph_Req "TSI_Offset_Mph_Req";
CM_ SG_ 156 TurnSignalView_Req "Turn Signal Activated Blind Spot Camera View with and without Trailer Options";
CM_ SG_ 608 BuiltUpArea_CS "Segment built-up area status";
CM_ SG_ 608 CountryCode "Country Code (Coding based on ISO 3166-1 numeric)";
CM_ SG_ 608 CRC_Telematic11 "CRC according to SAE J1850 standard at each frame transmission.";
CM_ SG_ 608 DrvSide "Driving Side";
CM_ SG_ 608 EffSpdLmt_CS "Effective Speed Limit Value";
CM_ SG_ 608 EffSpdLmtType_CS "Effective Speed Limit Type";
CM_ SG_ 608 ETM_ADS_MODE_REQ "Active damping system mode personalization request";
CM_ SG_ 608 ETM_EPS_MODE_REQ "EPS mode personalization request";
CM_ SG_ 608 ETM_PaddlesModeReq "Requested state of paddle lock-out function";
CM_ SG_ 608 FormOfWay_CS "Form of Way";
CM_ SG_ 608 FuncRoadClass_CS "Functional Road Class";
CM_ SG_ 608 HU_Front_PAMRequestSts "Radio Front Park Assist Button Pressed";
CM_ SG_ 608 HU_Iterate_Gain_Down "Radio Trailer Brake Gain Down Button Pressed";
CM_ SG_ 608 HU_Iterate_Gain_Up "Radio Trailer Brake Gain Up Button Pressed";
CM_ SG_ 608 HU_Rear_PAMRequestSts "Radio Rear Park Assist Button Pressed";
CM_ SG_ 608 Launch_RPM_Selected_Setting2 "Driver selected Launch RPM setting";
CM_ SG_ 608 Launch_Sft_Btn_status "Launch - soft button status; Launch on = [1]";
CM_ SG_ 608 MessageCounter_Telematic11 "This signal is a counter used for safety checks strategies. This counter is incremented of 1 (one) unit at each frame transmission.";
CM_ SG_ 608 NavDataAvailable_CS "Validity of Available Nav Data [1 = Valid Data Available]";
CM_ SG_ 608 PathIdx_CS "Path Index";
CM_ SG_ 608 SpdUnits "Speed Units";

BA_DEF_ SG_ "GenSigStartValue" INT 0 2147483647;
BA_DEF_ SG_ "GenSigInactiveValue" INT 0 2147483647;
BA_DEF_ SG_ "GenSigSendType" ENUM "NotUsed","OnWrite","OnWriteWithRepetition","OnChange","OnChangeWithRepetition","IfActive","IfActiveWithRepetition","NoSigSendType";
BA_DEF_ SG_ "SystemSignalLongSymbol" STRING ;
BA_DEF_ SG_ "GenSigTimeoutTime_AGSM" INT 0 65535;
BA_DEF_ SG_ "GenSigTimeoutTime_BCM" INT 0 65535;
BA_DEF_ SG_ "GenSigTimeoutTime_BSM" INT 0 65535;
BA_DEF_ SG_ "GenSigTimeoutTime_CADM" INT 0 65535;
BA_DEF_ SG_ "GenSigTimeoutTime_DMSM" INT 0 65535;
BA_DEF_ SG_ "GenSigTimeoutTime_DTCM" INT 0 65535;
BA_DEF_ SG_ "GenSigTimeoutTime_ECM" INT 0 65535;
BA_DEF_ SG_ "GenSigTimeoutTime_EVCU2" INT 0 65535;
BA_DEF_ SG_ "GenSigTimeoutTime_GNMM" INT 0 65535;
BA_DEF_ SG_ "GenSigTimeoutTime_HCP" INT 0 65535;
BA_DEF_ SG_ "GenSigTimeoutTime_IPC" INT 0 65535;
BA_DEF_ SG_ "GenSigTimeoutTime_RFHM" INT 0 65535;
BA_DEF_ SG_ "GenSigTimeoutTime_SGW" INT 0 65535;
BA_DEF_ SG_ "GenSigTimeoutTime_TCM" INT 0 65535;
BA_DEF_ BO_ "DiagRequest" ENUM "No","Yes";
BA_DEF_ BO_ "Type" ENUM "P","C","PE","COC","PE_Cntrl","E","E_Cntrl","OC","S","BAF","DC","EM","MM","ISO-TP","-";
BA_DEF_ BO_ "DiagResponse" ENUM "No","Yes";
BA_DEF_ BO_ "NmMessage" ENUM "No","Yes";
BA_DEF_ BO_ "GenMsgSendType" ENUM "Cyclic","NotUsed","NotUsed","NotUsed","NotUsed","NotUsed","NotUsed","NotUsed","NoMsgSendType";
BA_DEF_ BO_ "GenMsgNrOfRepetition" INT 0 255;
BA_DEF_ BO_ "GenMsgILSupport" ENUM "No","Yes";
BA_DEF_ BO_ "GenMsgStartDelayTime" INT 0 65535;
BA_DEF_ BO_ "GenMsgCycleTimeFast" INT 0 65535;
BA_DEF_ BO_ "GenMsgCycleTime" INT 0 65535;
BA_DEF_ BO_ "GenMsgDelayTime" INT 0 65535;
BA_DEF_ BO_ "NmAsrMessage" ENUM "No","Yes";
BA_DEF_ BO_ "DiagState" ENUM "No","Yes";
BA_DEF_ BO_ "DiagConnection" HEX 0 65535;
BA_DEF_ BO_ "VFrameFormat" ENUM "StandardCAN","ExtendedCAN","reserved","reserved","reserved","reserved","reserved","reserved","reserved","reserved","reserved","reserved","reserved","reserved","StandardCAN_FD","ExtendedCAN_FD";
BA_DEF_ BO_ "CANFD_BRS" ENUM "0","1";
BA_DEF_DEF_ "DiagRequest" "No";
BA_DEF_DEF_ "Type" "-";
BA_DEF_DEF_ "DiagResponse" "No";
BA_DEF_DEF_ "NmMessage" "No";
BA_DEF_DEF_ "GenMsgSendType" "NoMsgSendType";
BA_DEF_DEF_ "GenMsgNrOfRepetition" 0;
BA_DEF_DEF_ "GenMsgILSupport" "No";
BA_DEF_DEF_ "GenMsgStartDelayTime" 0;
BA_DEF_DEF_ "GenMsgCycleTimeFast" 0;
BA_DEF_DEF_ "GenMsgCycleTime" 0;
BA_DEF_DEF_ "GenMsgDelayTime" 0;
BA_DEF_DEF_ "NmAsrMessage" "No";
BA_DEF_DEF_ "DiagState" "No";
BA_DEF_DEF_ "DiagConnection" 0;
BA_DEF_DEF_ "VFrameFormat" "StandardCAN_FD";
BA_DEF_DEF_ "CANFD_BRS" "0";
BA_DEF_DEF_ "GenSigStartValue" 0;
BA_DEF_DEF_ "GenSigInactiveValue" 0;
BA_DEF_DEF_ "GenSigSendType" "NoSigSendType";
BA_DEF_DEF_ "SystemSignalLongSymbol" "";
BA_DEF_DEF_ "GenSigTimeoutTime_AGSM" 2500;
BA_DEF_DEF_ "GenSigTimeoutTime_BCM" 2500;
BA_DEF_DEF_ "GenSigTimeoutTime_BSM" 2500;
BA_DEF_DEF_ "GenSigTimeoutTime_CADM" 2500;
BA_DEF_DEF_ "GenSigTimeoutTime_DMSM" 2500;
BA_DEF_DEF_ "GenSigTimeoutTime_DTCM" 2500;
BA_DEF_DEF_ "GenSigTimeoutTime_ECM" 2500;
BA_DEF_DEF_ "GenSigTimeoutTime_EVCU2" 2500;
BA_DEF_DEF_ "GenSigTimeoutTime_GNMM" 2500;
BA_DEF_DEF_ "GenSigTimeoutTime_HCP" 2500;
BA_DEF_DEF_ "GenSigTimeoutTime_IPC" 2500;
BA_DEF_DEF_ "GenSigTimeoutTime_RFHM" 2500;
BA_DEF_DEF_ "GenSigTimeoutTime_SGW" 2500;
BA_DEF_DEF_ "GenSigTimeoutTime_TCM" 2500;
BA_ "Type" BO_ 519 1;
BA_ "GenMsgSendType" BO_ 519 0;
BA_ "GenMsgILSupport" BO_ 519 1;
BA_ "GenMsgCycleTime" BO_ 519 20;
BA_ "CANFD_BRS" BO_ 519 1;
BA_ "Type" BO_ 1449 3;
BA_ "GenMsgSendType" BO_ 1449 0;
BA_ "GenMsgNrOfRepetition" BO_ 1449 2;
BA_ "GenMsgILSupport" BO_ 1449 1;
BA_ "GenMsgCycleTimeFast" BO_ 1449 20;
BA_ "GenMsgCycleTime" BO_ 1449 1000;
BA_ "GenMsgDelayTime" BO_ 1449 20;
BA_ "CANFD_BRS" BO_ 1449 1;
BA_ "Type" BO_ 1876 3;
BA_ "GenMsgSendType" BO_ 1876 0;
BA_ "GenMsgNrOfRepetition" BO_ 1876 2;
BA_ "GenMsgILSupport" BO_ 1876 1;
BA_ "GenMsgCycleTimeFast" BO_ 1876 20;
BA_ "GenMsgCycleTime" BO_ 1876 2000;
BA_ "GenMsgDelayTime" BO_ 1876 20;
BA_ "CANFD_BRS" BO_ 1876 1;
BA_ "Type" BO_ 160 8;
BA_ "GenMsgILSupport" BO_ 160 1;
BA_ "CANFD_BRS" BO_ 160 1;
BA_ "Type" BO_ 612 3;
BA_ "GenMsgSendType" BO_ 612 0;
BA_ "GenMsgNrOfRepetition" BO_ 612 2;
BA_ "GenMsgILSupport" BO_ 612 1;
BA_ "GenMsgStartDelayTime" BO_ 612 80;
BA_ "GenMsgCycleTimeFast" BO_ 612 20;
BA_ "GenMsgCycleTime" BO_ 612 100;
BA_ "GenMsgDelayTime" BO_ 612 20;
BA_ "CANFD_BRS" BO_ 612 1;
BA_ "Type" BO_ 1026 1;
BA_ "GenMsgSendType" BO_ 1026 0;
BA_ "GenMsgILSupport" BO_ 1026 1;
BA_ "GenMsgStartDelayTime" BO_ 1026 85;
BA_ "GenMsgCycleTime" BO_ 1026 100;
BA_ "CANFD_BRS" BO_ 1026 1;
BA_ "Type" BO_ 1028 1;
BA_ "GenMsgSendType" BO_ 1028 0;
BA_ "GenMsgILSupport" BO_ 1028 1;
BA_ "GenMsgStartDelayTime" BO_ 1028 90;
BA_ "GenMsgCycleTime" BO_ 1028 100;
BA_ "CANFD_BRS" BO_ 1028 1;
BA_ "Type" BO_ 151 8;
BA_ "GenMsgILSupport" BO_ 151 1;
BA_ "GenMsgDelayTime" BO_ 151 20;
BA_ "CANFD_BRS" BO_ 151 1;
BA_ "Type" BO_ 577 3;
BA_ "GenMsgSendType" BO_ 577 0;
BA_ "GenMsgILSupport" BO_ 577 1;
BA_ "GenMsgCycleTime" BO_ 577 1000;
BA_ "GenMsgDelayTime" BO_ 577 20;
BA_ "CANFD_BRS" BO_ 577 1;
BA_ "Type" BO_ 1488 1;
BA_ "GenMsgSendType" BO_ 1488 0;
BA_ "GenMsgILSupport" BO_ 1488 1;
BA_ "GenMsgCycleTime" BO_ 1488 1000;
BA_ "GenMsgDelayTime" BO_ 1488 20;
BA_ "CANFD_BRS" BO_ 1488 1;
BA_ "Type" BO_ 1429 3;
BA_ "GenMsgSendType" BO_ 1429 0;
BA_ "GenMsgILSupport" BO_ 1429 1;
BA_ "GenMsgCycleTime" BO_ 1429 1000;
BA_ "CANFD_BRS" BO_ 1429 1;
BA_ "Type" BO_ 1451 3;
BA_ "GenMsgSendType" BO_ 1451 0;
BA_ "GenMsgILSupport" BO_ 1451 1;
BA_ "GenMsgCycleTime" BO_ 1451 1000;
BA_ "CANFD_BRS" BO_ 1451 1;
BA_ "Type" BO_ 1452 3;
BA_ "GenMsgSendType" BO_ 1452 0;
BA_ "GenMsgILSupport" BO_ 1452 1;
BA_ "GenMsgCycleTime" BO_ 1452 1000;
BA_ "CANFD_BRS" BO_ 1452 1;
BA_ "Type" BO_ 2654814219 8;
BA_ "GenMsgILSupport" BO_ 2654814219 1;
BA_ "VFrameFormat" BO_ 2654814219 15;
BA_ "CANFD_BRS" BO_ 2654814219 1;
BA_ "Type" BO_ 2654814262 8;
BA_ "GenMsgILSupport" BO_ 2654814262 1;
BA_ "VFrameFormat" BO_ 2654814262 15;
BA_ "CANFD_BRS" BO_ 2654814262 1;
BA_ "Type" BO_ 2654814263 8;
BA_ "GenMsgILSupport" BO_ 2654814263 1;
BA_ "VFrameFormat" BO_ 2654814263 15;
BA_ "CANFD_BRS" BO_ 2654814263 1;
BA_ "Type" BO_ 2654814264 8;
BA_ "GenMsgILSupport" BO_ 2654814264 1;
BA_ "VFrameFormat" BO_ 2654814264 15;
BA_ "CANFD_BRS" BO_ 2654814264 1;
BA_ "Type" BO_ 156 8;
BA_ "GenMsgILSupport" BO_ 156 1;
BA_ "CANFD_BRS" BO_ 156 1;
BA_ "Type" BO_ 608 3;
BA_ "GenMsgSendType" BO_ 608 0;
BA_ "GenMsgNrOfRepetition" BO_ 608 2;
BA_ "GenMsgILSupport" BO_ 608 1;
BA_ "GenMsgCycleTimeFast" BO_ 608 20;
BA_ "GenMsgCycleTime" BO_ 608 100;
BA_ "GenMsgDelayTime" BO_ 608 20;
BA_ "CANFD_BRS" BO_ 608 1;
BA_ "GenSigTimeoutTime_AGSM" SG_ 519 CRC_RFHUB1 0;
BA_ "GenSigTimeoutTime_BCM" SG_ 519 CRC_RFHUB1 0;
BA_ "GenSigTimeoutTime_BSM" SG_ 519 CRC_RFHUB1 0;
BA_ "GenSigTimeoutTime_CADM" SG_ 519 CRC_RFHUB1 0;
BA_ "GenSigTimeoutTime_DMSM" SG_ 519 CRC_RFHUB1 0;
BA_ "GenSigTimeoutTime_DTCM" SG_ 519 CRC_RFHUB1 0;
BA_ "GenSigTimeoutTime_ECM" SG_ 519 CRC_RFHUB1 0;
BA_ "GenSigTimeoutTime_EVCU2" SG_ 519 CRC_RFHUB1 0;
BA_ "GenSigTimeoutTime_GNMM" SG_ 519 CRC_RFHUB1 0;
BA_ "GenSigTimeoutTime_HCP" SG_ 519 CRC_RFHUB1 0;
BA_ "GenSigTimeoutTime_IPC" SG_ 519 CRC_RFHUB1 0;
BA_ "GenSigTimeoutTime_RFHM" SG_ 519 CRC_RFHUB1 0;
BA_ "GenSigTimeoutTime_SGW" SG_ 519 CRC_RFHUB1 0;
BA_ "GenSigTimeoutTime_AGSM" SG_ 519 CustKeyInIgnSts 0;
BA_ "GenSigTimeoutTime_BSM" SG_ 519 CustKeyInIgnSts 0;
BA_ "GenSigTimeoutTime_CADM" SG_ 519 CustKeyInIgnSts 0;
BA_ "GenSigTimeoutTime_DMSM" SG_ 519 CustKeyInIgnSts 0;
BA_ "GenSigTimeoutTime_DTCM" SG_ 519 CustKeyInIgnSts 0;
BA_ "GenSigTimeoutTime_ECM" SG_ 519 CustKeyInIgnSts 0;
BA_ "GenSigTimeoutTime_EVCU2" SG_ 519 CustKeyInIgnSts 0;
BA_ "GenSigTimeoutTime_GNMM" SG_ 519 CustKeyInIgnSts 0;
BA_ "GenSigTimeoutTime_HCP" SG_ 519 CustKeyInIgnSts 0;
BA_ "GenSigTimeoutTime_IPC" SG_ 519 CustKeyInIgnSts 0;
BA_ "GenSigTimeoutTime_RFHM" SG_ 519 CustKeyInIgnSts 0;
BA_ "GenSigTimeoutTime_TCM" SG_ 519 CustKeyInIgnSts 0;
BA_ "GenSigTimeoutTime_AGSM" SG_ 519 DriverEngineOffRequest 0;
BA_ "GenSigTimeoutTime_BSM" SG_ 519 DriverEngineOffRequest 0;
BA_ "GenSigTimeoutTime_CADM" SG_ 519 DriverEngineOffRequest 0;
BA_ "GenSigTimeoutTime_DMSM" SG_ 519 DriverEngineOffRequest 0;
BA_ "GenSigTimeoutTime_DTCM" SG_ 519 DriverEngineOffRequest 0;
BA_ "GenSigTimeoutTime_ECM" SG_ 519 DriverEngineOffRequest 0;
BA_ "GenSigTimeoutTime_GNMM" SG_ 519 DriverEngineOffRequest 0;
BA_ "GenSigTimeoutTime_HCP" SG_ 519 DriverEngineOffRequest 0;
BA_ "GenSigTimeoutTime_IPC" SG_ 519 DriverEngineOffRequest 0;
BA_ "GenSigTimeoutTime_RFHM" SG_ 519 DriverEngineOffRequest 0;
BA_ "GenSigTimeoutTime_SGW" SG_ 519 DriverEngineOffRequest 0;
BA_ "GenSigSendType" SG_ 519 EcoTimer 3;
BA_ "GenSigTimeoutTime_AGSM" SG_ 519 EcoTimer 0;
BA_ "GenSigTimeoutTime_BSM" SG_ 519 EcoTimer 0;
BA_ "GenSigTimeoutTime_CADM" SG_ 519 EcoTimer 0;
BA_ "GenSigTimeoutTime_DMSM" SG_ 519 EcoTimer 0;
BA_ "GenSigTimeoutTime_DTCM" SG_ 519 EcoTimer 0;
BA_ "GenSigTimeoutTime_ECM" SG_ 519 EcoTimer 0;
BA_ "GenSigTimeoutTime_EVCU2" SG_ 519 EcoTimer 0;
BA_ "GenSigTimeoutTime_GNMM" SG_ 519 EcoTimer 0;
BA_ "GenSigTimeoutTime_HCP" SG_ 519 EcoTimer 0;
BA_ "GenSigTimeoutTime_IPC" SG_ 519 EcoTimer 0;
BA_ "GenSigTimeoutTime_RFHM" SG_ 519 EcoTimer 0;
BA_ "GenSigTimeoutTime_SGW" SG_ 519 EcoTimer 0;
BA_ "GenSigTimeoutTime_TCM" SG_ 519 EcoTimer 0;
BA_ "GenSigTimeoutTime_AGSM" SG_ 519 FobSearchResult 0;
BA_ "GenSigTimeoutTime_BSM" SG_ 519 FobSearchResult 0;
BA_ "GenSigTimeoutTime_CADM" SG_ 519 FobSearchResult 0;
BA_ "GenSigTimeoutTime_DMSM" SG_ 519 FobSearchResult 0;
BA_ "GenSigTimeoutTime_DTCM" SG_ 519 FobSearchResult 0;
BA_ "GenSigTimeoutTime_ECM" SG_ 519 FobSearchResult 0;
BA_ "GenSigTimeoutTime_EVCU2" SG_ 519 FobSearchResult 0;
BA_ "GenSigTimeoutTime_GNMM" SG_ 519 FobSearchResult 0;
BA_ "GenSigTimeoutTime_HCP" SG_ 519 FobSearchResult 0;
BA_ "GenSigTimeoutTime_IPC" SG_ 519 FobSearchResult 0;
BA_ "GenSigTimeoutTime_RFHM" SG_ 519 FobSearchResult 0;
BA_ "GenSigTimeoutTime_SGW" SG_ 519 FobSearchResult 0;
BA_ "GenSigTimeoutTime_TCM" SG_ 519 FobSearchResult 0;
BA_ "GenSigTimeoutTime_AGSM" SG_ 519 FSRExteriorFront 0;
BA_ "GenSigTimeoutTime_BSM" SG_ 519 FSRExteriorFront 0;
BA_ "GenSigTimeoutTime_CADM" SG_ 519 FSRExteriorFront 0;
BA_ "GenSigTimeoutTime_DMSM" SG_ 519 FSRExteriorFront 0;
BA_ "GenSigTimeoutTime_DTCM" SG_ 519 FSRExteriorFront 0;
BA_ "GenSigTimeoutTime_ECM" SG_ 519 FSRExteriorFront 0;
BA_ "GenSigTimeoutTime_EVCU2" SG_ 519 FSRExteriorFront 0;
BA_ "GenSigTimeoutTime_GNMM" SG_ 519 FSRExteriorFront 0;
BA_ "GenSigTimeoutTime_HCP" SG_ 519 FSRExteriorFront 0;
BA_ "GenSigTimeoutTime_IPC" SG_ 519 FSRExteriorFront 0;
BA_ "GenSigTimeoutTime_RFHM" SG_ 519 FSRExteriorFront 0;
BA_ "GenSigTimeoutTime_SGW" SG_ 519 FSRExteriorFront 0;
BA_ "GenSigTimeoutTime_TCM" SG_ 519 FSRExteriorFront 0;
BA_ "GenSigTimeoutTime_AGSM" SG_ 519 FSRFrontTrunk 0;
BA_ "GenSigTimeoutTime_BSM" SG_ 519 FSRFrontTrunk 0;
BA_ "GenSigTimeoutTime_CADM" SG_ 519 FSRFrontTrunk 0;
BA_ "GenSigTimeoutTime_DMSM" SG_ 519 FSRFrontTrunk 0;
BA_ "GenSigTimeoutTime_DTCM" SG_ 519 FSRFrontTrunk 0;
BA_ "GenSigTimeoutTime_ECM" SG_ 519 FSRFrontTrunk 0;
BA_ "GenSigTimeoutTime_EVCU2" SG_ 519 FSRFrontTrunk 0;
BA_ "GenSigTimeoutTime_GNMM" SG_ 519 FSRFrontTrunk 0;
BA_ "GenSigTimeoutTime_HCP" SG_ 519 FSRFrontTrunk 0;
BA_ "GenSigTimeoutTime_IPC" SG_ 519 FSRFrontTrunk 0;
BA_ "GenSigTimeoutTime_RFHM" SG_ 519 FSRFrontTrunk 0;
BA_ "GenSigTimeoutTime_SGW" SG_ 519 FSRFrontTrunk 0;
BA_ "GenSigTimeoutTime_TCM" SG_ 519 FSRFrontTrunk 0;
BA_ "GenSigTimeoutTime_AGSM" SG_ 519 IgnPosSts 0;
BA_ "GenSigTimeoutTime_BSM" SG_ 519 IgnPosSts 0;
BA_ "GenSigTimeoutTime_CADM" SG_ 519 IgnPosSts 0;
BA_ "GenSigTimeoutTime_DMSM" SG_ 519 IgnPosSts 0;
BA_ "GenSigTimeoutTime_DTCM" SG_ 519 IgnPosSts 0;
BA_ "GenSigTimeoutTime_ECM" SG_ 519 IgnPosSts 0;
BA_ "GenSigTimeoutTime_EVCU2" SG_ 519 IgnPosSts 0;
BA_ "GenSigTimeoutTime_GNMM" SG_ 519 IgnPosSts 0;
BA_ "GenSigTimeoutTime_HCP" SG_ 519 IgnPosSts 0;
BA_ "GenSigTimeoutTime_IPC" SG_ 519 IgnPosSts 0;
BA_ "GenSigTimeoutTime_RFHM" SG_ 519 IgnPosSts 0;
BA_ "GenSigTimeoutTime_TCM" SG_ 519 IgnPosSts 0;
BA_ "GenSigTimeoutTime_AGSM" SG_ 519 KeyAuth_Status 0;
BA_ "GenSigTimeoutTime_BCM" SG_ 519 KeyAuth_Status 0;
BA_ "GenSigTimeoutTime_BSM" SG_ 519 KeyAuth_Status 0;
BA_ "GenSigTimeoutTime_CADM" SG_ 519 KeyAuth_Status 0;
BA_ "GenSigTimeoutTime_DMSM" SG_ 519 KeyAuth_Status 0;
BA_ "GenSigTimeoutTime_DTCM" SG_ 519 KeyAuth_Status 0;
BA_ "GenSigTimeoutTime_ECM" SG_ 519 KeyAuth_Status 0;
BA_ "GenSigTimeoutTime_EVCU2" SG_ 519 KeyAuth_Status 0;
BA_ "GenSigTimeoutTime_GNMM" SG_ 519 KeyAuth_Status 0;
BA_ "GenSigTimeoutTime_HCP" SG_ 519 KeyAuth_Status 0;
BA_ "GenSigTimeoutTime_RFHM" SG_ 519 KeyAuth_Status 0;
BA_ "GenSigTimeoutTime_SGW" SG_ 519 KeyAuth_Status 0;
BA_ "GenSigTimeoutTime_TCM" SG_ 519 KeyAuth_Status 0;
BA_ "GenSigTimeoutTime_AGSM" SG_ 519 MessageCounter_RFHUB1 0;
BA_ "GenSigTimeoutTime_BCM" SG_ 519 MessageCounter_RFHUB1 0;
BA_ "GenSigTimeoutTime_BSM" SG_ 519 MessageCounter_RFHUB1 0;
BA_ "GenSigTimeoutTime_CADM" SG_ 519 MessageCounter_RFHUB1 0;
BA_ "GenSigTimeoutTime_DMSM" SG_ 519 MessageCounter_RFHUB1 0;
BA_ "GenSigTimeoutTime_DTCM" SG_ 519 MessageCounter_RFHUB1 0;
BA_ "GenSigTimeoutTime_ECM" SG_ 519 MessageCounter_RFHUB1 0;
BA_ "GenSigTimeoutTime_EVCU2" SG_ 519 MessageCounter_RFHUB1 0;
BA_ "GenSigTimeoutTime_GNMM" SG_ 519 MessageCounter_RFHUB1 0;
BA_ "GenSigTimeoutTime_HCP" SG_ 519 MessageCounter_RFHUB1 0;
BA_ "GenSigTimeoutTime_IPC" SG_ 519 MessageCounter_RFHUB1 0;
BA_ "GenSigTimeoutTime_RFHM" SG_ 519 MessageCounter_RFHUB1 0;
BA_ "GenSigTimeoutTime_SGW" SG_ 519 MessageCounter_RFHUB1 0;
BA_ "GenSigTimeoutTime_AGSM" SG_ 519 RFCfgReq 0;
BA_ "GenSigTimeoutTime_BCM" SG_ 519 RFCfgReq 0;
BA_ "GenSigTimeoutTime_BSM" SG_ 519 RFCfgReq 0;
BA_ "GenSigTimeoutTime_CADM" SG_ 519 RFCfgReq 0;
BA_ "GenSigTimeoutTime_DMSM" SG_ 519 RFCfgReq 0;
BA_ "GenSigTimeoutTime_DTCM" SG_ 519 RFCfgReq 0;
BA_ "GenSigTimeoutTime_ECM" SG_ 519 RFCfgReq 0;
BA_ "GenSigTimeoutTime_EVCU2" SG_ 519 RFCfgReq 0;
BA_ "GenSigTimeoutTime_GNMM" SG_ 519 RFCfgReq 0;
BA_ "GenSigTimeoutTime_HCP" SG_ 519 RFCfgReq 0;
BA_ "GenSigTimeoutTime_RFHM" SG_ 519 RFCfgReq 0;
BA_ "GenSigTimeoutTime_TCM" SG_ 519 RFCfgReq 0;
BA_ "GenSigTimeoutTime_AGSM" SG_ 519 RFFobNum3 0;
BA_ "GenSigTimeoutTime_BSM" SG_ 519 RFFobNum3 0;
BA_ "GenSigTimeoutTime_CADM" SG_ 519 RFFobNum3 0;
BA_ "GenSigTimeoutTime_DMSM" SG_ 519 RFFobNum3 0;
BA_ "GenSigTimeoutTime_DTCM" SG_ 519 RFFobNum3 0;
BA_ "GenSigTimeoutTime_ECM" SG_ 519 RFFobNum3 0;
BA_ "GenSigTimeoutTime_EVCU2" SG_ 519 RFFobNum3 0;
BA_ "GenSigTimeoutTime_GNMM" SG_ 519 RFFobNum3 0;
BA_ "GenSigTimeoutTime_HCP" SG_ 519 RFFobNum3 0;
BA_ "GenSigTimeoutTime_IPC" SG_ 519 RFFobNum3 0;
BA_ "GenSigTimeoutTime_RFHM" SG_ 519 RFFobNum3 0;
BA_ "GenSigTimeoutTime_TCM" SG_ 519 RFFobNum3 0;
BA_ "GenSigTimeoutTime_AGSM" SG_ 519 RFFuncReq 0;
BA_ "GenSigTimeoutTime_BSM" SG_ 519 RFFuncReq 0;
BA_ "GenSigTimeoutTime_CADM" SG_ 519 RFFuncReq 0;
BA_ "GenSigTimeoutTime_DMSM" SG_ 519 RFFuncReq 0;
BA_ "GenSigTimeoutTime_DTCM" SG_ 519 RFFuncReq 0;
BA_ "GenSigTimeoutTime_ECM" SG_ 519 RFFuncReq 0;
BA_ "GenSigTimeoutTime_EVCU2" SG_ 519 RFFuncReq 0;
BA_ "GenSigTimeoutTime_GNMM" SG_ 519 RFFuncReq 0;
BA_ "GenSigTimeoutTime_HCP" SG_ 519 RFFuncReq 0;
BA_ "GenSigTimeoutTime_RFHM" SG_ 519 RFFuncReq 0;
BA_ "GenSigTimeoutTime_TCM" SG_ 519 RFFuncReq 0;
BA_ "GenSigTimeoutTime_AGSM" SG_ 519 RFReq 0;
BA_ "GenSigTimeoutTime_BSM" SG_ 519 RFReq 0;
BA_ "GenSigTimeoutTime_CADM" SG_ 519 RFReq 0;
BA_ "GenSigTimeoutTime_DMSM" SG_ 519 RFReq 0;
BA_ "GenSigTimeoutTime_DTCM" SG_ 519 RFReq 0;
BA_ "GenSigTimeoutTime_ECM" SG_ 519 RFReq 0;
BA_ "GenSigTimeoutTime_EVCU2" SG_ 519 RFReq 0;
BA_ "GenSigTimeoutTime_GNMM" SG_ 519 RFReq 0;
BA_ "GenSigTimeoutTime_HCP" SG_ 519 RFReq 0;
BA_ "GenSigTimeoutTime_RFHM" SG_ 519 RFReq 0;
BA_ "GenSigTimeoutTime_TCM" SG_ 519 RFReq 0;
BA_ "GenSigTimeoutTime_AGSM" SG_ 519 ValetMode_SPAAK 0;
BA_ "GenSigTimeoutTime_BCM" SG_ 519 ValetMode_SPAAK 0;
BA_ "GenSigTimeoutTime_BSM" SG_ 519 ValetMode_SPAAK 0;
BA_ "GenSigTimeoutTime_CADM" SG_ 519 ValetMode_SPAAK 0;
BA_ "GenSigTimeoutTime_DMSM" SG_ 519 ValetMode_SPAAK 0;
BA_ "GenSigTimeoutTime_DTCM" SG_ 519 ValetMode_SPAAK 0;
BA_ "GenSigTimeoutTime_ECM" SG_ 519 ValetMode_SPAAK 0;
BA_ "GenSigTimeoutTime_EVCU2" SG_ 519 ValetMode_SPAAK 0;
BA_ "GenSigTimeoutTime_GNMM" SG_ 519 ValetMode_SPAAK 0;
BA_ "GenSigTimeoutTime_HCP" SG_ 519 ValetMode_SPAAK 0;
BA_ "GenSigTimeoutTime_IPC" SG_ 519 ValetMode_SPAAK 0;
BA_ "GenSigTimeoutTime_RFHM" SG_ 519 ValetMode_SPAAK 0;
BA_ "GenSigTimeoutTime_TCM" SG_ 519 ValetMode_SPAAK 0;
BA_ "GenSigSendType" SG_ 1449 BatteryLow 3;
BA_ "GenSigTimeoutTime_AGSM" SG_ 1449 BatteryLow 0;
BA_ "GenSigTimeoutTime_BCM" SG_ 1449 BatteryLow 0;
BA_ "GenSigTimeoutTime_BSM" SG_ 1449 BatteryLow 0;
BA_ "GenSigTimeoutTime_CADM" SG_ 1449 BatteryLow 0;
BA_ "GenSigTimeoutTime_DMSM" SG_ 1449 BatteryLow 0;
BA_ "GenSigTimeoutTime_DTCM" SG_ 1449 BatteryLow 0;
BA_ "GenSigTimeoutTime_ECM" SG_ 1449 BatteryLow 0;
BA_ "GenSigTimeoutTime_EVCU2" SG_ 1449 BatteryLow 0;
BA_ "GenSigTimeoutTime_GNMM" SG_ 1449 BatteryLow 0;
BA_ "GenSigTimeoutTime_HCP" SG_ 1449 BatteryLow 0;
BA_ "GenSigTimeoutTime_RFHM" SG_ 1449 BatteryLow 0;
BA_ "GenSigTimeoutTime_SGW" SG_ 1449 BatteryLow 0;
BA_ "GenSigTimeoutTime_TCM" SG_ 1449 BatteryLow 0;
BA_ "GenSigSendType" SG_ 1449 FOBSearchActive 3;
BA_ "GenSigTimeoutTime_AGSM" SG_ 1449 FOBSearchActive 0;
BA_ "GenSigTimeoutTime_BCM" SG_ 1449 FOBSearchActive 0;
BA_ "GenSigTimeoutTime_BSM" SG_ 1449 FOBSearchActive 0;
BA_ "GenSigTimeoutTime_CADM" SG_ 1449 FOBSearchActive 0;
BA_ "GenSigTimeoutTime_DMSM" SG_ 1449 FOBSearchActive 0;
BA_ "GenSigTimeoutTime_DTCM" SG_ 1449 FOBSearchActive 0;
BA_ "GenSigTimeoutTime_ECM" SG_ 1449 FOBSearchActive 0;
BA_ "GenSigTimeoutTime_EVCU2" SG_ 1449 FOBSearchActive 0;
BA_ "GenSigTimeoutTime_GNMM" SG_ 1449 FOBSearchActive 0;
BA_ "GenSigTimeoutTime_HCP" SG_ 1449 FOBSearchActive 0;
BA_ "GenSigTimeoutTime_IPC" SG_ 1449 FOBSearchActive 0;
BA_ "GenSigTimeoutTime_RFHM" SG_ 1449 FOBSearchActive 0;
BA_ "GenSigTimeoutTime_SGW" SG_ 1449 FOBSearchActive 0;
BA_ "GenSigTimeoutTime_TCM" SG_ 1449 FOBSearchActive 0;
BA_ "GenSigSendType" SG_ 1449 FtTrPlacardPress 3;
BA_ "GenSigTimeoutTime_AGSM" SG_ 1449 FtTrPlacardPress 0;
BA_ "GenSigTimeoutTime_BCM" SG_ 1449 FtTrPlacardPress 0;
BA_ "GenSigTimeoutTime_BSM" SG_ 1449 FtTrPlacardPress 0;
BA_ "GenSigTimeoutTime_CADM" SG_ 1449 FtTrPlacardPress 0;
BA_ "GenSigTimeoutTime_DMSM" SG_ 1449 FtTrPlacardPress 0;
BA_ "GenSigTimeoutTime_DTCM" SG_ 1449 FtTrPlacardPress 0;
BA_ "GenSigTimeoutTime_ECM" SG_ 1449 FtTrPlacardPress 0;
BA_ "GenSigTimeoutTime_EVCU2" SG_ 1449 FtTrPlacardPress 0;
BA_ "GenSigTimeoutTime_GNMM" SG_ 1449 FtTrPlacardPress 0;
BA_ "GenSigTimeoutTime_HCP" SG_ 1449 FtTrPlacardPress 0;
BA_ "GenSigTimeoutTime_RFHM" SG_ 1449 FtTrPlacardPress 0;
BA_ "GenSigTimeoutTime_SGW" SG_ 1449 FtTrPlacardPress 0;
BA_ "GenSigTimeoutTime_TCM" SG_ 1449 FtTrPlacardPress 0;
BA_ "GenSigSendType" SG_ 1449 KeyFob_Present 3;
BA_ "GenSigTimeoutTime_AGSM" SG_ 1449 KeyFob_Present 0;
BA_ "GenSigTimeoutTime_BSM" SG_ 1449 KeyFob_Present 0;
BA_ "GenSigTimeoutTime_CADM" SG_ 1449 KeyFob_Present 0;
BA_ "GenSigTimeoutTime_DMSM" SG_ 1449 KeyFob_Present 0;
BA_ "GenSigTimeoutTime_DTCM" SG_ 1449 KeyFob_Present 0;
BA_ "GenSigTimeoutTime_ECM" SG_ 1449 KeyFob_Present 0;
BA_ "GenSigTimeoutTime_EVCU2" SG_ 1449 KeyFob_Present 0;
BA_ "GenSigTimeoutTime_GNMM" SG_ 1449 KeyFob_Present 0;
BA_ "GenSigTimeoutTime_HCP" SG_ 1449 KeyFob_Present 0;
BA_ "GenSigTimeoutTime_IPC" SG_ 1449 KeyFob_Present 0;
BA_ "GenSigTimeoutTime_RFHM" SG_ 1449 KeyFob_Present 0;
BA_ "GenSigTimeoutTime_TCM" SG_ 1449 KeyFob_Present 0;
BA_ "GenSigSendType" SG_ 1449 KeyProgramSts 3;
BA_ "GenSigTimeoutTime_AGSM" SG_ 1449 KeyProgramSts 0;
BA_ "GenSigTimeoutTime_BCM" SG_ 1449 KeyProgramSts 0;
BA_ "GenSigTimeoutTime_BSM" SG_ 1449 KeyProgramSts 0;
BA_ "GenSigTimeoutTime_CADM" SG_ 1449 KeyProgramSts 0;
BA_ "GenSigTimeoutTime_DMSM" SG_ 1449 KeyProgramSts 0;
BA_ "GenSigTimeoutTime_DTCM" SG_ 1449 KeyProgramSts 0;
BA_ "GenSigTimeoutTime_ECM" SG_ 1449 KeyProgramSts 0;
BA_ "GenSigTimeoutTime_EVCU2" SG_ 1449 KeyProgramSts 0;
BA_ "GenSigTimeoutTime_GNMM" SG_ 1449 KeyProgramSts 0;
BA_ "GenSigTimeoutTime_HCP" SG_ 1449 KeyProgramSts 0;
BA_ "GenSigTimeoutTime_RFHM" SG_ 1449 KeyProgramSts 0;
BA_ "GenSigTimeoutTime_SGW" SG_ 1449 KeyProgramSts 0;
BA_ "GenSigTimeoutTime_TCM" SG_ 1449 KeyProgramSts 0;
BA_ "GenSigSendType" SG_ 1449 MemRq_FobNum3 3;
BA_ "GenSigTimeoutTime_AGSM" SG_ 1449 MemRq_FobNum3 0;
BA_ "GenSigTimeoutTime_BSM" SG_ 1449 MemRq_FobNum3 0;
BA_ "GenSigTimeoutTime_CADM" SG_ 1449 MemRq_FobNum3 0;
BA_ "GenSigTimeoutTime_DMSM" SG_ 1449 MemRq_FobNum3 0;
BA_ "GenSigTimeoutTime_DTCM" SG_ 1449 MemRq_FobNum3 0;
BA_ "GenSigTimeoutTime_ECM" SG_ 1449 MemRq_FobNum3 0;
BA_ "GenSigTimeoutTime_EVCU2" SG_ 1449 MemRq_FobNum3 0;
BA_ "GenSigTimeoutTime_GNMM" SG_ 1449 MemRq_FobNum3 0;
BA_ "GenSigTimeoutTime_HCP" SG_ 1449 MemRq_FobNum3 0;
BA_ "GenSigTimeoutTime_IPC" SG_ 1449 MemRq_FobNum3 0;
BA_ "GenSigTimeoutTime_RFHM" SG_ 1449 MemRq_FobNum3 0;
BA_ "GenSigTimeoutTime_SGW" SG_ 1449 MemRq_FobNum3 0;
BA_ "GenSigTimeoutTime_TCM" SG_ 1449 MemRq_FobNum3 0;
BA_ "GenSigSendType" SG_ 1449 MsgFOBLeftVeh 3;
BA_ "GenSigTimeoutTime_AGSM" SG_ 1449 MsgFOBLeftVeh 0;
BA_ "GenSigTimeoutTime_BSM" SG_ 1449 MsgFOBLeftVeh 0;
BA_ "GenSigTimeoutTime_CADM" SG_ 1449 MsgFOBLeftVeh 0;
BA_ "GenSigTimeoutTime_DMSM" SG_ 1449 MsgFOBLeftVeh 0;
BA_ "GenSigTimeoutTime_DTCM" SG_ 1449 MsgFOBLeftVeh 0;
BA_ "GenSigTimeoutTime_ECM" SG_ 1449 MsgFOBLeftVeh 0;
BA_ "GenSigTimeoutTime_GNMM" SG_ 1449 MsgFOBLeftVeh 0;
BA_ "GenSigTimeoutTime_HCP" SG_ 1449 MsgFOBLeftVeh 0;
BA_ "GenSigTimeoutTime_RFHM" SG_ 1449 MsgFOBLeftVeh 0;
BA_ "GenSigTimeoutTime_SGW" SG_ 1449 MsgFOBLeftVeh 0;
BA_ "GenSigSendType" SG_ 1449 MsgFOBNotFnd 3;
BA_ "GenSigTimeoutTime_AGSM" SG_ 1449 MsgFOBNotFnd 0;
BA_ "GenSigTimeoutTime_BCM" SG_ 1449 MsgFOBNotFnd 0;
BA_ "GenSigTimeoutTime_BSM" SG_ 1449 MsgFOBNotFnd 0;
BA_ "GenSigTimeoutTime_CADM" SG_ 1449 MsgFOBNotFnd 0;
BA_ "GenSigTimeoutTime_DMSM" SG_ 1449 MsgFOBNotFnd 0;
BA_ "GenSigTimeoutTime_DTCM" SG_ 1449 MsgFOBNotFnd 0;
BA_ "GenSigTimeoutTime_ECM" SG_ 1449 MsgFOBNotFnd 0;
BA_ "GenSigTimeoutTime_EVCU2" SG_ 1449 MsgFOBNotFnd 0;
BA_ "GenSigTimeoutTime_GNMM" SG_ 1449 MsgFOBNotFnd 0;
BA_ "GenSigTimeoutTime_HCP" SG_ 1449 MsgFOBNotFnd 0;
BA_ "GenSigTimeoutTime_RFHM" SG_ 1449 MsgFOBNotFnd 0;
BA_ "GenSigTimeoutTime_SGW" SG_ 1449 MsgFOBNotFnd 0;
BA_ "GenSigTimeoutTime_TCM" SG_ 1449 MsgFOBNotFnd 0;
BA_ "GenSigSendType" SG_ 1449 MsgKeyNotFnd 3;
BA_ "GenSigTimeoutTime_AGSM" SG_ 1449 MsgKeyNotFnd 0;
BA_ "GenSigTimeoutTime_BCM" SG_ 1449 MsgKeyNotFnd 0;
BA_ "GenSigTimeoutTime_BSM" SG_ 1449 MsgKeyNotFnd 0;
BA_ "GenSigTimeoutTime_CADM" SG_ 1449 MsgKeyNotFnd 0;
BA_ "GenSigTimeoutTime_DMSM" SG_ 1449 MsgKeyNotFnd 0;
BA_ "GenSigTimeoutTime_DTCM" SG_ 1449 MsgKeyNotFnd 0;
BA_ "GenSigTimeoutTime_ECM" SG_ 1449 MsgKeyNotFnd 0;
BA_ "GenSigTimeoutTime_EVCU2" SG_ 1449 MsgKeyNotFnd 0;
BA_ "GenSigTimeoutTime_GNMM" SG_ 1449 MsgKeyNotFnd 0;
BA_ "GenSigTimeoutTime_HCP" SG_ 1449 MsgKeyNotFnd 0;
BA_ "GenSigTimeoutTime_RFHM" SG_ 1449 MsgKeyNotFnd 0;
BA_ "GenSigTimeoutTime_SGW" SG_ 1449 MsgKeyNotFnd 0;
BA_ "GenSigTimeoutTime_TCM" SG_ 1449 MsgKeyNotFnd 0;
BA_ "GenSigSendType" SG_ 1449 MsgNotInPark 3;
BA_ "GenSigTimeoutTime_AGSM" SG_ 1449 MsgNotInPark 0;
BA_ "GenSigTimeoutTime_BCM" SG_ 1449 MsgNotInPark 0;
BA_ "GenSigTimeoutTime_BSM" SG_ 1449 MsgNotInPark 0;
BA_ "GenSigTimeoutTime_CADM" SG_ 1449 MsgNotInPark 0;
BA_ "GenSigTimeoutTime_DMSM" SG_ 1449 MsgNotInPark 0;
BA_ "GenSigTimeoutTime_DTCM" SG_ 1449 MsgNotInPark 0;
BA_ "GenSigTimeoutTime_ECM" SG_ 1449 MsgNotInPark 0;
BA_ "GenSigTimeoutTime_EVCU2" SG_ 1449 MsgNotInPark 0;
BA_ "GenSigTimeoutTime_GNMM" SG_ 1449 MsgNotInPark 0;
BA_ "GenSigTimeoutTime_HCP" SG_ 1449 MsgNotInPark 0;
BA_ "GenSigTimeoutTime_RFHM" SG_ 1449 MsgNotInPark 0;
BA_ "GenSigTimeoutTime_SGW" SG_ 1449 MsgNotInPark 0;
BA_ "GenSigTimeoutTime_TCM" SG_ 1449 MsgNotInPark 0;
BA_ "GenSigSendType" SG_ 1449 MsgPushBtnKey 3;
BA_ "GenSigTimeoutTime_AGSM" SG_ 1449 MsgPushBtnKey 0;
BA_ "GenSigTimeoutTime_BCM" SG_ 1449 MsgPushBtnKey 0;
BA_ "GenSigTimeoutTime_BSM" SG_ 1449 MsgPushBtnKey 0;
BA_ "GenSigTimeoutTime_CADM" SG_ 1449 MsgPushBtnKey 0;
BA_ "GenSigTimeoutTime_DMSM" SG_ 1449 MsgPushBtnKey 0;
BA_ "GenSigTimeoutTime_DTCM" SG_ 1449 MsgPushBtnKey 0;
BA_ "GenSigTimeoutTime_ECM" SG_ 1449 MsgPushBtnKey 0;
BA_ "GenSigTimeoutTime_EVCU2" SG_ 1449 MsgPushBtnKey 0;
BA_ "GenSigTimeoutTime_GNMM" SG_ 1449 MsgPushBtnKey 0;
BA_ "GenSigTimeoutTime_HCP" SG_ 1449 MsgPushBtnKey 0;
BA_ "GenSigTimeoutTime_RFHM" SG_ 1449 MsgPushBtnKey 0;
BA_ "GenSigTimeoutTime_SGW" SG_ 1449 MsgPushBtnKey 0;
BA_ "GenSigTimeoutTime_TCM" SG_ 1449 MsgPushBtnKey 0;
BA_ "GenSigSendType" SG_ 1449 RFMemRq 3;
BA_ "GenSigTimeoutTime_AGSM" SG_ 1449 RFMemRq 0;
BA_ "GenSigTimeoutTime_BSM" SG_ 1449 RFMemRq 0;
BA_ "GenSigTimeoutTime_CADM" SG_ 1449 RFMemRq 0;
BA_ "GenSigTimeoutTime_DMSM" SG_ 1449 RFMemRq 0;
BA_ "GenSigTimeoutTime_DTCM" SG_ 1449 RFMemRq 0;
BA_ "GenSigTimeoutTime_ECM" SG_ 1449 RFMemRq 0;
BA_ "GenSigTimeoutTime_EVCU2" SG_ 1449 RFMemRq 0;
BA_ "GenSigTimeoutTime_GNMM" SG_ 1449 RFMemRq 0;
BA_ "GenSigTimeoutTime_HCP" SG_ 1449 RFMemRq 0;
BA_ "GenSigTimeoutTime_IPC" SG_ 1449 RFMemRq 0;
BA_ "GenSigTimeoutTime_RFHM" SG_ 1449 RFMemRq 0;
BA_ "GenSigTimeoutTime_SGW" SG_ 1449 RFMemRq 0;
BA_ "GenSigTimeoutTime_TCM" SG_ 1449 RFMemRq 0;
BA_ "GenSigSendType" SG_ 1449 RrTrPlacardPress 3;
BA_ "GenSigTimeoutTime_AGSM" SG_ 1449 RrTrPlacardPress 0;
BA_ "GenSigTimeoutTime_BCM" SG_ 1449 RrTrPlacardPress 0;
BA_ "GenSigTimeoutTime_BSM" SG_ 1449 RrTrPlacardPress 0;
BA_ "GenSigTimeoutTime_CADM" SG_ 1449 RrTrPlacardPress 0;
BA_ "GenSigTimeoutTime_DMSM" SG_ 1449 RrTrPlacardPress 0;
BA_ "GenSigTimeoutTime_DTCM" SG_ 1449 RrTrPlacardPress 0;
BA_ "GenSigTimeoutTime_ECM" SG_ 1449 RrTrPlacardPress 0;
BA_ "GenSigTimeoutTime_EVCU2" SG_ 1449 RrTrPlacardPress 0;
BA_ "GenSigTimeoutTime_GNMM" SG_ 1449 RrTrPlacardPress 0;
BA_ "GenSigTimeoutTime_HCP" SG_ 1449 RrTrPlacardPress 0;
BA_ "GenSigTimeoutTime_RFHM" SG_ 1449 RrTrPlacardPress 0;
BA_ "GenSigTimeoutTime_SGW" SG_ 1449 RrTrPlacardPress 0;
BA_ "GenSigTimeoutTime_TCM" SG_ 1449 RrTrPlacardPress 0;
BA_ "GenSigSendType" SG_ 1449 TPMHazardFlash 3;
BA_ "GenSigTimeoutTime_AGSM" SG_ 1449 TPMHazardFlash 0;
BA_ "GenSigTimeoutTime_BSM" SG_ 1449 TPMHazardFlash 0;
BA_ "GenSigTimeoutTime_CADM" SG_ 1449 TPMHazardFlash 0;
BA_ "GenSigTimeoutTime_DMSM" SG_ 1449 TPMHazardFlash 0;
BA_ "GenSigTimeoutTime_DTCM" SG_ 1449 TPMHazardFlash 0;
BA_ "GenSigTimeoutTime_ECM" SG_ 1449 TPMHazardFlash 0;
BA_ "GenSigTimeoutTime_EVCU2" SG_ 1449 TPMHazardFlash 0;
BA_ "GenSigTimeoutTime_GNMM" SG_ 1449 TPMHazardFlash 0;
BA_ "GenSigTimeoutTime_HCP" SG_ 1449 TPMHazardFlash 0;
BA_ "GenSigTimeoutTime_RFHM" SG_ 1449 TPMHazardFlash 0;
BA_ "GenSigTimeoutTime_SGW" SG_ 1449 TPMHazardFlash 0;
BA_ "GenSigTimeoutTime_TCM" SG_ 1449 TPMHazardFlash 0;
BA_ "GenSigSendType" SG_ 1449 TPMHornChirp 3;
BA_ "GenSigTimeoutTime_AGSM" SG_ 1449 TPMHornChirp 0;
BA_ "GenSigTimeoutTime_BSM" SG_ 1449 TPMHornChirp 0;
BA_ "GenSigTimeoutTime_CADM" SG_ 1449 TPMHornChirp 0;
BA_ "GenSigTimeoutTime_DMSM" SG_ 1449 TPMHornChirp 0;
BA_ "GenSigTimeoutTime_DTCM" SG_ 1449 TPMHornChirp 0;
BA_ "GenSigTimeoutTime_ECM" SG_ 1449 TPMHornChirp 0;
BA_ "GenSigTimeoutTime_EVCU2" SG_ 1449 TPMHornChirp 0;
BA_ "GenSigTimeoutTime_GNMM" SG_ 1449 TPMHornChirp 0;
BA_ "GenSigTimeoutTime_HCP" SG_ 1449 TPMHornChirp 0;
BA_ "GenSigTimeoutTime_IPC" SG_ 1449 TPMHornChirp 0;
BA_ "GenSigTimeoutTime_RFHM" SG_ 1449 TPMHornChirp 0;
BA_ "GenSigTimeoutTime_SGW" SG_ 1449 TPMHornChirp 0;
BA_ "GenSigTimeoutTime_TCM" SG_ 1449 TPMHornChirp 0;
BA_ "GenSigTimeoutTime_AGSM" SG_ 1876 CRC_RFHUB3 0;
BA_ "GenSigTimeoutTime_BCM" SG_ 1876 CRC_RFHUB3 0;
BA_ "GenSigTimeoutTime_BSM" SG_ 1876 CRC_RFHUB3 0;
BA_ "GenSigTimeoutTime_CADM" SG_ 1876 CRC_RFHUB3 0;
BA_ "GenSigTimeoutTime_DMSM" SG_ 1876 CRC_RFHUB3 0;
BA_ "GenSigTimeoutTime_DTCM" SG_ 1876 CRC_RFHUB3 0;
BA_ "GenSigTimeoutTime_ECM" SG_ 1876 CRC_RFHUB3 0;
BA_ "GenSigTimeoutTime_GNMM" SG_ 1876 CRC_RFHUB3 0;
BA_ "GenSigTimeoutTime_HCP" SG_ 1876 CRC_RFHUB3 0;
BA_ "GenSigTimeoutTime_RFHM" SG_ 1876 CRC_RFHUB3 0;
BA_ "GenSigTimeoutTime_SGW" SG_ 1876 CRC_RFHUB3 0;
BA_ "GenSigTimeoutTime_TCM" SG_ 1876 CRC_RFHUB3 0;
BA_ "GenSigSendType" SG_ 1876 InflationState_LHF_Tyre 4;
BA_ "GenSigTimeoutTime_AGSM" SG_ 1876 InflationState_LHF_Tyre 0;
BA_ "GenSigTimeoutTime_BSM" SG_ 1876 InflationState_LHF_Tyre 0;
BA_ "GenSigTimeoutTime_CADM" SG_ 1876 InflationState_LHF_Tyre 0;
BA_ "GenSigTimeoutTime_DMSM" SG_ 1876 InflationState_LHF_Tyre 0;
BA_ "GenSigTimeoutTime_DTCM" SG_ 1876 InflationState_LHF_Tyre 0;
BA_ "GenSigTimeoutTime_ECM" SG_ 1876 InflationState_LHF_Tyre 0;
BA_ "GenSigTimeoutTime_EVCU2" SG_ 1876 InflationState_LHF_Tyre 0;
BA_ "GenSigTimeoutTime_GNMM" SG_ 1876 InflationState_LHF_Tyre 0;
BA_ "GenSigTimeoutTime_HCP" SG_ 1876 InflationState_LHF_Tyre 0;
BA_ "GenSigTimeoutTime_RFHM" SG_ 1876 InflationState_LHF_Tyre 0;
BA_ "GenSigTimeoutTime_TCM" SG_ 1876 InflationState_LHF_Tyre 0;
BA_ "GenSigSendType" SG_ 1876 InflationState_LHR_Tyre 4;
BA_ "GenSigTimeoutTime_AGSM" SG_ 1876 InflationState_LHR_Tyre 0;
BA_ "GenSigTimeoutTime_BSM" SG_ 1876 InflationState_LHR_Tyre 0;
BA_ "GenSigTimeoutTime_CADM" SG_ 1876 InflationState_LHR_Tyre 0;
BA_ "GenSigTimeoutTime_DMSM" SG_ 1876 InflationState_LHR_Tyre 0;
BA_ "GenSigTimeoutTime_DTCM" SG_ 1876 InflationState_LHR_Tyre 0;
BA_ "GenSigTimeoutTime_ECM" SG_ 1876 InflationState_LHR_Tyre 0;
BA_ "GenSigTimeoutTime_EVCU2" SG_ 1876 InflationState_LHR_Tyre 0;
BA_ "GenSigTimeoutTime_GNMM" SG_ 1876 InflationState_LHR_Tyre 0;
BA_ "GenSigTimeoutTime_HCP" SG_ 1876 InflationState_LHR_Tyre 0;
BA_ "GenSigTimeoutTime_RFHM" SG_ 1876 InflationState_LHR_Tyre 0;
BA_ "GenSigTimeoutTime_TCM" SG_ 1876 InflationState_LHR_Tyre 0;
BA_ "GenSigSendType" SG_ 1876 InflationState_RHF_Tyre 4;
BA_ "GenSigTimeoutTime_AGSM" SG_ 1876 InflationState_RHF_Tyre 0;
BA_ "GenSigTimeoutTime_BSM" SG_ 1876 InflationState_RHF_Tyre 0;
BA_ "GenSigTimeoutTime_CADM" SG_ 1876 InflationState_RHF_Tyre 0;
BA_ "GenSigTimeoutTime_DMSM" SG_ 1876 InflationState_RHF_Tyre 0;
BA_ "GenSigTimeoutTime_DTCM" SG_ 1876 InflationState_RHF_Tyre 0;
BA_ "GenSigTimeoutTime_ECM" SG_ 1876 InflationState_RHF_Tyre 0;
BA_ "GenSigTimeoutTime_EVCU2" SG_ 1876 InflationState_RHF_Tyre 0;
BA_ "GenSigTimeoutTime_GNMM" SG_ 1876 InflationState_RHF_Tyre 0;
BA_ "GenSigTimeoutTime_HCP" SG_ 1876 InflationState_RHF_Tyre 0;
BA_ "GenSigTimeoutTime_RFHM" SG_ 1876 InflationState_RHF_Tyre 0;
BA_ "GenSigTimeoutTime_TCM" SG_ 1876 InflationState_RHF_Tyre 0;
BA_ "GenSigSendType" SG_ 1876 InflationState_RHR_Tyre 4;
BA_ "GenSigTimeoutTime_AGSM" SG_ 1876 InflationState_RHR_Tyre 0;
BA_ "GenSigTimeoutTime_BSM" SG_ 1876 InflationState_RHR_Tyre 0;
BA_ "GenSigTimeoutTime_CADM" SG_ 1876 InflationState_RHR_Tyre 0;
BA_ "GenSigTimeoutTime_DMSM" SG_ 1876 InflationState_RHR_Tyre 0;
BA_ "GenSigTimeoutTime_DTCM" SG_ 1876 InflationState_RHR_Tyre 0;
BA_ "GenSigTimeoutTime_ECM" SG_ 1876 InflationState_RHR_Tyre 0;
BA_ "GenSigTimeoutTime_EVCU2" SG_ 1876 InflationState_RHR_Tyre 0;
BA_ "GenSigTimeoutTime_GNMM" SG_ 1876 InflationState_RHR_Tyre 0;
BA_ "GenSigTimeoutTime_HCP" SG_ 1876 InflationState_RHR_Tyre 0;
BA_ "GenSigTimeoutTime_RFHM" SG_ 1876 InflationState_RHR_Tyre 0;
BA_ "GenSigTimeoutTime_TCM" SG_ 1876 InflationState_RHR_Tyre 0;
BA_ "GenSigTimeoutTime_AGSM" SG_ 1876 MessageCounter_RFHUB3 0;
BA_ "GenSigTimeoutTime_BCM" SG_ 1876 MessageCounter_RFHUB3 0;
BA_ "GenSigTimeoutTime_BSM" SG_ 1876 MessageCounter_RFHUB3 0;
BA_ "GenSigTimeoutTime_CADM" SG_ 1876 MessageCounter_RFHUB3 0;
BA_ "GenSigTimeoutTime_DMSM" SG_ 1876 MessageCounter_RFHUB3 0;
BA_ "GenSigTimeoutTime_DTCM" SG_ 1876 MessageCounter_RFHUB3 0;
BA_ "GenSigTimeoutTime_ECM" SG_ 1876 MessageCounter_RFHUB3 0;
BA_ "GenSigTimeoutTime_GNMM" SG_ 1876 MessageCounter_RFHUB3 0;
BA_ "GenSigTimeoutTime_HCP" SG_ 1876 MessageCounter_RFHUB3 0;
BA_ "GenSigTimeoutTime_RFHM" SG_ 1876 MessageCounter_RFHUB3 0;
BA_ "GenSigTimeoutTime_SGW" SG_ 1876 MessageCounter_RFHUB3 0;
BA_ "GenSigTimeoutTime_TCM" SG_ 1876 MessageCounter_RFHUB3 0;
BA_ "GenSigTimeoutTime_AGSM" SG_ 1876 PressureValue_LHF_Tyre 0;
BA_ "GenSigTimeoutTime_BSM" SG_ 1876 PressureValue_LHF_Tyre 0;
BA_ "GenSigTimeoutTime_DMSM" SG_ 1876 PressureValue_LHF_Tyre 0;
BA_ "GenSigTimeoutTime_DTCM" SG_ 1876 PressureValue_LHF_Tyre 0;
BA_ "GenSigTimeoutTime_ECM" SG_ 1876 PressureValue_LHF_Tyre 0;
BA_ "GenSigTimeoutTime_EVCU2" SG_ 1876 PressureValue_LHF_Tyre 0;
BA_ "GenSigTimeoutTime_GNMM" SG_ 1876 PressureValue_LHF_Tyre 0;
BA_ "GenSigTimeoutTime_HCP" SG_ 1876 PressureValue_LHF_Tyre 0;
BA_ "GenSigTimeoutTime_RFHM" SG_ 1876 PressureValue_LHF_Tyre 0;
BA_ "GenSigTimeoutTime_TCM" SG_ 1876 PressureValue_LHF_Tyre 0;
BA_ "GenSigTimeoutTime_AGSM" SG_ 1876 PressureValue_LHR_Tyre 0;
BA_ "GenSigTimeoutTime_BSM" SG_ 1876 PressureValue_LHR_Tyre 0;
BA_ "GenSigTimeoutTime_DMSM" SG_ 1876 PressureValue_LHR_Tyre 0;
BA_ "GenSigTimeoutTime_DTCM" SG_ 1876 PressureValue_LHR_Tyre 0;
BA_ "GenSigTimeoutTime_ECM" SG_ 1876 PressureValue_LHR_Tyre 0;
BA_ "GenSigTimeoutTime_EVCU2" SG_ 1876 PressureValue_LHR_Tyre 0;
BA_ "GenSigTimeoutTime_GNMM" SG_ 1876 PressureValue_LHR_Tyre 0;
BA_ "GenSigTimeoutTime_HCP" SG_ 1876 PressureValue_LHR_Tyre 0;
BA_ "GenSigTimeoutTime_RFHM" SG_ 1876 PressureValue_LHR_Tyre 0;
BA_ "GenSigTimeoutTime_TCM" SG_ 1876 PressureValue_LHR_Tyre 0;
BA_ "GenSigTimeoutTime_AGSM" SG_ 1876 PressureValue_RHF_Tyre 0;
BA_ "GenSigTimeoutTime_BSM" SG_ 1876 PressureValue_RHF_Tyre 0;
BA_ "GenSigTimeoutTime_DMSM" SG_ 1876 PressureValue_RHF_Tyre 0;
BA_ "GenSigTimeoutTime_DTCM" SG_ 1876 PressureValue_RHF_Tyre 0;
BA_ "GenSigTimeoutTime_ECM" SG_ 1876 PressureValue_RHF_Tyre 0;
BA_ "GenSigTimeoutTime_EVCU2" SG_ 1876 PressureValue_RHF_Tyre 0;
BA_ "GenSigTimeoutTime_GNMM" SG_ 1876 PressureValue_RHF_Tyre 0;
BA_ "GenSigTimeoutTime_HCP" SG_ 1876 PressureValue_RHF_Tyre 0;
BA_ "GenSigTimeoutTime_RFHM" SG_ 1876 PressureValue_RHF_Tyre 0;
BA_ "GenSigTimeoutTime_TCM" SG_ 1876 PressureValue_RHF_Tyre 0;
BA_ "GenSigTimeoutTime_AGSM" SG_ 1876 PressureValue_RHR_Tyre 0;
BA_ "GenSigTimeoutTime_BSM" SG_ 1876 PressureValue_RHR_Tyre 0;
BA_ "GenSigTimeoutTime_DMSM" SG_ 1876 PressureValue_RHR_Tyre 0;
BA_ "GenSigTimeoutTime_DTCM" SG_ 1876 PressureValue_RHR_Tyre 0;
BA_ "GenSigTimeoutTime_ECM" SG_ 1876 PressureValue_RHR_Tyre 0;
BA_ "GenSigTimeoutTime_EVCU2" SG_ 1876 PressureValue_RHR_Tyre 0;
BA_ "GenSigTimeoutTime_GNMM" SG_ 1876 PressureValue_RHR_Tyre 0;
BA_ "GenSigTimeoutTime_HCP" SG_ 1876 PressureValue_RHR_Tyre 0;
BA_ "GenSigTimeoutTime_RFHM" SG_ 1876 PressureValue_RHR_Tyre 0;
BA_ "GenSigTimeoutTime_TCM" SG_ 1876 PressureValue_RHR_Tyre 0;
BA_ "GenSigTimeoutTime_AGSM" SG_ 1876 TPMActivitySts 0;
BA_ "GenSigTimeoutTime_BCM" SG_ 1876 TPMActivitySts 0;
BA_ "GenSigTimeoutTime_BSM" SG_ 1876 TPMActivitySts 0;
BA_ "GenSigTimeoutTime_CADM" SG_ 1876 TPMActivitySts 0;
BA_ "GenSigTimeoutTime_DMSM" SG_ 1876 TPMActivitySts 0;
BA_ "GenSigTimeoutTime_DTCM" SG_ 1876 TPMActivitySts 0;
BA_ "GenSigTimeoutTime_ECM" SG_ 1876 TPMActivitySts 0;
BA_ "GenSigTimeoutTime_EVCU2" SG_ 1876 TPMActivitySts 0;
BA_ "GenSigTimeoutTime_GNMM" SG_ 1876 TPMActivitySts 0;
BA_ "GenSigTimeoutTime_HCP" SG_ 1876 TPMActivitySts 0;
BA_ "GenSigTimeoutTime_RFHM" SG_ 1876 TPMActivitySts 0;
BA_ "GenSigTimeoutTime_SGW" SG_ 1876 TPMActivitySts 0;
BA_ "GenSigTimeoutTime_TCM" SG_ 1876 TPMActivitySts 0;
BA_ "GenSigSendType" SG_ 1876 TyrePressureSysProgrammedSts 4;
BA_ "GenSigTimeoutTime_AGSM" SG_ 1876 TyrePressureSysProgrammedSts 0;
BA_ "GenSigTimeoutTime_BCM" SG_ 1876 TyrePressureSysProgrammedSts 0;
BA_ "GenSigTimeoutTime_BSM" SG_ 1876 TyrePressureSysProgrammedSts 0;
BA_ "GenSigTimeoutTime_CADM" SG_ 1876 TyrePressureSysProgrammedSts 0;
BA_ "GenSigTimeoutTime_DMSM" SG_ 1876 TyrePressureSysProgrammedSts 0;
BA_ "GenSigTimeoutTime_DTCM" SG_ 1876 TyrePressureSysProgrammedSts 0;
BA_ "GenSigTimeoutTime_ECM" SG_ 1876 TyrePressureSysProgrammedSts 0;
BA_ "GenSigTimeoutTime_EVCU2" SG_ 1876 TyrePressureSysProgrammedSts 0;
BA_ "GenSigTimeoutTime_GNMM" SG_ 1876 TyrePressureSysProgrammedSts 0;
BA_ "GenSigTimeoutTime_HCP" SG_ 1876 TyrePressureSysProgrammedSts 0;
BA_ "GenSigTimeoutTime_RFHM" SG_ 1876 TyrePressureSysProgrammedSts 0;
BA_ "GenSigTimeoutTime_SGW" SG_ 1876 TyrePressureSysProgrammedSts 0;
BA_ "GenSigTimeoutTime_TCM" SG_ 1876 TyrePressureSysProgrammedSts 0;
BA_ "GenSigSendType" SG_ 1876 TyrePressureSystemFailSts 4;
BA_ "GenSigTimeoutTime_AGSM" SG_ 1876 TyrePressureSystemFailSts 0;
BA_ "GenSigTimeoutTime_BSM" SG_ 1876 TyrePressureSystemFailSts 0;
BA_ "GenSigTimeoutTime_CADM" SG_ 1876 TyrePressureSystemFailSts 0;
BA_ "GenSigTimeoutTime_DMSM" SG_ 1876 TyrePressureSystemFailSts 0;
BA_ "GenSigTimeoutTime_DTCM" SG_ 1876 TyrePressureSystemFailSts 0;
BA_ "GenSigTimeoutTime_ECM" SG_ 1876 TyrePressureSystemFailSts 0;
BA_ "GenSigTimeoutTime_EVCU2" SG_ 1876 TyrePressureSystemFailSts 0;
BA_ "GenSigTimeoutTime_GNMM" SG_ 1876 TyrePressureSystemFailSts 0;
BA_ "GenSigTimeoutTime_HCP" SG_ 1876 TyrePressureSystemFailSts 0;
BA_ "GenSigTimeoutTime_RFHM" SG_ 1876 TyrePressureSystemFailSts 0;
BA_ "GenSigTimeoutTime_TCM" SG_ 1876 TyrePressureSystemFailSts 0;
BA_ "GenSigSendType" SG_ 160 UConnSeed1 1;
BA_ "GenSigTimeoutTime_AGSM" SG_ 160 UConnSeed1 0;
BA_ "GenSigTimeoutTime_BCM" SG_ 160 UConnSeed1 0;
BA_ "GenSigTimeoutTime_BSM" SG_ 160 UConnSeed1 0;
BA_ "GenSigTimeoutTime_CADM" SG_ 160 UConnSeed1 0;
BA_ "GenSigTimeoutTime_DMSM" SG_ 160 UConnSeed1 0;
BA_ "GenSigTimeoutTime_DTCM" SG_ 160 UConnSeed1 0;
BA_ "GenSigTimeoutTime_ECM" SG_ 160 UConnSeed1 0;
BA_ "GenSigTimeoutTime_EVCU2" SG_ 160 UConnSeed1 0;
BA_ "GenSigTimeoutTime_GNMM" SG_ 160 UConnSeed1 0;
BA_ "GenSigTimeoutTime_HCP" SG_ 160 UConnSeed1 0;
BA_ "GenSigTimeoutTime_IPC" SG_ 160 UConnSeed1 0;
BA_ "GenSigTimeoutTime_RFHM" SG_ 160 UConnSeed1 0;
BA_ "GenSigTimeoutTime_TCM" SG_ 160 UConnSeed1 0;
BA_ "GenSigSendType" SG_ 160 UConnSeed2 1;
BA_ "GenSigTimeoutTime_AGSM" SG_ 160 UConnSeed2 0;
BA_ "GenSigTimeoutTime_BCM" SG_ 160 UConnSeed2 0;
BA_ "GenSigTimeoutTime_BSM" SG_ 160 UConnSeed2 0;
BA_ "GenSigTimeoutTime_CADM" SG_ 160 UConnSeed2 0;
BA_ "GenSigTimeoutTime_DMSM" SG_ 160 UConnSeed2 0;
BA_ "GenSigTimeoutTime_DTCM" SG_ 160 UConnSeed2 0;
BA_ "GenSigTimeoutTime_ECM" SG_ 160 UConnSeed2 0;
BA_ "GenSigTimeoutTime_EVCU2" SG_ 160 UConnSeed2 0;
BA_ "GenSigTimeoutTime_GNMM" SG_ 160 UConnSeed2 0;
BA_ "GenSigTimeoutTime_HCP" SG_ 160 UConnSeed2 0;
BA_ "GenSigTimeoutTime_IPC" SG_ 160 UConnSeed2 0;
BA_ "GenSigTimeoutTime_RFHM" SG_ 160 UConnSeed2 0;
BA_ "GenSigTimeoutTime_TCM" SG_ 160 UConnSeed2 0;
BA_ "GenSigSendType" SG_ 160 UConnSeed3 1;
BA_ "GenSigTimeoutTime_AGSM" SG_ 160 UConnSeed3 0;
BA_ "GenSigTimeoutTime_BCM" SG_ 160 UConnSeed3 0;
BA_ "GenSigTimeoutTime_BSM" SG_ 160 UConnSeed3 0;
BA_ "GenSigTimeoutTime_CADM" SG_ 160 UConnSeed3 0;
BA_ "GenSigTimeoutTime_DMSM" SG_ 160 UConnSeed3 0;
BA_ "GenSigTimeoutTime_DTCM" SG_ 160 UConnSeed3 0;
BA_ "GenSigTimeoutTime_ECM" SG_ 160 UConnSeed3 0;
BA_ "GenSigTimeoutTime_EVCU2" SG_ 160 UConnSeed3 0;
BA_ "GenSigTimeoutTime_GNMM" SG_ 160 UConnSeed3 0;
BA_ "GenSigTimeoutTime_HCP" SG_ 160 UConnSeed3 0;
BA_ "GenSigTimeoutTime_IPC" SG_ 160 UConnSeed3 0;
BA_ "GenSigTimeoutTime_RFHM" SG_ 160 UConnSeed3 0;
BA_ "GenSigTimeoutTime_TCM" SG_ 160 UConnSeed3 0;
BA_ "GenSigSendType" SG_ 160 UConnSeed4 1;
BA_ "GenSigTimeoutTime_AGSM" SG_ 160 UConnSeed4 0;
BA_ "GenSigTimeoutTime_BCM" SG_ 160 UConnSeed4 0;
BA_ "GenSigTimeoutTime_BSM" SG_ 160 UConnSeed4 0;
BA_ "GenSigTimeoutTime_CADM" SG_ 160 UConnSeed4 0;
BA_ "GenSigTimeoutTime_DMSM" SG_ 160 UConnSeed4 0;
BA_ "GenSigTimeoutTime_DTCM" SG_ 160 UConnSeed4 0;
BA_ "GenSigTimeoutTime_ECM" SG_ 160 UConnSeed4 0;
BA_ "GenSigTimeoutTime_EVCU2" SG_ 160 UConnSeed4 0;
BA_ "GenSigTimeoutTime_GNMM" SG_ 160 UConnSeed4 0;
BA_ "GenSigTimeoutTime_HCP" SG_ 160 UConnSeed4 0;
BA_ "GenSigTimeoutTime_IPC" SG_ 160 UConnSeed4 0;
BA_ "GenSigTimeoutTime_RFHM" SG_ 160 UConnSeed4 0;
BA_ "GenSigTimeoutTime_TCM" SG_ 160 UConnSeed4 0;
BA_ "GenSigSendType" SG_ 612 WprWashSw_Psd 3;
BA_ "GenSigTimeoutTime_AGSM" SG_ 612 WprWashSw_Psd 0;
BA_ "GenSigTimeoutTime_BCM" SG_ 612 WprWashSw_Psd 0;
BA_ "GenSigTimeoutTime_BSM" SG_ 612 WprWashSw_Psd 0;
BA_ "GenSigTimeoutTime_DMSM" SG_ 612 WprWashSw_Psd 0;
BA_ "GenSigTimeoutTime_DTCM" SG_ 612 WprWashSw_Psd 0;
BA_ "GenSigTimeoutTime_ECM" SG_ 612 WprWashSw_Psd 0;
BA_ "GenSigTimeoutTime_EVCU2" SG_ 612 WprWashSw_Psd 0;
BA_ "GenSigTimeoutTime_GNMM" SG_ 612 WprWashSw_Psd 0;
BA_ "GenSigTimeoutTime_HCP" SG_ 612 WprWashSw_Psd 0;
BA_ "GenSigTimeoutTime_IPC" SG_ 612 WprWashSw_Psd 0;
BA_ "GenSigTimeoutTime_RFHM" SG_ 612 WprWashSw_Psd 0;
BA_ "GenSigTimeoutTime_SGW" SG_ 612 WprWashSw_Psd 0;
BA_ "GenSigTimeoutTime_TCM" SG_ 612 WprWashSw_Psd 0;
BA_ "GenSigTimeoutTime_AGSM" SG_ 1026 CRC_SLML_STATUS_FD 0;
BA_ "GenSigTimeoutTime_BCM" SG_ 1026 CRC_SLML_STATUS_FD 0;
BA_ "GenSigTimeoutTime_BSM" SG_ 1026 CRC_SLML_STATUS_FD 0;
BA_ "GenSigTimeoutTime_DMSM" SG_ 1026 CRC_SLML_STATUS_FD 0;
BA_ "GenSigTimeoutTime_DTCM" SG_ 1026 CRC_SLML_STATUS_FD 0;
BA_ "GenSigTimeoutTime_ECM" SG_ 1026 CRC_SLML_STATUS_FD 0;
BA_ "GenSigTimeoutTime_EVCU2" SG_ 1026 CRC_SLML_STATUS_FD 0;
BA_ "GenSigTimeoutTime_GNMM" SG_ 1026 CRC_SLML_STATUS_FD 0;
BA_ "GenSigTimeoutTime_HCP" SG_ 1026 CRC_SLML_STATUS_FD 0;
BA_ "GenSigTimeoutTime_IPC" SG_ 1026 CRC_SLML_STATUS_FD 0;
BA_ "GenSigTimeoutTime_RFHM" SG_ 1026 CRC_SLML_STATUS_FD 0;
BA_ "GenSigTimeoutTime_SGW" SG_ 1026 CRC_SLML_STATUS_FD 0;
BA_ "GenSigTimeoutTime_TCM" SG_ 1026 CRC_SLML_STATUS_FD 0;
BA_ "GenSigTimeoutTime_AGSM" SG_ 1026 DRLPositionSts_L 0;
BA_ "GenSigTimeoutTime_BCM" SG_ 1026 DRLPositionSts_L 0;
BA_ "GenSigTimeoutTime_BSM" SG_ 1026 DRLPositionSts_L 0;
BA_ "GenSigTimeoutTime_CADM" SG_ 1026 DRLPositionSts_L 0;
BA_ "GenSigTimeoutTime_DMSM" SG_ 1026 DRLPositionSts_L 0;
BA_ "GenSigTimeoutTime_DTCM" SG_ 1026 DRLPositionSts_L 0;
BA_ "GenSigTimeoutTime_ECM" SG_ 1026 DRLPositionSts_L 0;
BA_ "GenSigTimeoutTime_EVCU2" SG_ 1026 DRLPositionSts_L 0;
BA_ "GenSigTimeoutTime_GNMM" SG_ 1026 DRLPositionSts_L 0;
BA_ "GenSigTimeoutTime_HCP" SG_ 1026 DRLPositionSts_L 0;
BA_ "GenSigTimeoutTime_RFHM" SG_ 1026 DRLPositionSts_L 0;
BA_ "GenSigTimeoutTime_SGW" SG_ 1026 DRLPositionSts_L 0;
BA_ "GenSigTimeoutTime_TCM" SG_ 1026 DRLPositionSts_L 0;
BA_ "GenSigTimeoutTime_AGSM" SG_ 1026 HighBeamSts_L 0;
BA_ "GenSigTimeoutTime_BCM" SG_ 1026 HighBeamSts_L 0;
BA_ "GenSigTimeoutTime_BSM" SG_ 1026 HighBeamSts_L 0;
BA_ "GenSigTimeoutTime_CADM" SG_ 1026 HighBeamSts_L 0;
BA_ "GenSigTimeoutTime_DMSM" SG_ 1026 HighBeamSts_L 0;
BA_ "GenSigTimeoutTime_DTCM" SG_ 1026 HighBeamSts_L 0;
BA_ "GenSigTimeoutTime_ECM" SG_ 1026 HighBeamSts_L 0;
BA_ "GenSigTimeoutTime_EVCU2" SG_ 1026 HighBeamSts_L 0;
BA_ "GenSigTimeoutTime_GNMM" SG_ 1026 HighBeamSts_L 0;
BA_ "GenSigTimeoutTime_HCP" SG_ 1026 HighBeamSts_L 0;
BA_ "GenSigTimeoutTime_RFHM" SG_ 1026 HighBeamSts_L 0;
BA_ "GenSigTimeoutTime_SGW" SG_ 1026 HighBeamSts_L 0;
BA_ "GenSigTimeoutTime_TCM" SG_ 1026 HighBeamSts_L 0;
BA_ "GenSigTimeoutTime_AGSM" SG_ 1026 LowBeamSts_L 0;
BA_ "GenSigTimeoutTime_BCM" SG_ 1026 LowBeamSts_L 0;
BA_ "GenSigTimeoutTime_BSM" SG_ 1026 LowBeamSts_L 0;
BA_ "GenSigTimeoutTime_DMSM" SG_ 1026 LowBeamSts_L 0;
BA_ "GenSigTimeoutTime_DTCM" SG_ 1026 LowBeamSts_L 0;
BA_ "GenSigTimeoutTime_ECM" SG_ 1026 LowBeamSts_L 0;
BA_ "GenSigTimeoutTime_EVCU2" SG_ 1026 LowBeamSts_L 0;
BA_ "GenSigTimeoutTime_GNMM" SG_ 1026 LowBeamSts_L 0;
BA_ "GenSigTimeoutTime_HCP" SG_ 1026 LowBeamSts_L 0;
BA_ "GenSigTimeoutTime_RFHM" SG_ 1026 LowBeamSts_L 0;
BA_ "GenSigTimeoutTime_TCM" SG_ 1026 LowBeamSts_L 0;
BA_ "GenSigTimeoutTime_AGSM" SG_ 1026 MessageCounter_SLML_STATUS_FD 0;
BA_ "GenSigTimeoutTime_BCM" SG_ 1026 MessageCounter_SLML_STATUS_FD 0;
BA_ "GenSigTimeoutTime_BSM" SG_ 1026 MessageCounter_SLML_STATUS_FD 0;
BA_ "GenSigTimeoutTime_DMSM" SG_ 1026 MessageCounter_SLML_STATUS_FD 0;
BA_ "GenSigTimeoutTime_DTCM" SG_ 1026 MessageCounter_SLML_STATUS_FD 0;
BA_ "GenSigTimeoutTime_ECM" SG_ 1026 MessageCounter_SLML_STATUS_FD 0;
BA_ "GenSigTimeoutTime_EVCU2" SG_ 1026 MessageCounter_SLML_STATUS_FD 0;
BA_ "GenSigTimeoutTime_GNMM" SG_ 1026 MessageCounter_SLML_STATUS_FD 0;
BA_ "GenSigTimeoutTime_HCP" SG_ 1026 MessageCounter_SLML_STATUS_FD 0;
BA_ "GenSigTimeoutTime_IPC" SG_ 1026 MessageCounter_SLML_STATUS_FD 0;
BA_ "GenSigTimeoutTime_RFHM" SG_ 1026 MessageCounter_SLML_STATUS_FD 0;
BA_ "GenSigTimeoutTime_SGW" SG_ 1026 MessageCounter_SLML_STATUS_FD 0;
BA_ "GenSigTimeoutTime_TCM" SG_ 1026 MessageCounter_SLML_STATUS_FD 0;
BA_ "GenSigTimeoutTime_AGSM" SG_ 1026 PositionLampSts_L 0;
BA_ "GenSigTimeoutTime_BCM" SG_ 1026 PositionLampSts_L 0;
BA_ "GenSigTimeoutTime_BSM" SG_ 1026 PositionLampSts_L 0;
BA_ "GenSigTimeoutTime_CADM" SG_ 1026 PositionLampSts_L 0;
BA_ "GenSigTimeoutTime_DMSM" SG_ 1026 PositionLampSts_L 0;
BA_ "GenSigTimeoutTime_DTCM" SG_ 1026 PositionLampSts_L 0;
BA_ "GenSigTimeoutTime_ECM" SG_ 1026 PositionLampSts_L 0;
BA_ "GenSigTimeoutTime_EVCU2" SG_ 1026 PositionLampSts_L 0;
BA_ "GenSigTimeoutTime_GNMM" SG_ 1026 PositionLampSts_L 0;
BA_ "GenSigTimeoutTime_HCP" SG_ 1026 PositionLampSts_L 0;
BA_ "GenSigTimeoutTime_RFHM" SG_ 1026 PositionLampSts_L 0;
BA_ "GenSigTimeoutTime_TCM" SG_ 1026 PositionLampSts_L 0;
BA_ "GenSigTimeoutTime_AGSM" SG_ 1026 SideMarkerLampSts_L 0;
BA_ "GenSigTimeoutTime_BCM" SG_ 1026 SideMarkerLampSts_L 0;
BA_ "GenSigTimeoutTime_BSM" SG_ 1026 SideMarkerLampSts_L 0;
BA_ "GenSigTimeoutTime_CADM" SG_ 1026 SideMarkerLampSts_L 0;
BA_ "GenSigTimeoutTime_DMSM" SG_ 1026 SideMarkerLampSts_L 0;
BA_ "GenSigTimeoutTime_DTCM" SG_ 1026 SideMarkerLampSts_L 0;
BA_ "GenSigTimeoutTime_ECM" SG_ 1026 SideMarkerLampSts_L 0;
BA_ "GenSigTimeoutTime_EVCU2" SG_ 1026 SideMarkerLampSts_L 0;
BA_ "GenSigTimeoutTime_GNMM" SG_ 1026 SideMarkerLampSts_L 0;
BA_ "GenSigTimeoutTime_HCP" SG_ 1026 SideMarkerLampSts_L 0;
BA_ "GenSigTimeoutTime_RFHM" SG_ 1026 SideMarkerLampSts_L 0;
BA_ "GenSigTimeoutTime_SGW" SG_ 1026 SideMarkerLampSts_L 0;
BA_ "GenSigTimeoutTime_TCM" SG_ 1026 SideMarkerLampSts_L 0;
BA_ "GenSigTimeoutTime_AGSM" SG_ 1026 SLMLSts 0;
BA_ "GenSigTimeoutTime_BCM" SG_ 1026 SLMLSts 0;
BA_ "GenSigTimeoutTime_BSM" SG_ 1026 SLMLSts 0;
BA_ "GenSigTimeoutTime_CADM" SG_ 1026 SLMLSts 0;
BA_ "GenSigTimeoutTime_DMSM" SG_ 1026 SLMLSts 0;
BA_ "GenSigTimeoutTime_DTCM" SG_ 1026 SLMLSts 0;
BA_ "GenSigTimeoutTime_ECM" SG_ 1026 SLMLSts 0;
BA_ "GenSigTimeoutTime_EVCU2" SG_ 1026 SLMLSts 0;
BA_ "GenSigTimeoutTime_GNMM" SG_ 1026 SLMLSts 0;
BA_ "GenSigTimeoutTime_HCP" SG_ 1026 SLMLSts 0;
BA_ "GenSigTimeoutTime_RFHM" SG_ 1026 SLMLSts 0;
BA_ "GenSigTimeoutTime_SGW" SG_ 1026 SLMLSts 0;
BA_ "GenSigTimeoutTime_TCM" SG_ 1026 SLMLSts 0;
BA_ "GenSigTimeoutTime_AGSM" SG_ 1026 TurnSignalSts_L 0;
BA_ "GenSigTimeoutTime_BCM" SG_ 1026 TurnSignalSts_L 0;
BA_ "GenSigTimeoutTime_BSM" SG_ 1026 TurnSignalSts_L 0;
BA_ "GenSigTimeoutTime_CADM" SG_ 1026 TurnSignalSts_L 0;
BA_ "GenSigTimeoutTime_DMSM" SG_ 1026 TurnSignalSts_L 0;
BA_ "GenSigTimeoutTime_DTCM" SG_ 1026 TurnSignalSts_L 0;
BA_ "GenSigTimeoutTime_ECM" SG_ 1026 TurnSignalSts_L 0;
BA_ "GenSigTimeoutTime_EVCU2" SG_ 1026 TurnSignalSts_L 0;
BA_ "GenSigTimeoutTime_GNMM" SG_ 1026 TurnSignalSts_L 0;
BA_ "GenSigTimeoutTime_HCP" SG_ 1026 TurnSignalSts_L 0;
BA_ "GenSigTimeoutTime_IPC" SG_ 1026 TurnSignalSts_L 0;
BA_ "GenSigTimeoutTime_RFHM" SG_ 1026 TurnSignalSts_L 0;
BA_ "GenSigTimeoutTime_SGW" SG_ 1026 TurnSignalSts_L 0;
BA_ "GenSigTimeoutTime_TCM" SG_ 1026 TurnSignalSts_L 0;
BA_ "GenSigTimeoutTime_AGSM" SG_ 1028 CRC_SLMR_STATUS_FD 0;
BA_ "GenSigTimeoutTime_BCM" SG_ 1028 CRC_SLMR_STATUS_FD 0;
BA_ "GenSigTimeoutTime_BSM" SG_ 1028 CRC_SLMR_STATUS_FD 0;
BA_ "GenSigTimeoutTime_DMSM" SG_ 1028 CRC_SLMR_STATUS_FD 0;
BA_ "GenSigTimeoutTime_DTCM" SG_ 1028 CRC_SLMR_STATUS_FD 0;
BA_ "GenSigTimeoutTime_ECM" SG_ 1028 CRC_SLMR_STATUS_FD 0;
BA_ "GenSigTimeoutTime_EVCU2" SG_ 1028 CRC_SLMR_STATUS_FD 0;
BA_ "GenSigTimeoutTime_GNMM" SG_ 1028 CRC_SLMR_STATUS_FD 0;
BA_ "GenSigTimeoutTime_HCP" SG_ 1028 CRC_SLMR_STATUS_FD 0;
BA_ "GenSigTimeoutTime_IPC" SG_ 1028 CRC_SLMR_STATUS_FD 0;
BA_ "GenSigTimeoutTime_RFHM" SG_ 1028 CRC_SLMR_STATUS_FD 0;
BA_ "GenSigTimeoutTime_SGW" SG_ 1028 CRC_SLMR_STATUS_FD 0;
BA_ "GenSigTimeoutTime_TCM" SG_ 1028 CRC_SLMR_STATUS_FD 0;
BA_ "GenSigTimeoutTime_AGSM" SG_ 1028 DRLPositionSts_R 0;
BA_ "GenSigTimeoutTime_BCM" SG_ 1028 DRLPositionSts_R 0;
BA_ "GenSigTimeoutTime_BSM" SG_ 1028 DRLPositionSts_R 0;
BA_ "GenSigTimeoutTime_CADM" SG_ 1028 DRLPositionSts_R 0;
BA_ "GenSigTimeoutTime_DMSM" SG_ 1028 DRLPositionSts_R 0;
BA_ "GenSigTimeoutTime_DTCM" SG_ 1028 DRLPositionSts_R 0;
BA_ "GenSigTimeoutTime_ECM" SG_ 1028 DRLPositionSts_R 0;
BA_ "GenSigTimeoutTime_EVCU2" SG_ 1028 DRLPositionSts_R 0;
BA_ "GenSigTimeoutTime_GNMM" SG_ 1028 DRLPositionSts_R 0;
BA_ "GenSigTimeoutTime_HCP" SG_ 1028 DRLPositionSts_R 0;
BA_ "GenSigTimeoutTime_RFHM" SG_ 1028 DRLPositionSts_R 0;
BA_ "GenSigTimeoutTime_SGW" SG_ 1028 DRLPositionSts_R 0;
BA_ "GenSigTimeoutTime_TCM" SG_ 1028 DRLPositionSts_R 0;
BA_ "GenSigTimeoutTime_AGSM" SG_ 1028 HighBeamSts_R 0;
BA_ "GenSigTimeoutTime_BCM" SG_ 1028 HighBeamSts_R 0;
BA_ "GenSigTimeoutTime_BSM" SG_ 1028 HighBeamSts_R 0;
BA_ "GenSigTimeoutTime_CADM" SG_ 1028 HighBeamSts_R 0;
BA_ "GenSigTimeoutTime_DMSM" SG_ 1028 HighBeamSts_R 0;
BA_ "GenSigTimeoutTime_DTCM" SG_ 1028 HighBeamSts_R 0;
BA_ "GenSigTimeoutTime_ECM" SG_ 1028 HighBeamSts_R 0;
BA_ "GenSigTimeoutTime_EVCU2" SG_ 1028 HighBeamSts_R 0;
BA_ "GenSigTimeoutTime_GNMM" SG_ 1028 HighBeamSts_R 0;
BA_ "GenSigTimeoutTime_HCP" SG_ 1028 HighBeamSts_R 0;
BA_ "GenSigTimeoutTime_RFHM" SG_ 1028 HighBeamSts_R 0;
BA_ "GenSigTimeoutTime_SGW" SG_ 1028 HighBeamSts_R 0;
BA_ "GenSigTimeoutTime_TCM" SG_ 1028 HighBeamSts_R 0;
BA_ "GenSigTimeoutTime_AGSM" SG_ 1028 LowBeamSts_R 0;
BA_ "GenSigTimeoutTime_BCM" SG_ 1028 LowBeamSts_R 0;
BA_ "GenSigTimeoutTime_BSM" SG_ 1028 LowBeamSts_R 0;
BA_ "GenSigTimeoutTime_DMSM" SG_ 1028 LowBeamSts_R 0;
BA_ "GenSigTimeoutTime_DTCM" SG_ 1028 LowBeamSts_R 0;
BA_ "GenSigTimeoutTime_ECM" SG_ 1028 LowBeamSts_R 0;
BA_ "GenSigTimeoutTime_EVCU2" SG_ 1028 LowBeamSts_R 0;
BA_ "GenSigTimeoutTime_GNMM" SG_ 1028 LowBeamSts_R 0;
BA_ "GenSigTimeoutTime_HCP" SG_ 1028 LowBeamSts_R 0;
BA_ "GenSigTimeoutTime_RFHM" SG_ 1028 LowBeamSts_R 0;
BA_ "GenSigTimeoutTime_TCM" SG_ 1028 LowBeamSts_R 0;
BA_ "GenSigTimeoutTime_AGSM" SG_ 1028 MessageCounter_SLMR_STATUS_FD 0;
BA_ "GenSigTimeoutTime_BCM" SG_ 1028 MessageCounter_SLMR_STATUS_FD 0;
BA_ "GenSigTimeoutTime_BSM" SG_ 1028 MessageCounter_SLMR_STATUS_FD 0;
BA_ "GenSigTimeoutTime_DMSM" SG_ 1028 MessageCounter_SLMR_STATUS_FD 0;
BA_ "GenSigTimeoutTime_DTCM" SG_ 1028 MessageCounter_SLMR_STATUS_FD 0;
BA_ "GenSigTimeoutTime_ECM" SG_ 1028 MessageCounter_SLMR_STATUS_FD 0;
BA_ "GenSigTimeoutTime_EVCU2" SG_ 1028 MessageCounter_SLMR_STATUS_FD 0;
BA_ "GenSigTimeoutTime_GNMM" SG_ 1028 MessageCounter_SLMR_STATUS_FD 0;
BA_ "GenSigTimeoutTime_HCP" SG_ 1028 MessageCounter_SLMR_STATUS_FD 0;
BA_ "GenSigTimeoutTime_IPC" SG_ 1028 MessageCounter_SLMR_STATUS_FD 0;
BA_ "GenSigTimeoutTime_RFHM" SG_ 1028 MessageCounter_SLMR_STATUS_FD 0;
BA_ "GenSigTimeoutTime_SGW" SG_ 1028 MessageCounter_SLMR_STATUS_FD 0;
BA_ "GenSigTimeoutTime_TCM" SG_ 1028 MessageCounter_SLMR_STATUS_FD 0;
BA_ "GenSigTimeoutTime_AGSM" SG_ 1028 PositionLampSts_R 0;
BA_ "GenSigTimeoutTime_BCM" SG_ 1028 PositionLampSts_R 0;
BA_ "GenSigTimeoutTime_BSM" SG_ 1028 PositionLampSts_R 0;
BA_ "GenSigTimeoutTime_CADM" SG_ 1028 PositionLampSts_R 0;
BA_ "GenSigTimeoutTime_DMSM" SG_ 1028 PositionLampSts_R 0;
BA_ "GenSigTimeoutTime_DTCM" SG_ 1028 PositionLampSts_R 0;
BA_ "GenSigTimeoutTime_ECM" SG_ 1028 PositionLampSts_R 0;
BA_ "GenSigTimeoutTime_EVCU2" SG_ 1028 PositionLampSts_R 0;
BA_ "GenSigTimeoutTime_GNMM" SG_ 1028 PositionLampSts_R 0;
BA_ "GenSigTimeoutTime_HCP" SG_ 1028 PositionLampSts_R 0;
BA_ "GenSigTimeoutTime_RFHM" SG_ 1028 PositionLampSts_R 0;
BA_ "GenSigTimeoutTime_TCM" SG_ 1028 PositionLampSts_R 0;
BA_ "GenSigTimeoutTime_AGSM" SG_ 1028 SideMarkerLampSts_R 0;
BA_ "GenSigTimeoutTime_BCM" SG_ 1028 SideMarkerLampSts_R 0;
BA_ "GenSigTimeoutTime_BSM" SG_ 1028 SideMarkerLampSts_R 0;
BA_ "GenSigTimeoutTime_CADM" SG_ 1028 SideMarkerLampSts_R 0;
BA_ "GenSigTimeoutTime_DMSM" SG_ 1028 SideMarkerLampSts_R 0;
BA_ "GenSigTimeoutTime_DTCM" SG_ 1028 SideMarkerLampSts_R 0;
BA_ "GenSigTimeoutTime_ECM" SG_ 1028 SideMarkerLampSts_R 0;
BA_ "GenSigTimeoutTime_EVCU2" SG_ 1028 SideMarkerLampSts_R 0;
BA_ "GenSigTimeoutTime_GNMM" SG_ 1028 SideMarkerLampSts_R 0;
BA_ "GenSigTimeoutTime_HCP" SG_ 1028 SideMarkerLampSts_R 0;
BA_ "GenSigTimeoutTime_RFHM" SG_ 1028 SideMarkerLampSts_R 0;
BA_ "GenSigTimeoutTime_SGW" SG_ 1028 SideMarkerLampSts_R 0;
BA_ "GenSigTimeoutTime_TCM" SG_ 1028 SideMarkerLampSts_R 0;
BA_ "GenSigTimeoutTime_AGSM" SG_ 1028 SLMRSts 0;
BA_ "GenSigTimeoutTime_BCM" SG_ 1028 SLMRSts 0;
BA_ "GenSigTimeoutTime_BSM" SG_ 1028 SLMRSts 0;
BA_ "GenSigTimeoutTime_CADM" SG_ 1028 SLMRSts 0;
BA_ "GenSigTimeoutTime_DMSM" SG_ 1028 SLMRSts 0;
BA_ "GenSigTimeoutTime_DTCM" SG_ 1028 SLMRSts 0;
BA_ "GenSigTimeoutTime_ECM" SG_ 1028 SLMRSts 0;
BA_ "GenSigTimeoutTime_EVCU2" SG_ 1028 SLMRSts 0;
BA_ "GenSigTimeoutTime_GNMM" SG_ 1028 SLMRSts 0;
BA_ "GenSigTimeoutTime_HCP" SG_ 1028 SLMRSts 0;
BA_ "GenSigTimeoutTime_RFHM" SG_ 1028 SLMRSts 0;
BA_ "GenSigTimeoutTime_SGW" SG_ 1028 SLMRSts 0;
BA_ "GenSigTimeoutTime_TCM" SG_ 1028 SLMRSts 0;
BA_ "GenSigTimeoutTime_AGSM" SG_ 1028 TurnSignalSts_R 0;
BA_ "GenSigTimeoutTime_BCM" SG_ 1028 TurnSignalSts_R 0;
BA_ "GenSigTimeoutTime_BSM" SG_ 1028 TurnSignalSts_R 0;
BA_ "GenSigTimeoutTime_CADM" SG_ 1028 TurnSignalSts_R 0;
BA_ "GenSigTimeoutTime_DMSM" SG_ 1028 TurnSignalSts_R 0;
BA_ "GenSigTimeoutTime_DTCM" SG_ 1028 TurnSignalSts_R 0;
BA_ "GenSigTimeoutTime_ECM" SG_ 1028 TurnSignalSts_R 0;
BA_ "GenSigTimeoutTime_EVCU2" SG_ 1028 TurnSignalSts_R 0;
BA_ "GenSigTimeoutTime_GNMM" SG_ 1028 TurnSignalSts_R 0;
BA_ "GenSigTimeoutTime_HCP" SG_ 1028 TurnSignalSts_R 0;
BA_ "GenSigTimeoutTime_IPC" SG_ 1028 TurnSignalSts_R 0;
BA_ "GenSigTimeoutTime_RFHM" SG_ 1028 TurnSignalSts_R 0;
BA_ "GenSigTimeoutTime_SGW" SG_ 1028 TurnSignalSts_R 0;
BA_ "GenSigTimeoutTime_TCM" SG_ 1028 TurnSignalSts_R 0;
BA_ "GenSigStartValue" SG_ 151 Calc_Threshold 255;
BA_ "GenSigTimeoutTime_AGSM" SG_ 151 Calc_Threshold 0;
BA_ "GenSigTimeoutTime_BCM" SG_ 151 Calc_Threshold 0;
BA_ "GenSigTimeoutTime_BSM" SG_ 151 Calc_Threshold 0;
BA_ "GenSigTimeoutTime_DMSM" SG_ 151 Calc_Threshold 0;
BA_ "GenSigTimeoutTime_DTCM" SG_ 151 Calc_Threshold 0;
BA_ "GenSigTimeoutTime_ECM" SG_ 151 Calc_Threshold 0;
BA_ "GenSigTimeoutTime_EVCU2" SG_ 151 Calc_Threshold 0;
BA_ "GenSigTimeoutTime_GNMM" SG_ 151 Calc_Threshold 0;
BA_ "GenSigTimeoutTime_HCP" SG_ 151 Calc_Threshold 0;
BA_ "GenSigTimeoutTime_IPC" SG_ 151 Calc_Threshold 0;
BA_ "GenSigTimeoutTime_RFHM" SG_ 151 Calc_Threshold 0;
BA_ "GenSigTimeoutTime_SGW" SG_ 151 Calc_Threshold 0;
BA_ "GenSigTimeoutTime_TCM" SG_ 151 Calc_Threshold 0;
BA_ "GenSigStartValue" SG_ 151 CRC_SWSM_1 255;
BA_ "GenSigTimeoutTime_AGSM" SG_ 151 CRC_SWSM_1 0;
BA_ "GenSigTimeoutTime_BCM" SG_ 151 CRC_SWSM_1 0;
BA_ "GenSigTimeoutTime_BSM" SG_ 151 CRC_SWSM_1 0;
BA_ "GenSigTimeoutTime_DMSM" SG_ 151 CRC_SWSM_1 0;
BA_ "GenSigTimeoutTime_DTCM" SG_ 151 CRC_SWSM_1 0;
BA_ "GenSigTimeoutTime_ECM" SG_ 151 CRC_SWSM_1 0;
BA_ "GenSigTimeoutTime_EVCU2" SG_ 151 CRC_SWSM_1 0;
BA_ "GenSigTimeoutTime_GNMM" SG_ 151 CRC_SWSM_1 0;
BA_ "GenSigTimeoutTime_HCP" SG_ 151 CRC_SWSM_1 0;
BA_ "GenSigTimeoutTime_IPC" SG_ 151 CRC_SWSM_1 0;
BA_ "GenSigTimeoutTime_RFHM" SG_ 151 CRC_SWSM_1 0;
BA_ "GenSigTimeoutTime_SGW" SG_ 151 CRC_SWSM_1 0;
BA_ "GenSigTimeoutTime_TCM" SG_ 151 CRC_SWSM_1 0;
BA_ "GenSigSendType" SG_ 151 ERR_ST_HOD 1;
BA_ "GenSigTimeoutTime_AGSM" SG_ 151 ERR_ST_HOD 0;
BA_ "GenSigTimeoutTime_BCM" SG_ 151 ERR_ST_HOD 0;
BA_ "GenSigTimeoutTime_BSM" SG_ 151 ERR_ST_HOD 0;
BA_ "GenSigTimeoutTime_DMSM" SG_ 151 ERR_ST_HOD 0;
BA_ "GenSigTimeoutTime_DTCM" SG_ 151 ERR_ST_HOD 0;
BA_ "GenSigTimeoutTime_ECM" SG_ 151 ERR_ST_HOD 0;
BA_ "GenSigTimeoutTime_EVCU2" SG_ 151 ERR_ST_HOD 0;
BA_ "GenSigTimeoutTime_GNMM" SG_ 151 ERR_ST_HOD 0;
BA_ "GenSigTimeoutTime_HCP" SG_ 151 ERR_ST_HOD 0;
BA_ "GenSigTimeoutTime_IPC" SG_ 151 ERR_ST_HOD 0;
BA_ "GenSigTimeoutTime_RFHM" SG_ 151 ERR_ST_HOD 0;
BA_ "GenSigTimeoutTime_SGW" SG_ 151 ERR_ST_HOD 0;
BA_ "GenSigTimeoutTime_TCM" SG_ 151 ERR_ST_HOD 0;
BA_ "GenSigTimeoutTime_AGSM" SG_ 151 HOFF_RCOG_SEN 0;
BA_ "GenSigTimeoutTime_BCM" SG_ 151 HOFF_RCOG_SEN 0;
BA_ "GenSigTimeoutTime_BSM" SG_ 151 HOFF_RCOG_SEN 0;
BA_ "GenSigTimeoutTime_DMSM" SG_ 151 HOFF_RCOG_SEN 0;
BA_ "GenSigTimeoutTime_DTCM" SG_ 151 HOFF_RCOG_SEN 0;
BA_ "GenSigTimeoutTime_ECM" SG_ 151 HOFF_RCOG_SEN 0;
BA_ "GenSigTimeoutTime_EVCU2" SG_ 151 HOFF_RCOG_SEN 0;
BA_ "GenSigTimeoutTime_GNMM" SG_ 151 HOFF_RCOG_SEN 0;
BA_ "GenSigTimeoutTime_HCP" SG_ 151 HOFF_RCOG_SEN 0;
BA_ "GenSigTimeoutTime_IPC" SG_ 151 HOFF_RCOG_SEN 0;
BA_ "GenSigTimeoutTime_RFHM" SG_ 151 HOFF_RCOG_SEN 0;
BA_ "GenSigTimeoutTime_SGW" SG_ 151 HOFF_RCOG_SEN 0;
BA_ "GenSigTimeoutTime_TCM" SG_ 151 HOFF_RCOG_SEN 0;
BA_ "GenSigStartValue" SG_ 151 Immag_Impedence 255;
BA_ "GenSigTimeoutTime_AGSM" SG_ 151 Immag_Impedence 0;
BA_ "GenSigTimeoutTime_BCM" SG_ 151 Immag_Impedence 0;
BA_ "GenSigTimeoutTime_BSM" SG_ 151 Immag_Impedence 0;
BA_ "GenSigTimeoutTime_DMSM" SG_ 151 Immag_Impedence 0;
BA_ "GenSigTimeoutTime_DTCM" SG_ 151 Immag_Impedence 0;
BA_ "GenSigTimeoutTime_ECM" SG_ 151 Immag_Impedence 0;
BA_ "GenSigTimeoutTime_EVCU2" SG_ 151 Immag_Impedence 0;
BA_ "GenSigTimeoutTime_GNMM" SG_ 151 Immag_Impedence 0;
BA_ "GenSigTimeoutTime_HCP" SG_ 151 Immag_Impedence 0;
BA_ "GenSigTimeoutTime_IPC" SG_ 151 Immag_Impedence 0;
BA_ "GenSigTimeoutTime_RFHM" SG_ 151 Immag_Impedence 0;
BA_ "GenSigTimeoutTime_SGW" SG_ 151 Immag_Impedence 0;
BA_ "GenSigTimeoutTime_TCM" SG_ 151 Immag_Impedence 0;
BA_ "GenSigTimeoutTime_AGSM" SG_ 151 MC_SWSM_1 0;
BA_ "GenSigTimeoutTime_BCM" SG_ 151 MC_SWSM_1 0;
BA_ "GenSigTimeoutTime_BSM" SG_ 151 MC_SWSM_1 0;
BA_ "GenSigTimeoutTime_DMSM" SG_ 151 MC_SWSM_1 0;
BA_ "GenSigTimeoutTime_DTCM" SG_ 151 MC_SWSM_1 0;
BA_ "GenSigTimeoutTime_ECM" SG_ 151 MC_SWSM_1 0;
BA_ "GenSigTimeoutTime_EVCU2" SG_ 151 MC_SWSM_1 0;
BA_ "GenSigTimeoutTime_GNMM" SG_ 151 MC_SWSM_1 0;
BA_ "GenSigTimeoutTime_HCP" SG_ 151 MC_SWSM_1 0;
BA_ "GenSigTimeoutTime_IPC" SG_ 151 MC_SWSM_1 0;
BA_ "GenSigTimeoutTime_RFHM" SG_ 151 MC_SWSM_1 0;
BA_ "GenSigTimeoutTime_SGW" SG_ 151 MC_SWSM_1 0;
BA_ "GenSigTimeoutTime_TCM" SG_ 151 MC_SWSM_1 0;
BA_ "GenSigStartValue" SG_ 151 Real_Impedence 255;
BA_ "GenSigTimeoutTime_AGSM" SG_ 151 Real_Impedence 0;
BA_ "GenSigTimeoutTime_BCM" SG_ 151 Real_Impedence 0;
BA_ "GenSigTimeoutTime_BSM" SG_ 151 Real_Impedence 0;
BA_ "GenSigTimeoutTime_DMSM" SG_ 151 Real_Impedence 0;
BA_ "GenSigTimeoutTime_DTCM" SG_ 151 Real_Impedence 0;
BA_ "GenSigTimeoutTime_ECM" SG_ 151 Real_Impedence 0;
BA_ "GenSigTimeoutTime_EVCU2" SG_ 151 Real_Impedence 0;
BA_ "GenSigTimeoutTime_GNMM" SG_ 151 Real_Impedence 0;
BA_ "GenSigTimeoutTime_HCP" SG_ 151 Real_Impedence 0;
BA_ "GenSigTimeoutTime_IPC" SG_ 151 Real_Impedence 0;
BA_ "GenSigTimeoutTime_RFHM" SG_ 151 Real_Impedence 0;
BA_ "GenSigTimeoutTime_SGW" SG_ 151 Real_Impedence 0;
BA_ "GenSigTimeoutTime_TCM" SG_ 151 Real_Impedence 0;
BA_ "GenSigTimeoutTime_AGSM" SG_ 151 RsErr_SWSM 0;
BA_ "GenSigTimeoutTime_BCM" SG_ 151 RsErr_SWSM 0;
BA_ "GenSigTimeoutTime_BSM" SG_ 151 RsErr_SWSM 0;
BA_ "GenSigTimeoutTime_DMSM" SG_ 151 RsErr_SWSM 0;
BA_ "GenSigTimeoutTime_DTCM" SG_ 151 RsErr_SWSM 0;
BA_ "GenSigTimeoutTime_ECM" SG_ 151 RsErr_SWSM 0;
BA_ "GenSigTimeoutTime_EVCU2" SG_ 151 RsErr_SWSM 0;
BA_ "GenSigTimeoutTime_GNMM" SG_ 151 RsErr_SWSM 0;
BA_ "GenSigTimeoutTime_HCP" SG_ 151 RsErr_SWSM 0;
BA_ "GenSigTimeoutTime_IPC" SG_ 151 RsErr_SWSM 0;
BA_ "GenSigTimeoutTime_RFHM" SG_ 151 RsErr_SWSM 0;
BA_ "GenSigTimeoutTime_SGW" SG_ 151 RsErr_SWSM 0;
BA_ "GenSigTimeoutTime_TCM" SG_ 151 RsErr_SWSM 0;
BA_ "GenSigSendType" SG_ 577 QualifyDriveCycle 3;
BA_ "GenSigTimeoutTime_BCM" SG_ 577 QualifyDriveCycle 0;
BA_ "GenSigTimeoutTime_CADM" SG_ 577 QualifyDriveCycle 0;
BA_ "GenSigTimeoutTime_DMSM" SG_ 577 QualifyDriveCycle 0;
BA_ "GenSigTimeoutTime_DTCM" SG_ 577 QualifyDriveCycle 0;
BA_ "GenSigTimeoutTime_ECM" SG_ 577 QualifyDriveCycle 0;
BA_ "GenSigTimeoutTime_GNMM" SG_ 577 QualifyDriveCycle 0;
BA_ "GenSigTimeoutTime_HCP" SG_ 577 QualifyDriveCycle 0;
BA_ "GenSigTimeoutTime_IPC" SG_ 577 QualifyDriveCycle 0;
BA_ "GenSigTimeoutTime_RFHM" SG_ 577 QualifyDriveCycle 0;
BA_ "GenSigTimeoutTime_SGW" SG_ 577 QualifyDriveCycle 0;
BA_ "GenSigTimeoutTime_AGSM" SG_ 1488 Cooperative_Vehicle_Location 0;
BA_ "GenSigTimeoutTime_BCM" SG_ 1488 Cooperative_Vehicle_Location 0;
BA_ "GenSigTimeoutTime_BSM" SG_ 1488 Cooperative_Vehicle_Location 0;
BA_ "GenSigTimeoutTime_CADM" SG_ 1488 Cooperative_Vehicle_Location 0;
BA_ "GenSigTimeoutTime_DMSM" SG_ 1488 Cooperative_Vehicle_Location 0;
BA_ "GenSigTimeoutTime_DTCM" SG_ 1488 Cooperative_Vehicle_Location 0;
BA_ "GenSigTimeoutTime_ECM" SG_ 1488 Cooperative_Vehicle_Location 0;
BA_ "GenSigTimeoutTime_GNMM" SG_ 1488 Cooperative_Vehicle_Location 0;
BA_ "GenSigTimeoutTime_HCP" SG_ 1488 Cooperative_Vehicle_Location 0;
BA_ "GenSigTimeoutTime_IPC" SG_ 1488 Cooperative_Vehicle_Location 0;
BA_ "GenSigTimeoutTime_RFHM" SG_ 1488 Cooperative_Vehicle_Location 0;
BA_ "GenSigTimeoutTime_SGW" SG_ 1488 Cooperative_Vehicle_Location 0;
BA_ "GenSigTimeoutTime_TCM" SG_ 1488 Cooperative_Vehicle_Location 0;
BA_ "GenSigTimeoutTime_AGSM" SG_ 1488 Remote_Chargeport_Command 0;
BA_ "GenSigTimeoutTime_BCM" SG_ 1488 Remote_Chargeport_Command 0;
BA_ "GenSigTimeoutTime_BSM" SG_ 1488 Remote_Chargeport_Command 0;
BA_ "GenSigTimeoutTime_CADM" SG_ 1488 Remote_Chargeport_Command 0;
BA_ "GenSigTimeoutTime_DMSM" SG_ 1488 Remote_Chargeport_Command 0;
BA_ "GenSigTimeoutTime_DTCM" SG_ 1488 Remote_Chargeport_Command 0;
BA_ "GenSigTimeoutTime_ECM" SG_ 1488 Remote_Chargeport_Command 0;
BA_ "GenSigTimeoutTime_GNMM" SG_ 1488 Remote_Chargeport_Command 0;
BA_ "GenSigTimeoutTime_HCP" SG_ 1488 Remote_Chargeport_Command 0;
BA_ "GenSigTimeoutTime_IPC" SG_ 1488 Remote_Chargeport_Command 0;
BA_ "GenSigTimeoutTime_RFHM" SG_ 1488 Remote_Chargeport_Command 0;
BA_ "GenSigTimeoutTime_SGW" SG_ 1488 Remote_Chargeport_Command 0;
BA_ "GenSigTimeoutTime_TCM" SG_ 1488 Remote_Chargeport_Command 0;
BA_ "GenSigTimeoutTime_AGSM" SG_ 1488 TBM_Cooperative_Charge_Command 0;
BA_ "GenSigTimeoutTime_BCM" SG_ 1488 TBM_Cooperative_Charge_Command 0;
BA_ "GenSigTimeoutTime_BSM" SG_ 1488 TBM_Cooperative_Charge_Command 0;
BA_ "GenSigTimeoutTime_CADM" SG_ 1488 TBM_Cooperative_Charge_Command 0;
BA_ "GenSigTimeoutTime_DMSM" SG_ 1488 TBM_Cooperative_Charge_Command 0;
BA_ "GenSigTimeoutTime_DTCM" SG_ 1488 TBM_Cooperative_Charge_Command 0;
BA_ "GenSigTimeoutTime_ECM" SG_ 1488 TBM_Cooperative_Charge_Command 0;
BA_ "GenSigTimeoutTime_GNMM" SG_ 1488 TBM_Cooperative_Charge_Command 0;
BA_ "GenSigTimeoutTime_HCP" SG_ 1488 TBM_Cooperative_Charge_Command 0;
BA_ "GenSigTimeoutTime_IPC" SG_ 1488 TBM_Cooperative_Charge_Command 0;
BA_ "GenSigTimeoutTime_RFHM" SG_ 1488 TBM_Cooperative_Charge_Command 0;
BA_ "GenSigTimeoutTime_SGW" SG_ 1488 TBM_Cooperative_Charge_Command 0;
BA_ "GenSigTimeoutTime_TCM" SG_ 1488 TBM_Cooperative_Charge_Command 0;
BA_ "GenSigTimeoutTime_AGSM" SG_ 1488 TBM_StopCharge 0;
BA_ "GenSigTimeoutTime_BCM" SG_ 1488 TBM_StopCharge 0;
BA_ "GenSigTimeoutTime_BSM" SG_ 1488 TBM_StopCharge 0;
BA_ "GenSigTimeoutTime_CADM" SG_ 1488 TBM_StopCharge 0;
BA_ "GenSigTimeoutTime_DMSM" SG_ 1488 TBM_StopCharge 0;
BA_ "GenSigTimeoutTime_DTCM" SG_ 1488 TBM_StopCharge 0;
BA_ "GenSigTimeoutTime_ECM" SG_ 1488 TBM_StopCharge 0;
BA_ "GenSigTimeoutTime_GNMM" SG_ 1488 TBM_StopCharge 0;
BA_ "GenSigTimeoutTime_HCP" SG_ 1488 TBM_StopCharge 0;
BA_ "GenSigTimeoutTime_IPC" SG_ 1488 TBM_StopCharge 0;
BA_ "GenSigTimeoutTime_RFHM" SG_ 1488 TBM_StopCharge 0;
BA_ "GenSigTimeoutTime_SGW" SG_ 1488 TBM_StopCharge 0;
BA_ "GenSigTimeoutTime_TCM" SG_ 1488 TBM_StopCharge 0;
BA_ "GenSigTimeoutTime_AGSM" SG_ 1429 ACV_Request 0;
BA_ "GenSigTimeoutTime_BSM" SG_ 1429 ACV_Request 0;
BA_ "GenSigTimeoutTime_CADM" SG_ 1429 ACV_Request 0;
BA_ "GenSigTimeoutTime_DMSM" SG_ 1429 ACV_Request 0;
BA_ "GenSigTimeoutTime_DTCM" SG_ 1429 ACV_Request 0;
BA_ "GenSigTimeoutTime_ECM" SG_ 1429 ACV_Request 0;
BA_ "GenSigTimeoutTime_EVCU2" SG_ 1429 ACV_Request 0;
BA_ "GenSigTimeoutTime_GNMM" SG_ 1429 ACV_Request 0;
BA_ "GenSigTimeoutTime_HCP" SG_ 1429 ACV_Request 0;
BA_ "GenSigTimeoutTime_IPC" SG_ 1429 ACV_Request 0;
BA_ "GenSigTimeoutTime_RFHM" SG_ 1429 ACV_Request 0;
BA_ "GenSigTimeoutTime_SGW" SG_ 1429 ACV_Request 0;
BA_ "GenSigTimeoutTime_TCM" SG_ 1429 ACV_Request 0;
BA_ "GenSigSendType" SG_ 1429 Disarm_Mobile_App_Req 3;
BA_ "GenSigTimeoutTime_AGSM" SG_ 1429 Disarm_Mobile_App_Req 0;
BA_ "GenSigTimeoutTime_BSM" SG_ 1429 Disarm_Mobile_App_Req 0;
BA_ "GenSigTimeoutTime_CADM" SG_ 1429 Disarm_Mobile_App_Req 0;
BA_ "GenSigTimeoutTime_DMSM" SG_ 1429 Disarm_Mobile_App_Req 0;
BA_ "GenSigTimeoutTime_DTCM" SG_ 1429 Disarm_Mobile_App_Req 0;
BA_ "GenSigTimeoutTime_ECM" SG_ 1429 Disarm_Mobile_App_Req 0;
BA_ "GenSigTimeoutTime_EVCU2" SG_ 1429 Disarm_Mobile_App_Req 0;
BA_ "GenSigTimeoutTime_GNMM" SG_ 1429 Disarm_Mobile_App_Req 0;
BA_ "GenSigTimeoutTime_HCP" SG_ 1429 Disarm_Mobile_App_Req 0;
BA_ "GenSigTimeoutTime_IPC" SG_ 1429 Disarm_Mobile_App_Req 0;
BA_ "GenSigTimeoutTime_RFHM" SG_ 1429 Disarm_Mobile_App_Req 0;
BA_ "GenSigTimeoutTime_SGW" SG_ 1429 Disarm_Mobile_App_Req 0;
BA_ "GenSigTimeoutTime_TCM" SG_ 1429 Disarm_Mobile_App_Req 0;
BA_ "GenSigSendType" SG_ 1429 SOSCallStatus 3;
BA_ "GenSigTimeoutTime_AGSM" SG_ 1429 SOSCallStatus 0;
BA_ "GenSigTimeoutTime_BCM" SG_ 1429 SOSCallStatus 0;
BA_ "GenSigTimeoutTime_BSM" SG_ 1429 SOSCallStatus 0;
BA_ "GenSigTimeoutTime_CADM" SG_ 1429 SOSCallStatus 0;
BA_ "GenSigTimeoutTime_DMSM" SG_ 1429 SOSCallStatus 0;
BA_ "GenSigTimeoutTime_DTCM" SG_ 1429 SOSCallStatus 0;
BA_ "GenSigTimeoutTime_ECM" SG_ 1429 SOSCallStatus 0;
BA_ "GenSigTimeoutTime_EVCU2" SG_ 1429 SOSCallStatus 0;
BA_ "GenSigTimeoutTime_GNMM" SG_ 1429 SOSCallStatus 0;
BA_ "GenSigTimeoutTime_HCP" SG_ 1429 SOSCallStatus 0;
BA_ "GenSigTimeoutTime_RFHM" SG_ 1429 SOSCallStatus 0;
BA_ "GenSigTimeoutTime_SGW" SG_ 1429 SOSCallStatus 0;
BA_ "GenSigTimeoutTime_TCM" SG_ 1429 SOSCallStatus 0;
BA_ "GenSigSendType" SG_ 1429 U_CONN_REQ_BCM_FOA_ALERT_FB 3;
BA_ "GenSigTimeoutTime_AGSM" SG_ 1429 U_CONN_REQ_BCM_FOA_ALERT_FB 0;
BA_ "GenSigTimeoutTime_BSM" SG_ 1429 U_CONN_REQ_BCM_FOA_ALERT_FB 0;
BA_ "GenSigTimeoutTime_CADM" SG_ 1429 U_CONN_REQ_BCM_FOA_ALERT_FB 0;
BA_ "GenSigTimeoutTime_DMSM" SG_ 1429 U_CONN_REQ_BCM_FOA_ALERT_FB 0;
BA_ "GenSigTimeoutTime_DTCM" SG_ 1429 U_CONN_REQ_BCM_FOA_ALERT_FB 0;
BA_ "GenSigTimeoutTime_ECM" SG_ 1429 U_CONN_REQ_BCM_FOA_ALERT_FB 0;
BA_ "GenSigTimeoutTime_EVCU2" SG_ 1429 U_CONN_REQ_BCM_FOA_ALERT_FB 0;
BA_ "GenSigTimeoutTime_GNMM" SG_ 1429 U_CONN_REQ_BCM_FOA_ALERT_FB 0;
BA_ "GenSigTimeoutTime_HCP" SG_ 1429 U_CONN_REQ_BCM_FOA_ALERT_FB 0;
BA_ "GenSigTimeoutTime_IPC" SG_ 1429 U_CONN_REQ_BCM_FOA_ALERT_FB 0;
BA_ "GenSigTimeoutTime_RFHM" SG_ 1429 U_CONN_REQ_BCM_FOA_ALERT_FB 0;
BA_ "GenSigTimeoutTime_SGW" SG_ 1429 U_CONN_REQ_BCM_FOA_ALERT_FB 0;
BA_ "GenSigTimeoutTime_TCM" SG_ 1429 U_CONN_REQ_BCM_FOA_ALERT_FB 0;
BA_ "GenSigSendType" SG_ 1429 UCONREQ_TBM_TrailerLightCheck 3;
BA_ "GenSigTimeoutTime_AGSM" SG_ 1429 UCONREQ_TBM_TrailerLightCheck 0;
BA_ "GenSigTimeoutTime_BSM" SG_ 1429 UCONREQ_TBM_TrailerLightCheck 0;
BA_ "GenSigTimeoutTime_CADM" SG_ 1429 UCONREQ_TBM_TrailerLightCheck 0;
BA_ "GenSigTimeoutTime_DMSM" SG_ 1429 UCONREQ_TBM_TrailerLightCheck 0;
BA_ "GenSigTimeoutTime_DTCM" SG_ 1429 UCONREQ_TBM_TrailerLightCheck 0;
BA_ "GenSigTimeoutTime_ECM" SG_ 1429 UCONREQ_TBM_TrailerLightCheck 0;
BA_ "GenSigTimeoutTime_EVCU2" SG_ 1429 UCONREQ_TBM_TrailerLightCheck 0;
BA_ "GenSigTimeoutTime_GNMM" SG_ 1429 UCONREQ_TBM_TrailerLightCheck 0;
BA_ "GenSigTimeoutTime_HCP" SG_ 1429 UCONREQ_TBM_TrailerLightCheck 0;
BA_ "GenSigTimeoutTime_IPC" SG_ 1429 UCONREQ_TBM_TrailerLightCheck 0;
BA_ "GenSigTimeoutTime_RFHM" SG_ 1429 UCONREQ_TBM_TrailerLightCheck 0;
BA_ "GenSigTimeoutTime_SGW" SG_ 1429 UCONREQ_TBM_TrailerLightCheck 0;
BA_ "GenSigTimeoutTime_TCM" SG_ 1429 UCONREQ_TBM_TrailerLightCheck 0;
BA_ "GenSigSendType" SG_ 1451 SOC_Max_Lev_Rem_Req 3;
BA_ "GenSigTimeoutTime_AGSM" SG_ 1451 SOC_Max_Lev_Rem_Req 0;
BA_ "GenSigTimeoutTime_BCM" SG_ 1451 SOC_Max_Lev_Rem_Req 0;
BA_ "GenSigTimeoutTime_BSM" SG_ 1451 SOC_Max_Lev_Rem_Req 0;
BA_ "GenSigTimeoutTime_CADM" SG_ 1451 SOC_Max_Lev_Rem_Req 0;
BA_ "GenSigTimeoutTime_DMSM" SG_ 1451 SOC_Max_Lev_Rem_Req 0;
BA_ "GenSigTimeoutTime_DTCM" SG_ 1451 SOC_Max_Lev_Rem_Req 0;
BA_ "GenSigTimeoutTime_ECM" SG_ 1451 SOC_Max_Lev_Rem_Req 0;
BA_ "GenSigTimeoutTime_EVCU2" SG_ 1451 SOC_Max_Lev_Rem_Req 0;
BA_ "GenSigTimeoutTime_GNMM" SG_ 1451 SOC_Max_Lev_Rem_Req 0;
BA_ "GenSigTimeoutTime_HCP" SG_ 1451 SOC_Max_Lev_Rem_Req 0;
BA_ "GenSigTimeoutTime_RFHM" SG_ 1451 SOC_Max_Lev_Rem_Req 0;
BA_ "GenSigTimeoutTime_SGW" SG_ 1451 SOC_Max_Lev_Rem_Req 0;
BA_ "GenSigTimeoutTime_TCM" SG_ 1451 SOC_Max_Lev_Rem_Req 0;
BA_ "GenSigSendType" SG_ 1451 TBM_Charge_Now 3;
BA_ "GenSigTimeoutTime_AGSM" SG_ 1451 TBM_Charge_Now 0;
BA_ "GenSigTimeoutTime_BCM" SG_ 1451 TBM_Charge_Now 0;
BA_ "GenSigTimeoutTime_BSM" SG_ 1451 TBM_Charge_Now 0;
BA_ "GenSigTimeoutTime_CADM" SG_ 1451 TBM_Charge_Now 0;
BA_ "GenSigTimeoutTime_DMSM" SG_ 1451 TBM_Charge_Now 0;
BA_ "GenSigTimeoutTime_DTCM" SG_ 1451 TBM_Charge_Now 0;
BA_ "GenSigTimeoutTime_ECM" SG_ 1451 TBM_Charge_Now 0;
BA_ "GenSigTimeoutTime_GNMM" SG_ 1451 TBM_Charge_Now 0;
BA_ "GenSigTimeoutTime_HCP" SG_ 1451 TBM_Charge_Now 0;
BA_ "GenSigTimeoutTime_IPC" SG_ 1451 TBM_Charge_Now 0;
BA_ "GenSigTimeoutTime_RFHM" SG_ 1451 TBM_Charge_Now 0;
BA_ "GenSigTimeoutTime_SGW" SG_ 1451 TBM_Charge_Now 0;
BA_ "GenSigTimeoutTime_TCM" SG_ 1451 TBM_Charge_Now 0;
BA_ "GenSigTimeoutTime_AGSM" SG_ 1451 TBM_ChargeSchedule_Type1_Req 0;
BA_ "GenSigTimeoutTime_BCM" SG_ 1451 TBM_ChargeSchedule_Type1_Req 0;
BA_ "GenSigTimeoutTime_BSM" SG_ 1451 TBM_ChargeSchedule_Type1_Req 0;
BA_ "GenSigTimeoutTime_CADM" SG_ 1451 TBM_ChargeSchedule_Type1_Req 0;
BA_ "GenSigTimeoutTime_DMSM" SG_ 1451 TBM_ChargeSchedule_Type1_Req 0;
BA_ "GenSigTimeoutTime_DTCM" SG_ 1451 TBM_ChargeSchedule_Type1_Req 0;
BA_ "GenSigTimeoutTime_ECM" SG_ 1451 TBM_ChargeSchedule_Type1_Req 0;
BA_ "GenSigTimeoutTime_GNMM" SG_ 1451 TBM_ChargeSchedule_Type1_Req 0;
BA_ "GenSigTimeoutTime_HCP" SG_ 1451 TBM_ChargeSchedule_Type1_Req 0;
BA_ "GenSigTimeoutTime_IPC" SG_ 1451 TBM_ChargeSchedule_Type1_Req 0;
BA_ "GenSigTimeoutTime_RFHM" SG_ 1451 TBM_ChargeSchedule_Type1_Req 0;
BA_ "GenSigTimeoutTime_SGW" SG_ 1451 TBM_ChargeSchedule_Type1_Req 0;
BA_ "GenSigTimeoutTime_TCM" SG_ 1451 TBM_ChargeSchedule_Type1_Req 0;
BA_ "GenSigTimeoutTime_AGSM" SG_ 1451 TBM_ChargeSchedule_Type2_Req 0;
BA_ "GenSigTimeoutTime_BCM" SG_ 1451 TBM_ChargeSchedule_Type2_Req 0;
BA_ "GenSigTimeoutTime_BSM" SG_ 1451 TBM_ChargeSchedule_Type2_Req 0;
BA_ "GenSigTimeoutTime_CADM" SG_ 1451 TBM_ChargeSchedule_Type2_Req 0;
BA_ "GenSigTimeoutTime_DMSM" SG_ 1451 TBM_ChargeSchedule_Type2_Req 0;
BA_ "GenSigTimeoutTime_DTCM" SG_ 1451 TBM_ChargeSchedule_Type2_Req 0;
BA_ "GenSigTimeoutTime_ECM" SG_ 1451 TBM_ChargeSchedule_Type2_Req 0;
BA_ "GenSigTimeoutTime_GNMM" SG_ 1451 TBM_ChargeSchedule_Type2_Req 0;
BA_ "GenSigTimeoutTime_HCP" SG_ 1451 TBM_ChargeSchedule_Type2_Req 0;
BA_ "GenSigTimeoutTime_IPC" SG_ 1451 TBM_ChargeSchedule_Type2_Req 0;
BA_ "GenSigTimeoutTime_RFHM" SG_ 1451 TBM_ChargeSchedule_Type2_Req 0;
BA_ "GenSigTimeoutTime_SGW" SG_ 1451 TBM_ChargeSchedule_Type2_Req 0;
BA_ "GenSigTimeoutTime_TCM" SG_ 1451 TBM_ChargeSchedule_Type2_Req 0;
BA_ "GenSigSendType" SG_ 1451 TBM_ChargeUntilFull1 3;
BA_ "GenSigTimeoutTime_AGSM" SG_ 1451 TBM_ChargeUntilFull1 0;
BA_ "GenSigTimeoutTime_BCM" SG_ 1451 TBM_ChargeUntilFull1 0;
BA_ "GenSigTimeoutTime_BSM" SG_ 1451 TBM_ChargeUntilFull1 0;
BA_ "GenSigTimeoutTime_CADM" SG_ 1451 TBM_ChargeUntilFull1 0;
BA_ "GenSigTimeoutTime_DMSM" SG_ 1451 TBM_ChargeUntilFull1 0;
BA_ "GenSigTimeoutTime_DTCM" SG_ 1451 TBM_ChargeUntilFull1 0;
BA_ "GenSigTimeoutTime_ECM" SG_ 1451 TBM_ChargeUntilFull1 0;
BA_ "GenSigTimeoutTime_GNMM" SG_ 1451 TBM_ChargeUntilFull1 0;
BA_ "GenSigTimeoutTime_HCP" SG_ 1451 TBM_ChargeUntilFull1 0;
BA_ "GenSigTimeoutTime_IPC" SG_ 1451 TBM_ChargeUntilFull1 0;
BA_ "GenSigTimeoutTime_RFHM" SG_ 1451 TBM_ChargeUntilFull1 0;
BA_ "GenSigTimeoutTime_SGW" SG_ 1451 TBM_ChargeUntilFull1 0;
BA_ "GenSigTimeoutTime_TCM" SG_ 1451 TBM_ChargeUntilFull1 0;
BA_ "GenSigSendType" SG_ 1451 TBM_ChargeUntilFull2 3;
BA_ "GenSigTimeoutTime_AGSM" SG_ 1451 TBM_ChargeUntilFull2 0;
BA_ "GenSigTimeoutTime_BCM" SG_ 1451 TBM_ChargeUntilFull2 0;
BA_ "GenSigTimeoutTime_BSM" SG_ 1451 TBM_ChargeUntilFull2 0;
BA_ "GenSigTimeoutTime_CADM" SG_ 1451 TBM_ChargeUntilFull2 0;
BA_ "GenSigTimeoutTime_DMSM" SG_ 1451 TBM_ChargeUntilFull2 0;
BA_ "GenSigTimeoutTime_DTCM" SG_ 1451 TBM_ChargeUntilFull2 0;
BA_ "GenSigTimeoutTime_ECM" SG_ 1451 TBM_ChargeUntilFull2 0;
BA_ "GenSigTimeoutTime_GNMM" SG_ 1451 TBM_ChargeUntilFull2 0;
BA_ "GenSigTimeoutTime_HCP" SG_ 1451 TBM_ChargeUntilFull2 0;
BA_ "GenSigTimeoutTime_IPC" SG_ 1451 TBM_ChargeUntilFull2 0;
BA_ "GenSigTimeoutTime_RFHM" SG_ 1451 TBM_ChargeUntilFull2 0;
BA_ "GenSigTimeoutTime_SGW" SG_ 1451 TBM_ChargeUntilFull2 0;
BA_ "GenSigTimeoutTime_TCM" SG_ 1451 TBM_ChargeUntilFull2 0;
BA_ "GenSigSendType" SG_ 1451 TBM_Enable_Schedule1 3;
BA_ "GenSigTimeoutTime_AGSM" SG_ 1451 TBM_Enable_Schedule1 0;
BA_ "GenSigTimeoutTime_BCM" SG_ 1451 TBM_Enable_Schedule1 0;
BA_ "GenSigTimeoutTime_BSM" SG_ 1451 TBM_Enable_Schedule1 0;
BA_ "GenSigTimeoutTime_CADM" SG_ 1451 TBM_Enable_Schedule1 0;
BA_ "GenSigTimeoutTime_DMSM" SG_ 1451 TBM_Enable_Schedule1 0;
BA_ "GenSigTimeoutTime_DTCM" SG_ 1451 TBM_Enable_Schedule1 0;
BA_ "GenSigTimeoutTime_ECM" SG_ 1451 TBM_Enable_Schedule1 0;
BA_ "GenSigTimeoutTime_GNMM" SG_ 1451 TBM_Enable_Schedule1 0;
BA_ "GenSigTimeoutTime_HCP" SG_ 1451 TBM_Enable_Schedule1 0;
BA_ "GenSigTimeoutTime_IPC" SG_ 1451 TBM_Enable_Schedule1 0;
BA_ "GenSigTimeoutTime_RFHM" SG_ 1451 TBM_Enable_Schedule1 0;
BA_ "GenSigTimeoutTime_SGW" SG_ 1451 TBM_Enable_Schedule1 0;
BA_ "GenSigTimeoutTime_TCM" SG_ 1451 TBM_Enable_Schedule1 0;
BA_ "GenSigSendType" SG_ 1451 TBM_Enable_Schedule2 3;
BA_ "GenSigTimeoutTime_AGSM" SG_ 1451 TBM_Enable_Schedule2 0;
BA_ "GenSigTimeoutTime_BCM" SG_ 1451 TBM_Enable_Schedule2 0;
BA_ "GenSigTimeoutTime_BSM" SG_ 1451 TBM_Enable_Schedule2 0;
BA_ "GenSigTimeoutTime_CADM" SG_ 1451 TBM_Enable_Schedule2 0;
BA_ "GenSigTimeoutTime_DMSM" SG_ 1451 TBM_Enable_Schedule2 0;
BA_ "GenSigTimeoutTime_DTCM" SG_ 1451 TBM_Enable_Schedule2 0;
BA_ "GenSigTimeoutTime_ECM" SG_ 1451 TBM_Enable_Schedule2 0;
BA_ "GenSigTimeoutTime_GNMM" SG_ 1451 TBM_Enable_Schedule2 0;
BA_ "GenSigTimeoutTime_HCP" SG_ 1451 TBM_Enable_Schedule2 0;
BA_ "GenSigTimeoutTime_IPC" SG_ 1451 TBM_Enable_Schedule2 0;
BA_ "GenSigTimeoutTime_RFHM" SG_ 1451 TBM_Enable_Schedule2 0;
BA_ "GenSigTimeoutTime_SGW" SG_ 1451 TBM_Enable_Schedule2 0;
BA_ "GenSigTimeoutTime_TCM" SG_ 1451 TBM_Enable_Schedule2 0;
BA_ "GenSigSendType" SG_ 1451 TBM_End_Time_Hr1 3;
BA_ "GenSigTimeoutTime_AGSM" SG_ 1451 TBM_End_Time_Hr1 0;
BA_ "GenSigTimeoutTime_BCM" SG_ 1451 TBM_End_Time_Hr1 0;
BA_ "GenSigTimeoutTime_BSM" SG_ 1451 TBM_End_Time_Hr1 0;
BA_ "GenSigTimeoutTime_CADM" SG_ 1451 TBM_End_Time_Hr1 0;
BA_ "GenSigTimeoutTime_DMSM" SG_ 1451 TBM_End_Time_Hr1 0;
BA_ "GenSigTimeoutTime_DTCM" SG_ 1451 TBM_End_Time_Hr1 0;
BA_ "GenSigTimeoutTime_ECM" SG_ 1451 TBM_End_Time_Hr1 0;
BA_ "GenSigTimeoutTime_GNMM" SG_ 1451 TBM_End_Time_Hr1 0;
BA_ "GenSigTimeoutTime_HCP" SG_ 1451 TBM_End_Time_Hr1 0;
BA_ "GenSigTimeoutTime_IPC" SG_ 1451 TBM_End_Time_Hr1 0;
BA_ "GenSigTimeoutTime_RFHM" SG_ 1451 TBM_End_Time_Hr1 0;
BA_ "GenSigTimeoutTime_SGW" SG_ 1451 TBM_End_Time_Hr1 0;
BA_ "GenSigTimeoutTime_TCM" SG_ 1451 TBM_End_Time_Hr1 0;
BA_ "GenSigSendType" SG_ 1451 TBM_End_Time_Hr2 3;
BA_ "GenSigTimeoutTime_AGSM" SG_ 1451 TBM_End_Time_Hr2 0;
BA_ "GenSigTimeoutTime_BCM" SG_ 1451 TBM_End_Time_Hr2 0;
BA_ "GenSigTimeoutTime_BSM" SG_ 1451 TBM_End_Time_Hr2 0;
BA_ "GenSigTimeoutTime_CADM" SG_ 1451 TBM_End_Time_Hr2 0;
BA_ "GenSigTimeoutTime_DMSM" SG_ 1451 TBM_End_Time_Hr2 0;
BA_ "GenSigTimeoutTime_DTCM" SG_ 1451 TBM_End_Time_Hr2 0;
BA_ "GenSigTimeoutTime_ECM" SG_ 1451 TBM_End_Time_Hr2 0;
BA_ "GenSigTimeoutTime_GNMM" SG_ 1451 TBM_End_Time_Hr2 0;
BA_ "GenSigTimeoutTime_HCP" SG_ 1451 TBM_End_Time_Hr2 0;
BA_ "GenSigTimeoutTime_IPC" SG_ 1451 TBM_End_Time_Hr2 0;
BA_ "GenSigTimeoutTime_RFHM" SG_ 1451 TBM_End_Time_Hr2 0;
BA_ "GenSigTimeoutTime_SGW" SG_ 1451 TBM_End_Time_Hr2 0;
BA_ "GenSigTimeoutTime_TCM" SG_ 1451 TBM_End_Time_Hr2 0;
BA_ "GenSigSendType" SG_ 1451 TBM_End_Time_Min1 3;
BA_ "GenSigTimeoutTime_AGSM" SG_ 1451 TBM_End_Time_Min1 0;
BA_ "GenSigTimeoutTime_BCM" SG_ 1451 TBM_End_Time_Min1 0;
BA_ "GenSigTimeoutTime_BSM" SG_ 1451 TBM_End_Time_Min1 0;
BA_ "GenSigTimeoutTime_CADM" SG_ 1451 TBM_End_Time_Min1 0;
BA_ "GenSigTimeoutTime_DMSM" SG_ 1451 TBM_End_Time_Min1 0;
BA_ "GenSigTimeoutTime_DTCM" SG_ 1451 TBM_End_Time_Min1 0;
BA_ "GenSigTimeoutTime_ECM" SG_ 1451 TBM_End_Time_Min1 0;
BA_ "GenSigTimeoutTime_GNMM" SG_ 1451 TBM_End_Time_Min1 0;
BA_ "GenSigTimeoutTime_HCP" SG_ 1451 TBM_End_Time_Min1 0;
BA_ "GenSigTimeoutTime_IPC" SG_ 1451 TBM_End_Time_Min1 0;
BA_ "GenSigTimeoutTime_RFHM" SG_ 1451 TBM_End_Time_Min1 0;
BA_ "GenSigTimeoutTime_SGW" SG_ 1451 TBM_End_Time_Min1 0;
BA_ "GenSigTimeoutTime_TCM" SG_ 1451 TBM_End_Time_Min1 0;
BA_ "GenSigSendType" SG_ 1451 TBM_End_Time_Min2 3;
BA_ "GenSigTimeoutTime_AGSM" SG_ 1451 TBM_End_Time_Min2 0;
BA_ "GenSigTimeoutTime_BCM" SG_ 1451 TBM_End_Time_Min2 0;
BA_ "GenSigTimeoutTime_BSM" SG_ 1451 TBM_End_Time_Min2 0;
BA_ "GenSigTimeoutTime_CADM" SG_ 1451 TBM_End_Time_Min2 0;
BA_ "GenSigTimeoutTime_DMSM" SG_ 1451 TBM_End_Time_Min2 0;
BA_ "GenSigTimeoutTime_DTCM" SG_ 1451 TBM_End_Time_Min2 0;
BA_ "GenSigTimeoutTime_ECM" SG_ 1451 TBM_End_Time_Min2 0;
BA_ "GenSigTimeoutTime_GNMM" SG_ 1451 TBM_End_Time_Min2 0;
BA_ "GenSigTimeoutTime_HCP" SG_ 1451 TBM_End_Time_Min2 0;
BA_ "GenSigTimeoutTime_IPC" SG_ 1451 TBM_End_Time_Min2 0;
BA_ "GenSigTimeoutTime_RFHM" SG_ 1451 TBM_End_Time_Min2 0;
BA_ "GenSigTimeoutTime_SGW" SG_ 1451 TBM_End_Time_Min2 0;
BA_ "GenSigTimeoutTime_TCM" SG_ 1451 TBM_End_Time_Min2 0;
BA_ "GenSigStartValue" SG_ 1451 TBM_External_ChargeTarget1 15;
BA_ "GenSigTimeoutTime_AGSM" SG_ 1451 TBM_External_ChargeTarget1 0;
BA_ "GenSigTimeoutTime_BCM" SG_ 1451 TBM_External_ChargeTarget1 0;
BA_ "GenSigTimeoutTime_BSM" SG_ 1451 TBM_External_ChargeTarget1 0;
BA_ "GenSigTimeoutTime_CADM" SG_ 1451 TBM_External_ChargeTarget1 0;
BA_ "GenSigTimeoutTime_DMSM" SG_ 1451 TBM_External_ChargeTarget1 0;
BA_ "GenSigTimeoutTime_DTCM" SG_ 1451 TBM_External_ChargeTarget1 0;
BA_ "GenSigTimeoutTime_ECM" SG_ 1451 TBM_External_ChargeTarget1 0;
BA_ "GenSigTimeoutTime_GNMM" SG_ 1451 TBM_External_ChargeTarget1 0;
BA_ "GenSigTimeoutTime_HCP" SG_ 1451 TBM_External_ChargeTarget1 0;
BA_ "GenSigTimeoutTime_IPC" SG_ 1451 TBM_External_ChargeTarget1 0;
BA_ "GenSigTimeoutTime_RFHM" SG_ 1451 TBM_External_ChargeTarget1 0;
BA_ "GenSigTimeoutTime_SGW" SG_ 1451 TBM_External_ChargeTarget1 0;
BA_ "GenSigTimeoutTime_TCM" SG_ 1451 TBM_External_ChargeTarget1 0;
BA_ "GenSigStartValue" SG_ 1451 TBM_External_ChargeTarget2 15;
BA_ "GenSigTimeoutTime_AGSM" SG_ 1451 TBM_External_ChargeTarget2 0;
BA_ "GenSigTimeoutTime_BCM" SG_ 1451 TBM_External_ChargeTarget2 0;
BA_ "GenSigTimeoutTime_BSM" SG_ 1451 TBM_External_ChargeTarget2 0;
BA_ "GenSigTimeoutTime_CADM" SG_ 1451 TBM_External_ChargeTarget2 0;
BA_ "GenSigTimeoutTime_DMSM" SG_ 1451 TBM_External_ChargeTarget2 0;
BA_ "GenSigTimeoutTime_DTCM" SG_ 1451 TBM_External_ChargeTarget2 0;
BA_ "GenSigTimeoutTime_ECM" SG_ 1451 TBM_External_ChargeTarget2 0;
BA_ "GenSigTimeoutTime_GNMM" SG_ 1451 TBM_External_ChargeTarget2 0;
BA_ "GenSigTimeoutTime_HCP" SG_ 1451 TBM_External_ChargeTarget2 0;
BA_ "GenSigTimeoutTime_IPC" SG_ 1451 TBM_External_ChargeTarget2 0;
BA_ "GenSigTimeoutTime_RFHM" SG_ 1451 TBM_External_ChargeTarget2 0;
BA_ "GenSigTimeoutTime_SGW" SG_ 1451 TBM_External_ChargeTarget2 0;
BA_ "GenSigTimeoutTime_TCM" SG_ 1451 TBM_External_ChargeTarget2 0;
BA_ "GenSigStartValue" SG_ 1451 TBM_Immediate_ChargeTarget1 15;
BA_ "GenSigTimeoutTime_AGSM" SG_ 1451 TBM_Immediate_ChargeTarget1 0;
BA_ "GenSigTimeoutTime_BCM" SG_ 1451 TBM_Immediate_ChargeTarget1 0;
BA_ "GenSigTimeoutTime_BSM" SG_ 1451 TBM_Immediate_ChargeTarget1 0;
BA_ "GenSigTimeoutTime_CADM" SG_ 1451 TBM_Immediate_ChargeTarget1 0;
BA_ "GenSigTimeoutTime_DMSM" SG_ 1451 TBM_Immediate_ChargeTarget1 0;
BA_ "GenSigTimeoutTime_DTCM" SG_ 1451 TBM_Immediate_ChargeTarget1 0;
BA_ "GenSigTimeoutTime_ECM" SG_ 1451 TBM_Immediate_ChargeTarget1 0;
BA_ "GenSigTimeoutTime_GNMM" SG_ 1451 TBM_Immediate_ChargeTarget1 0;
BA_ "GenSigTimeoutTime_HCP" SG_ 1451 TBM_Immediate_ChargeTarget1 0;
BA_ "GenSigTimeoutTime_IPC" SG_ 1451 TBM_Immediate_ChargeTarget1 0;
BA_ "GenSigTimeoutTime_RFHM" SG_ 1451 TBM_Immediate_ChargeTarget1 0;
BA_ "GenSigTimeoutTime_SGW" SG_ 1451 TBM_Immediate_ChargeTarget1 0;
BA_ "GenSigTimeoutTime_TCM" SG_ 1451 TBM_Immediate_ChargeTarget1 0;
BA_ "GenSigStartValue" SG_ 1451 TBM_Immediate_ChargeTarget2 15;
BA_ "GenSigTimeoutTime_AGSM" SG_ 1451 TBM_Immediate_ChargeTarget2 0;
BA_ "GenSigTimeoutTime_BCM" SG_ 1451 TBM_Immediate_ChargeTarget2 0;
BA_ "GenSigTimeoutTime_BSM" SG_ 1451 TBM_Immediate_ChargeTarget2 0;
BA_ "GenSigTimeoutTime_CADM" SG_ 1451 TBM_Immediate_ChargeTarget2 0;
BA_ "GenSigTimeoutTime_DMSM" SG_ 1451 TBM_Immediate_ChargeTarget2 0;
BA_ "GenSigTimeoutTime_DTCM" SG_ 1451 TBM_Immediate_ChargeTarget2 0;
BA_ "GenSigTimeoutTime_ECM" SG_ 1451 TBM_Immediate_ChargeTarget2 0;
BA_ "GenSigTimeoutTime_GNMM" SG_ 1451 TBM_Immediate_ChargeTarget2 0;
BA_ "GenSigTimeoutTime_HCP" SG_ 1451 TBM_Immediate_ChargeTarget2 0;
BA_ "GenSigTimeoutTime_IPC" SG_ 1451 TBM_Immediate_ChargeTarget2 0;
BA_ "GenSigTimeoutTime_RFHM" SG_ 1451 TBM_Immediate_ChargeTarget2 0;
BA_ "GenSigTimeoutTime_SGW" SG_ 1451 TBM_Immediate_ChargeTarget2 0;
BA_ "GenSigTimeoutTime_TCM" SG_ 1451 TBM_Immediate_ChargeTarget2 0;
BA_ "GenSigTimeoutTime_AGSM" SG_ 1451 TBM_PowerLevel_Req 0;
BA_ "GenSigTimeoutTime_BCM" SG_ 1451 TBM_PowerLevel_Req 0;
BA_ "GenSigTimeoutTime_BSM" SG_ 1451 TBM_PowerLevel_Req 0;
BA_ "GenSigTimeoutTime_CADM" SG_ 1451 TBM_PowerLevel_Req 0;
BA_ "GenSigTimeoutTime_DMSM" SG_ 1451 TBM_PowerLevel_Req 0;
BA_ "GenSigTimeoutTime_DTCM" SG_ 1451 TBM_PowerLevel_Req 0;
BA_ "GenSigTimeoutTime_ECM" SG_ 1451 TBM_PowerLevel_Req 0;
BA_ "GenSigTimeoutTime_EVCU2" SG_ 1451 TBM_PowerLevel_Req 0;
BA_ "GenSigTimeoutTime_GNMM" SG_ 1451 TBM_PowerLevel_Req 0;
BA_ "GenSigTimeoutTime_HCP" SG_ 1451 TBM_PowerLevel_Req 0;
BA_ "GenSigTimeoutTime_RFHM" SG_ 1451 TBM_PowerLevel_Req 0;
BA_ "GenSigTimeoutTime_SGW" SG_ 1451 TBM_PowerLevel_Req 0;
BA_ "GenSigTimeoutTime_TCM" SG_ 1451 TBM_PowerLevel_Req 0;
BA_ "GenSigSendType" SG_ 1451 TBM_Schedule_Day1 3;
BA_ "GenSigTimeoutTime_AGSM" SG_ 1451 TBM_Schedule_Day1 0;
BA_ "GenSigTimeoutTime_BCM" SG_ 1451 TBM_Schedule_Day1 0;
BA_ "GenSigTimeoutTime_BSM" SG_ 1451 TBM_Schedule_Day1 0;
BA_ "GenSigTimeoutTime_CADM" SG_ 1451 TBM_Schedule_Day1 0;
BA_ "GenSigTimeoutTime_DMSM" SG_ 1451 TBM_Schedule_Day1 0;
BA_ "GenSigTimeoutTime_DTCM" SG_ 1451 TBM_Schedule_Day1 0;
BA_ "GenSigTimeoutTime_ECM" SG_ 1451 TBM_Schedule_Day1 0;
BA_ "GenSigTimeoutTime_GNMM" SG_ 1451 TBM_Schedule_Day1 0;
BA_ "GenSigTimeoutTime_HCP" SG_ 1451 TBM_Schedule_Day1 0;
BA_ "GenSigTimeoutTime_IPC" SG_ 1451 TBM_Schedule_Day1 0;
BA_ "GenSigTimeoutTime_RFHM" SG_ 1451 TBM_Schedule_Day1 0;
BA_ "GenSigTimeoutTime_SGW" SG_ 1451 TBM_Schedule_Day1 0;
BA_ "GenSigTimeoutTime_TCM" SG_ 1451 TBM_Schedule_Day1 0;
BA_ "GenSigSendType" SG_ 1451 TBM_Schedule_Day2 3;
BA_ "GenSigTimeoutTime_AGSM" SG_ 1451 TBM_Schedule_Day2 0;
BA_ "GenSigTimeoutTime_BCM" SG_ 1451 TBM_Schedule_Day2 0;
BA_ "GenSigTimeoutTime_BSM" SG_ 1451 TBM_Schedule_Day2 0;
BA_ "GenSigTimeoutTime_CADM" SG_ 1451 TBM_Schedule_Day2 0;
BA_ "GenSigTimeoutTime_DMSM" SG_ 1451 TBM_Schedule_Day2 0;
BA_ "GenSigTimeoutTime_DTCM" SG_ 1451 TBM_Schedule_Day2 0;
BA_ "GenSigTimeoutTime_ECM" SG_ 1451 TBM_Schedule_Day2 0;
BA_ "GenSigTimeoutTime_GNMM" SG_ 1451 TBM_Schedule_Day2 0;
BA_ "GenSigTimeoutTime_HCP" SG_ 1451 TBM_Schedule_Day2 0;
BA_ "GenSigTimeoutTime_IPC" SG_ 1451 TBM_Schedule_Day2 0;
BA_ "GenSigTimeoutTime_RFHM" SG_ 1451 TBM_Schedule_Day2 0;
BA_ "GenSigTimeoutTime_SGW" SG_ 1451 TBM_Schedule_Day2 0;
BA_ "GenSigTimeoutTime_TCM" SG_ 1451 TBM_Schedule_Day2 0;
BA_ "GenSigSendType" SG_ 1451 TBM_Start_Time_Hr1 3;
BA_ "GenSigTimeoutTime_AGSM" SG_ 1451 TBM_Start_Time_Hr1 0;
BA_ "GenSigTimeoutTime_BCM" SG_ 1451 TBM_Start_Time_Hr1 0;
BA_ "GenSigTimeoutTime_BSM" SG_ 1451 TBM_Start_Time_Hr1 0;
BA_ "GenSigTimeoutTime_CADM" SG_ 1451 TBM_Start_Time_Hr1 0;
BA_ "GenSigTimeoutTime_DMSM" SG_ 1451 TBM_Start_Time_Hr1 0;
BA_ "GenSigTimeoutTime_DTCM" SG_ 1451 TBM_Start_Time_Hr1 0;
BA_ "GenSigTimeoutTime_ECM" SG_ 1451 TBM_Start_Time_Hr1 0;
BA_ "GenSigTimeoutTime_GNMM" SG_ 1451 TBM_Start_Time_Hr1 0;
BA_ "GenSigTimeoutTime_HCP" SG_ 1451 TBM_Start_Time_Hr1 0;
BA_ "GenSigTimeoutTime_IPC" SG_ 1451 TBM_Start_Time_Hr1 0;
BA_ "GenSigTimeoutTime_RFHM" SG_ 1451 TBM_Start_Time_Hr1 0;
BA_ "GenSigTimeoutTime_SGW" SG_ 1451 TBM_Start_Time_Hr1 0;
BA_ "GenSigTimeoutTime_TCM" SG_ 1451 TBM_Start_Time_Hr1 0;
BA_ "GenSigSendType" SG_ 1451 TBM_Start_Time_Hr2 3;
BA_ "GenSigTimeoutTime_AGSM" SG_ 1451 TBM_Start_Time_Hr2 0;
BA_ "GenSigTimeoutTime_BCM" SG_ 1451 TBM_Start_Time_Hr2 0;
BA_ "GenSigTimeoutTime_BSM" SG_ 1451 TBM_Start_Time_Hr2 0;
BA_ "GenSigTimeoutTime_CADM" SG_ 1451 TBM_Start_Time_Hr2 0;
BA_ "GenSigTimeoutTime_DMSM" SG_ 1451 TBM_Start_Time_Hr2 0;
BA_ "GenSigTimeoutTime_DTCM" SG_ 1451 TBM_Start_Time_Hr2 0;
BA_ "GenSigTimeoutTime_ECM" SG_ 1451 TBM_Start_Time_Hr2 0;
BA_ "GenSigTimeoutTime_GNMM" SG_ 1451 TBM_Start_Time_Hr2 0;
BA_ "GenSigTimeoutTime_HCP" SG_ 1451 TBM_Start_Time_Hr2 0;
BA_ "GenSigTimeoutTime_IPC" SG_ 1451 TBM_Start_Time_Hr2 0;
BA_ "GenSigTimeoutTime_RFHM" SG_ 1451 TBM_Start_Time_Hr2 0;
BA_ "GenSigTimeoutTime_SGW" SG_ 1451 TBM_Start_Time_Hr2 0;
BA_ "GenSigTimeoutTime_TCM" SG_ 1451 TBM_Start_Time_Hr2 0;
BA_ "GenSigSendType" SG_ 1451 TBM_Start_Time_Min1 3;
BA_ "GenSigTimeoutTime_AGSM" SG_ 1451 TBM_Start_Time_Min1 0;
BA_ "GenSigTimeoutTime_BCM" SG_ 1451 TBM_Start_Time_Min1 0;
BA_ "GenSigTimeoutTime_BSM" SG_ 1451 TBM_Start_Time_Min1 0;
BA_ "GenSigTimeoutTime_CADM" SG_ 1451 TBM_Start_Time_Min1 0;
BA_ "GenSigTimeoutTime_DMSM" SG_ 1451 TBM_Start_Time_Min1 0;
BA_ "GenSigTimeoutTime_DTCM" SG_ 1451 TBM_Start_Time_Min1 0;
BA_ "GenSigTimeoutTime_ECM" SG_ 1451 TBM_Start_Time_Min1 0;
BA_ "GenSigTimeoutTime_GNMM" SG_ 1451 TBM_Start_Time_Min1 0;
BA_ "GenSigTimeoutTime_HCP" SG_ 1451 TBM_Start_Time_Min1 0;
BA_ "GenSigTimeoutTime_IPC" SG_ 1451 TBM_Start_Time_Min1 0;
BA_ "GenSigTimeoutTime_RFHM" SG_ 1451 TBM_Start_Time_Min1 0;
BA_ "GenSigTimeoutTime_SGW" SG_ 1451 TBM_Start_Time_Min1 0;
BA_ "GenSigTimeoutTime_TCM" SG_ 1451 TBM_Start_Time_Min1 0;
BA_ "GenSigSendType" SG_ 1451 TBM_Start_Time_Min2 3;
BA_ "GenSigTimeoutTime_AGSM" SG_ 1451 TBM_Start_Time_Min2 0;
BA_ "GenSigTimeoutTime_BCM" SG_ 1451 TBM_Start_Time_Min2 0;
BA_ "GenSigTimeoutTime_BSM" SG_ 1451 TBM_Start_Time_Min2 0;
BA_ "GenSigTimeoutTime_CADM" SG_ 1451 TBM_Start_Time_Min2 0;
BA_ "GenSigTimeoutTime_DMSM" SG_ 1451 TBM_Start_Time_Min2 0;
BA_ "GenSigTimeoutTime_DTCM" SG_ 1451 TBM_Start_Time_Min2 0;
BA_ "GenSigTimeoutTime_ECM" SG_ 1451 TBM_Start_Time_Min2 0;
BA_ "GenSigTimeoutTime_GNMM" SG_ 1451 TBM_Start_Time_Min2 0;
BA_ "GenSigTimeoutTime_HCP" SG_ 1451 TBM_Start_Time_Min2 0;
BA_ "GenSigTimeoutTime_IPC" SG_ 1451 TBM_Start_Time_Min2 0;
BA_ "GenSigTimeoutTime_RFHM" SG_ 1451 TBM_Start_Time_Min2 0;
BA_ "GenSigTimeoutTime_SGW" SG_ 1451 TBM_Start_Time_Min2 0;
BA_ "GenSigTimeoutTime_TCM" SG_ 1451 TBM_Start_Time_Min2 0;
BA_ "GenSigSendType" SG_ 1451 TBM_Submit_Schedule1 3;
BA_ "GenSigTimeoutTime_AGSM" SG_ 1451 TBM_Submit_Schedule1 0;
BA_ "GenSigTimeoutTime_BCM" SG_ 1451 TBM_Submit_Schedule1 0;
BA_ "GenSigTimeoutTime_BSM" SG_ 1451 TBM_Submit_Schedule1 0;
BA_ "GenSigTimeoutTime_CADM" SG_ 1451 TBM_Submit_Schedule1 0;
BA_ "GenSigTimeoutTime_DMSM" SG_ 1451 TBM_Submit_Schedule1 0;
BA_ "GenSigTimeoutTime_DTCM" SG_ 1451 TBM_Submit_Schedule1 0;
BA_ "GenSigTimeoutTime_ECM" SG_ 1451 TBM_Submit_Schedule1 0;
BA_ "GenSigTimeoutTime_GNMM" SG_ 1451 TBM_Submit_Schedule1 0;
BA_ "GenSigTimeoutTime_HCP" SG_ 1451 TBM_Submit_Schedule1 0;
BA_ "GenSigTimeoutTime_IPC" SG_ 1451 TBM_Submit_Schedule1 0;
BA_ "GenSigTimeoutTime_RFHM" SG_ 1451 TBM_Submit_Schedule1 0;
BA_ "GenSigTimeoutTime_SGW" SG_ 1451 TBM_Submit_Schedule1 0;
BA_ "GenSigTimeoutTime_TCM" SG_ 1451 TBM_Submit_Schedule1 0;
BA_ "GenSigSendType" SG_ 1451 TBM_Submit_Schedule2 3;
BA_ "GenSigTimeoutTime_AGSM" SG_ 1451 TBM_Submit_Schedule2 0;
BA_ "GenSigTimeoutTime_BCM" SG_ 1451 TBM_Submit_Schedule2 0;
BA_ "GenSigTimeoutTime_BSM" SG_ 1451 TBM_Submit_Schedule2 0;
BA_ "GenSigTimeoutTime_CADM" SG_ 1451 TBM_Submit_Schedule2 0;
BA_ "GenSigTimeoutTime_DMSM" SG_ 1451 TBM_Submit_Schedule2 0;
BA_ "GenSigTimeoutTime_DTCM" SG_ 1451 TBM_Submit_Schedule2 0;
BA_ "GenSigTimeoutTime_ECM" SG_ 1451 TBM_Submit_Schedule2 0;
BA_ "GenSigTimeoutTime_GNMM" SG_ 1451 TBM_Submit_Schedule2 0;
BA_ "GenSigTimeoutTime_HCP" SG_ 1451 TBM_Submit_Schedule2 0;
BA_ "GenSigTimeoutTime_IPC" SG_ 1451 TBM_Submit_Schedule2 0;
BA_ "GenSigTimeoutTime_RFHM" SG_ 1451 TBM_Submit_Schedule2 0;
BA_ "GenSigTimeoutTime_SGW" SG_ 1451 TBM_Submit_Schedule2 0;
BA_ "GenSigTimeoutTime_TCM" SG_ 1451 TBM_Submit_Schedule2 0;
BA_ "GenSigSendType" SG_ 1452 E_Call_Stat_TBM 3;
BA_ "GenSigTimeoutTime_AGSM" SG_ 1452 E_Call_Stat_TBM 0;
BA_ "GenSigTimeoutTime_BSM" SG_ 1452 E_Call_Stat_TBM 0;
BA_ "GenSigTimeoutTime_CADM" SG_ 1452 E_Call_Stat_TBM 0;
BA_ "GenSigTimeoutTime_DMSM" SG_ 1452 E_Call_Stat_TBM 0;
BA_ "GenSigTimeoutTime_DTCM" SG_ 1452 E_Call_Stat_TBM 0;
BA_ "GenSigTimeoutTime_ECM" SG_ 1452 E_Call_Stat_TBM 0;
BA_ "GenSigTimeoutTime_EVCU2" SG_ 1452 E_Call_Stat_TBM 0;
BA_ "GenSigTimeoutTime_GNMM" SG_ 1452 E_Call_Stat_TBM 0;
BA_ "GenSigTimeoutTime_HCP" SG_ 1452 E_Call_Stat_TBM 0;
BA_ "GenSigTimeoutTime_IPC" SG_ 1452 E_Call_Stat_TBM 0;
BA_ "GenSigTimeoutTime_RFHM" SG_ 1452 E_Call_Stat_TBM 0;
BA_ "GenSigTimeoutTime_SGW" SG_ 1452 E_Call_Stat_TBM 0;
BA_ "GenSigTimeoutTime_TCM" SG_ 1452 E_Call_Stat_TBM 0;
BA_ "GenSigSendType" SG_ 1452 PrivacyMode 3;
BA_ "GenSigTimeoutTime_AGSM" SG_ 1452 PrivacyMode 0;
BA_ "GenSigTimeoutTime_BCM" SG_ 1452 PrivacyMode 0;
BA_ "GenSigTimeoutTime_BSM" SG_ 1452 PrivacyMode 0;
BA_ "GenSigTimeoutTime_DMSM" SG_ 1452 PrivacyMode 0;
BA_ "GenSigTimeoutTime_DTCM" SG_ 1452 PrivacyMode 0;
BA_ "GenSigTimeoutTime_ECM" SG_ 1452 PrivacyMode 0;
BA_ "GenSigTimeoutTime_EVCU2" SG_ 1452 PrivacyMode 0;
BA_ "GenSigTimeoutTime_GNMM" SG_ 1452 PrivacyMode 0;
BA_ "GenSigTimeoutTime_HCP" SG_ 1452 PrivacyMode 0;
BA_ "GenSigTimeoutTime_IPC" SG_ 1452 PrivacyMode 0;
BA_ "GenSigTimeoutTime_RFHM" SG_ 1452 PrivacyMode 0;
BA_ "GenSigTimeoutTime_SGW" SG_ 1452 PrivacyMode 0;
BA_ "GenSigTimeoutTime_TCM" SG_ 1452 PrivacyMode 0;
BA_ "GenSigSendType" SG_ 1452 U_Call_Stat_TBM 3;
BA_ "GenSigTimeoutTime_AGSM" SG_ 1452 U_Call_Stat_TBM 0;
BA_ "GenSigTimeoutTime_BSM" SG_ 1452 U_Call_Stat_TBM 0;
BA_ "GenSigTimeoutTime_CADM" SG_ 1452 U_Call_Stat_TBM 0;
BA_ "GenSigTimeoutTime_DMSM" SG_ 1452 U_Call_Stat_TBM 0;
BA_ "GenSigTimeoutTime_DTCM" SG_ 1452 U_Call_Stat_TBM 0;
BA_ "GenSigTimeoutTime_ECM" SG_ 1452 U_Call_Stat_TBM 0;
BA_ "GenSigTimeoutTime_EVCU2" SG_ 1452 U_Call_Stat_TBM 0;
BA_ "GenSigTimeoutTime_GNMM" SG_ 1452 U_Call_Stat_TBM 0;
BA_ "GenSigTimeoutTime_HCP" SG_ 1452 U_Call_Stat_TBM 0;
BA_ "GenSigTimeoutTime_IPC" SG_ 1452 U_Call_Stat_TBM 0;
BA_ "GenSigTimeoutTime_RFHM" SG_ 1452 U_Call_Stat_TBM 0;
BA_ "GenSigTimeoutTime_SGW" SG_ 1452 U_Call_Stat_TBM 0;
BA_ "GenSigTimeoutTime_TCM" SG_ 1452 U_Call_Stat_TBM 0;
BA_ "GenSigTimeoutTime_AGSM" SG_ 2654814219 TCM_to_AZG1 0;
BA_ "GenSigTimeoutTime_BCM" SG_ 2654814219 TCM_to_AZG1 0;
BA_ "GenSigTimeoutTime_BSM" SG_ 2654814219 TCM_to_AZG1 0;
BA_ "GenSigTimeoutTime_CADM" SG_ 2654814219 TCM_to_AZG1 0;
BA_ "GenSigTimeoutTime_DMSM" SG_ 2654814219 TCM_to_AZG1 0;
BA_ "GenSigTimeoutTime_DTCM" SG_ 2654814219 TCM_to_AZG1 0;
BA_ "GenSigTimeoutTime_ECM" SG_ 2654814219 TCM_to_AZG1 0;
BA_ "GenSigTimeoutTime_EVCU2" SG_ 2654814219 TCM_to_AZG1 0;
BA_ "GenSigTimeoutTime_GNMM" SG_ 2654814219 TCM_to_AZG1 0;
BA_ "GenSigTimeoutTime_HCP" SG_ 2654814219 TCM_to_AZG1 0;
BA_ "GenSigTimeoutTime_IPC" SG_ 2654814219 TCM_to_AZG1 0;
BA_ "GenSigTimeoutTime_RFHM" SG_ 2654814219 TCM_to_AZG1 0;
BA_ "GenSigTimeoutTime_TCM" SG_ 2654814219 TCM_to_AZG1 0;
BA_ "GenSigTimeoutTime_AGSM" SG_ 2654814262 TCM_to_AZG2 0;
BA_ "GenSigTimeoutTime_BCM" SG_ 2654814262 TCM_to_AZG2 0;
BA_ "GenSigTimeoutTime_BSM" SG_ 2654814262 TCM_to_AZG2 0;
BA_ "GenSigTimeoutTime_CADM" SG_ 2654814262 TCM_to_AZG2 0;
BA_ "GenSigTimeoutTime_DMSM" SG_ 2654814262 TCM_to_AZG2 0;
BA_ "GenSigTimeoutTime_DTCM" SG_ 2654814262 TCM_to_AZG2 0;
BA_ "GenSigTimeoutTime_ECM" SG_ 2654814262 TCM_to_AZG2 0;
BA_ "GenSigTimeoutTime_EVCU2" SG_ 2654814262 TCM_to_AZG2 0;
BA_ "GenSigTimeoutTime_GNMM" SG_ 2654814262 TCM_to_AZG2 0;
BA_ "GenSigTimeoutTime_HCP" SG_ 2654814262 TCM_to_AZG2 0;
BA_ "GenSigTimeoutTime_IPC" SG_ 2654814262 TCM_to_AZG2 0;
BA_ "GenSigTimeoutTime_RFHM" SG_ 2654814262 TCM_to_AZG2 0;
BA_ "GenSigTimeoutTime_TCM" SG_ 2654814262 TCM_to_AZG2 0;
BA_ "GenSigTimeoutTime_AGSM" SG_ 2654814263 TCM_to_AZG3 0;
BA_ "GenSigTimeoutTime_BCM" SG_ 2654814263 TCM_to_AZG3 0;
BA_ "GenSigTimeoutTime_BSM" SG_ 2654814263 TCM_to_AZG3 0;
BA_ "GenSigTimeoutTime_CADM" SG_ 2654814263 TCM_to_AZG3 0;
BA_ "GenSigTimeoutTime_DMSM" SG_ 2654814263 TCM_to_AZG3 0;
BA_ "GenSigTimeoutTime_DTCM" SG_ 2654814263 TCM_to_AZG3 0;
BA_ "GenSigTimeoutTime_ECM" SG_ 2654814263 TCM_to_AZG3 0;
BA_ "GenSigTimeoutTime_EVCU2" SG_ 2654814263 TCM_to_AZG3 0;
BA_ "GenSigTimeoutTime_GNMM" SG_ 2654814263 TCM_to_AZG3 0;
BA_ "GenSigTimeoutTime_HCP" SG_ 2654814263 TCM_to_AZG3 0;
BA_ "GenSigTimeoutTime_IPC" SG_ 2654814263 TCM_to_AZG3 0;
BA_ "GenSigTimeoutTime_RFHM" SG_ 2654814263 TCM_to_AZG3 0;
BA_ "GenSigTimeoutTime_TCM" SG_ 2654814263 TCM_to_AZG3 0;
BA_ "GenSigTimeoutTime_AGSM" SG_ 2654814264 TRANSMISSION_APPL 0;
BA_ "GenSigTimeoutTime_BCM" SG_ 2654814264 TRANSMISSION_APPL 0;
BA_ "GenSigTimeoutTime_BSM" SG_ 2654814264 TRANSMISSION_APPL 0;
BA_ "GenSigTimeoutTime_CADM" SG_ 2654814264 TRANSMISSION_APPL 0;
BA_ "GenSigTimeoutTime_DMSM" SG_ 2654814264 TRANSMISSION_APPL 0;
BA_ "GenSigTimeoutTime_DTCM" SG_ 2654814264 TRANSMISSION_APPL 0;
BA_ "GenSigTimeoutTime_ECM" SG_ 2654814264 TRANSMISSION_APPL 0;
BA_ "GenSigTimeoutTime_EVCU2" SG_ 2654814264 TRANSMISSION_APPL 0;
BA_ "GenSigTimeoutTime_GNMM" SG_ 2654814264 TRANSMISSION_APPL 0;
BA_ "GenSigTimeoutTime_HCP" SG_ 2654814264 TRANSMISSION_APPL 0;
BA_ "GenSigTimeoutTime_IPC" SG_ 2654814264 TRANSMISSION_APPL 0;
BA_ "GenSigTimeoutTime_RFHM" SG_ 2654814264 TRANSMISSION_APPL 0;
BA_ "GenSigTimeoutTime_TCM" SG_ 2654814264 TRANSMISSION_APPL 0;
BA_ "GenSigSendType" SG_ 156 AUX1_HLEnbl_Req 3;
BA_ "GenSigTimeoutTime_AGSM" SG_ 156 AUX1_HLEnbl_Req 0;
BA_ "GenSigTimeoutTime_BCM" SG_ 156 AUX1_HLEnbl_Req 0;
BA_ "GenSigTimeoutTime_BSM" SG_ 156 AUX1_HLEnbl_Req 0;
BA_ "GenSigTimeoutTime_CADM" SG_ 156 AUX1_HLEnbl_Req 0;
BA_ "GenSigTimeoutTime_DMSM" SG_ 156 AUX1_HLEnbl_Req 0;
BA_ "GenSigTimeoutTime_DTCM" SG_ 156 AUX1_HLEnbl_Req 0;
BA_ "GenSigTimeoutTime_ECM" SG_ 156 AUX1_HLEnbl_Req 0;
BA_ "GenSigTimeoutTime_EVCU2" SG_ 156 AUX1_HLEnbl_Req 0;
BA_ "GenSigTimeoutTime_GNMM" SG_ 156 AUX1_HLEnbl_Req 0;
BA_ "GenSigTimeoutTime_HCP" SG_ 156 AUX1_HLEnbl_Req 0;
BA_ "GenSigTimeoutTime_RFHM" SG_ 156 AUX1_HLEnbl_Req 0;
BA_ "GenSigTimeoutTime_SGW" SG_ 156 AUX1_HLEnbl_Req 0;
BA_ "GenSigTimeoutTime_TCM" SG_ 156 AUX1_HLEnbl_Req 0;
BA_ "GenSigSendType" SG_ 156 AUX1_PWRMD_Req 3;
BA_ "GenSigTimeoutTime_AGSM" SG_ 156 AUX1_PWRMD_Req 0;
BA_ "GenSigTimeoutTime_BCM" SG_ 156 AUX1_PWRMD_Req 0;
BA_ "GenSigTimeoutTime_BSM" SG_ 156 AUX1_PWRMD_Req 0;
BA_ "GenSigTimeoutTime_CADM" SG_ 156 AUX1_PWRMD_Req 0;
BA_ "GenSigTimeoutTime_DMSM" SG_ 156 AUX1_PWRMD_Req 0;
BA_ "GenSigTimeoutTime_DTCM" SG_ 156 AUX1_PWRMD_Req 0;
BA_ "GenSigTimeoutTime_ECM" SG_ 156 AUX1_PWRMD_Req 0;
BA_ "GenSigTimeoutTime_EVCU2" SG_ 156 AUX1_PWRMD_Req 0;
BA_ "GenSigTimeoutTime_GNMM" SG_ 156 AUX1_PWRMD_Req 0;
BA_ "GenSigTimeoutTime_HCP" SG_ 156 AUX1_PWRMD_Req 0;
BA_ "GenSigTimeoutTime_RFHM" SG_ 156 AUX1_PWRMD_Req 0;
BA_ "GenSigTimeoutTime_SGW" SG_ 156 AUX1_PWRMD_Req 0;
BA_ "GenSigTimeoutTime_TCM" SG_ 156 AUX1_PWRMD_Req 0;
BA_ "GenSigSendType" SG_ 156 AUX1_TYPE_Req 3;
BA_ "GenSigTimeoutTime_AGSM" SG_ 156 AUX1_TYPE_Req 0;
BA_ "GenSigTimeoutTime_BCM" SG_ 156 AUX1_TYPE_Req 0;
BA_ "GenSigTimeoutTime_BSM" SG_ 156 AUX1_TYPE_Req 0;
BA_ "GenSigTimeoutTime_CADM" SG_ 156 AUX1_TYPE_Req 0;
BA_ "GenSigTimeoutTime_DMSM" SG_ 156 AUX1_TYPE_Req 0;
BA_ "GenSigTimeoutTime_DTCM" SG_ 156 AUX1_TYPE_Req 0;
BA_ "GenSigTimeoutTime_ECM" SG_ 156 AUX1_TYPE_Req 0;
BA_ "GenSigTimeoutTime_EVCU2" SG_ 156 AUX1_TYPE_Req 0;
BA_ "GenSigTimeoutTime_GNMM" SG_ 156 AUX1_TYPE_Req 0;
BA_ "GenSigTimeoutTime_HCP" SG_ 156 AUX1_TYPE_Req 0;
BA_ "GenSigTimeoutTime_RFHM" SG_ 156 AUX1_TYPE_Req 0;
BA_ "GenSigTimeoutTime_SGW" SG_ 156 AUX1_TYPE_Req 0;
BA_ "GenSigTimeoutTime_TCM" SG_ 156 AUX1_TYPE_Req 0;
BA_ "GenSigSendType" SG_ 156 AUX2_HLEnbl_Req 3;
BA_ "GenSigTimeoutTime_AGSM" SG_ 156 AUX2_HLEnbl_Req 0;
BA_ "GenSigTimeoutTime_BCM" SG_ 156 AUX2_HLEnbl_Req 0;
BA_ "GenSigTimeoutTime_BSM" SG_ 156 AUX2_HLEnbl_Req 0;
BA_ "GenSigTimeoutTime_CADM" SG_ 156 AUX2_HLEnbl_Req 0;
BA_ "GenSigTimeoutTime_DMSM" SG_ 156 AUX2_HLEnbl_Req 0;
BA_ "GenSigTimeoutTime_DTCM" SG_ 156 AUX2_HLEnbl_Req 0;
BA_ "GenSigTimeoutTime_ECM" SG_ 156 AUX2_HLEnbl_Req 0;
BA_ "GenSigTimeoutTime_EVCU2" SG_ 156 AUX2_HLEnbl_Req 0;
BA_ "GenSigTimeoutTime_GNMM" SG_ 156 AUX2_HLEnbl_Req 0;
BA_ "GenSigTimeoutTime_HCP" SG_ 156 AUX2_HLEnbl_Req 0;
BA_ "GenSigTimeoutTime_RFHM" SG_ 156 AUX2_HLEnbl_Req 0;
BA_ "GenSigTimeoutTime_SGW" SG_ 156 AUX2_HLEnbl_Req 0;
BA_ "GenSigTimeoutTime_TCM" SG_ 156 AUX2_HLEnbl_Req 0;
BA_ "GenSigSendType" SG_ 156 AUX2_PWRMD_Req 3;
BA_ "GenSigTimeoutTime_AGSM" SG_ 156 AUX2_PWRMD_Req 0;
BA_ "GenSigTimeoutTime_BCM" SG_ 156 AUX2_PWRMD_Req 0;
BA_ "GenSigTimeoutTime_BSM" SG_ 156 AUX2_PWRMD_Req 0;
BA_ "GenSigTimeoutTime_CADM" SG_ 156 AUX2_PWRMD_Req 0;
BA_ "GenSigTimeoutTime_DMSM" SG_ 156 AUX2_PWRMD_Req 0;
BA_ "GenSigTimeoutTime_DTCM" SG_ 156 AUX2_PWRMD_Req 0;
BA_ "GenSigTimeoutTime_ECM" SG_ 156 AUX2_PWRMD_Req 0;
BA_ "GenSigTimeoutTime_EVCU2" SG_ 156 AUX2_PWRMD_Req 0;
BA_ "GenSigTimeoutTime_GNMM" SG_ 156 AUX2_PWRMD_Req 0;
BA_ "GenSigTimeoutTime_HCP" SG_ 156 AUX2_PWRMD_Req 0;
BA_ "GenSigTimeoutTime_RFHM" SG_ 156 AUX2_PWRMD_Req 0;
BA_ "GenSigTimeoutTime_SGW" SG_ 156 AUX2_PWRMD_Req 0;
BA_ "GenSigTimeoutTime_TCM" SG_ 156 AUX2_PWRMD_Req 0;
BA_ "GenSigSendType" SG_ 156 AUX2_TYPE_Req 3;
BA_ "GenSigTimeoutTime_AGSM" SG_ 156 AUX2_TYPE_Req 0;
BA_ "GenSigTimeoutTime_BCM" SG_ 156 AUX2_TYPE_Req 0;
BA_ "GenSigTimeoutTime_BSM" SG_ 156 AUX2_TYPE_Req 0;
BA_ "GenSigTimeoutTime_CADM" SG_ 156 AUX2_TYPE_Req 0;
BA_ "GenSigTimeoutTime_DMSM" SG_ 156 AUX2_TYPE_Req 0;
BA_ "GenSigTimeoutTime_DTCM" SG_ 156 AUX2_TYPE_Req 0;
BA_ "GenSigTimeoutTime_ECM" SG_ 156 AUX2_TYPE_Req 0;
BA_ "GenSigTimeoutTime_EVCU2" SG_ 156 AUX2_TYPE_Req 0;
BA_ "GenSigTimeoutTime_GNMM" SG_ 156 AUX2_TYPE_Req 0;
BA_ "GenSigTimeoutTime_HCP" SG_ 156 AUX2_TYPE_Req 0;
BA_ "GenSigTimeoutTime_RFHM" SG_ 156 AUX2_TYPE_Req 0;
BA_ "GenSigTimeoutTime_SGW" SG_ 156 AUX2_TYPE_Req 0;
BA_ "GenSigTimeoutTime_TCM" SG_ 156 AUX2_TYPE_Req 0;
BA_ "GenSigSendType" SG_ 156 AUX3_HLEnbl_Req 3;
BA_ "GenSigTimeoutTime_AGSM" SG_ 156 AUX3_HLEnbl_Req 0;
BA_ "GenSigTimeoutTime_BCM" SG_ 156 AUX3_HLEnbl_Req 0;
BA_ "GenSigTimeoutTime_BSM" SG_ 156 AUX3_HLEnbl_Req 0;
BA_ "GenSigTimeoutTime_CADM" SG_ 156 AUX3_HLEnbl_Req 0;
BA_ "GenSigTimeoutTime_DMSM" SG_ 156 AUX3_HLEnbl_Req 0;
BA_ "GenSigTimeoutTime_DTCM" SG_ 156 AUX3_HLEnbl_Req 0;
BA_ "GenSigTimeoutTime_ECM" SG_ 156 AUX3_HLEnbl_Req 0;
BA_ "GenSigTimeoutTime_EVCU2" SG_ 156 AUX3_HLEnbl_Req 0;
BA_ "GenSigTimeoutTime_GNMM" SG_ 156 AUX3_HLEnbl_Req 0;
BA_ "GenSigTimeoutTime_HCP" SG_ 156 AUX3_HLEnbl_Req 0;
BA_ "GenSigTimeoutTime_RFHM" SG_ 156 AUX3_HLEnbl_Req 0;
BA_ "GenSigTimeoutTime_SGW" SG_ 156 AUX3_HLEnbl_Req 0;
BA_ "GenSigTimeoutTime_TCM" SG_ 156 AUX3_HLEnbl_Req 0;
BA_ "GenSigSendType" SG_ 156 AUX3_PWRMD_Req 3;
BA_ "GenSigTimeoutTime_AGSM" SG_ 156 AUX3_PWRMD_Req 0;
BA_ "GenSigTimeoutTime_BCM" SG_ 156 AUX3_PWRMD_Req 0;
BA_ "GenSigTimeoutTime_BSM" SG_ 156 AUX3_PWRMD_Req 0;
BA_ "GenSigTimeoutTime_CADM" SG_ 156 AUX3_PWRMD_Req 0;
BA_ "GenSigTimeoutTime_DMSM" SG_ 156 AUX3_PWRMD_Req 0;
BA_ "GenSigTimeoutTime_DTCM" SG_ 156 AUX3_PWRMD_Req 0;
BA_ "GenSigTimeoutTime_ECM" SG_ 156 AUX3_PWRMD_Req 0;
BA_ "GenSigTimeoutTime_EVCU2" SG_ 156 AUX3_PWRMD_Req 0;
BA_ "GenSigTimeoutTime_GNMM" SG_ 156 AUX3_PWRMD_Req 0;
BA_ "GenSigTimeoutTime_HCP" SG_ 156 AUX3_PWRMD_Req 0;
BA_ "GenSigTimeoutTime_RFHM" SG_ 156 AUX3_PWRMD_Req 0;
BA_ "GenSigTimeoutTime_SGW" SG_ 156 AUX3_PWRMD_Req 0;
BA_ "GenSigTimeoutTime_TCM" SG_ 156 AUX3_PWRMD_Req 0;
BA_ "GenSigSendType" SG_ 156 AUX3_TYPE_Req 3;
BA_ "GenSigTimeoutTime_AGSM" SG_ 156 AUX3_TYPE_Req 0;
BA_ "GenSigTimeoutTime_BCM" SG_ 156 AUX3_TYPE_Req 0;
BA_ "GenSigTimeoutTime_BSM" SG_ 156 AUX3_TYPE_Req 0;
BA_ "GenSigTimeoutTime_CADM" SG_ 156 AUX3_TYPE_Req 0;
BA_ "GenSigTimeoutTime_DMSM" SG_ 156 AUX3_TYPE_Req 0;
BA_ "GenSigTimeoutTime_DTCM" SG_ 156 AUX3_TYPE_Req 0;
BA_ "GenSigTimeoutTime_ECM" SG_ 156 AUX3_TYPE_Req 0;
BA_ "GenSigTimeoutTime_EVCU2" SG_ 156 AUX3_TYPE_Req 0;
BA_ "GenSigTimeoutTime_GNMM" SG_ 156 AUX3_TYPE_Req 0;
BA_ "GenSigTimeoutTime_HCP" SG_ 156 AUX3_TYPE_Req 0;
BA_ "GenSigTimeoutTime_RFHM" SG_ 156 AUX3_TYPE_Req 0;
BA_ "GenSigTimeoutTime_SGW" SG_ 156 AUX3_TYPE_Req 0;
BA_ "GenSigTimeoutTime_TCM" SG_ 156 AUX3_TYPE_Req 0;
BA_ "GenSigSendType" SG_ 156 AUX4_HLEnbl_Req 3;
BA_ "GenSigTimeoutTime_AGSM" SG_ 156 AUX4_HLEnbl_Req 0;
BA_ "GenSigTimeoutTime_BCM" SG_ 156 AUX4_HLEnbl_Req 0;
BA_ "GenSigTimeoutTime_BSM" SG_ 156 AUX4_HLEnbl_Req 0;
BA_ "GenSigTimeoutTime_CADM" SG_ 156 AUX4_HLEnbl_Req 0;
BA_ "GenSigTimeoutTime_DMSM" SG_ 156 AUX4_HLEnbl_Req 0;
BA_ "GenSigTimeoutTime_DTCM" SG_ 156 AUX4_HLEnbl_Req 0;
BA_ "GenSigTimeoutTime_ECM" SG_ 156 AUX4_HLEnbl_Req 0;
BA_ "GenSigTimeoutTime_EVCU2" SG_ 156 AUX4_HLEnbl_Req 0;
BA_ "GenSigTimeoutTime_GNMM" SG_ 156 AUX4_HLEnbl_Req 0;
BA_ "GenSigTimeoutTime_HCP" SG_ 156 AUX4_HLEnbl_Req 0;
BA_ "GenSigTimeoutTime_RFHM" SG_ 156 AUX4_HLEnbl_Req 0;
BA_ "GenSigTimeoutTime_SGW" SG_ 156 AUX4_HLEnbl_Req 0;
BA_ "GenSigTimeoutTime_TCM" SG_ 156 AUX4_HLEnbl_Req 0;
BA_ "GenSigSendType" SG_ 156 AUX4_PWRMD_Req 3;
BA_ "GenSigTimeoutTime_AGSM" SG_ 156 AUX4_PWRMD_Req 0;
BA_ "GenSigTimeoutTime_BCM" SG_ 156 AUX4_PWRMD_Req 0;
BA_ "GenSigTimeoutTime_BSM" SG_ 156 AUX4_PWRMD_Req 0;
BA_ "GenSigTimeoutTime_CADM" SG_ 156 AUX4_PWRMD_Req 0;
BA_ "GenSigTimeoutTime_DMSM" SG_ 156 AUX4_PWRMD_Req 0;
BA_ "GenSigTimeoutTime_DTCM" SG_ 156 AUX4_PWRMD_Req 0;
BA_ "GenSigTimeoutTime_ECM" SG_ 156 AUX4_PWRMD_Req 0;
BA_ "GenSigTimeoutTime_EVCU2" SG_ 156 AUX4_PWRMD_Req 0;
BA_ "GenSigTimeoutTime_GNMM" SG_ 156 AUX4_PWRMD_Req 0;
BA_ "GenSigTimeoutTime_HCP" SG_ 156 AUX4_PWRMD_Req 0;
BA_ "GenSigTimeoutTime_RFHM" SG_ 156 AUX4_PWRMD_Req 0;
BA_ "GenSigTimeoutTime_SGW" SG_ 156 AUX4_PWRMD_Req 0;
BA_ "GenSigTimeoutTime_TCM" SG_ 156 AUX4_PWRMD_Req 0;
BA_ "GenSigSendType" SG_ 156 AUX4_TYPE_Req 3;
BA_ "GenSigTimeoutTime_AGSM" SG_ 156 AUX4_TYPE_Req 0;
BA_ "GenSigTimeoutTime_BCM" SG_ 156 AUX4_TYPE_Req 0;
BA_ "GenSigTimeoutTime_BSM" SG_ 156 AUX4_TYPE_Req 0;
BA_ "GenSigTimeoutTime_CADM" SG_ 156 AUX4_TYPE_Req 0;
BA_ "GenSigTimeoutTime_DMSM" SG_ 156 AUX4_TYPE_Req 0;
BA_ "GenSigTimeoutTime_DTCM" SG_ 156 AUX4_TYPE_Req 0;
BA_ "GenSigTimeoutTime_ECM" SG_ 156 AUX4_TYPE_Req 0;
BA_ "GenSigTimeoutTime_EVCU2" SG_ 156 AUX4_TYPE_Req 0;
BA_ "GenSigTimeoutTime_GNMM" SG_ 156 AUX4_TYPE_Req 0;
BA_ "GenSigTimeoutTime_HCP" SG_ 156 AUX4_TYPE_Req 0;
BA_ "GenSigTimeoutTime_RFHM" SG_ 156 AUX4_TYPE_Req 0;
BA_ "GenSigTimeoutTime_SGW" SG_ 156 AUX4_TYPE_Req 0;
BA_ "GenSigTimeoutTime_TCM" SG_ 156 AUX4_TYPE_Req 0;
BA_ "GenSigSendType" SG_ 156 AUX5_HLEnbl_Req 4;
BA_ "GenSigTimeoutTime_AGSM" SG_ 156 AUX5_HLEnbl_Req 0;
BA_ "GenSigTimeoutTime_BCM" SG_ 156 AUX5_HLEnbl_Req 0;
BA_ "GenSigTimeoutTime_BSM" SG_ 156 AUX5_HLEnbl_Req 0;
BA_ "GenSigTimeoutTime_CADM" SG_ 156 AUX5_HLEnbl_Req 0;
BA_ "GenSigTimeoutTime_DMSM" SG_ 156 AUX5_HLEnbl_Req 0;
BA_ "GenSigTimeoutTime_DTCM" SG_ 156 AUX5_HLEnbl_Req 0;
BA_ "GenSigTimeoutTime_ECM" SG_ 156 AUX5_HLEnbl_Req 0;
BA_ "GenSigTimeoutTime_EVCU2" SG_ 156 AUX5_HLEnbl_Req 0;
BA_ "GenSigTimeoutTime_GNMM" SG_ 156 AUX5_HLEnbl_Req 0;
BA_ "GenSigTimeoutTime_HCP" SG_ 156 AUX5_HLEnbl_Req 0;
BA_ "GenSigTimeoutTime_RFHM" SG_ 156 AUX5_HLEnbl_Req 0;
BA_ "GenSigTimeoutTime_SGW" SG_ 156 AUX5_HLEnbl_Req 0;
BA_ "GenSigTimeoutTime_TCM" SG_ 156 AUX5_HLEnbl_Req 0;
BA_ "GenSigSendType" SG_ 156 AUX5_PWRMD_Req 4;
BA_ "GenSigTimeoutTime_AGSM" SG_ 156 AUX5_PWRMD_Req 0;
BA_ "GenSigTimeoutTime_BCM" SG_ 156 AUX5_PWRMD_Req 0;
BA_ "GenSigTimeoutTime_BSM" SG_ 156 AUX5_PWRMD_Req 0;
BA_ "GenSigTimeoutTime_CADM" SG_ 156 AUX5_PWRMD_Req 0;
BA_ "GenSigTimeoutTime_DMSM" SG_ 156 AUX5_PWRMD_Req 0;
BA_ "GenSigTimeoutTime_DTCM" SG_ 156 AUX5_PWRMD_Req 0;
BA_ "GenSigTimeoutTime_ECM" SG_ 156 AUX5_PWRMD_Req 0;
BA_ "GenSigTimeoutTime_EVCU2" SG_ 156 AUX5_PWRMD_Req 0;
BA_ "GenSigTimeoutTime_GNMM" SG_ 156 AUX5_PWRMD_Req 0;
BA_ "GenSigTimeoutTime_HCP" SG_ 156 AUX5_PWRMD_Req 0;
BA_ "GenSigTimeoutTime_RFHM" SG_ 156 AUX5_PWRMD_Req 0;
BA_ "GenSigTimeoutTime_SGW" SG_ 156 AUX5_PWRMD_Req 0;
BA_ "GenSigTimeoutTime_TCM" SG_ 156 AUX5_PWRMD_Req 0;
BA_ "GenSigSendType" SG_ 156 AUX5_TYPE_Req 3;
BA_ "GenSigTimeoutTime_AGSM" SG_ 156 AUX5_TYPE_Req 0;
BA_ "GenSigTimeoutTime_BCM" SG_ 156 AUX5_TYPE_Req 0;
BA_ "GenSigTimeoutTime_BSM" SG_ 156 AUX5_TYPE_Req 0;
BA_ "GenSigTimeoutTime_CADM" SG_ 156 AUX5_TYPE_Req 0;
BA_ "GenSigTimeoutTime_DMSM" SG_ 156 AUX5_TYPE_Req 0;
BA_ "GenSigTimeoutTime_DTCM" SG_ 156 AUX5_TYPE_Req 0;
BA_ "GenSigTimeoutTime_ECM" SG_ 156 AUX5_TYPE_Req 0;
BA_ "GenSigTimeoutTime_EVCU2" SG_ 156 AUX5_TYPE_Req 0;
BA_ "GenSigTimeoutTime_GNMM" SG_ 156 AUX5_TYPE_Req 0;
BA_ "GenSigTimeoutTime_HCP" SG_ 156 AUX5_TYPE_Req 0;
BA_ "GenSigTimeoutTime_RFHM" SG_ 156 AUX5_TYPE_Req 0;
BA_ "GenSigTimeoutTime_SGW" SG_ 156 AUX5_TYPE_Req 0;
BA_ "GenSigTimeoutTime_TCM" SG_ 156 AUX5_TYPE_Req 0;
BA_ "GenSigSendType" SG_ 156 AUX6_HLEnbl_Req 4;
BA_ "GenSigTimeoutTime_AGSM" SG_ 156 AUX6_HLEnbl_Req 0;
BA_ "GenSigTimeoutTime_BCM" SG_ 156 AUX6_HLEnbl_Req 0;
BA_ "GenSigTimeoutTime_BSM" SG_ 156 AUX6_HLEnbl_Req 0;
BA_ "GenSigTimeoutTime_CADM" SG_ 156 AUX6_HLEnbl_Req 0;
BA_ "GenSigTimeoutTime_DMSM" SG_ 156 AUX6_HLEnbl_Req 0;
BA_ "GenSigTimeoutTime_DTCM" SG_ 156 AUX6_HLEnbl_Req 0;
BA_ "GenSigTimeoutTime_ECM" SG_ 156 AUX6_HLEnbl_Req 0;
BA_ "GenSigTimeoutTime_EVCU2" SG_ 156 AUX6_HLEnbl_Req 0;
BA_ "GenSigTimeoutTime_GNMM" SG_ 156 AUX6_HLEnbl_Req 0;
BA_ "GenSigTimeoutTime_HCP" SG_ 156 AUX6_HLEnbl_Req 0;
BA_ "GenSigTimeoutTime_RFHM" SG_ 156 AUX6_HLEnbl_Req 0;
BA_ "GenSigTimeoutTime_SGW" SG_ 156 AUX6_HLEnbl_Req 0;
BA_ "GenSigTimeoutTime_TCM" SG_ 156 AUX6_HLEnbl_Req 0;
BA_ "GenSigSendType" SG_ 156 AUX6_PWRMD_Req 4;
BA_ "GenSigTimeoutTime_AGSM" SG_ 156 AUX6_PWRMD_Req 0;
BA_ "GenSigTimeoutTime_BCM" SG_ 156 AUX6_PWRMD_Req 0;
BA_ "GenSigTimeoutTime_BSM" SG_ 156 AUX6_PWRMD_Req 0;
BA_ "GenSigTimeoutTime_CADM" SG_ 156 AUX6_PWRMD_Req 0;
BA_ "GenSigTimeoutTime_DMSM" SG_ 156 AUX6_PWRMD_Req 0;
BA_ "GenSigTimeoutTime_DTCM" SG_ 156 AUX6_PWRMD_Req 0;
BA_ "GenSigTimeoutTime_ECM" SG_ 156 AUX6_PWRMD_Req 0;
BA_ "GenSigTimeoutTime_EVCU2" SG_ 156 AUX6_PWRMD_Req 0;
BA_ "GenSigTimeoutTime_GNMM" SG_ 156 AUX6_PWRMD_Req 0;
BA_ "GenSigTimeoutTime_HCP" SG_ 156 AUX6_PWRMD_Req 0;
BA_ "GenSigTimeoutTime_RFHM" SG_ 156 AUX6_PWRMD_Req 0;
BA_ "GenSigTimeoutTime_SGW" SG_ 156 AUX6_PWRMD_Req 0;
BA_ "GenSigTimeoutTime_TCM" SG_ 156 AUX6_PWRMD_Req 0;
BA_ "GenSigSendType" SG_ 156 AUX6_TYPE_Req 3;
BA_ "GenSigTimeoutTime_AGSM" SG_ 156 AUX6_TYPE_Req 0;
BA_ "GenSigTimeoutTime_BCM" SG_ 156 AUX6_TYPE_Req 0;
BA_ "GenSigTimeoutTime_BSM" SG_ 156 AUX6_TYPE_Req 0;
BA_ "GenSigTimeoutTime_CADM" SG_ 156 AUX6_TYPE_Req 0;
BA_ "GenSigTimeoutTime_DMSM" SG_ 156 AUX6_TYPE_Req 0;
BA_ "GenSigTimeoutTime_DTCM" SG_ 156 AUX6_TYPE_Req 0;
BA_ "GenSigTimeoutTime_ECM" SG_ 156 AUX6_TYPE_Req 0;
BA_ "GenSigTimeoutTime_EVCU2" SG_ 156 AUX6_TYPE_Req 0;
BA_ "GenSigTimeoutTime_GNMM" SG_ 156 AUX6_TYPE_Req 0;
BA_ "GenSigTimeoutTime_HCP" SG_ 156 AUX6_TYPE_Req 0;
BA_ "GenSigTimeoutTime_RFHM" SG_ 156 AUX6_TYPE_Req 0;
BA_ "GenSigTimeoutTime_SGW" SG_ 156 AUX6_TYPE_Req 0;
BA_ "GenSigTimeoutTime_TCM" SG_ 156 AUX6_TYPE_Req 0;
BA_ "GenSigSendType" SG_ 156 Day1_TLM 1;
BA_ "GenSigTimeoutTime_AGSM" SG_ 156 Day1_TLM 0;
BA_ "GenSigTimeoutTime_BCM" SG_ 156 Day1_TLM 0;
BA_ "GenSigTimeoutTime_BSM" SG_ 156 Day1_TLM 0;
BA_ "GenSigTimeoutTime_CADM" SG_ 156 Day1_TLM 0;
BA_ "GenSigTimeoutTime_DMSM" SG_ 156 Day1_TLM 0;
BA_ "GenSigTimeoutTime_DTCM" SG_ 156 Day1_TLM 0;
BA_ "GenSigTimeoutTime_GNMM" SG_ 156 Day1_TLM 0;
BA_ "GenSigTimeoutTime_HCP" SG_ 156 Day1_TLM 0;
BA_ "GenSigTimeoutTime_IPC" SG_ 156 Day1_TLM 0;
BA_ "GenSigTimeoutTime_SGW" SG_ 156 Day1_TLM 0;
BA_ "GenSigTimeoutTime_TCM" SG_ 156 Day1_TLM 0;
BA_ "GenSigTimeoutTime_AGSM" SG_ 156 Day2_TLM 0;
BA_ "GenSigTimeoutTime_BCM" SG_ 156 Day2_TLM 0;
BA_ "GenSigTimeoutTime_BSM" SG_ 156 Day2_TLM 0;
BA_ "GenSigTimeoutTime_CADM" SG_ 156 Day2_TLM 0;
BA_ "GenSigTimeoutTime_DMSM" SG_ 156 Day2_TLM 0;
BA_ "GenSigTimeoutTime_DTCM" SG_ 156 Day2_TLM 0;
BA_ "GenSigTimeoutTime_GNMM" SG_ 156 Day2_TLM 0;
BA_ "GenSigTimeoutTime_HCP" SG_ 156 Day2_TLM 0;
BA_ "GenSigTimeoutTime_IPC" SG_ 156 Day2_TLM 0;
BA_ "GenSigTimeoutTime_SGW" SG_ 156 Day2_TLM 0;
BA_ "GenSigTimeoutTime_TCM" SG_ 156 Day2_TLM 0;
BA_ "GenSigSendType" SG_ 156 Default_Ride_Height_Req 4;
BA_ "GenSigTimeoutTime_AGSM" SG_ 156 Default_Ride_Height_Req 0;
BA_ "GenSigTimeoutTime_BCM" SG_ 156 Default_Ride_Height_Req 0;
BA_ "GenSigTimeoutTime_BSM" SG_ 156 Default_Ride_Height_Req 0;
BA_ "GenSigTimeoutTime_CADM" SG_ 156 Default_Ride_Height_Req 0;
BA_ "GenSigTimeoutTime_DMSM" SG_ 156 Default_Ride_Height_Req 0;
BA_ "GenSigTimeoutTime_DTCM" SG_ 156 Default_Ride_Height_Req 0;
BA_ "GenSigTimeoutTime_ECM" SG_ 156 Default_Ride_Height_Req 0;
BA_ "GenSigTimeoutTime_EVCU2" SG_ 156 Default_Ride_Height_Req 0;
BA_ "GenSigTimeoutTime_GNMM" SG_ 156 Default_Ride_Height_Req 0;
BA_ "GenSigTimeoutTime_HCP" SG_ 156 Default_Ride_Height_Req 0;
BA_ "GenSigTimeoutTime_RFHM" SG_ 156 Default_Ride_Height_Req 0;
BA_ "GenSigTimeoutTime_SGW" SG_ 156 Default_Ride_Height_Req 0;
BA_ "GenSigTimeoutTime_TCM" SG_ 156 Default_Ride_Height_Req 0;
BA_ "GenSigStartValue" SG_ 156 Display_Synch_Req 1;
BA_ "GenSigSendType" SG_ 156 Display_Synch_Req 4;
BA_ "GenSigTimeoutTime_AGSM" SG_ 156 Display_Synch_Req 0;
BA_ "GenSigTimeoutTime_BCM" SG_ 156 Display_Synch_Req 0;
BA_ "GenSigTimeoutTime_BSM" SG_ 156 Display_Synch_Req 0;
BA_ "GenSigTimeoutTime_CADM" SG_ 156 Display_Synch_Req 0;
BA_ "GenSigTimeoutTime_DMSM" SG_ 156 Display_Synch_Req 0;
BA_ "GenSigTimeoutTime_DTCM" SG_ 156 Display_Synch_Req 0;
BA_ "GenSigTimeoutTime_ECM" SG_ 156 Display_Synch_Req 0;
BA_ "GenSigTimeoutTime_EVCU2" SG_ 156 Display_Synch_Req 0;
BA_ "GenSigTimeoutTime_GNMM" SG_ 156 Display_Synch_Req 0;
BA_ "GenSigTimeoutTime_HCP" SG_ 156 Display_Synch_Req 0;
BA_ "GenSigTimeoutTime_RFHM" SG_ 156 Display_Synch_Req 0;
BA_ "GenSigTimeoutTime_SGW" SG_ 156 Display_Synch_Req 0;
BA_ "GenSigTimeoutTime_TCM" SG_ 156 Display_Synch_Req 0;
BA_ "GenSigSendType" SG_ 156 Fuel_Saver_Display_Req 4;
BA_ "GenSigTimeoutTime_AGSM" SG_ 156 Fuel_Saver_Display_Req 0;
BA_ "GenSigTimeoutTime_BCM" SG_ 156 Fuel_Saver_Display_Req 0;
BA_ "GenSigTimeoutTime_BSM" SG_ 156 Fuel_Saver_Display_Req 0;
BA_ "GenSigTimeoutTime_CADM" SG_ 156 Fuel_Saver_Display_Req 0;
BA_ "GenSigTimeoutTime_DMSM" SG_ 156 Fuel_Saver_Display_Req 0;
BA_ "GenSigTimeoutTime_DTCM" SG_ 156 Fuel_Saver_Display_Req 0;
BA_ "GenSigTimeoutTime_ECM" SG_ 156 Fuel_Saver_Display_Req 0;
BA_ "GenSigTimeoutTime_EVCU2" SG_ 156 Fuel_Saver_Display_Req 0;
BA_ "GenSigTimeoutTime_GNMM" SG_ 156 Fuel_Saver_Display_Req 0;
BA_ "GenSigTimeoutTime_HCP" SG_ 156 Fuel_Saver_Display_Req 0;
BA_ "GenSigTimeoutTime_RFHM" SG_ 156 Fuel_Saver_Display_Req 0;
BA_ "GenSigTimeoutTime_SGW" SG_ 156 Fuel_Saver_Display_Req 0;
BA_ "GenSigTimeoutTime_TCM" SG_ 156 Fuel_Saver_Display_Req 0;
BA_ "GenSigStartValue" SG_ 156 GPS_Date_Day 255;
BA_ "GenSigTimeoutTime_AGSM" SG_ 156 GPS_Date_Day 0;
BA_ "GenSigTimeoutTime_BCM" SG_ 156 GPS_Date_Day 0;
BA_ "GenSigTimeoutTime_BSM" SG_ 156 GPS_Date_Day 0;
BA_ "GenSigTimeoutTime_CADM" SG_ 156 GPS_Date_Day 0;
BA_ "GenSigTimeoutTime_DTCM" SG_ 156 GPS_Date_Day 0;
BA_ "GenSigTimeoutTime_ECM" SG_ 156 GPS_Date_Day 0;
BA_ "GenSigTimeoutTime_GNMM" SG_ 156 GPS_Date_Day 0;
BA_ "GenSigTimeoutTime_HCP" SG_ 156 GPS_Date_Day 0;
BA_ "GenSigTimeoutTime_IPC" SG_ 156 GPS_Date_Day 0;
BA_ "GenSigTimeoutTime_SGW" SG_ 156 GPS_Date_Day 0;
BA_ "GenSigTimeoutTime_TCM" SG_ 156 GPS_Date_Day 0;
BA_ "GenSigStartValue" SG_ 156 GPS_Date_Month 255;
BA_ "GenSigTimeoutTime_AGSM" SG_ 156 GPS_Date_Month 0;
BA_ "GenSigTimeoutTime_BCM" SG_ 156 GPS_Date_Month 0;
BA_ "GenSigTimeoutTime_BSM" SG_ 156 GPS_Date_Month 0;
BA_ "GenSigTimeoutTime_CADM" SG_ 156 GPS_Date_Month 0;
BA_ "GenSigTimeoutTime_DTCM" SG_ 156 GPS_Date_Month 0;
BA_ "GenSigTimeoutTime_ECM" SG_ 156 GPS_Date_Month 0;
BA_ "GenSigTimeoutTime_GNMM" SG_ 156 GPS_Date_Month 0;
BA_ "GenSigTimeoutTime_HCP" SG_ 156 GPS_Date_Month 0;
BA_ "GenSigTimeoutTime_IPC" SG_ 156 GPS_Date_Month 0;
BA_ "GenSigTimeoutTime_SGW" SG_ 156 GPS_Date_Month 0;
BA_ "GenSigTimeoutTime_TCM" SG_ 156 GPS_Date_Month 0;
BA_ "GenSigStartValue" SG_ 156 GPS_Date_Year 65535;
BA_ "GenSigTimeoutTime_AGSM" SG_ 156 GPS_Date_Year 0;
BA_ "GenSigTimeoutTime_BCM" SG_ 156 GPS_Date_Year 0;
BA_ "GenSigTimeoutTime_BSM" SG_ 156 GPS_Date_Year 0;
BA_ "GenSigTimeoutTime_CADM" SG_ 156 GPS_Date_Year 0;
BA_ "GenSigTimeoutTime_DTCM" SG_ 156 GPS_Date_Year 0;
BA_ "GenSigTimeoutTime_ECM" SG_ 156 GPS_Date_Year 0;
BA_ "GenSigTimeoutTime_GNMM" SG_ 156 GPS_Date_Year 0;
BA_ "GenSigTimeoutTime_HCP" SG_ 156 GPS_Date_Year 0;
BA_ "GenSigTimeoutTime_IPC" SG_ 156 GPS_Date_Year 0;
BA_ "GenSigTimeoutTime_SGW" SG_ 156 GPS_Date_Year 0;
BA_ "GenSigTimeoutTime_TCM" SG_ 156 GPS_Date_Year 0;
BA_ "GenSigStartValue" SG_ 156 GPS_UTC_Hour 255;
BA_ "GenSigTimeoutTime_AGSM" SG_ 156 GPS_UTC_Hour 0;
BA_ "GenSigTimeoutTime_BCM" SG_ 156 GPS_UTC_Hour 0;
BA_ "GenSigTimeoutTime_BSM" SG_ 156 GPS_UTC_Hour 0;
BA_ "GenSigTimeoutTime_CADM" SG_ 156 GPS_UTC_Hour 0;
BA_ "GenSigTimeoutTime_DTCM" SG_ 156 GPS_UTC_Hour 0;
BA_ "GenSigTimeoutTime_ECM" SG_ 156 GPS_UTC_Hour 0;
BA_ "GenSigTimeoutTime_GNMM" SG_ 156 GPS_UTC_Hour 0;
BA_ "GenSigTimeoutTime_HCP" SG_ 156 GPS_UTC_Hour 0;
BA_ "GenSigTimeoutTime_IPC" SG_ 156 GPS_UTC_Hour 0;
BA_ "GenSigTimeoutTime_RFHM" SG_ 156 GPS_UTC_Hour 0;
BA_ "GenSigTimeoutTime_SGW" SG_ 156 GPS_UTC_Hour 0;
BA_ "GenSigTimeoutTime_TCM" SG_ 156 GPS_UTC_Hour 0;
BA_ "GenSigStartValue" SG_ 156 GPS_UTC_Minute 255;
BA_ "GenSigTimeoutTime_AGSM" SG_ 156 GPS_UTC_Minute 0;
BA_ "GenSigTimeoutTime_BCM" SG_ 156 GPS_UTC_Minute 0;
BA_ "GenSigTimeoutTime_BSM" SG_ 156 GPS_UTC_Minute 0;
BA_ "GenSigTimeoutTime_CADM" SG_ 156 GPS_UTC_Minute 0;
BA_ "GenSigTimeoutTime_DTCM" SG_ 156 GPS_UTC_Minute 0;
BA_ "GenSigTimeoutTime_ECM" SG_ 156 GPS_UTC_Minute 0;
BA_ "GenSigTimeoutTime_GNMM" SG_ 156 GPS_UTC_Minute 0;
BA_ "GenSigTimeoutTime_HCP" SG_ 156 GPS_UTC_Minute 0;
BA_ "GenSigTimeoutTime_IPC" SG_ 156 GPS_UTC_Minute 0;
BA_ "GenSigTimeoutTime_RFHM" SG_ 156 GPS_UTC_Minute 0;
BA_ "GenSigTimeoutTime_SGW" SG_ 156 GPS_UTC_Minute 0;
BA_ "GenSigTimeoutTime_TCM" SG_ 156 GPS_UTC_Minute 0;
BA_ "GenSigStartValue" SG_ 156 GPS_UTC_Second 65535;
BA_ "GenSigTimeoutTime_AGSM" SG_ 156 GPS_UTC_Second 0;
BA_ "GenSigTimeoutTime_BCM" SG_ 156 GPS_UTC_Second 0;
BA_ "GenSigTimeoutTime_BSM" SG_ 156 GPS_UTC_Second 0;
BA_ "GenSigTimeoutTime_CADM" SG_ 156 GPS_UTC_Second 0;
BA_ "GenSigTimeoutTime_DTCM" SG_ 156 GPS_UTC_Second 0;
BA_ "GenSigTimeoutTime_ECM" SG_ 156 GPS_UTC_Second 0;
BA_ "GenSigTimeoutTime_GNMM" SG_ 156 GPS_UTC_Second 0;
BA_ "GenSigTimeoutTime_HCP" SG_ 156 GPS_UTC_Second 0;
BA_ "GenSigTimeoutTime_IPC" SG_ 156 GPS_UTC_Second 0;
BA_ "GenSigTimeoutTime_RFHM" SG_ 156 GPS_UTC_Second 0;
BA_ "GenSigTimeoutTime_SGW" SG_ 156 GPS_UTC_Second 0;
BA_ "GenSigTimeoutTime_TCM" SG_ 156 GPS_UTC_Second 0;
BA_ "GenSigTimeoutTime_AGSM" SG_ 156 Hour1_TLM 0;
BA_ "GenSigTimeoutTime_BCM" SG_ 156 Hour1_TLM 0;
BA_ "GenSigTimeoutTime_BSM" SG_ 156 Hour1_TLM 0;
BA_ "GenSigTimeoutTime_CADM" SG_ 156 Hour1_TLM 0;
BA_ "GenSigTimeoutTime_DMSM" SG_ 156 Hour1_TLM 0;
BA_ "GenSigTimeoutTime_DTCM" SG_ 156 Hour1_TLM 0;
BA_ "GenSigTimeoutTime_GNMM" SG_ 156 Hour1_TLM 0;
BA_ "GenSigTimeoutTime_HCP" SG_ 156 Hour1_TLM 0;
BA_ "GenSigTimeoutTime_SGW" SG_ 156 Hour1_TLM 0;
BA_ "GenSigTimeoutTime_TCM" SG_ 156 Hour1_TLM 0;
BA_ "GenSigTimeoutTime_AGSM" SG_ 156 Hour2_TLM 0;
BA_ "GenSigTimeoutTime_BCM" SG_ 156 Hour2_TLM 0;
BA_ "GenSigTimeoutTime_BSM" SG_ 156 Hour2_TLM 0;
BA_ "GenSigTimeoutTime_CADM" SG_ 156 Hour2_TLM 0;
BA_ "GenSigTimeoutTime_DMSM" SG_ 156 Hour2_TLM 0;
BA_ "GenSigTimeoutTime_DTCM" SG_ 156 Hour2_TLM 0;
BA_ "GenSigTimeoutTime_GNMM" SG_ 156 Hour2_TLM 0;
BA_ "GenSigTimeoutTime_HCP" SG_ 156 Hour2_TLM 0;
BA_ "GenSigTimeoutTime_SGW" SG_ 156 Hour2_TLM 0;
BA_ "GenSigTimeoutTime_TCM" SG_ 156 Hour2_TLM 0;
BA_ "GenSigTimeoutTime_AGSM" SG_ 156 Minute1_TLM 0;
BA_ "GenSigTimeoutTime_BCM" SG_ 156 Minute1_TLM 0;
BA_ "GenSigTimeoutTime_BSM" SG_ 156 Minute1_TLM 0;
BA_ "GenSigTimeoutTime_CADM" SG_ 156 Minute1_TLM 0;
BA_ "GenSigTimeoutTime_DMSM" SG_ 156 Minute1_TLM 0;
BA_ "GenSigTimeoutTime_DTCM" SG_ 156 Minute1_TLM 0;
BA_ "GenSigTimeoutTime_GNMM" SG_ 156 Minute1_TLM 0;
BA_ "GenSigTimeoutTime_HCP" SG_ 156 Minute1_TLM 0;
BA_ "GenSigTimeoutTime_SGW" SG_ 156 Minute1_TLM 0;
BA_ "GenSigTimeoutTime_TCM" SG_ 156 Minute1_TLM 0;
BA_ "GenSigTimeoutTime_AGSM" SG_ 156 Minute2_TLM 0;
BA_ "GenSigTimeoutTime_BCM" SG_ 156 Minute2_TLM 0;
BA_ "GenSigTimeoutTime_BSM" SG_ 156 Minute2_TLM 0;
BA_ "GenSigTimeoutTime_CADM" SG_ 156 Minute2_TLM 0;
BA_ "GenSigTimeoutTime_DMSM" SG_ 156 Minute2_TLM 0;
BA_ "GenSigTimeoutTime_DTCM" SG_ 156 Minute2_TLM 0;
BA_ "GenSigTimeoutTime_GNMM" SG_ 156 Minute2_TLM 0;
BA_ "GenSigTimeoutTime_HCP" SG_ 156 Minute2_TLM 0;
BA_ "GenSigTimeoutTime_SGW" SG_ 156 Minute2_TLM 0;
BA_ "GenSigTimeoutTime_TCM" SG_ 156 Minute2_TLM 0;
BA_ "GenSigTimeoutTime_AGSM" SG_ 156 Month1_TLM 0;
BA_ "GenSigTimeoutTime_BCM" SG_ 156 Month1_TLM 0;
BA_ "GenSigTimeoutTime_BSM" SG_ 156 Month1_TLM 0;
BA_ "GenSigTimeoutTime_CADM" SG_ 156 Month1_TLM 0;
BA_ "GenSigTimeoutTime_DMSM" SG_ 156 Month1_TLM 0;
BA_ "GenSigTimeoutTime_DTCM" SG_ 156 Month1_TLM 0;
BA_ "GenSigTimeoutTime_GNMM" SG_ 156 Month1_TLM 0;
BA_ "GenSigTimeoutTime_HCP" SG_ 156 Month1_TLM 0;
BA_ "GenSigTimeoutTime_IPC" SG_ 156 Month1_TLM 0;
BA_ "GenSigTimeoutTime_SGW" SG_ 156 Month1_TLM 0;
BA_ "GenSigTimeoutTime_TCM" SG_ 156 Month1_TLM 0;
BA_ "GenSigTimeoutTime_AGSM" SG_ 156 Month2_TLM 0;
BA_ "GenSigTimeoutTime_BCM" SG_ 156 Month2_TLM 0;
BA_ "GenSigTimeoutTime_BSM" SG_ 156 Month2_TLM 0;
BA_ "GenSigTimeoutTime_CADM" SG_ 156 Month2_TLM 0;
BA_ "GenSigTimeoutTime_DMSM" SG_ 156 Month2_TLM 0;
BA_ "GenSigTimeoutTime_DTCM" SG_ 156 Month2_TLM 0;
BA_ "GenSigTimeoutTime_GNMM" SG_ 156 Month2_TLM 0;
BA_ "GenSigTimeoutTime_HCP" SG_ 156 Month2_TLM 0;
BA_ "GenSigTimeoutTime_IPC" SG_ 156 Month2_TLM 0;
BA_ "GenSigTimeoutTime_SGW" SG_ 156 Month2_TLM 0;
BA_ "GenSigTimeoutTime_TCM" SG_ 156 Month2_TLM 0;
BA_ "GenSigSendType" SG_ 156 ParkSenseSignalView_Req 4;
BA_ "GenSigTimeoutTime_AGSM" SG_ 156 ParkSenseSignalView_Req 0;
BA_ "GenSigTimeoutTime_BCM" SG_ 156 ParkSenseSignalView_Req 0;
BA_ "GenSigTimeoutTime_BSM" SG_ 156 ParkSenseSignalView_Req 0;
BA_ "GenSigTimeoutTime_CADM" SG_ 156 ParkSenseSignalView_Req 0;
BA_ "GenSigTimeoutTime_DMSM" SG_ 156 ParkSenseSignalView_Req 0;
BA_ "GenSigTimeoutTime_DTCM" SG_ 156 ParkSenseSignalView_Req 0;
BA_ "GenSigTimeoutTime_ECM" SG_ 156 ParkSenseSignalView_Req 0;
BA_ "GenSigTimeoutTime_EVCU2" SG_ 156 ParkSenseSignalView_Req 0;
BA_ "GenSigTimeoutTime_GNMM" SG_ 156 ParkSenseSignalView_Req 0;
BA_ "GenSigTimeoutTime_HCP" SG_ 156 ParkSenseSignalView_Req 0;
BA_ "GenSigTimeoutTime_RFHM" SG_ 156 ParkSenseSignalView_Req 0;
BA_ "GenSigTimeoutTime_SGW" SG_ 156 ParkSenseSignalView_Req 0;
BA_ "GenSigTimeoutTime_TCM" SG_ 156 ParkSenseSignalView_Req 0;
BA_ "GenSigStartValue" SG_ 156 PFTM_Alert_Req 1;
BA_ "GenSigSendType" SG_ 156 PFTM_Alert_Req 3;
BA_ "GenSigTimeoutTime_AGSM" SG_ 156 PFTM_Alert_Req 0;
BA_ "GenSigTimeoutTime_BCM" SG_ 156 PFTM_Alert_Req 0;
BA_ "GenSigTimeoutTime_BSM" SG_ 156 PFTM_Alert_Req 0;
BA_ "GenSigTimeoutTime_CADM" SG_ 156 PFTM_Alert_Req 0;
BA_ "GenSigTimeoutTime_DMSM" SG_ 156 PFTM_Alert_Req 0;
BA_ "GenSigTimeoutTime_DTCM" SG_ 156 PFTM_Alert_Req 0;
BA_ "GenSigTimeoutTime_ECM" SG_ 156 PFTM_Alert_Req 0;
BA_ "GenSigTimeoutTime_EVCU2" SG_ 156 PFTM_Alert_Req 0;
BA_ "GenSigTimeoutTime_GNMM" SG_ 156 PFTM_Alert_Req 0;
BA_ "GenSigTimeoutTime_HCP" SG_ 156 PFTM_Alert_Req 0;
BA_ "GenSigTimeoutTime_RFHM" SG_ 156 PFTM_Alert_Req 0;
BA_ "GenSigTimeoutTime_SGW" SG_ 156 PFTM_Alert_Req 0;
BA_ "GenSigTimeoutTime_TCM" SG_ 156 PFTM_Alert_Req 0;
BA_ "GenSigStartValue" SG_ 156 PFTM_Enable_Req 1;
BA_ "GenSigSendType" SG_ 156 PFTM_Enable_Req 3;
BA_ "GenSigTimeoutTime_AGSM" SG_ 156 PFTM_Enable_Req 0;
BA_ "GenSigTimeoutTime_BCM" SG_ 156 PFTM_Enable_Req 0;
BA_ "GenSigTimeoutTime_BSM" SG_ 156 PFTM_Enable_Req 0;
BA_ "GenSigTimeoutTime_CADM" SG_ 156 PFTM_Enable_Req 0;
BA_ "GenSigTimeoutTime_DMSM" SG_ 156 PFTM_Enable_Req 0;
BA_ "GenSigTimeoutTime_DTCM" SG_ 156 PFTM_Enable_Req 0;
BA_ "GenSigTimeoutTime_ECM" SG_ 156 PFTM_Enable_Req 0;
BA_ "GenSigTimeoutTime_EVCU2" SG_ 156 PFTM_Enable_Req 0;
BA_ "GenSigTimeoutTime_GNMM" SG_ 156 PFTM_Enable_Req 0;
BA_ "GenSigTimeoutTime_HCP" SG_ 156 PFTM_Enable_Req 0;
BA_ "GenSigTimeoutTime_RFHM" SG_ 156 PFTM_Enable_Req 0;
BA_ "GenSigTimeoutTime_SGW" SG_ 156 PFTM_Enable_Req 0;
BA_ "GenSigTimeoutTime_TCM" SG_ 156 PFTM_Enable_Req 0;
BA_ "GenSigStartValue" SG_ 156 Rear_G_LGT_with_Cargo_Lights_Req 1;
BA_ "GenSigSendType" SG_ 156 Rear_G_LGT_with_Cargo_Lights_Req 4;
BA_ "GenSigTimeoutTime_AGSM" SG_ 156 Rear_G_LGT_with_Cargo_Lights_Req 0;
BA_ "GenSigTimeoutTime_BCM" SG_ 156 Rear_G_LGT_with_Cargo_Lights_Req 0;
BA_ "GenSigTimeoutTime_BSM" SG_ 156 Rear_G_LGT_with_Cargo_Lights_Req 0;
BA_ "GenSigTimeoutTime_CADM" SG_ 156 Rear_G_LGT_with_Cargo_Lights_Req 0;
BA_ "GenSigTimeoutTime_DMSM" SG_ 156 Rear_G_LGT_with_Cargo_Lights_Req 0;
BA_ "GenSigTimeoutTime_DTCM" SG_ 156 Rear_G_LGT_with_Cargo_Lights_Req 0;
BA_ "GenSigTimeoutTime_ECM" SG_ 156 Rear_G_LGT_with_Cargo_Lights_Req 0;
BA_ "GenSigTimeoutTime_EVCU2" SG_ 156 Rear_G_LGT_with_Cargo_Lights_Req 0;
BA_ "GenSigTimeoutTime_GNMM" SG_ 156 Rear_G_LGT_with_Cargo_Lights_Req 0;
BA_ "GenSigTimeoutTime_HCP" SG_ 156 Rear_G_LGT_with_Cargo_Lights_Req 0;
BA_ "GenSigTimeoutTime_RFHM" SG_ 156 Rear_G_LGT_with_Cargo_Lights_Req 0;
BA_ "GenSigTimeoutTime_SGW" SG_ 156 Rear_G_LGT_with_Cargo_Lights_Req 0;
BA_ "GenSigTimeoutTime_TCM" SG_ 156 Rear_G_LGT_with_Cargo_Lights_Req 0;
BA_ "GenSigSendType" SG_ 156 TSI_Offset_Kph_Req 1;
BA_ "GenSigTimeoutTime_AGSM" SG_ 156 TSI_Offset_Kph_Req 0;
BA_ "GenSigTimeoutTime_BCM" SG_ 156 TSI_Offset_Kph_Req 0;
BA_ "GenSigTimeoutTime_BSM" SG_ 156 TSI_Offset_Kph_Req 0;
BA_ "GenSigTimeoutTime_CADM" SG_ 156 TSI_Offset_Kph_Req 0;
BA_ "GenSigTimeoutTime_DMSM" SG_ 156 TSI_Offset_Kph_Req 0;
BA_ "GenSigTimeoutTime_DTCM" SG_ 156 TSI_Offset_Kph_Req 0;
BA_ "GenSigTimeoutTime_ECM" SG_ 156 TSI_Offset_Kph_Req 0;
BA_ "GenSigTimeoutTime_EVCU2" SG_ 156 TSI_Offset_Kph_Req 0;
BA_ "GenSigTimeoutTime_GNMM" SG_ 156 TSI_Offset_Kph_Req 0;
BA_ "GenSigTimeoutTime_HCP" SG_ 156 TSI_Offset_Kph_Req 0;
BA_ "GenSigTimeoutTime_RFHM" SG_ 156 TSI_Offset_Kph_Req 0;
BA_ "GenSigTimeoutTime_SGW" SG_ 156 TSI_Offset_Kph_Req 0;
BA_ "GenSigTimeoutTime_TCM" SG_ 156 TSI_Offset_Kph_Req 0;
BA_ "GenSigSendType" SG_ 156 TSI_Offset_Mph_Req 1;
BA_ "GenSigTimeoutTime_AGSM" SG_ 156 TSI_Offset_Mph_Req 0;
BA_ "GenSigTimeoutTime_BCM" SG_ 156 TSI_Offset_Mph_Req 0;
BA_ "GenSigTimeoutTime_BSM" SG_ 156 TSI_Offset_Mph_Req 0;
BA_ "GenSigTimeoutTime_CADM" SG_ 156 TSI_Offset_Mph_Req 0;
BA_ "GenSigTimeoutTime_DMSM" SG_ 156 TSI_Offset_Mph_Req 0;
BA_ "GenSigTimeoutTime_DTCM" SG_ 156 TSI_Offset_Mph_Req 0;
BA_ "GenSigTimeoutTime_ECM" SG_ 156 TSI_Offset_Mph_Req 0;
BA_ "GenSigTimeoutTime_EVCU2" SG_ 156 TSI_Offset_Mph_Req 0;
BA_ "GenSigTimeoutTime_GNMM" SG_ 156 TSI_Offset_Mph_Req 0;
BA_ "GenSigTimeoutTime_HCP" SG_ 156 TSI_Offset_Mph_Req 0;
BA_ "GenSigTimeoutTime_RFHM" SG_ 156 TSI_Offset_Mph_Req 0;
BA_ "GenSigTimeoutTime_SGW" SG_ 156 TSI_Offset_Mph_Req 0;
BA_ "GenSigTimeoutTime_TCM" SG_ 156 TSI_Offset_Mph_Req 0;
BA_ "GenSigSendType" SG_ 156 TurnSignalView_Req 4;
BA_ "GenSigTimeoutTime_AGSM" SG_ 156 TurnSignalView_Req 0;
BA_ "GenSigTimeoutTime_BCM" SG_ 156 TurnSignalView_Req 0;
BA_ "GenSigTimeoutTime_BSM" SG_ 156 TurnSignalView_Req 0;
BA_ "GenSigTimeoutTime_CADM" SG_ 156 TurnSignalView_Req 0;
BA_ "GenSigTimeoutTime_DMSM" SG_ 156 TurnSignalView_Req 0;
BA_ "GenSigTimeoutTime_DTCM" SG_ 156 TurnSignalView_Req 0;
BA_ "GenSigTimeoutTime_ECM" SG_ 156 TurnSignalView_Req 0;
BA_ "GenSigTimeoutTime_EVCU2" SG_ 156 TurnSignalView_Req 0;
BA_ "GenSigTimeoutTime_GNMM" SG_ 156 TurnSignalView_Req 0;
BA_ "GenSigTimeoutTime_HCP" SG_ 156 TurnSignalView_Req 0;
BA_ "GenSigTimeoutTime_RFHM" SG_ 156 TurnSignalView_Req 0;
BA_ "GenSigTimeoutTime_SGW" SG_ 156 TurnSignalView_Req 0;
BA_ "GenSigTimeoutTime_TCM" SG_ 156 TurnSignalView_Req 0;
BA_ "GenSigTimeoutTime_AGSM" SG_ 156 Year1_TLM 0;
BA_ "GenSigTimeoutTime_BCM" SG_ 156 Year1_TLM 0;
BA_ "GenSigTimeoutTime_BSM" SG_ 156 Year1_TLM 0;
BA_ "GenSigTimeoutTime_CADM" SG_ 156 Year1_TLM 0;
BA_ "GenSigTimeoutTime_DMSM" SG_ 156 Year1_TLM 0;
BA_ "GenSigTimeoutTime_DTCM" SG_ 156 Year1_TLM 0;
BA_ "GenSigTimeoutTime_GNMM" SG_ 156 Year1_TLM 0;
BA_ "GenSigTimeoutTime_HCP" SG_ 156 Year1_TLM 0;
BA_ "GenSigTimeoutTime_IPC" SG_ 156 Year1_TLM 0;
BA_ "GenSigTimeoutTime_SGW" SG_ 156 Year1_TLM 0;
BA_ "GenSigTimeoutTime_TCM" SG_ 156 Year1_TLM 0;
BA_ "GenSigTimeoutTime_AGSM" SG_ 156 Year2_TLM 0;
BA_ "GenSigTimeoutTime_BCM" SG_ 156 Year2_TLM 0;
BA_ "GenSigTimeoutTime_BSM" SG_ 156 Year2_TLM 0;
BA_ "GenSigTimeoutTime_CADM" SG_ 156 Year2_TLM 0;
BA_ "GenSigTimeoutTime_DMSM" SG_ 156 Year2_TLM 0;
BA_ "GenSigTimeoutTime_DTCM" SG_ 156 Year2_TLM 0;
BA_ "GenSigTimeoutTime_GNMM" SG_ 156 Year2_TLM 0;
BA_ "GenSigTimeoutTime_HCP" SG_ 156 Year2_TLM 0;
BA_ "GenSigTimeoutTime_IPC" SG_ 156 Year2_TLM 0;
BA_ "GenSigTimeoutTime_SGW" SG_ 156 Year2_TLM 0;
BA_ "GenSigTimeoutTime_TCM" SG_ 156 Year2_TLM 0;
BA_ "GenSigTimeoutTime_AGSM" SG_ 156 Year3_TLM 0;
BA_ "GenSigTimeoutTime_BCM" SG_ 156 Year3_TLM 0;
BA_ "GenSigTimeoutTime_BSM" SG_ 156 Year3_TLM 0;
BA_ "GenSigTimeoutTime_CADM" SG_ 156 Year3_TLM 0;
BA_ "GenSigTimeoutTime_DMSM" SG_ 156 Year3_TLM 0;
BA_ "GenSigTimeoutTime_DTCM" SG_ 156 Year3_TLM 0;
BA_ "GenSigTimeoutTime_GNMM" SG_ 156 Year3_TLM 0;
BA_ "GenSigTimeoutTime_HCP" SG_ 156 Year3_TLM 0;
BA_ "GenSigTimeoutTime_IPC" SG_ 156 Year3_TLM 0;
BA_ "GenSigTimeoutTime_SGW" SG_ 156 Year3_TLM 0;
BA_ "GenSigTimeoutTime_TCM" SG_ 156 Year3_TLM 0;
BA_ "GenSigTimeoutTime_AGSM" SG_ 156 Year4_TLM 0;
BA_ "GenSigTimeoutTime_BCM" SG_ 156 Year4_TLM 0;
BA_ "GenSigTimeoutTime_BSM" SG_ 156 Year4_TLM 0;
BA_ "GenSigTimeoutTime_CADM" SG_ 156 Year4_TLM 0;
BA_ "GenSigTimeoutTime_DMSM" SG_ 156 Year4_TLM 0;
BA_ "GenSigTimeoutTime_DTCM" SG_ 156 Year4_TLM 0;
BA_ "GenSigTimeoutTime_GNMM" SG_ 156 Year4_TLM 0;
BA_ "GenSigTimeoutTime_HCP" SG_ 156 Year4_TLM 0;
BA_ "GenSigTimeoutTime_IPC" SG_ 156 Year4_TLM 0;
BA_ "GenSigTimeoutTime_SGW" SG_ 156 Year4_TLM 0;
BA_ "GenSigTimeoutTime_TCM" SG_ 156 Year4_TLM 0;
BA_ "GenSigSendType" SG_ 608 BuiltUpArea_CS 3;
BA_ "GenSigTimeoutTime_AGSM" SG_ 608 BuiltUpArea_CS 0;
BA_ "GenSigTimeoutTime_BCM" SG_ 608 BuiltUpArea_CS 0;
BA_ "GenSigTimeoutTime_BSM" SG_ 608 BuiltUpArea_CS 0;
BA_ "GenSigTimeoutTime_DMSM" SG_ 608 BuiltUpArea_CS 0;
BA_ "GenSigTimeoutTime_DTCM" SG_ 608 BuiltUpArea_CS 0;
BA_ "GenSigTimeoutTime_ECM" SG_ 608 BuiltUpArea_CS 0;
BA_ "GenSigTimeoutTime_EVCU2" SG_ 608 BuiltUpArea_CS 0;
BA_ "GenSigTimeoutTime_GNMM" SG_ 608 BuiltUpArea_CS 0;
BA_ "GenSigTimeoutTime_HCP" SG_ 608 BuiltUpArea_CS 0;
BA_ "GenSigTimeoutTime_IPC" SG_ 608 BuiltUpArea_CS 0;
BA_ "GenSigTimeoutTime_RFHM" SG_ 608 BuiltUpArea_CS 0;
BA_ "GenSigTimeoutTime_SGW" SG_ 608 BuiltUpArea_CS 0;
BA_ "GenSigTimeoutTime_TCM" SG_ 608 BuiltUpArea_CS 0;
BA_ "GenSigTimeoutTime_AGSM" SG_ 608 CountryCode 0;
BA_ "GenSigTimeoutTime_BCM" SG_ 608 CountryCode 0;
BA_ "GenSigTimeoutTime_BSM" SG_ 608 CountryCode 0;
BA_ "GenSigTimeoutTime_DMSM" SG_ 608 CountryCode 0;
BA_ "GenSigTimeoutTime_DTCM" SG_ 608 CountryCode 0;
BA_ "GenSigTimeoutTime_ECM" SG_ 608 CountryCode 0;
BA_ "GenSigTimeoutTime_EVCU2" SG_ 608 CountryCode 0;
BA_ "GenSigTimeoutTime_GNMM" SG_ 608 CountryCode 0;
BA_ "GenSigTimeoutTime_HCP" SG_ 608 CountryCode 0;
BA_ "GenSigTimeoutTime_IPC" SG_ 608 CountryCode 0;
BA_ "GenSigTimeoutTime_RFHM" SG_ 608 CountryCode 0;
BA_ "GenSigTimeoutTime_SGW" SG_ 608 CountryCode 0;
BA_ "GenSigTimeoutTime_TCM" SG_ 608 CountryCode 0;
BA_ "GenSigTimeoutTime_AGSM" SG_ 608 CRC_Telematic11 0;
BA_ "GenSigTimeoutTime_BCM" SG_ 608 CRC_Telematic11 0;
BA_ "GenSigTimeoutTime_BSM" SG_ 608 CRC_Telematic11 0;
BA_ "GenSigTimeoutTime_DMSM" SG_ 608 CRC_Telematic11 0;
BA_ "GenSigTimeoutTime_DTCM" SG_ 608 CRC_Telematic11 0;
BA_ "GenSigTimeoutTime_ECM" SG_ 608 CRC_Telematic11 0;
BA_ "GenSigTimeoutTime_EVCU2" SG_ 608 CRC_Telematic11 0;
BA_ "GenSigTimeoutTime_GNMM" SG_ 608 CRC_Telematic11 0;
BA_ "GenSigTimeoutTime_HCP" SG_ 608 CRC_Telematic11 0;
BA_ "GenSigTimeoutTime_IPC" SG_ 608 CRC_Telematic11 0;
BA_ "GenSigTimeoutTime_RFHM" SG_ 608 CRC_Telematic11 0;
BA_ "GenSigTimeoutTime_SGW" SG_ 608 CRC_Telematic11 0;
BA_ "GenSigTimeoutTime_TCM" SG_ 608 CRC_Telematic11 0;
BA_ "GenSigTimeoutTime_AGSM" SG_ 608 DrvSide 0;
BA_ "GenSigTimeoutTime_BCM" SG_ 608 DrvSide 0;
BA_ "GenSigTimeoutTime_BSM" SG_ 608 DrvSide 0;
BA_ "GenSigTimeoutTime_DMSM" SG_ 608 DrvSide 0;
BA_ "GenSigTimeoutTime_DTCM" SG_ 608 DrvSide 0;
BA_ "GenSigTimeoutTime_ECM" SG_ 608 DrvSide 0;
BA_ "GenSigTimeoutTime_EVCU2" SG_ 608 DrvSide 0;
BA_ "GenSigTimeoutTime_GNMM" SG_ 608 DrvSide 0;
BA_ "GenSigTimeoutTime_HCP" SG_ 608 DrvSide 0;
BA_ "GenSigTimeoutTime_IPC" SG_ 608 DrvSide 0;
BA_ "GenSigTimeoutTime_RFHM" SG_ 608 DrvSide 0;
BA_ "GenSigTimeoutTime_SGW" SG_ 608 DrvSide 0;
BA_ "GenSigTimeoutTime_TCM" SG_ 608 DrvSide 0;
BA_ "GenSigSendType" SG_ 608 EffSpdLmt_CS 3;
BA_ "GenSigTimeoutTime_AGSM" SG_ 608 EffSpdLmt_CS 0;
BA_ "GenSigTimeoutTime_BCM" SG_ 608 EffSpdLmt_CS 0;
BA_ "GenSigTimeoutTime_BSM" SG_ 608 EffSpdLmt_CS 0;
BA_ "GenSigTimeoutTime_DMSM" SG_ 608 EffSpdLmt_CS 0;
BA_ "GenSigTimeoutTime_DTCM" SG_ 608 EffSpdLmt_CS 0;
BA_ "GenSigTimeoutTime_ECM" SG_ 608 EffSpdLmt_CS 0;
BA_ "GenSigTimeoutTime_EVCU2" SG_ 608 EffSpdLmt_CS 0;
BA_ "GenSigTimeoutTime_GNMM" SG_ 608 EffSpdLmt_CS 0;
BA_ "GenSigTimeoutTime_HCP" SG_ 608 EffSpdLmt_CS 0;
BA_ "GenSigTimeoutTime_RFHM" SG_ 608 EffSpdLmt_CS 0;
BA_ "GenSigTimeoutTime_SGW" SG_ 608 EffSpdLmt_CS 0;
BA_ "GenSigTimeoutTime_TCM" SG_ 608 EffSpdLmt_CS 0;
BA_ "GenSigSendType" SG_ 608 EffSpdLmtType_CS 3;
BA_ "GenSigTimeoutTime_AGSM" SG_ 608 EffSpdLmtType_CS 0;
BA_ "GenSigTimeoutTime_BCM" SG_ 608 EffSpdLmtType_CS 0;
BA_ "GenSigTimeoutTime_BSM" SG_ 608 EffSpdLmtType_CS 0;
BA_ "GenSigTimeoutTime_DMSM" SG_ 608 EffSpdLmtType_CS 0;
BA_ "GenSigTimeoutTime_DTCM" SG_ 608 EffSpdLmtType_CS 0;
BA_ "GenSigTimeoutTime_ECM" SG_ 608 EffSpdLmtType_CS 0;
BA_ "GenSigTimeoutTime_EVCU2" SG_ 608 EffSpdLmtType_CS 0;
BA_ "GenSigTimeoutTime_GNMM" SG_ 608 EffSpdLmtType_CS 0;
BA_ "GenSigTimeoutTime_HCP" SG_ 608 EffSpdLmtType_CS 0;
BA_ "GenSigTimeoutTime_IPC" SG_ 608 EffSpdLmtType_CS 0;
BA_ "GenSigTimeoutTime_RFHM" SG_ 608 EffSpdLmtType_CS 0;
BA_ "GenSigTimeoutTime_SGW" SG_ 608 EffSpdLmtType_CS 0;
BA_ "GenSigTimeoutTime_TCM" SG_ 608 EffSpdLmtType_CS 0;
BA_ "GenSigSendType" SG_ 608 ETM_ADS_MODE_REQ 3;
BA_ "GenSigTimeoutTime_AGSM" SG_ 608 ETM_ADS_MODE_REQ 0;
BA_ "GenSigTimeoutTime_BSM" SG_ 608 ETM_ADS_MODE_REQ 0;
BA_ "GenSigTimeoutTime_CADM" SG_ 608 ETM_ADS_MODE_REQ 0;
BA_ "GenSigTimeoutTime_DMSM" SG_ 608 ETM_ADS_MODE_REQ 0;
BA_ "GenSigTimeoutTime_DTCM" SG_ 608 ETM_ADS_MODE_REQ 0;
BA_ "GenSigTimeoutTime_ECM" SG_ 608 ETM_ADS_MODE_REQ 0;
BA_ "GenSigTimeoutTime_EVCU2" SG_ 608 ETM_ADS_MODE_REQ 0;
BA_ "GenSigTimeoutTime_GNMM" SG_ 608 ETM_ADS_MODE_REQ 0;
BA_ "GenSigTimeoutTime_HCP" SG_ 608 ETM_ADS_MODE_REQ 0;
BA_ "GenSigTimeoutTime_IPC" SG_ 608 ETM_ADS_MODE_REQ 0;
BA_ "GenSigTimeoutTime_RFHM" SG_ 608 ETM_ADS_MODE_REQ 0;
BA_ "GenSigTimeoutTime_SGW" SG_ 608 ETM_ADS_MODE_REQ 0;
BA_ "GenSigTimeoutTime_TCM" SG_ 608 ETM_ADS_MODE_REQ 0;
BA_ "GenSigSendType" SG_ 608 ETM_EPS_MODE_REQ 3;
BA_ "GenSigTimeoutTime_AGSM" SG_ 608 ETM_EPS_MODE_REQ 0;
BA_ "GenSigTimeoutTime_BSM" SG_ 608 ETM_EPS_MODE_REQ 0;
BA_ "GenSigTimeoutTime_CADM" SG_ 608 ETM_EPS_MODE_REQ 0;
BA_ "GenSigTimeoutTime_DMSM" SG_ 608 ETM_EPS_MODE_REQ 0;
BA_ "GenSigTimeoutTime_DTCM" SG_ 608 ETM_EPS_MODE_REQ 0;
BA_ "GenSigTimeoutTime_ECM" SG_ 608 ETM_EPS_MODE_REQ 0;
BA_ "GenSigTimeoutTime_EVCU2" SG_ 608 ETM_EPS_MODE_REQ 0;
BA_ "GenSigTimeoutTime_GNMM" SG_ 608 ETM_EPS_MODE_REQ 0;
BA_ "GenSigTimeoutTime_HCP" SG_ 608 ETM_EPS_MODE_REQ 0;
BA_ "GenSigTimeoutTime_IPC" SG_ 608 ETM_EPS_MODE_REQ 0;
BA_ "GenSigTimeoutTime_RFHM" SG_ 608 ETM_EPS_MODE_REQ 0;
BA_ "GenSigTimeoutTime_SGW" SG_ 608 ETM_EPS_MODE_REQ 0;
BA_ "GenSigTimeoutTime_TCM" SG_ 608 ETM_EPS_MODE_REQ 0;
BA_ "GenSigSendType" SG_ 608 ETM_PaddlesModeReq 3;
BA_ "GenSigTimeoutTime_AGSM" SG_ 608 ETM_PaddlesModeReq 0;
BA_ "GenSigTimeoutTime_BSM" SG_ 608 ETM_PaddlesModeReq 0;
BA_ "GenSigTimeoutTime_CADM" SG_ 608 ETM_PaddlesModeReq 0;
BA_ "GenSigTimeoutTime_DMSM" SG_ 608 ETM_PaddlesModeReq 0;
BA_ "GenSigTimeoutTime_DTCM" SG_ 608 ETM_PaddlesModeReq 0;
BA_ "GenSigTimeoutTime_ECM" SG_ 608 ETM_PaddlesModeReq 0;
BA_ "GenSigTimeoutTime_EVCU2" SG_ 608 ETM_PaddlesModeReq 0;
BA_ "GenSigTimeoutTime_GNMM" SG_ 608 ETM_PaddlesModeReq 0;
BA_ "GenSigTimeoutTime_HCP" SG_ 608 ETM_PaddlesModeReq 0;
BA_ "GenSigTimeoutTime_IPC" SG_ 608 ETM_PaddlesModeReq 0;
BA_ "GenSigTimeoutTime_RFHM" SG_ 608 ETM_PaddlesModeReq 0;
BA_ "GenSigTimeoutTime_SGW" SG_ 608 ETM_PaddlesModeReq 0;
BA_ "GenSigTimeoutTime_TCM" SG_ 608 ETM_PaddlesModeReq 0;
BA_ "GenSigSendType" SG_ 608 FormOfWay_CS 3;
BA_ "GenSigTimeoutTime_AGSM" SG_ 608 FormOfWay_CS 0;
BA_ "GenSigTimeoutTime_BCM" SG_ 608 FormOfWay_CS 0;
BA_ "GenSigTimeoutTime_BSM" SG_ 608 FormOfWay_CS 0;
BA_ "GenSigTimeoutTime_DMSM" SG_ 608 FormOfWay_CS 0;
BA_ "GenSigTimeoutTime_DTCM" SG_ 608 FormOfWay_CS 0;
BA_ "GenSigTimeoutTime_ECM" SG_ 608 FormOfWay_CS 0;
BA_ "GenSigTimeoutTime_EVCU2" SG_ 608 FormOfWay_CS 0;
BA_ "GenSigTimeoutTime_GNMM" SG_ 608 FormOfWay_CS 0;
BA_ "GenSigTimeoutTime_HCP" SG_ 608 FormOfWay_CS 0;
BA_ "GenSigTimeoutTime_IPC" SG_ 608 FormOfWay_CS 0;
BA_ "GenSigTimeoutTime_RFHM" SG_ 608 FormOfWay_CS 0;
BA_ "GenSigTimeoutTime_SGW" SG_ 608 FormOfWay_CS 0;
BA_ "GenSigTimeoutTime_TCM" SG_ 608 FormOfWay_CS 0;
BA_ "GenSigSendType" SG_ 608 FuncRoadClass_CS 3;
BA_ "GenSigTimeoutTime_AGSM" SG_ 608 FuncRoadClass_CS 0;
BA_ "GenSigTimeoutTime_BCM" SG_ 608 FuncRoadClass_CS 0;
BA_ "GenSigTimeoutTime_BSM" SG_ 608 FuncRoadClass_CS 0;
BA_ "GenSigTimeoutTime_DMSM" SG_ 608 FuncRoadClass_CS 0;
BA_ "GenSigTimeoutTime_DTCM" SG_ 608 FuncRoadClass_CS 0;
BA_ "GenSigTimeoutTime_ECM" SG_ 608 FuncRoadClass_CS 0;
BA_ "GenSigTimeoutTime_EVCU2" SG_ 608 FuncRoadClass_CS 0;
BA_ "GenSigTimeoutTime_GNMM" SG_ 608 FuncRoadClass_CS 0;
BA_ "GenSigTimeoutTime_HCP" SG_ 608 FuncRoadClass_CS 0;
BA_ "GenSigTimeoutTime_IPC" SG_ 608 FuncRoadClass_CS 0;
BA_ "GenSigTimeoutTime_RFHM" SG_ 608 FuncRoadClass_CS 0;
BA_ "GenSigTimeoutTime_SGW" SG_ 608 FuncRoadClass_CS 0;
BA_ "GenSigTimeoutTime_TCM" SG_ 608 FuncRoadClass_CS 0;
BA_ "GenSigSendType" SG_ 608 HU_Front_PAMRequestSts 3;
BA_ "GenSigTimeoutTime_AGSM" SG_ 608 HU_Front_PAMRequestSts 0;
BA_ "GenSigTimeoutTime_BSM" SG_ 608 HU_Front_PAMRequestSts 0;
BA_ "GenSigTimeoutTime_CADM" SG_ 608 HU_Front_PAMRequestSts 0;
BA_ "GenSigTimeoutTime_DMSM" SG_ 608 HU_Front_PAMRequestSts 0;
BA_ "GenSigTimeoutTime_DTCM" SG_ 608 HU_Front_PAMRequestSts 0;
BA_ "GenSigTimeoutTime_ECM" SG_ 608 HU_Front_PAMRequestSts 0;
BA_ "GenSigTimeoutTime_EVCU2" SG_ 608 HU_Front_PAMRequestSts 0;
BA_ "GenSigTimeoutTime_GNMM" SG_ 608 HU_Front_PAMRequestSts 0;
BA_ "GenSigTimeoutTime_HCP" SG_ 608 HU_Front_PAMRequestSts 0;
BA_ "GenSigTimeoutTime_IPC" SG_ 608 HU_Front_PAMRequestSts 0;
BA_ "GenSigTimeoutTime_RFHM" SG_ 608 HU_Front_PAMRequestSts 0;
BA_ "GenSigTimeoutTime_SGW" SG_ 608 HU_Front_PAMRequestSts 0;
BA_ "GenSigTimeoutTime_TCM" SG_ 608 HU_Front_PAMRequestSts 0;
BA_ "GenSigSendType" SG_ 608 HU_Iterate_Gain_Down 3;
BA_ "GenSigTimeoutTime_AGSM" SG_ 608 HU_Iterate_Gain_Down 0;
BA_ "GenSigTimeoutTime_BSM" SG_ 608 HU_Iterate_Gain_Down 0;
BA_ "GenSigTimeoutTime_CADM" SG_ 608 HU_Iterate_Gain_Down 0;
BA_ "GenSigTimeoutTime_DMSM" SG_ 608 HU_Iterate_Gain_Down 0;
BA_ "GenSigTimeoutTime_DTCM" SG_ 608 HU_Iterate_Gain_Down 0;
BA_ "GenSigTimeoutTime_ECM" SG_ 608 HU_Iterate_Gain_Down 0;
BA_ "GenSigTimeoutTime_EVCU2" SG_ 608 HU_Iterate_Gain_Down 0;
BA_ "GenSigTimeoutTime_GNMM" SG_ 608 HU_Iterate_Gain_Down 0;
BA_ "GenSigTimeoutTime_HCP" SG_ 608 HU_Iterate_Gain_Down 0;
BA_ "GenSigTimeoutTime_IPC" SG_ 608 HU_Iterate_Gain_Down 0;
BA_ "GenSigTimeoutTime_RFHM" SG_ 608 HU_Iterate_Gain_Down 0;
BA_ "GenSigTimeoutTime_SGW" SG_ 608 HU_Iterate_Gain_Down 0;
BA_ "GenSigTimeoutTime_TCM" SG_ 608 HU_Iterate_Gain_Down 0;
BA_ "GenSigSendType" SG_ 608 HU_Iterate_Gain_Up 3;
BA_ "GenSigTimeoutTime_AGSM" SG_ 608 HU_Iterate_Gain_Up 0;
BA_ "GenSigTimeoutTime_BSM" SG_ 608 HU_Iterate_Gain_Up 0;
BA_ "GenSigTimeoutTime_CADM" SG_ 608 HU_Iterate_Gain_Up 0;
BA_ "GenSigTimeoutTime_DMSM" SG_ 608 HU_Iterate_Gain_Up 0;
BA_ "GenSigTimeoutTime_DTCM" SG_ 608 HU_Iterate_Gain_Up 0;
BA_ "GenSigTimeoutTime_ECM" SG_ 608 HU_Iterate_Gain_Up 0;
BA_ "GenSigTimeoutTime_EVCU2" SG_ 608 HU_Iterate_Gain_Up 0;
BA_ "GenSigTimeoutTime_GNMM" SG_ 608 HU_Iterate_Gain_Up 0;
BA_ "GenSigTimeoutTime_HCP" SG_ 608 HU_Iterate_Gain_Up 0;
BA_ "GenSigTimeoutTime_IPC" SG_ 608 HU_Iterate_Gain_Up 0;
BA_ "GenSigTimeoutTime_RFHM" SG_ 608 HU_Iterate_Gain_Up 0;
BA_ "GenSigTimeoutTime_SGW" SG_ 608 HU_Iterate_Gain_Up 0;
BA_ "GenSigTimeoutTime_TCM" SG_ 608 HU_Iterate_Gain_Up 0;
BA_ "GenSigSendType" SG_ 608 HU_Rear_PAMRequestSts 3;
BA_ "GenSigTimeoutTime_AGSM" SG_ 608 HU_Rear_PAMRequestSts 0;
BA_ "GenSigTimeoutTime_BSM" SG_ 608 HU_Rear_PAMRequestSts 0;
BA_ "GenSigTimeoutTime_CADM" SG_ 608 HU_Rear_PAMRequestSts 0;
BA_ "GenSigTimeoutTime_DMSM" SG_ 608 HU_Rear_PAMRequestSts 0;
BA_ "GenSigTimeoutTime_DTCM" SG_ 608 HU_Rear_PAMRequestSts 0;
BA_ "GenSigTimeoutTime_ECM" SG_ 608 HU_Rear_PAMRequestSts 0;
BA_ "GenSigTimeoutTime_EVCU2" SG_ 608 HU_Rear_PAMRequestSts 0;
BA_ "GenSigTimeoutTime_GNMM" SG_ 608 HU_Rear_PAMRequestSts 0;
BA_ "GenSigTimeoutTime_HCP" SG_ 608 HU_Rear_PAMRequestSts 0;
BA_ "GenSigTimeoutTime_IPC" SG_ 608 HU_Rear_PAMRequestSts 0;
BA_ "GenSigTimeoutTime_RFHM" SG_ 608 HU_Rear_PAMRequestSts 0;
BA_ "GenSigTimeoutTime_SGW" SG_ 608 HU_Rear_PAMRequestSts 0;
BA_ "GenSigTimeoutTime_TCM" SG_ 608 HU_Rear_PAMRequestSts 0;
BA_ "GenSigSendType" SG_ 608 Launch_RPM_Selected_Setting2 3;
BA_ "GenSigTimeoutTime_AGSM" SG_ 608 Launch_RPM_Selected_Setting2 0;
BA_ "GenSigTimeoutTime_BCM" SG_ 608 Launch_RPM_Selected_Setting2 0;
BA_ "GenSigTimeoutTime_CADM" SG_ 608 Launch_RPM_Selected_Setting2 0;
BA_ "GenSigTimeoutTime_DMSM" SG_ 608 Launch_RPM_Selected_Setting2 0;
BA_ "GenSigTimeoutTime_DTCM" SG_ 608 Launch_RPM_Selected_Setting2 0;
BA_ "GenSigTimeoutTime_ECM" SG_ 608 Launch_RPM_Selected_Setting2 0;
BA_ "GenSigTimeoutTime_EVCU2" SG_ 608 Launch_RPM_Selected_Setting2 0;
BA_ "GenSigTimeoutTime_GNMM" SG_ 608 Launch_RPM_Selected_Setting2 0;
BA_ "GenSigTimeoutTime_HCP" SG_ 608 Launch_RPM_Selected_Setting2 0;
BA_ "GenSigTimeoutTime_IPC" SG_ 608 Launch_RPM_Selected_Setting2 0;
BA_ "GenSigTimeoutTime_RFHM" SG_ 608 Launch_RPM_Selected_Setting2 0;
BA_ "GenSigTimeoutTime_SGW" SG_ 608 Launch_RPM_Selected_Setting2 0;
BA_ "GenSigTimeoutTime_TCM" SG_ 608 Launch_RPM_Selected_Setting2 0;
BA_ "GenSigSendType" SG_ 608 Launch_Sft_Btn_status 3;
BA_ "GenSigTimeoutTime_AGSM" SG_ 608 Launch_Sft_Btn_status 0;
BA_ "GenSigTimeoutTime_BCM" SG_ 608 Launch_Sft_Btn_status 0;
BA_ "GenSigTimeoutTime_CADM" SG_ 608 Launch_Sft_Btn_status 0;
BA_ "GenSigTimeoutTime_DMSM" SG_ 608 Launch_Sft_Btn_status 0;
BA_ "GenSigTimeoutTime_DTCM" SG_ 608 Launch_Sft_Btn_status 0;
BA_ "GenSigTimeoutTime_ECM" SG_ 608 Launch_Sft_Btn_status 0;
BA_ "GenSigTimeoutTime_EVCU2" SG_ 608 Launch_Sft_Btn_status 0;
BA_ "GenSigTimeoutTime_GNMM" SG_ 608 Launch_Sft_Btn_status 0;
BA_ "GenSigTimeoutTime_HCP" SG_ 608 Launch_Sft_Btn_status 0;
BA_ "GenSigTimeoutTime_IPC" SG_ 608 Launch_Sft_Btn_status 0;
BA_ "GenSigTimeoutTime_RFHM" SG_ 608 Launch_Sft_Btn_status 0;
BA_ "GenSigTimeoutTime_SGW" SG_ 608 Launch_Sft_Btn_status 0;
BA_ "GenSigTimeoutTime_TCM" SG_ 608 Launch_Sft_Btn_status 0;
BA_ "GenSigTimeoutTime_AGSM" SG_ 608 MessageCounter_Telematic11 0;
BA_ "GenSigTimeoutTime_BCM" SG_ 608 MessageCounter_Telematic11 0;
BA_ "GenSigTimeoutTime_BSM" SG_ 608 MessageCounter_Telematic11 0;
BA_ "GenSigTimeoutTime_DMSM" SG_ 608 MessageCounter_Telematic11 0;
BA_ "GenSigTimeoutTime_DTCM" SG_ 608 MessageCounter_Telematic11 0;
BA_ "GenSigTimeoutTime_ECM" SG_ 608 MessageCounter_Telematic11 0;
BA_ "GenSigTimeoutTime_EVCU2" SG_ 608 MessageCounter_Telematic11 0;
BA_ "GenSigTimeoutTime_GNMM" SG_ 608 MessageCounter_Telematic11 0;
BA_ "GenSigTimeoutTime_HCP" SG_ 608 MessageCounter_Telematic11 0;
BA_ "GenSigTimeoutTime_IPC" SG_ 608 MessageCounter_Telematic11 0;
BA_ "GenSigTimeoutTime_RFHM" SG_ 608 MessageCounter_Telematic11 0;
BA_ "GenSigTimeoutTime_SGW" SG_ 608 MessageCounter_Telematic11 0;
BA_ "GenSigTimeoutTime_TCM" SG_ 608 MessageCounter_Telematic11 0;
BA_ "GenSigSendType" SG_ 608 NavDataAvailable_CS 3;
BA_ "GenSigTimeoutTime_AGSM" SG_ 608 NavDataAvailable_CS 0;
BA_ "GenSigTimeoutTime_BCM" SG_ 608 NavDataAvailable_CS 0;
BA_ "GenSigTimeoutTime_BSM" SG_ 608 NavDataAvailable_CS 0;
BA_ "GenSigTimeoutTime_DMSM" SG_ 608 NavDataAvailable_CS 0;
BA_ "GenSigTimeoutTime_DTCM" SG_ 608 NavDataAvailable_CS 0;
BA_ "GenSigTimeoutTime_ECM" SG_ 608 NavDataAvailable_CS 0;
BA_ "GenSigTimeoutTime_EVCU2" SG_ 608 NavDataAvailable_CS 0;
BA_ "GenSigTimeoutTime_GNMM" SG_ 608 NavDataAvailable_CS 0;
BA_ "GenSigTimeoutTime_HCP" SG_ 608 NavDataAvailable_CS 0;
BA_ "GenSigTimeoutTime_IPC" SG_ 608 NavDataAvailable_CS 0;
BA_ "GenSigTimeoutTime_RFHM" SG_ 608 NavDataAvailable_CS 0;
BA_ "GenSigTimeoutTime_SGW" SG_ 608 NavDataAvailable_CS 0;
BA_ "GenSigTimeoutTime_TCM" SG_ 608 NavDataAvailable_CS 0;
BA_ "GenSigSendType" SG_ 608 PathIdx_CS 3;
BA_ "GenSigTimeoutTime_AGSM" SG_ 608 PathIdx_CS 0;
BA_ "GenSigTimeoutTime_BCM" SG_ 608 PathIdx_CS 0;
BA_ "GenSigTimeoutTime_BSM" SG_ 608 PathIdx_CS 0;
BA_ "GenSigTimeoutTime_DMSM" SG_ 608 PathIdx_CS 0;
BA_ "GenSigTimeoutTime_DTCM" SG_ 608 PathIdx_CS 0;
BA_ "GenSigTimeoutTime_ECM" SG_ 608 PathIdx_CS 0;
BA_ "GenSigTimeoutTime_EVCU2" SG_ 608 PathIdx_CS 0;
BA_ "GenSigTimeoutTime_GNMM" SG_ 608 PathIdx_CS 0;
BA_ "GenSigTimeoutTime_HCP" SG_ 608 PathIdx_CS 0;
BA_ "GenSigTimeoutTime_IPC" SG_ 608 PathIdx_CS 0;
BA_ "GenSigTimeoutTime_RFHM" SG_ 608 PathIdx_CS 0;
BA_ "GenSigTimeoutTime_SGW" SG_ 608 PathIdx_CS 0;
BA_ "GenSigTimeoutTime_TCM" SG_ 608 PathIdx_CS 0;
BA_ "GenSigTimeoutTime_AGSM" SG_ 608 SpdUnits 0;
BA_ "GenSigTimeoutTime_BCM" SG_ 608 SpdUnits 0;
BA_ "GenSigTimeoutTime_BSM" SG_ 608 SpdUnits 0;
BA_ "GenSigTimeoutTime_DMSM" SG_ 608 SpdUnits 0;
BA_ "GenSigTimeoutTime_DTCM" SG_ 608 SpdUnits 0;
BA_ "GenSigTimeoutTime_ECM" SG_ 608 SpdUnits 0;
BA_ "GenSigTimeoutTime_EVCU2" SG_ 608 SpdUnits 0;
BA_ "GenSigTimeoutTime_GNMM" SG_ 608 SpdUnits 0;
BA_ "GenSigTimeoutTime_HCP" SG_ 608 SpdUnits 0;
BA_ "GenSigTimeoutTime_IPC" SG_ 608 SpdUnits 0;
BA_ "GenSigTimeoutTime_RFHM" SG_ 608 SpdUnits 0;
BA_ "GenSigTimeoutTime_SGW" SG_ 608 SpdUnits 0;
BA_ "GenSigTimeoutTime_TCM" SG_ 608 SpdUnits 0;
VAL_ 519 CustKeyInIgnSts 0 "CUST_KEY_DEFAULT" 1 "CUST_KEY_NOT_IN_IGNITION" 2 "CUST_KEY_IN_IGNITION" 3 "SNA";
VAL_ 519 DriverEngineOffRequest 0 "Not_Active" 1 "Active";
VAL_ 519 EcoTimer 0 "Not_Active" 1 "Active";
VAL_ 519 FSRExteriorFront 0 "NO_FOB_IN_ZONE" 1 "FOB_IN_ZONE";
VAL_ 519 FSRFrontTrunk 0 "NO_FOB_IN_ZONE" 1 "FOB_IN_ZONE";
VAL_ 519 IgnPosSts 0 "Initialization" 1 "IGN_LK" 3 "ACC" 4 "RUN" 5 "START" 7 "SNA";
VAL_ 519 KeyAuth_Status 0 "NONE" 1 "Auth_InProgress" 2 "Auth_CompletedSNA" 3 "Auth_Failed";
VAL_ 519 RFCfgReq 0 "DEFAULT" 1 "HORN_CHIRP_TOGGLE" 2 "OPTICAL_CHIRP_TOGGLE" 3 "DRIVER_UNLOCK_FIRST_TOGGLE" 7 "SNA";
VAL_ 519 RFFobNum3 0 "FOB_DEFAULT" 1 "FOB_1" 2 "FOB_2" 3 "FOB_3" 4 "FOB_4" 5 "FOB_5" 6 "FOB_6" 7 "FOB_7" 8 "FOB_8" 9 "KeySlotID_09" 10 "KeySlotID_10" 11 "KeySlotID_11" 12 "KeySlotID_12" 13 "KeySlotID_13" 14 "KeySlotID_14" 15 "KeySlotID_15" 16 "KeySlotID_16" 17 "KeySlotID_17" 18 "KeySlotID_18" 19 "KeySlotID_19" 20 "KeySlotID_20" 21 "KeySlotID_21" 22 "KeySlotID_22" 23 "KeySlotID_23" 24 "KeySlotID_24" 25 "KeySlotID_25" 26 "KeySlotID_26" 27 "KeySlotID_27" 28 "KeySlotID_28" 29 "KeySlotID_29" 30 "KeySlotID_30" 31 "KeySlotID_31" 32 "KeySlotID_32" 33 "KeySlotID_33" 34 "KeySlotID_34" 35 "KeySlotID_35" 36 "KeySlotID_36" 37 "KeySlotID_37" 38 "KeySlotID_38" 39 "KeySlotID_39" 40 "KeySlotID_40" 41 "KeySlotID_41" 42 "KeySlotID_42" 43 "KeySlotID_43" 44 "KeySlotID_44" 45 "KeySlotID_45" 46 "KeySlotID_46" 47 "KeySlotID_47" 48 "KeySlotID_48" 49 "KeySlotID_49" 50 "KeySlotID_50" 51 "KeySlotID_51" 52 "KeySlotID_52" 53 "KeySlotID_53" 54 "KeySlotID_54" 55 "KeySlotID_55" 56 "KeySlotID_56" 57 "KeySlotID_57" 58 "KeySlotID_58" 59 "KeySlotID_59" 60 "KeySlotID_60" 61 "KeySlotID_61" 62 "KeySlotID_62" 63 "KeySlotID_63" 64 "KeySlotID_64" 65 "KeySlotID_65" 66 "KeySlotID_66" 67 "KeySlotID_67" 68 "KeySlotID_68" 69 "KeySlotID_69" 70 "KeySlotID_70" 71 "KeySlotID_71" 72 "KeySlotID_72" 73 "KeySlotID_73" 74 "KeySlotID_74" 75 "KeySlotID_75" 76 "KeySlotID_76" 77 "KeySlotID_77" 78 "KeySlotID_78" 79 "KeySlotID_79" 80 "KeySlotID_80" 81 "KeySlotID_81" 82 "KeySlotID_82" 83 "KeySlotID_83" 84 "KeySlotID_84" 85 "KeySlotID_85" 86 "KeySlotID_86" 87 "KeySlotID_87" 88 "KeySlotID_88" 89 "KeySlotID_89" 90 "KeySlotID_90" 91 "KeySlotID_91" 92 "KeySlotID_92" 93 "KeySlotID_93" 94 "KeySlotID_94" 95 "KeySlotID_95" 96 "KeySlotID_96" 97 "KeySlotID_97" 98 "KeySlotID_98" 99 "KeySlotID_99" 100 "KeySlotID_100" 101 "KeySlotID_101";
VAL_ 519 RFFuncReq 0 "NO_BASIC_REQUEST" 1 "LOCK_REQUEST" 2 "RELOCK_REQUEST" 3 "DRIVER_UNLOCK_REQUEST" 4 "ALL_UNLOCK_REQUEST" 5 "TRUNK_PLG_TOGGLE_REQUEST" 6 "LEFT_SLIDER_TOGGLE_REQUEST" 7 "RIGHT_SLIDER_TOGGLE_REQUEST" 8 "FLIPPER_GLASS_REQUEST" 9 "REMOTE_START_ON" 10 "REMOTE_START_OFF" 11 "GLOBAL_WINDOW_DOWN_REQUEST" 12 "OPEN_CONVERTIBLE_TOP" 13 "CLOSE_CONVERTIBLE_TOP" 14 "PANIC_TOGGLE_REQUEST" 15 "DEAD_LOCK_REQUEST" 16 "GLOBAL_WINDOWS_UP_REQUEST" 17 "HEADLIGHTS_OFF_DELAY" 18 "TRUNK_PLG_STOP_REQUEST" 19 "ABORT_CRANKING_ON_REQUEST" 20 "ABORT_CRANKING_OFF_REQUEST" 21 "PRE_COND_ON" 22 "PRE_COND_OFF" 23 "AUTHENTICATION_REQUEST" 24 "CAR_FINDER_REQUEST" 25 "AirSuspReq" 26 "AirSuspCancel" 27 "ExtLightReq" 28 "Remote_Headlights" 30 "HOOD_TOGGLE_REQUEST" 31 "SNA";
VAL_ 519 RFReq 0 "REQUESTOR_DEFAULT" 1 "REQUESTOR_RKE" 2 "REQUESTOR_PE" 3 "REQUESTOR_REMOTESTART" 4 "REQUESTOR_UCONNECT" 5 "REQUESTOR_PE_HANDSFREE" 6 "REQUESTOR_PROXIMITY" 7 "SNA";
VAL_ 519 ValetMode_SPAAK 0 "False" 1 "True";
VAL_ 1449 BatteryLow 0 "MSG_DEFAULT" 1 "MSG_ACTIVE" 3 "SNA";
VAL_ 1449 FOBSearchActive 0 "not_active" 1 "active";
VAL_ 1449 KeyFob_Present 0 "Not_Present" 1 "Present";
VAL_ 1449 KeyProgramSts 0 "RKE_NORM_STAT" 1 "EN_KEY_PROG" 2 "PROG_ACT" 3 "EX_KEY_PROG" 4 "KEY_PROG" 5 "DMG_KEY" 6 "INV_KEY" 7 "EXCD_KEY" 8 "RKE_BATT_LO" 9 "SRV_SKREEM" 10 "BTN_DLY_ACT" 11 "BTN_DLY_INACT" 12 "KEY_NOT_PROG" 15 "SNA";
VAL_ 1449 MemRq_FobNum3 0 "FOB_DEFAULT" 1 "FOB_1" 2 "FOB_2" 3 "FOB_3" 4 "FOB_4" 5 "FOB_5" 6 "FOB_6" 7 "FOB_7" 8 "FOB_8" 9 "PHONEDEVICE_9" 10 "PHONEDEVICE_10" 11 "PHONEDEVICE_11" 12 "PHONEDEVICE_12" 13 "PHONEDEVICE_13" 14 "PHONEDEVICE_14" 15 "PHONEDEVICE_15" 16 "PHONEDEVICE_16" 17 "PHONEDEVICE_17" 18 "PHONEDEVICE_18" 19 "PHONEDEVICE_19" 20 "PHONEDEVICE_20" 21 "PHONEDEVICE_21" 22 "PHONEDEVICE_22" 23 "PHONEDEVICE_23" 24 "PHONEDEVICE_24" 25 "PHONEDEVICE_25" 26 "PHONEDEVICE_26" 27 "PHONEDEVICE_27" 28 "PHONEDEVICE_28" 29 "PHONEDEVICE_29" 30 "PHONEDEVICE_30" 31 "PHONEDEVICE_31" 32 "PHONEDEVICE_32" 33 "PHONEDEVICE_33" 34 "PHONEDEVICE_34" 35 "PHONEDEVICE_35" 36 "PHONEDEVICE_36" 37 "PHONEDEVICE_37" 38 "PHONEDEVICE_38" 39 "PHONEDEVICE_39" 40 "PHONEDEVICE_40" 41 "PHONEDEVICE_41" 42 "PHONEDEVICE_42" 43 "PHONEDEVICE_43" 44 "PHONEDEVICE_44" 45 "PHONEDEVICE_45" 46 "PHONEDEVICE_46" 47 "PHONEDEVICE_47" 48 "PHONEDEVICE_48" 49 "PHONEDEVICE_49" 50 "PHONEDEVICE_50" 51 "PHONEDEVICE_51" 52 "PHONEDEVICE_52" 53 "PHONEDEVICE_53" 54 "PHONEDEVICE_54" 55 "PHONEDEVICE_55" 56 "PHONEDEVICE_56" 57 "PHONEDEVICE_57" 58 "PHONEDEVICE_58" 59 "PHONEDEVICE_59" 60 "PHONEDEVICE_60" 61 "PHONEDEVICE_61" 62 "PHONEDEVICE_62" 63 "PHONEDEVICE_63" 64 "PHONEDEVICE_64" 65 "PHONEDEVICE_65" 66 "PHONEDEVICE_66" 67 "PHONEDEVICE_67" 68 "PHONEDEVICE_68" 69 "PHONEDEVICE_69" 70 "PHONEDEVICE_70" 71 "PHONEDEVICE_71" 72 "PHONEDEVICE_72" 73 "PHONEDEVICE_73" 74 "PHONEDEVICE_74" 75 "PHONEDEVICE_75" 76 "PHONEDEVICE_76" 77 "PHONEDEVICE_77" 78 "PHONEDEVICE_78" 79 "PHONEDEVICE_79" 80 "PHONEDEVICE_80" 81 "PHONEDEVICE_81" 82 "PHONEDEVICE_82" 83 "PHONEDEVICE_83" 84 "PHONEDEVICE_84" 85 "PHONEDEVICE_85" 86 "PHONEDEVICE_86" 87 "PHONEDEVICE_87" 88 "PHONEDEVICE_88" 89 "PHONEDEVICE_89" 90 "PHONEDEVICE_90" 91 "PHONEDEVICE_91" 92 "PHONEDEVICE_92" 93 "PHONEDEVICE_93" 94 "PHONEDEVICE_94" 95 "PHONEDEVICE_95" 96 "PHONEDEVICE_96" 97 "PHONEDEVICE_97" 98 "PHONEDEVICE_98" 99 "PHONEDEVICE_99" 100 "PHONEDEVICE_100" 101 "PHONEDEVICE_101" 127 "SNA";
VAL_ 1449 MsgFOBLeftVeh 0 "MSG_DEFAULT" 1 "MSG_ACTIVE" 3 "SNA";
VAL_ 1449 MsgFOBNotFnd 0 "MSG_DEFAULT" 1 "MSG_ACTIVE" 3 "SNA";
VAL_ 1449 MsgKeyNotFnd 0 "MSG_DEFAULT" 1 "MSG_ACTIVE" 2 "MSG_ACCESS_DENIED" 3 "SNA";
VAL_ 1449 MsgNotInPark 0 "MSG_DEFAULT" 1 "MSG_ACTIVE" 3 "SNA";
VAL_ 1449 MsgPushBtnKey 0 "MSG_DEFAULT" 1 "MSG_ACTIVE" 3 "SNA";
VAL_ 1449 RFMemRq 0 "Not_Active" 1 "Active";
VAL_ 1449 TPMHazardFlash 0 "False" 1 "TRUE";
VAL_ 1449 TPMHornChirp 0 "HORN_CHIRP_OFF" 1 "SINGLE_HORN_CHIRP" 2 "MULTIPLE_HORN_CHIRP" 3 "SNA";
VAL_ 1876 InflationState_LHF_Tyre 0 "Normal_Tyre_Pressure" 1 "Under_Inflated_Tyre" 2 "SignificantlyUnderInflatedTyre" 3 "Over_Inflated_Tyre" 4 "Sensor_Missing";
VAL_ 1876 InflationState_LHR_Tyre 0 "Normal_Tyre_Pressure" 1 "Under_Inflated_Tyre" 2 "SignificantlyUnderInflatedTyre" 3 "Over_Inflated_Tyre" 4 "Sensor_Missing";
VAL_ 1876 InflationState_RHF_Tyre 0 "Normal_Tyre_Pressure" 1 "Under_Inflated_Tyre" 2 "SignificantlyUnderInflatedTyre" 3 "Over_Inflated_Tyre" 4 "Sensor_Missing";
VAL_ 1876 InflationState_RHR_Tyre 0 "Normal_Tyre_Pressure" 1 "Under_Inflated_Tyre" 2 "SignificantlyUnderInflatedTyre" 3 "Over_Inflated_Tyre" 4 "Sensor_Missing";
VAL_ 1876 PressureValue_LHF_Tyre 255 "SNA";
VAL_ 1876 PressureValue_LHR_Tyre 255 "SNA";
VAL_ 1876 PressureValue_RHF_Tyre 255 "SNA";
VAL_ 1876 PressureValue_RHR_Tyre 255 "SNA";
VAL_ 1876 TPMActivitySts 0 "TPM_Enabled" 1 "TPM_Disabled";
VAL_ 1876 TyrePressureSysProgrammedSts 0 "System_Programmed" 1 "System_Not_Programmed";
VAL_ 1876 TyrePressureSystemFailSts 0 "Fail_Not_Present" 1 "Fail_Present";
VAL_ 612 WprWashSw_Psd 0 "NPSD" 1 "MIST" 2 "WASH";
VAL_ 1026 DRLPositionSts_L 0 "Off" 1 "On" 2 "Fault" 3 "SNA";
VAL_ 1026 HighBeamSts_L 0 "Off" 1 "On" 2 "Fault" 3 "SNA";
VAL_ 1026 LowBeamSts_L 0 "Off" 1 "On" 2 "Fault" 3 "SNA";
VAL_ 1026 PositionLampSts_L 0 "Off" 1 "On" 2 "Fault" 3 "SNA";
VAL_ 1026 SideMarkerLampSts_L 0 "Off" 1 "On" 2 "Fault" 3 "SNA";
VAL_ 1026 SLMLSts 0 "No_Fault" 1 "Fault" 3 "SNA";
VAL_ 1026 TurnSignalSts_L 0 "Off" 1 "On" 2 "Fault" 3 "SNA";
VAL_ 1028 DRLPositionSts_R 0 "Off" 1 "On" 2 "Fault" 3 "SNA";
VAL_ 1028 HighBeamSts_R 0 "Off" 1 "On" 2 "Fault" 3 "SNA";
VAL_ 1028 LowBeamSts_R 0 "Off" 1 "On" 2 "Fault" 3 "SNA";
VAL_ 1028 PositionLampSts_R 0 "Off" 1 "On" 2 "Fault" 3 "SNA";
VAL_ 1028 SideMarkerLampSts_R 0 "Off" 1 "On" 2 "Fault" 3 "SNA";
VAL_ 1028 SLMRSts 0 "No_Fault" 1 "Fault" 3 "SNA";
VAL_ 1028 TurnSignalSts_R 0 "Off" 1 "On" 2 "Fault" 3 "SNA";
VAL_ 151 ERR_ST_HOD 0 "NO_ERROR" 1 "HOD_EEPROM_ERROR" 2 "HOD_ROM_ERROR" 3 "HOD_WATCHDOG_ERROR" 4 "HOD_CPU_ERROR" 5 "HOD_GUARD_INTERRUPTION_ERROR" 6 "HOD_SENSE_INTERRUPTION_ERROR" 7 "HOD_CPU_DEFECT_OR_MAT_SHORTAGE" 8 "UNDERVOLTAGE_ERROR" 9 "OVERVOLTAGE_ERROR" 10 "HOD_CODING_ERROR" 11 "HOD_GENERIC_SYSTEM_ERROR" 15 "SNA";
VAL_ 151 HOFF_RCOG_SEN 0 "HANDS_OFF_DETECTED" 1 "ENERGY_SAVING_MODE" 2 "HANDS_OFF_NOT_DETECTED" 3 "HANDS_NOT_AVAILABLE" 4 "HANDS_OFF_ERROR" 15 "SNA";
VAL_ 151 RsErr_SWSM 0 "NO_ERROR" 1 "ERROR";
VAL_ 577 QualifyDriveCycle 0 "Not_Realized" 1 "Realized";
VAL_ 1488 Cooperative_Vehicle_Location 0 "Absent" 1 "Present";
VAL_ 1488 Remote_Chargeport_Command 0 "Default" 1 "Lock_Request" 2 "Unlock_Request" 3 "SNA";
VAL_ 1488 TBM_Cooperative_Charge_Command 0 "Default" 1 "Charge_Now" 2 "Stop_Charge" 3 "SNA";
VAL_ 1488 TBM_StopCharge 0 "No_Charge" 1 "Stop_Charge";
VAL_ 1429 ACV_Request 0 "OFF" 1 "ON";
VAL_ 1429 Disarm_Mobile_App_Req 0 "Not_Active" 1 "Active";
VAL_ 1429 SOSCallStatus 0 "No_Indication" 1 "Sos_Battery_Fail" 2 "Sos_Fail" 3 "Sos_Call_Ended" 4 "Sos_Call_Establish" 5 "Starting_SOS_Fail" 6 "Incoming_SOS_Call" 7 "Starting_SOS_1_Phase" 8 "Starting_SOS_2_Phase" 9 "Starting_SOS_Auto";
VAL_ 1429 U_CONN_REQ_BCM_FOA_ALERT_FB 0 "Not_Active" 1 "Active";
VAL_ 1429 UCONREQ_TBM_TrailerLightCheck 0 "Not_Request" 1 "Request" 2 "In_Progress" 3 "Cancel";
VAL_ 1451 SOC_Max_Lev_Rem_Req 0 "No_Change" 1 "Level1" 2 "Level2" 3 "SNA";
VAL_ 1451 TBM_Charge_Now 0 "No_Request" 1 "Charge_Now";
VAL_ 1451 TBM_ChargeSchedule_Type1_Req 0 "No_Selection" 1 "Standard_Charge" 2 "External_Charge" 3 "Reserved";
VAL_ 1451 TBM_ChargeSchedule_Type2_Req 0 "No_Selection" 1 "Standard_Charge" 2 "External_Charge" 3 "Reserved";
VAL_ 1451 TBM_ChargeUntilFull1 0 "Charge Until Full Not selected" 1 "Charge Until Full";
VAL_ 1451 TBM_ChargeUntilFull2 0 "Charge Until Full Not selected" 1 "Charge Until Full";
VAL_ 1451 TBM_Enable_Schedule1 0 "Disable schedule1" 1 "Enable schedule1";
VAL_ 1451 TBM_Enable_Schedule2 0 "Disable schedule1" 1 "Enable schedule1";
VAL_ 1451 TBM_End_Time_Hr1 31 "SNA";
VAL_ 1451 TBM_End_Time_Hr2 31 "SNA";
VAL_ 1451 TBM_End_Time_Min1 15 "SNA";
VAL_ 1451 TBM_End_Time_Min2 15 "SNA";
VAL_ 1451 TBM_External_ChargeTarget1 15 "No_Selection";
VAL_ 1451 TBM_External_ChargeTarget2 15 "No_Selection";
VAL_ 1451 TBM_Immediate_ChargeTarget1 15 "No_Selection";
VAL_ 1451 TBM_Immediate_ChargeTarget2 15 "No_Selection";
VAL_ 1451 TBM_PowerLevel_Req 0 "No_Change" 1 "No_Limitation" 2 "Level1" 3 "Level2" 4 "Level3" 5 "Level4" 6 "Level5";
VAL_ 1451 TBM_Schedule_Day1 0 "No Selection" 1 "M" 2 "T" 3 "TM" 4 "W" 5 "WM" 6 "WT" 7 "WTM" 8 "Th" 9 "ThM" 10 "ThT" 11 "ThTM" 12 "ThW" 13 "ThWM" 14 "ThWT" 15 "ThWTM" 16 "F" 17 "FM" 18 "FT" 19 "FTM" 20 "FW" 21 "FWM" 22 "FWT" 23 "FWTM" 24 "FTh" 25 "FThM" 26 "FThT" 27 "FThTM" 28 "FThW" 29 "FThWM" 30 "FThWT" 31 "FThWTM" 32 "S" 33 "SM" 34 "ST" 35 "STM" 36 "SW" 37 "SWM" 38 "SWT" 39 "SWTM" 40 "STh" 41 "SThM" 42 "SThT" 43 "SThTM" 44 "SThW" 45 "SThWM" 46 "SThWT" 47 "SThWTM" 48 "SF" 49 "SFM" 50 "SFT" 51 "SFTM" 52 "SFW" 53 "SFWM" 54 "SFWT" 55 "SFWTM" 56 "SFTh" 57 "SFThM" 58 "SFThT" 59 "SFThTM" 60 "SFThW" 61 "SFThWM" 62 "SFThWT" 63 "SFThWTM" 64 "Sa" 65 "SaM" 66 "SaT" 67 "SaTM" 68 "SaW" 69 "SaWM" 70 "SaWT" 71 "SaWTM" 72 "SaTh" 73 "SaThM" 74 "SaThT" 75 "SaThTM" 76 "SaThW" 77 "SaThWM" 78 "SaThWT" 79 "SaThWTM" 80 "SaF" 81 "SaFM" 82 "SaFT" 83 "SaFTM" 84 "SaFW" 85 "SaFWM" 86 "SaFWT" 87 "SaFWTM" 88 "SaFTh" 89 "SaFThM" 90 "SaFThT" 91 "SaFThTM" 92 "SaFThW" 93 "SaFThWM" 94 "SaFThWT" 95 "SaFThWTM" 96 "SaS" 97 "SaSM" 98 "SaST" 99 "SaSTM" 100 "SaSW" 101 "SaSWM" 102 "SaSWT" 103 "SaSWTM" 104 "SaSTh" 105 "SaSThM" 106 "SaSThT" 107 "SaSThTM" 108 "SaSThW" 109 "SaSThWM" 110 "SaSThWT" 111 "SaSThWTM" 112 "SaSF" 113 "SaSFM" 114 "SaSFT" 115 "SaSFTM" 116 "SaSFW" 117 "SaSFWM" 118 "SaSFWT" 119 "SaSFWTM" 120 "SaSFTh" 121 "SaSFThM" 122 "SaSFThT" 123 "SaSFThTM" 124 "SaSFThW" 125 "SaSFThWM" 126 "SaSFThWT" 127 "SaSFThWTM" 255 "SNA";
VAL_ 1451 TBM_Schedule_Day2 0 "No Selection" 1 "M" 2 "T" 3 "TM" 4 "W" 5 "WM" 6 "WT" 7 "WTM" 8 "Th" 9 "ThM" 10 "ThT" 11 "ThTM" 12 "ThW" 13 "ThWM" 14 "ThWT" 15 "ThWTM" 16 "F" 17 "FM" 18 "FT" 19 "FTM" 20 "FW" 21 "FWM" 22 "FWT" 23 "FWTM" 24 "FTh" 25 "FThM" 26 "FThT" 27 "FThTM" 28 "FThW" 29 "FThWM" 30 "FThWT" 31 "FThWTM" 32 "S" 33 "SM" 34 "ST" 35 "STM" 36 "SW" 37 "SWM" 38 "SWT" 39 "SWTM" 40 "STh" 41 "SThM" 42 "SThT" 43 "SThTM" 44 "SThW" 45 "SThWM" 46 "SThWT" 47 "SThWTM" 48 "SF" 49 "SFM" 50 "SFT" 51 "SFTM" 52 "SFW" 53 "SFWM" 54 "SFWT" 55 "SFWTM" 56 "SFTh" 57 "SFThM" 58 "SFThT" 59 "SFThTM" 60 "SFThW" 61 "SFThWM" 62 "SFThWT" 63 "SFThWTM" 64 "Sa" 65 "SaM" 66 "SaT" 67 "SaTM" 68 "SaW" 69 "SaWM" 70 "SaWT" 71 "SaWTM" 72 "SaTh" 73 "SaThM" 74 "SaThT" 75 "SaThTM" 76 "SaThW" 77 "SaThWM" 78 "SaThWT" 79 "SaThWTM" 80 "SaF" 81 "SaFM" 82 "SaFT" 83 "SaFTM" 84 "SaFW" 85 "SaFWM" 86 "SaFWT" 87 "SaFWTM" 88 "SaFTh" 89 "SaFThM" 90 "SaFThT" 91 "SaFThTM" 92 "SaFThW" 93 "SaFThWM" 94 "SaFThWT" 95 "SaFThWTM" 96 "SaS" 97 "SaSM" 98 "SaST" 99 "SaSTM" 100 "SaSW" 101 "SaSWM" 102 "SaSWT" 103 "SaSWTM" 104 "SaSTh" 105 "SaSThM" 106 "SaSThT" 107 "SaSThTM" 108 "SaSThW" 109 "SaSThWM" 110 "SaSThWT" 111 "SaSThWTM" 112 "SaSF" 113 "SaSFM" 114 "SaSFT" 115 "SaSFTM" 116 "SaSFW" 117 "SaSFWM" 118 "SaSFWT" 119 "SaSFWTM" 120 "SaSFTh" 121 "SaSFThM" 122 "SaSFThT" 123 "SaSFThTM" 124 "SaSFThW" 125 "SaSFThWM" 126 "SaSFThWT" 127 "SaSFThWTM" 255 "SNA";
VAL_ 1451 TBM_Start_Time_Hr1 31 "SNA";
VAL_ 1451 TBM_Start_Time_Hr2 31 "SNA";
VAL_ 1451 TBM_Start_Time_Min1 15 "SNA";
VAL_ 1451 TBM_Start_Time_Min2 15 "SNA";
VAL_ 1451 TBM_Submit_Schedule1 0 "No Change" 1 "Change in schedule 1";
VAL_ 1451 TBM_Submit_Schedule2 0 "No Change" 1 "Change in schedule 1";
VAL_ 1452 E_Call_Stat_TBM 0 "Off" 1 "Red_Solid" 2 "Red_Blink" 3 "Green_Blink_Fast" 4 "Green_Blink_Slow" 5 "Green_Solid" 7 "SNA";
VAL_ 1452 PrivacyMode 0 "Not_Active" 1 "Active";
VAL_ 1452 U_Call_Stat_TBM 0 "Off" 1 "Red_Solid" 2 "Red_Blink" 3 "Green_Blink_Fast" 4 "Green_Blink_Slow" 5 "Green_Solid" 7 "SNA";
VAL_ 156 AUX1_HLEnbl_Req 0 "Disable" 1 "Enable";
VAL_ 156 AUX1_PWRMD_Req 0 "Ignition" 1 "Battery";
VAL_ 156 AUX1_TYPE_Req 0 "Latching" 1 "Momentary";
VAL_ 156 AUX2_HLEnbl_Req 0 "Disable" 1 "Enable";
VAL_ 156 AUX2_PWRMD_Req 0 "Ignition" 1 "Battery";
VAL_ 156 AUX2_TYPE_Req 0 "Latching" 1 "Momentary";
VAL_ 156 AUX3_HLEnbl_Req 0 "Disable" 1 "Enable";
VAL_ 156 AUX3_PWRMD_Req 0 "Ignition" 1 "Battery";
VAL_ 156 AUX3_TYPE_Req 0 "Latching" 1 "Momentary";
VAL_ 156 AUX4_HLEnbl_Req 0 "Disable" 1 "Enable";
VAL_ 156 AUX4_PWRMD_Req 0 "Ignition" 1 "Battery";
VAL_ 156 AUX4_TYPE_Req 0 "Latching" 1 "Momentary";
VAL_ 156 AUX5_HLEnbl_Req 0 "Disable" 1 "Enable";
VAL_ 156 AUX5_PWRMD_Req 0 "IGNITION" 1 "BATTERY";
VAL_ 156 AUX5_TYPE_Req 0 "Latching" 1 "Momentary";
VAL_ 156 AUX6_HLEnbl_Req 0 "Disable" 1 "Enable";
VAL_ 156 AUX6_PWRMD_Req 0 "IGNITION" 1 "BATTERY";
VAL_ 156 AUX6_TYPE_Req 0 "Latching" 1 "Momentary";
VAL_ 156 Default_Ride_Height_Req 0 "Normal" 1 "Aerodynamic";
VAL_ 156 Display_Synch_Req 0 "OFF" 1 "ON";
VAL_ 156 Fuel_Saver_Display_Req 0 "Disable" 1 "Enable";
VAL_ 156 GPS_Date_Day 255 "SNA";
VAL_ 156 GPS_Date_Month 255 "SNA";
VAL_ 156 GPS_Date_Year 65535 "SNA";
VAL_ 156 GPS_UTC_Hour 255 "SNA";
VAL_ 156 GPS_UTC_Minute 255 "SNA";
VAL_ 156 GPS_UTC_Second 65535 "SNA";
VAL_ 156 ParkSenseSignalView_Req 0 "Disable" 1 "Enable";
VAL_ 156 PFTM_Alert_Req 0 "Disabled" 1 "Enabled";
VAL_ 156 PFTM_Enable_Req 0 "Disabled" 1 "Enabled";
VAL_ 156 Rear_G_LGT_with_Cargo_Lights_Req 0 "Disable" 1 "Enable";
VAL_ 156 TSI_Offset_Kph_Req 0 "0" 1 "1" 2 "2" 3 "3" 4 "4" 5 "5" 6 "6" 7 "7" 8 "8" 9 "9" 10 "10" 11 "11" 12 "12" 13 "13" 14 "14" 15 "15";
VAL_ 156 TSI_Offset_Mph_Req 0 "0" 1 "1" 2 "2" 3 "3" 4 "4" 5 "5" 6 "6" 7 "7" 8 "8" 9 "9" 10 "10";
VAL_ 156 TurnSignalView_Req 0 "Disable" 1 "Enable" 2 "Only_with_Trailer";
VAL_ 608 BuiltUpArea_CS 0 "No_built_up_area" 1 "Built_up_area" 2 "Unknown" 3 "NA";
VAL_ 608 DrvSide 0 "Left" 1 "Right";
VAL_ 608 EffSpdLmt_CS 0 "Unknown" 1 "Less_Equal_5kmh" 2 "7_kmh_mph" 3 "10_kmh_mph" 4 "15_kmh_mph" 5 "20_kmh_mph" 6 "25_kmh_mph" 7 "30_kmh_mph" 8 "35_kmh_mph" 9 "40_kmh_mph" 10 "45_kmh_mph" 11 "50_kmh_mph" 12 "55_kmh_mph" 13 "60_kmh_mph" 14 "65_kmh_mph" 15 "70_kmh_mph" 16 "75_kmh_mph" 17 "80_kmh_mph" 18 "85_kmh_mph" 19 "90_kmh_mph" 20 "95_kmh_mph" 21 "100_kmh_mph" 22 "105_kmh_mph" 23 "110_kmh_mph" 24 "115_kmh_mph" 25 "120_kmh_mph" 26 "130_kmh_mph" 27 "140_kmh_mph" 28 "150_kmh_mph" 29 "160_kmh_mph" 30 "Unlimited" 31 "Invalid";
VAL_ 608 EffSpdLmtType_CS 0 "Implicit" 1 "Explicit_On_Traffic_Sign" 2 "Explicit_Night" 3 "Explicit_Day" 4 "Explicit_Time_of_day" 5 "Explicit_Rain" 6 "Explicit_Snow" 7 "Unknown";
VAL_ 608 ETM_ADS_MODE_REQ 0 "DEFAULT" 1 "DM1" 2 "DM2" 3 "DM3" 4 "MODE_1" 5 "MODE_2" 6 "MODE_3" 7 "SNA";
VAL_ 608 ETM_EPS_MODE_REQ 0 "DEFAULT" 1 "DM1" 2 "DM2" 3 "DM3" 4 "MODE_1" 5 "MODE_2" 6 "MODE_3" 7 "SNA";
VAL_ 608 ETM_PaddlesModeReq 0 "NONE" 1 "DIS" 2 "EN" 3 "SNA";
VAL_ 608 FormOfWay_CS 0 "TYPE_0" 1 "TYPE_1" 2 "TYPE_2" 3 "TYPE_3" 4 "TYPE_4" 5 "TYPE_5" 6 "TYPE_6" 7 "TYPE_7" 8 "TYPE_8" 9 "TYPE_9" 10 "TYPE_10" 11 "TYPE_11" 12 "TYPE_12" 13 "TYPE_13" 14 "TYPE_14" 15 "SNA";
VAL_ 608 FuncRoadClass_CS 0 "Unknown" 1 "Priority_1" 2 "Priority_2" 3 "Priority_3" 4 "Priority_4" 5 "Priority_5" 6 "Priority_6" 7 "NA";
VAL_ 608 HU_Front_PAMRequestSts 0 "Not_Pressed" 1 "Pressed";
VAL_ 608 HU_Iterate_Gain_Down 0 "Not_Pressed" 1 "Pressed";
VAL_ 608 HU_Iterate_Gain_Up 0 "Not_Pressed" 1 "Pressed";
VAL_ 608 HU_Rear_PAMRequestSts 0 "Not_Pressed" 1 "Pressed";
VAL_ 608 Launch_RPM_Selected_Setting2 0 "DEFAULT" 63 "SNA";
VAL_ 608 NavDataAvailable_CS 0 "Valid_Data_Not_Available" 1 "Valid_Data_Available";
VAL_ 608 PathIdx_CS 0 "Map_data_not_valid_1" 1 "Map_data_not_valid_2" 2 "Map_data_not_valid_3" 3 "Map_data_not_valid_4" 4 "Map_data_valid" 5 "Map_data_not_valid_5" 6 "Map_data_not_valid_6" 7 "Map_data_not_valid_7" 8 "Map_data_not_valid_8" 9 "Map_data_not_valid_9" 10 "Map_data_not_valid_10" 11 "Map_data_not_valid_11" 12 "Map_data_not_valid_12" 13 "Map_data_not_valid_13" 14 "Map_data_not_valid_14" 15 "Map_data_not_valid_15" 16 "Map_data_not_valid_16" 17 "Map_data_not_valid_17" 18 "Map_data_not_valid_18" 19 "Map_data_not_valid_19" 20 "Map_data_not_valid_20" 21 "Map_data_not_valid_21" 22 "Map_data_not_valid_22" 23 "Map_data_not_valid_23" 24 "Map_data_not_valid_24" 25 "Map_data_not_valid_25" 26 "Map_data_not_valid_26" 27 "Map_data_not_valid_27" 28 "Map_data_not_valid_28" 29 "Map_data_not_valid_29" 30 "Map_data_not_valid_30" 31 "Map_data_not_valid_31" 32 "Map_data_not_valid_32" 33 "Map_data_not_valid_33" 34 "Map_data_not_valid_34" 35 "Map_data_not_valid_35" 36 "Map_data_not_valid_36" 37 "Map_data_not_valid_37" 38 "Map_data_not_valid_38" 39 "Map_data_not_valid_39" 40 "Map_data_not_valid_40" 41 "Map_data_not_valid_41" 42 "Map_data_not_valid_42" 43 "Map_data_not_valid_43" 44 "Map_data_not_valid_44" 45 "Map_data_not_valid_45" 46 "Map_data_not_valid_46" 47 "Map_data_not_valid_47" 48 "Map_data_not_valid_48" 49 "Map_data_not_valid_49" 50 "Map_data_not_valid_50" 51 "Map_data_not_valid_51" 52 "Map_data_not_valid_52" 53 "Map_data_not_valid_53" 54 "Map_data_not_valid_54" 55 "Map_data_not_valid_55" 56 "Map_data_not_valid_56" 57 "Map_data_not_valid_57" 58 "Map_data_not_valid_58" 59 "Map_data_not_valid_59" 60 "Map_data_not_valid_60" 61 "Map_data_not_valid_61" 62 "Map_data_not_valid_62" 63 "Map_data_not_valid_63";
VAL_ 608 SpdUnits 0 "km_h" 1 "mph";
