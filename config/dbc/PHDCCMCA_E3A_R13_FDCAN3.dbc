VERSION ""

NS_ :

BS_:

BU_: AGSM ASBS BCM BSM CADM DTCM ECM IPC RFHM SGW TCM
BO_ 1450 TRANSM_FD_4: 32 TCM
 SG_ CrankEnable : 113|1@0+ (1,0) [0|1] "-" SGW
 SG_ CRC_TRANSM4 : 191|8@0+ (1,0) [0|255] "-" AGSM,BCM,BSM,CADM,DTCM,ECM,IPC,SGW
 SG_ DriveModeSts : 83|4@0+ (1,0) [0|15] "-" BSM,ECM,TCM
 SG_ GearDisplayForCluster : 75|4@0+ (1,0) [0|14] "" CADM,IPC
 SG_ GearEngaged : 107|4@0+ (1,0) [0|15] "-" BCM,BSM,CADM,DTCM,ECM,RFHM,SGW
 SG_ GearIndicationSts : 95|1@0+ (1,0) [0|1] "-" AGSM,IPC
 SG_ HAS_SoH_TCM : 117|1@0+ (1,0) [0|1] "-" Vector__XXX
 SG_ LimpHomeSts : 112|1@0+ (1,0) [0|1] "-" BCM,CADM,ECM
 SG_ MessageCounter_TRANSM4 : 179|4@0+ (1,0) [0|15] "-" AGSM,BCM,BSM,CADM,DTCM,ECM,IPC,SGW
 SG_ MIReq : 127|1@0+ (1,0) [0|1] "-" ECM,SGW
 SG_ OilTemperatureSts : 86|1@0+ (1,0) [0|1] "-" IPC,SGW
 SG_ R_SHFT_LOCK : 116|1@0+ (1,0) [0|1] "-" AGSM
 SG_ Secure_Idle_HMI : 7|2@0+ (1,0) [0|3] "-" IPC
 SG_ ShiftInProgress : 114|1@0+ (1,0) [0|1] "-" BSM,ECM,SGW
 SG_ ShiftLeverLockReq : 101|1@0+ (1,0) [0|1] "-" AGSM
 SG_ ShiftLeverPosition : 111|4@0+ (1,0) [0|15] "-" AGSM,BCM,BSM,CADM,ECM,IPC,SGW
 SG_ ShiftMapNotAchieved : 121|1@0+ (1,0) [0|1] "-" ECM
 SG_ ShiftModeSts : 94|1@0+ (1,0) [0|1] "-" CADM,DTCM,IPC,SGW
 SG_ TransmissionFailSts : 87|1@0+ (1,0) [0|1] "-" AGSM,BCM,SGW
 SG_ TransmissionWarnings : 93|6@0+ (1,0) [0|63] "-" BCM,IPC,SGW

BO_ 1059 TRM_CODE_RESPONSE: 32 RFHM
 SG_ CodeCheckSts_TRM : 109|2@0+ (1,0) [0|3] "-" BCM
 SG_ ControlEncoding_TRM_Rsp : 87|8@0+ (1,0) [0|255] "-" BCM
 SG_ MiniCryptGCode_TRM_Rsp : 95|16@0+ (1,0) [0|65535] "-" BCM
 SG_ ProgrammedSts_TRM : 110|1@0+ (1,0) [0|1] "-" BCM
 SG_ TxpFound : 111|1@0+ (1,0) [0|1] "-" BCM
 SG_ TxpID3 : 15|7@0+ (1,0) [0|127] "-" BCM

BO_ 254 TRM_MKP_KEY: 32 RFHM
 SG_ DATA1 : 95|8@0+ (1,0) [0|255] "-" BCM
 SG_ DATA2 : 103|8@0+ (1,0) [0|255] "-" BCM
 SG_ DATA3 : 111|8@0+ (1,0) [0|255] "-" BCM
 SG_ DATA4 : 119|8@0+ (1,0) [0|255] "-" BCM
 SG_ DATA5 : 127|8@0+ (1,0) [0|255] "-" BCM
 SG_ DATA6 : 135|8@0+ (1,0) [0|255] "-" BCM
 SG_ DATA7 : 143|8@0+ (1,0) [0|255] "-" BCM
 SG_ FrameNumber : 87|4@0+ (1,0) [0|15] "-" BCM
 SG_ TotalFrameNumber : 83|4@0+ (1,0) [0|15] "-" BCM

BO_ 1472 TRSCM_FD_1: 32 BCM
 SG_ CRC_TRSCM1 : 191|8@0+ (1,0) [0|255] "-" BSM,ECM
 SG_ MessageCounter_TRSCM1 : 179|4@0+ (1,0) [0|15] "-" BSM,ECM
 SG_ TRSC_PopupDisp_Info2 : 103|6@0+ (1,0) [0|63] "" IPC
 SG_ TRSC_STAT : 7|3@0+ (1,0) [0|6] "" SGW

BO_ 951 U_CONN_REQ_TBM: 32 SGW
 SG_ UConnReq_TBM : 7|5@0+ (1,0) [0|31] "-" RFHM
 SG_ UConnReqAuthCode_TBM : 15|16@0+ (1,0) [0|65535] "-" RFHM
 SG_ UConnReqFOBNum_TBM : 31|4@0+ (1,0) [0|15] "-" RFHM

BO_ 2566846208 VEP1: 8 ECM
 SG_ VEP1_SIG : 7|64@0+ (1,0) [0|0] "" SGW

BO_ 2566842112 VH: 8 ECM
 SG_ VH_SIG : 7|64@0+ (1,0) [0|0] "" SGW

BO_ 2566843392 VI: 8 ECM
 SG_ VI_SIG : 7|64@0+ (1,0) [0|0] "" SGW

BO_ 1053 VIN: 32 BCM
 SG_ VIN_DATA : 87|56@0+ (1,0) [0|72057594037927900] "" AGSM,ASBS,BSM,CADM,DTCM,ECM,IPC,RFHM,SGW,TCM
 SG_ VIN_MSG : 75|2@0+ (1,0) [0|3] "" AGSM,ASBS,BSM,CADM,DTCM,ECM,IPC,RFHM,SGW,TCM

BO_ 1098 VSIM_FD_1: 32 SGW
 SG_ DoorLkAllRq : 27|1@0+ (1,0) [0|1] "" BCM
 SG_ DoorUnlkAllRq : 26|1@0+ (1,0) [0|1] "" BCM
 SG_ DsblTurnLmpFlt : 18|1@0+ (1,0) [0|1] "" BCM
 SG_ FtWigWagRq : 17|1@0+ (1,0) [0|1] "" BCM
 SG_ IdleShutDown_Disable : 28|1@0+ (1,0) [0|1] "" ECM
 SG_ J1939_RPM_RQ : 7|16@0+ (1,0) [0|65535] "rpm" ECM
 SG_ PosEngdSwStat : 23|1@0+ (1,0) [0|1] "" ECM,TCM
 SG_ PTO_IdleSpd1 : 22|1@0+ (1,0) [0|1] "" ECM
 SG_ PTO_IdleSpd2 : 21|1@0+ (1,0) [0|1] "" ECM
 SG_ PTO_IdleSpd3 : 20|1@0+ (1,0) [0|1] "" ECM
 SG_ R_AC_Enable : 16|1@0+ (1,0) [0|1] "" BCM
 SG_ RrWigWagRq : 31|1@0+ (1,0) [0|1] "" BCM
 SG_ SprtRearLtg : 30|1@0+ (1,0) [0|1] "" BCM
 SG_ SupHrnRq : 29|1@0+ (1,0) [0|1] "" BCM
 SG_ VSIMEngineOffRequest : 25|1@0+ (1,0) [0|1] "" RFHM

CM_ SG_ 1450 CrankEnable "This signal is used to enable the cranking in safety condition";
CM_ SG_ 1450 CRC_TRANSM4 "CRC according to SAE J1850 standard at each frame transmission.";
CM_ SG_ 1450 DriveModeSts "-";
CM_ SG_ 1450 GearDisplayForCluster "GearDisplayForCluster";
CM_ SG_ 1450 GearEngaged "Current engaged gear.";
CM_ SG_ 1450 GearIndicationSts "-";
CM_ SG_ 1450 HAS_SoH_TCM "HAS SoH TCM";
CM_ SG_ 1450 LimpHomeSts "This signal is used in case of those gearbox faults that limit the higher usable gear.";
CM_ SG_ 1450 MessageCounter_TRANSM4 "This signal is a counter used for safety checks strategies. This counter is incremented of 1 (one) unit at each frame transmission.";
CM_ SG_ 1450 MIReq "This signal indicates that the gearbox has any EOBD errors.";
CM_ SG_ 1450 OilTemperatureSts "-";
CM_ SG_ 1450 R_SHFT_LOCK "Shiftlock for reverse; locked = [1]";
CM_ SG_ 1450 Secure_Idle_HMI "-";
CM_ SG_ 1450 ShiftInProgress "Transmission shift in progress";
CM_ SG_ 1450 ShiftLeverLockReq "-";
CM_ SG_ 1450 ShiftLeverPosition "This signal indicates the executed shift lever position.";
CM_ SG_ 1450 ShiftMapNotAchieved "Transmission shift in progress";
CM_ SG_ 1450 ShiftModeSts "This signal indicates the gear selector modality selected by driver (Manual or Automatic).";
CM_ SG_ 1450 TransmissionFailSts "This signal indicates if the TCM currently detects the failure or not (for TCM)";
CM_ SG_ 1450 TransmissionWarnings "-";
CM_ SG_ 1059 CodeCheckSts_TRM "This signal is used to indicate the result of the code check.";
CM_ SG_ 1059 ControlEncoding_TRM_Rsp "-";
CM_ SG_ 1059 MiniCryptGCode_TRM_Rsp "-";
CM_ SG_ 1059 ProgrammedSts_TRM "This signal  is used to indicate if the TRM is programmed.";
CM_ SG_ 1059 TxpFound "This signal is used to give information about the presence of a transponder";
CM_ SG_ 1059 TxpID3 "Key ID's";
CM_ SG_ 254 DATA1 "-";
CM_ SG_ 254 DATA2 "-";
CM_ SG_ 254 DATA3 "-";
CM_ SG_ 254 DATA4 "-";
CM_ SG_ 254 DATA5 "-";
CM_ SG_ 254 DATA6 "-";
CM_ SG_ 254 DATA7 "-";
CM_ SG_ 254 FrameNumber "-";
CM_ SG_ 254 TotalFrameNumber "-";
CM_ SG_ 1472 CRC_TRSCM1 "CRC according to SAE J1850 standard at each frame transmission.";
CM_ SG_ 1472 MessageCounter_TRSCM1 "This signal is a counter used for safety checks strategies. This counter is incremented of 1 (one) unit at each frame transmission.";
CM_ SG_ 1472 TRSC_PopupDisp_Info2 "TRSC Cluster PopUp Request";
CM_ SG_ 1472 TRSC_STAT "Trailer Reverse steering status signal";
CM_ SG_ 951 UConnReq_TBM "Requests specific vehicle function";
CM_ SG_ 951 UConnReqAuthCode_TBM "Authenticates function requests";
CM_ SG_ 951 UConnReqFOBNum_TBM "Indicates Corresponding  FOB number 1-8";
CM_ SG_ 2566846208 VEP1_SIG "Vehicle Electrical Power 1 (from ECM to OBD)";
CM_ SG_ 2566842112 VH_SIG "Vehicle Hours (from ECM to OBD)";
CM_ SG_ 2566843392 VI_SIG "Vehicle Identification (from ECM to OBD)";
CM_ SG_ 1053 VIN_DATA "VIN Digits (8 bit ascii encoded)";
CM_ SG_ 1053 VIN_MSG "VIN Message Information";
CM_ SG_ 1098 DoorLkAllRq "Request to lock all doors";
CM_ SG_ 1098 DoorUnlkAllRq "Request to unlock all doors";
CM_ SG_ 1098 DsblTurnLmpFlt "Disable rear turn lamp fault";
CM_ SG_ 1098 FtWigWagRq "Front wig wag request";
CM_ SG_ 1098 IdleShutDown_Disable "5 Minute Idle shut down feature disabled signal";
CM_ SG_ 1098 J1939_RPM_RQ "Engine RPM requested through J1939";
CM_ SG_ 1098 PosEngdSwStat "Positive engagement switch status;";
CM_ SG_ 1098 PTO_IdleSpd1 "Power takeoff idle speed 1 selected";
CM_ SG_ 1098 PTO_IdleSpd2 "Power takeoff idle speed 2 selected";
CM_ SG_ 1098 PTO_IdleSpd3 "Power takeoff idle speed 3 selected";
CM_ SG_ 1098 R_AC_Enable "Rear A/C enable request";
CM_ SG_ 1098 RrWigWagRq "Rear wig wag request";
CM_ SG_ 1098 SprtRearLtg "Separate rear lighting";
CM_ SG_ 1098 SupHrnRq "Suppress horn request";
CM_ SG_ 1098 VSIMEngineOffRequest "This signal informs the RF_HUB that VSIM Emergency Stop wire is activated";

BA_DEF_ SG_ "GenSigStartValue" INT 0 2147483647;
BA_DEF_ SG_ "GenSigInactiveValue" INT 0 2147483647;
BA_DEF_ SG_ "GenSigSendType" ENUM "NotUsed","OnWrite","OnWriteWithRepetition","OnChange","OnChangeWithRepetition","IfActive","IfActiveWithRepetition","NoSigSendType";
BA_DEF_ SG_ "GenSigTimeoutTime_AGSM" INT 0 65535;
BA_DEF_ SG_ "GenSigTimeoutTime_ASBS" INT 0 65535;
BA_DEF_ SG_ "GenSigTimeoutTime_BCM" INT 0 65535;
BA_DEF_ SG_ "GenSigTimeoutTime_BSM" INT 0 65535;
BA_DEF_ SG_ "GenSigTimeoutTime_CADM" INT 0 65535;
BA_DEF_ SG_ "GenSigTimeoutTime_DTCM" INT 0 65535;
BA_DEF_ SG_ "GenSigTimeoutTime_ECM" INT 0 65535;
BA_DEF_ SG_ "GenSigTimeoutTime_IPC" INT 0 65535;
BA_DEF_ SG_ "GenSigTimeoutTime_RFHM" INT 0 65535;
BA_DEF_ SG_ "GenSigTimeoutTime_SGW" INT 0 65535;
BA_DEF_ SG_ "GenSigTimeoutTime_TCM" INT 0 65535;
BA_DEF_ BO_ "DiagRequest" ENUM "No","Yes";
BA_DEF_ BO_ "Type" ENUM "P","C","PE","COC","PE_Cntrl","E","E_Cntrl","OC","S","BAF","DC","EM","MM","ISO-TP","-";
BA_DEF_ BO_ "DiagResponse" ENUM "No","Yes";
BA_DEF_ BO_ "NmMessage" ENUM "No","Yes";
BA_DEF_ BO_ "GenMsgSendType" ENUM "Cyclic","NotUsed","NotUsed","NotUsed","NotUsed","NotUsed","NotUsed","NotUsed","NoMsgSendType";
BA_DEF_ BO_ "GenMsgNrOfRepetition" INT 0 255;
BA_DEF_ BO_ "GenMsgILSupport" ENUM "No","Yes";
BA_DEF_ BO_ "GenMsgStartDelayTime" INT 0 65535;
BA_DEF_ BO_ "GenMsgCycleTimeFast" INT 0 65535;
BA_DEF_ BO_ "GenMsgCycleTime" INT 0 65535;
BA_DEF_ BO_ "GenMsgDelayTime" INT 0 65535;
BA_DEF_ BO_ "NmAsrMessage" ENUM "No","Yes";
BA_DEF_ BO_ "DiagState" ENUM "No","Yes";
BA_DEF_ BO_ "DiagConnection" HEX 0 65535;
BA_DEF_ BO_ "VFrameFormat" ENUM "StandardCAN","ExtendedCAN","reserved","reserved","reserved","reserved","reserved","reserved","reserved","reserved","reserved","reserved","reserved","reserved","StandardCAN_FD","ExtendedCAN_FD";
BA_DEF_ BO_ "CANFD_BRS" ENUM "0","1";
BA_DEF_DEF_ "DiagRequest" "No";
BA_DEF_DEF_ "Type" "-";
BA_DEF_DEF_ "DiagResponse" "No";
BA_DEF_DEF_ "NmMessage" "No";
BA_DEF_DEF_ "GenMsgSendType" "NoMsgSendType";
BA_DEF_DEF_ "GenMsgNrOfRepetition" 0;
BA_DEF_DEF_ "GenMsgILSupport" "No";
BA_DEF_DEF_ "GenMsgStartDelayTime" 0;
BA_DEF_DEF_ "GenMsgCycleTimeFast" 0;
BA_DEF_DEF_ "GenMsgCycleTime" 0;
BA_DEF_DEF_ "GenMsgDelayTime" 0;
BA_DEF_DEF_ "NmAsrMessage" "No";
BA_DEF_DEF_ "DiagState" "No";
BA_DEF_DEF_ "DiagConnection" 0;
BA_DEF_DEF_ "VFrameFormat" "StandardCAN_FD";
BA_DEF_DEF_ "CANFD_BRS" "0";
BA_DEF_DEF_ "GenSigStartValue" 0;
BA_DEF_DEF_ "GenSigInactiveValue" 0;
BA_DEF_DEF_ "GenSigSendType" "NoSigSendType";
BA_DEF_DEF_ "GenSigTimeoutTime_AGSM" 2500;
BA_DEF_DEF_ "GenSigTimeoutTime_ASBS" 2500;
BA_DEF_DEF_ "GenSigTimeoutTime_BCM" 2500;
BA_DEF_DEF_ "GenSigTimeoutTime_BSM" 2500;
BA_DEF_DEF_ "GenSigTimeoutTime_CADM" 2500;
BA_DEF_DEF_ "GenSigTimeoutTime_DTCM" 2500;
BA_DEF_DEF_ "GenSigTimeoutTime_ECM" 2500;
BA_DEF_DEF_ "GenSigTimeoutTime_IPC" 2500;
BA_DEF_DEF_ "GenSigTimeoutTime_RFHM" 2500;
BA_DEF_DEF_ "GenSigTimeoutTime_SGW" 2500;
BA_DEF_DEF_ "GenSigTimeoutTime_TCM" 2500;
BA_ "Type" BO_ 1450 3;
BA_ "GenMsgSendType" BO_ 1450 0;
BA_ "GenMsgNrOfRepetition" BO_ 1450 2;
BA_ "GenMsgILSupport" BO_ 1450 1;
BA_ "GenMsgCycleTimeFast" BO_ 1450 20;
BA_ "GenMsgCycleTime" BO_ 1450 1000;
BA_ "GenMsgDelayTime" BO_ 1450 20;
BA_ "CANFD_BRS" BO_ 1450 1;
BA_ "Type" BO_ 1059 8;
BA_ "GenMsgILSupport" BO_ 1059 1;
BA_ "CANFD_BRS" BO_ 1059 1;
BA_ "Type" BO_ 254 12;
BA_ "GenMsgILSupport" BO_ 254 1;
BA_ "CANFD_BRS" BO_ 254 1;
BA_ "Type" BO_ 1472 3;
BA_ "GenMsgSendType" BO_ 1472 0;
BA_ "GenMsgILSupport" BO_ 1472 1;
BA_ "GenMsgCycleTime" BO_ 1472 1000;
BA_ "GenMsgDelayTime" BO_ 1472 20;
BA_ "CANFD_BRS" BO_ 1472 1;
BA_ "Type" BO_ 951 9;
BA_ "GenMsgNrOfRepetition" BO_ 951 2;
BA_ "GenMsgILSupport" BO_ 951 1;
BA_ "GenMsgCycleTimeFast" BO_ 951 100;
BA_ "GenMsgDelayTime" BO_ 951 20;
BA_ "CANFD_BRS" BO_ 951 1;
BA_ "Type" BO_ 2566846208 1;
BA_ "GenMsgSendType" BO_ 2566846208 0;
BA_ "GenMsgILSupport" BO_ 2566846208 1;
BA_ "GenMsgCycleTime" BO_ 2566846208 1000;
BA_ "GenMsgDelayTime" BO_ 2566846208 20;
BA_ "VFrameFormat" BO_ 2566846208 1;
BA_ "Type" BO_ 2566842112 8;
BA_ "GenMsgILSupport" BO_ 2566842112 1;
BA_ "GenMsgDelayTime" BO_ 2566842112 20;
BA_ "VFrameFormat" BO_ 2566842112 1;
BA_ "Type" BO_ 2566843392 8;
BA_ "GenMsgILSupport" BO_ 2566843392 1;
BA_ "GenMsgDelayTime" BO_ 2566843392 20;
BA_ "VFrameFormat" BO_ 2566843392 1;
BA_ "Type" BO_ 1053 1;
BA_ "GenMsgSendType" BO_ 1053 0;
BA_ "GenMsgILSupport" BO_ 1053 1;
BA_ "GenMsgStartDelayTime" BO_ 1053 95;
BA_ "GenMsgCycleTime" BO_ 1053 100;
BA_ "CANFD_BRS" BO_ 1053 1;
BA_ "Type" BO_ 1098 1;
BA_ "GenMsgSendType" BO_ 1098 0;
BA_ "GenMsgILSupport" BO_ 1098 1;
BA_ "GenMsgCycleTime" BO_ 1098 100;
BA_ "CANFD_BRS" BO_ 1098 1;
BA_ "GenSigSendType" SG_ 1450 CrankEnable 3;
BA_ "GenSigTimeoutTime_AGSM" SG_ 1450 CrankEnable 0;
BA_ "GenSigTimeoutTime_ASBS" SG_ 1450 CrankEnable 0;
BA_ "GenSigTimeoutTime_BCM" SG_ 1450 CrankEnable 0;
BA_ "GenSigTimeoutTime_BSM" SG_ 1450 CrankEnable 0;
BA_ "GenSigTimeoutTime_CADM" SG_ 1450 CrankEnable 0;
BA_ "GenSigTimeoutTime_DTCM" SG_ 1450 CrankEnable 0;
BA_ "GenSigTimeoutTime_ECM" SG_ 1450 CrankEnable 0;
BA_ "GenSigTimeoutTime_IPC" SG_ 1450 CrankEnable 0;
BA_ "GenSigTimeoutTime_RFHM" SG_ 1450 CrankEnable 0;
BA_ "GenSigTimeoutTime_TCM" SG_ 1450 CrankEnable 0;
BA_ "GenSigTimeoutTime_ASBS" SG_ 1450 CRC_TRANSM4 0;
BA_ "GenSigTimeoutTime_RFHM" SG_ 1450 CRC_TRANSM4 0;
BA_ "GenSigTimeoutTime_TCM" SG_ 1450 CRC_TRANSM4 0;
BA_ "GenSigSendType" SG_ 1450 DriveModeSts 3;
BA_ "GenSigTimeoutTime_AGSM" SG_ 1450 DriveModeSts 0;
BA_ "GenSigTimeoutTime_ASBS" SG_ 1450 DriveModeSts 0;
BA_ "GenSigTimeoutTime_BCM" SG_ 1450 DriveModeSts 0;
BA_ "GenSigTimeoutTime_CADM" SG_ 1450 DriveModeSts 0;
BA_ "GenSigTimeoutTime_DTCM" SG_ 1450 DriveModeSts 0;
BA_ "GenSigTimeoutTime_IPC" SG_ 1450 DriveModeSts 0;
BA_ "GenSigTimeoutTime_RFHM" SG_ 1450 DriveModeSts 0;
BA_ "GenSigTimeoutTime_SGW" SG_ 1450 DriveModeSts 0;
BA_ "GenSigSendType" SG_ 1450 GearDisplayForCluster 3;
BA_ "GenSigTimeoutTime_AGSM" SG_ 1450 GearDisplayForCluster 0;
BA_ "GenSigTimeoutTime_ASBS" SG_ 1450 GearDisplayForCluster 0;
BA_ "GenSigTimeoutTime_BCM" SG_ 1450 GearDisplayForCluster 0;
BA_ "GenSigTimeoutTime_BSM" SG_ 1450 GearDisplayForCluster 0;
BA_ "GenSigTimeoutTime_DTCM" SG_ 1450 GearDisplayForCluster 0;
BA_ "GenSigTimeoutTime_ECM" SG_ 1450 GearDisplayForCluster 0;
BA_ "GenSigTimeoutTime_RFHM" SG_ 1450 GearDisplayForCluster 0;
BA_ "GenSigTimeoutTime_SGW" SG_ 1450 GearDisplayForCluster 0;
BA_ "GenSigTimeoutTime_TCM" SG_ 1450 GearDisplayForCluster 0;
BA_ "GenSigSendType" SG_ 1450 GearEngaged 3;
BA_ "GenSigTimeoutTime_AGSM" SG_ 1450 GearEngaged 0;
BA_ "GenSigTimeoutTime_ASBS" SG_ 1450 GearEngaged 0;
BA_ "GenSigTimeoutTime_IPC" SG_ 1450 GearEngaged 0;
BA_ "GenSigTimeoutTime_TCM" SG_ 1450 GearEngaged 0;
BA_ "GenSigSendType" SG_ 1450 GearIndicationSts 3;
BA_ "GenSigTimeoutTime_ASBS" SG_ 1450 GearIndicationSts 0;
BA_ "GenSigTimeoutTime_BCM" SG_ 1450 GearIndicationSts 0;
BA_ "GenSigTimeoutTime_BSM" SG_ 1450 GearIndicationSts 0;
BA_ "GenSigTimeoutTime_CADM" SG_ 1450 GearIndicationSts 0;
BA_ "GenSigTimeoutTime_DTCM" SG_ 1450 GearIndicationSts 0;
BA_ "GenSigTimeoutTime_ECM" SG_ 1450 GearIndicationSts 0;
BA_ "GenSigTimeoutTime_RFHM" SG_ 1450 GearIndicationSts 0;
BA_ "GenSigTimeoutTime_SGW" SG_ 1450 GearIndicationSts 0;
BA_ "GenSigTimeoutTime_TCM" SG_ 1450 GearIndicationSts 0;
BA_ "GenSigSendType" SG_ 1450 HAS_SoH_TCM 3;
BA_ "GenSigTimeoutTime_AGSM" SG_ 1450 HAS_SoH_TCM 0;
BA_ "GenSigTimeoutTime_ASBS" SG_ 1450 HAS_SoH_TCM 0;
BA_ "GenSigTimeoutTime_BCM" SG_ 1450 HAS_SoH_TCM 0;
BA_ "GenSigTimeoutTime_BSM" SG_ 1450 HAS_SoH_TCM 0;
BA_ "GenSigTimeoutTime_CADM" SG_ 1450 HAS_SoH_TCM 0;
BA_ "GenSigTimeoutTime_DTCM" SG_ 1450 HAS_SoH_TCM 0;
BA_ "GenSigTimeoutTime_ECM" SG_ 1450 HAS_SoH_TCM 0;
BA_ "GenSigTimeoutTime_IPC" SG_ 1450 HAS_SoH_TCM 0;
BA_ "GenSigTimeoutTime_RFHM" SG_ 1450 HAS_SoH_TCM 0;
BA_ "GenSigTimeoutTime_SGW" SG_ 1450 HAS_SoH_TCM 0;
BA_ "GenSigTimeoutTime_TCM" SG_ 1450 HAS_SoH_TCM 0;
BA_ "GenSigSendType" SG_ 1450 LimpHomeSts 3;
BA_ "GenSigTimeoutTime_AGSM" SG_ 1450 LimpHomeSts 0;
BA_ "GenSigTimeoutTime_ASBS" SG_ 1450 LimpHomeSts 0;
BA_ "GenSigTimeoutTime_BSM" SG_ 1450 LimpHomeSts 0;
BA_ "GenSigTimeoutTime_DTCM" SG_ 1450 LimpHomeSts 0;
BA_ "GenSigTimeoutTime_IPC" SG_ 1450 LimpHomeSts 0;
BA_ "GenSigTimeoutTime_RFHM" SG_ 1450 LimpHomeSts 0;
BA_ "GenSigTimeoutTime_SGW" SG_ 1450 LimpHomeSts 0;
BA_ "GenSigTimeoutTime_TCM" SG_ 1450 LimpHomeSts 0;
BA_ "GenSigTimeoutTime_ASBS" SG_ 1450 MessageCounter_TRANSM4 0;
BA_ "GenSigTimeoutTime_RFHM" SG_ 1450 MessageCounter_TRANSM4 0;
BA_ "GenSigTimeoutTime_TCM" SG_ 1450 MessageCounter_TRANSM4 0;
BA_ "GenSigSendType" SG_ 1450 MIReq 3;
BA_ "GenSigTimeoutTime_AGSM" SG_ 1450 MIReq 0;
BA_ "GenSigTimeoutTime_ASBS" SG_ 1450 MIReq 0;
BA_ "GenSigTimeoutTime_BCM" SG_ 1450 MIReq 0;
BA_ "GenSigTimeoutTime_BSM" SG_ 1450 MIReq 0;
BA_ "GenSigTimeoutTime_CADM" SG_ 1450 MIReq 0;
BA_ "GenSigTimeoutTime_DTCM" SG_ 1450 MIReq 0;
BA_ "GenSigTimeoutTime_IPC" SG_ 1450 MIReq 0;
BA_ "GenSigTimeoutTime_RFHM" SG_ 1450 MIReq 0;
BA_ "GenSigTimeoutTime_TCM" SG_ 1450 MIReq 0;
BA_ "GenSigSendType" SG_ 1450 OilTemperatureSts 3;
BA_ "GenSigTimeoutTime_AGSM" SG_ 1450 OilTemperatureSts 0;
BA_ "GenSigTimeoutTime_ASBS" SG_ 1450 OilTemperatureSts 0;
BA_ "GenSigTimeoutTime_BCM" SG_ 1450 OilTemperatureSts 0;
BA_ "GenSigTimeoutTime_BSM" SG_ 1450 OilTemperatureSts 0;
BA_ "GenSigTimeoutTime_CADM" SG_ 1450 OilTemperatureSts 0;
BA_ "GenSigTimeoutTime_DTCM" SG_ 1450 OilTemperatureSts 0;
BA_ "GenSigTimeoutTime_ECM" SG_ 1450 OilTemperatureSts 0;
BA_ "GenSigTimeoutTime_RFHM" SG_ 1450 OilTemperatureSts 0;
BA_ "GenSigTimeoutTime_TCM" SG_ 1450 OilTemperatureSts 0;
BA_ "GenSigSendType" SG_ 1450 R_SHFT_LOCK 3;
BA_ "GenSigTimeoutTime_ASBS" SG_ 1450 R_SHFT_LOCK 0;
BA_ "GenSigTimeoutTime_BCM" SG_ 1450 R_SHFT_LOCK 0;
BA_ "GenSigTimeoutTime_BSM" SG_ 1450 R_SHFT_LOCK 0;
BA_ "GenSigTimeoutTime_CADM" SG_ 1450 R_SHFT_LOCK 0;
BA_ "GenSigTimeoutTime_DTCM" SG_ 1450 R_SHFT_LOCK 0;
BA_ "GenSigTimeoutTime_ECM" SG_ 1450 R_SHFT_LOCK 0;
BA_ "GenSigTimeoutTime_IPC" SG_ 1450 R_SHFT_LOCK 0;
BA_ "GenSigTimeoutTime_RFHM" SG_ 1450 R_SHFT_LOCK 0;
BA_ "GenSigTimeoutTime_SGW" SG_ 1450 R_SHFT_LOCK 0;
BA_ "GenSigTimeoutTime_TCM" SG_ 1450 R_SHFT_LOCK 0;
BA_ "GenSigSendType" SG_ 1450 Secure_Idle_HMI 3;
BA_ "GenSigTimeoutTime_AGSM" SG_ 1450 Secure_Idle_HMI 0;
BA_ "GenSigTimeoutTime_ASBS" SG_ 1450 Secure_Idle_HMI 0;
BA_ "GenSigTimeoutTime_BCM" SG_ 1450 Secure_Idle_HMI 0;
BA_ "GenSigTimeoutTime_BSM" SG_ 1450 Secure_Idle_HMI 0;
BA_ "GenSigTimeoutTime_CADM" SG_ 1450 Secure_Idle_HMI 0;
BA_ "GenSigTimeoutTime_DTCM" SG_ 1450 Secure_Idle_HMI 0;
BA_ "GenSigTimeoutTime_ECM" SG_ 1450 Secure_Idle_HMI 0;
BA_ "GenSigTimeoutTime_RFHM" SG_ 1450 Secure_Idle_HMI 0;
BA_ "GenSigTimeoutTime_SGW" SG_ 1450 Secure_Idle_HMI 0;
BA_ "GenSigTimeoutTime_TCM" SG_ 1450 Secure_Idle_HMI 0;
BA_ "GenSigSendType" SG_ 1450 ShiftInProgress 3;
BA_ "GenSigTimeoutTime_AGSM" SG_ 1450 ShiftInProgress 0;
BA_ "GenSigTimeoutTime_ASBS" SG_ 1450 ShiftInProgress 0;
BA_ "GenSigTimeoutTime_BCM" SG_ 1450 ShiftInProgress 0;
BA_ "GenSigTimeoutTime_CADM" SG_ 1450 ShiftInProgress 0;
BA_ "GenSigTimeoutTime_DTCM" SG_ 1450 ShiftInProgress 0;
BA_ "GenSigTimeoutTime_IPC" SG_ 1450 ShiftInProgress 0;
BA_ "GenSigTimeoutTime_RFHM" SG_ 1450 ShiftInProgress 0;
BA_ "GenSigTimeoutTime_TCM" SG_ 1450 ShiftInProgress 0;
BA_ "GenSigSendType" SG_ 1450 ShiftLeverLockReq 3;
BA_ "GenSigTimeoutTime_ASBS" SG_ 1450 ShiftLeverLockReq 0;
BA_ "GenSigTimeoutTime_BCM" SG_ 1450 ShiftLeverLockReq 0;
BA_ "GenSigTimeoutTime_BSM" SG_ 1450 ShiftLeverLockReq 0;
BA_ "GenSigTimeoutTime_CADM" SG_ 1450 ShiftLeverLockReq 0;
BA_ "GenSigTimeoutTime_DTCM" SG_ 1450 ShiftLeverLockReq 0;
BA_ "GenSigTimeoutTime_ECM" SG_ 1450 ShiftLeverLockReq 0;
BA_ "GenSigTimeoutTime_IPC" SG_ 1450 ShiftLeverLockReq 0;
BA_ "GenSigTimeoutTime_RFHM" SG_ 1450 ShiftLeverLockReq 0;
BA_ "GenSigTimeoutTime_SGW" SG_ 1450 ShiftLeverLockReq 0;
BA_ "GenSigTimeoutTime_TCM" SG_ 1450 ShiftLeverLockReq 0;
BA_ "GenSigSendType" SG_ 1450 ShiftLeverPosition 3;
BA_ "GenSigTimeoutTime_ASBS" SG_ 1450 ShiftLeverPosition 0;
BA_ "GenSigTimeoutTime_DTCM" SG_ 1450 ShiftLeverPosition 0;
BA_ "GenSigTimeoutTime_RFHM" SG_ 1450 ShiftLeverPosition 0;
BA_ "GenSigTimeoutTime_TCM" SG_ 1450 ShiftLeverPosition 0;
BA_ "GenSigSendType" SG_ 1450 ShiftMapNotAchieved 3;
BA_ "GenSigTimeoutTime_AGSM" SG_ 1450 ShiftMapNotAchieved 0;
BA_ "GenSigTimeoutTime_ASBS" SG_ 1450 ShiftMapNotAchieved 0;
BA_ "GenSigTimeoutTime_BCM" SG_ 1450 ShiftMapNotAchieved 0;
BA_ "GenSigTimeoutTime_BSM" SG_ 1450 ShiftMapNotAchieved 0;
BA_ "GenSigTimeoutTime_CADM" SG_ 1450 ShiftMapNotAchieved 0;
BA_ "GenSigTimeoutTime_DTCM" SG_ 1450 ShiftMapNotAchieved 0;
BA_ "GenSigTimeoutTime_IPC" SG_ 1450 ShiftMapNotAchieved 0;
BA_ "GenSigTimeoutTime_RFHM" SG_ 1450 ShiftMapNotAchieved 0;
BA_ "GenSigTimeoutTime_SGW" SG_ 1450 ShiftMapNotAchieved 0;
BA_ "GenSigTimeoutTime_TCM" SG_ 1450 ShiftMapNotAchieved 0;
BA_ "GenSigSendType" SG_ 1450 ShiftModeSts 3;
BA_ "GenSigTimeoutTime_AGSM" SG_ 1450 ShiftModeSts 0;
BA_ "GenSigTimeoutTime_ASBS" SG_ 1450 ShiftModeSts 0;
BA_ "GenSigTimeoutTime_BCM" SG_ 1450 ShiftModeSts 0;
BA_ "GenSigTimeoutTime_BSM" SG_ 1450 ShiftModeSts 0;
BA_ "GenSigTimeoutTime_ECM" SG_ 1450 ShiftModeSts 0;
BA_ "GenSigTimeoutTime_RFHM" SG_ 1450 ShiftModeSts 0;
BA_ "GenSigTimeoutTime_TCM" SG_ 1450 ShiftModeSts 0;
BA_ "GenSigSendType" SG_ 1450 TransmissionFailSts 3;
BA_ "GenSigTimeoutTime_ASBS" SG_ 1450 TransmissionFailSts 0;
BA_ "GenSigTimeoutTime_BSM" SG_ 1450 TransmissionFailSts 0;
BA_ "GenSigTimeoutTime_CADM" SG_ 1450 TransmissionFailSts 0;
BA_ "GenSigTimeoutTime_DTCM" SG_ 1450 TransmissionFailSts 0;
BA_ "GenSigTimeoutTime_ECM" SG_ 1450 TransmissionFailSts 0;
BA_ "GenSigTimeoutTime_IPC" SG_ 1450 TransmissionFailSts 0;
BA_ "GenSigTimeoutTime_RFHM" SG_ 1450 TransmissionFailSts 0;
BA_ "GenSigTimeoutTime_TCM" SG_ 1450 TransmissionFailSts 0;
BA_ "GenSigSendType" SG_ 1450 TransmissionWarnings 3;
BA_ "GenSigTimeoutTime_AGSM" SG_ 1450 TransmissionWarnings 0;
BA_ "GenSigTimeoutTime_ASBS" SG_ 1450 TransmissionWarnings 0;
BA_ "GenSigTimeoutTime_BSM" SG_ 1450 TransmissionWarnings 0;
BA_ "GenSigTimeoutTime_CADM" SG_ 1450 TransmissionWarnings 0;
BA_ "GenSigTimeoutTime_DTCM" SG_ 1450 TransmissionWarnings 0;
BA_ "GenSigTimeoutTime_ECM" SG_ 1450 TransmissionWarnings 0;
BA_ "GenSigTimeoutTime_RFHM" SG_ 1450 TransmissionWarnings 0;
BA_ "GenSigTimeoutTime_TCM" SG_ 1450 TransmissionWarnings 0;
BA_ "GenSigTimeoutTime_AGSM" SG_ 1059 CodeCheckSts_TRM 0;
BA_ "GenSigTimeoutTime_ASBS" SG_ 1059 CodeCheckSts_TRM 0;
BA_ "GenSigTimeoutTime_BSM" SG_ 1059 CodeCheckSts_TRM 0;
BA_ "GenSigTimeoutTime_CADM" SG_ 1059 CodeCheckSts_TRM 0;
BA_ "GenSigTimeoutTime_DTCM" SG_ 1059 CodeCheckSts_TRM 0;
BA_ "GenSigTimeoutTime_ECM" SG_ 1059 CodeCheckSts_TRM 0;
BA_ "GenSigTimeoutTime_IPC" SG_ 1059 CodeCheckSts_TRM 0;
BA_ "GenSigTimeoutTime_RFHM" SG_ 1059 CodeCheckSts_TRM 0;
BA_ "GenSigTimeoutTime_SGW" SG_ 1059 CodeCheckSts_TRM 0;
BA_ "GenSigTimeoutTime_TCM" SG_ 1059 CodeCheckSts_TRM 0;
BA_ "GenSigSendType" SG_ 1059 ControlEncoding_TRM_Rsp 3;
BA_ "GenSigTimeoutTime_AGSM" SG_ 1059 ControlEncoding_TRM_Rsp 0;
BA_ "GenSigTimeoutTime_ASBS" SG_ 1059 ControlEncoding_TRM_Rsp 0;
BA_ "GenSigTimeoutTime_BSM" SG_ 1059 ControlEncoding_TRM_Rsp 0;
BA_ "GenSigTimeoutTime_CADM" SG_ 1059 ControlEncoding_TRM_Rsp 0;
BA_ "GenSigTimeoutTime_DTCM" SG_ 1059 ControlEncoding_TRM_Rsp 0;
BA_ "GenSigTimeoutTime_ECM" SG_ 1059 ControlEncoding_TRM_Rsp 0;
BA_ "GenSigTimeoutTime_IPC" SG_ 1059 ControlEncoding_TRM_Rsp 0;
BA_ "GenSigTimeoutTime_RFHM" SG_ 1059 ControlEncoding_TRM_Rsp 0;
BA_ "GenSigTimeoutTime_SGW" SG_ 1059 ControlEncoding_TRM_Rsp 0;
BA_ "GenSigTimeoutTime_TCM" SG_ 1059 ControlEncoding_TRM_Rsp 0;
BA_ "GenSigTimeoutTime_AGSM" SG_ 1059 MiniCryptGCode_TRM_Rsp 0;
BA_ "GenSigTimeoutTime_ASBS" SG_ 1059 MiniCryptGCode_TRM_Rsp 0;
BA_ "GenSigTimeoutTime_BSM" SG_ 1059 MiniCryptGCode_TRM_Rsp 0;
BA_ "GenSigTimeoutTime_CADM" SG_ 1059 MiniCryptGCode_TRM_Rsp 0;
BA_ "GenSigTimeoutTime_DTCM" SG_ 1059 MiniCryptGCode_TRM_Rsp 0;
BA_ "GenSigTimeoutTime_ECM" SG_ 1059 MiniCryptGCode_TRM_Rsp 0;
BA_ "GenSigTimeoutTime_IPC" SG_ 1059 MiniCryptGCode_TRM_Rsp 0;
BA_ "GenSigTimeoutTime_RFHM" SG_ 1059 MiniCryptGCode_TRM_Rsp 0;
BA_ "GenSigTimeoutTime_SGW" SG_ 1059 MiniCryptGCode_TRM_Rsp 0;
BA_ "GenSigTimeoutTime_TCM" SG_ 1059 MiniCryptGCode_TRM_Rsp 0;
BA_ "GenSigTimeoutTime_AGSM" SG_ 1059 ProgrammedSts_TRM 0;
BA_ "GenSigTimeoutTime_ASBS" SG_ 1059 ProgrammedSts_TRM 0;
BA_ "GenSigTimeoutTime_BSM" SG_ 1059 ProgrammedSts_TRM 0;
BA_ "GenSigTimeoutTime_CADM" SG_ 1059 ProgrammedSts_TRM 0;
BA_ "GenSigTimeoutTime_DTCM" SG_ 1059 ProgrammedSts_TRM 0;
BA_ "GenSigTimeoutTime_ECM" SG_ 1059 ProgrammedSts_TRM 0;
BA_ "GenSigTimeoutTime_IPC" SG_ 1059 ProgrammedSts_TRM 0;
BA_ "GenSigTimeoutTime_RFHM" SG_ 1059 ProgrammedSts_TRM 0;
BA_ "GenSigTimeoutTime_SGW" SG_ 1059 ProgrammedSts_TRM 0;
BA_ "GenSigTimeoutTime_TCM" SG_ 1059 ProgrammedSts_TRM 0;
BA_ "GenSigStartValue" SG_ 1059 TxpFound 1;
BA_ "GenSigTimeoutTime_AGSM" SG_ 1059 TxpFound 0;
BA_ "GenSigTimeoutTime_ASBS" SG_ 1059 TxpFound 0;
BA_ "GenSigTimeoutTime_BSM" SG_ 1059 TxpFound 0;
BA_ "GenSigTimeoutTime_CADM" SG_ 1059 TxpFound 0;
BA_ "GenSigTimeoutTime_DTCM" SG_ 1059 TxpFound 0;
BA_ "GenSigTimeoutTime_ECM" SG_ 1059 TxpFound 0;
BA_ "GenSigTimeoutTime_IPC" SG_ 1059 TxpFound 0;
BA_ "GenSigTimeoutTime_RFHM" SG_ 1059 TxpFound 0;
BA_ "GenSigTimeoutTime_SGW" SG_ 1059 TxpFound 0;
BA_ "GenSigTimeoutTime_TCM" SG_ 1059 TxpFound 0;
BA_ "GenSigSendType" SG_ 1059 TxpID3 3;
BA_ "GenSigTimeoutTime_AGSM" SG_ 1059 TxpID3 0;
BA_ "GenSigTimeoutTime_ASBS" SG_ 1059 TxpID3 0;
BA_ "GenSigTimeoutTime_BSM" SG_ 1059 TxpID3 0;
BA_ "GenSigTimeoutTime_CADM" SG_ 1059 TxpID3 0;
BA_ "GenSigTimeoutTime_DTCM" SG_ 1059 TxpID3 0;
BA_ "GenSigTimeoutTime_ECM" SG_ 1059 TxpID3 0;
BA_ "GenSigTimeoutTime_IPC" SG_ 1059 TxpID3 0;
BA_ "GenSigTimeoutTime_RFHM" SG_ 1059 TxpID3 0;
BA_ "GenSigTimeoutTime_SGW" SG_ 1059 TxpID3 0;
BA_ "GenSigTimeoutTime_TCM" SG_ 1059 TxpID3 0;
BA_ "GenSigTimeoutTime_AGSM" SG_ 254 DATA1 0;
BA_ "GenSigTimeoutTime_ASBS" SG_ 254 DATA1 0;
BA_ "GenSigTimeoutTime_BSM" SG_ 254 DATA1 0;
BA_ "GenSigTimeoutTime_CADM" SG_ 254 DATA1 0;
BA_ "GenSigTimeoutTime_DTCM" SG_ 254 DATA1 0;
BA_ "GenSigTimeoutTime_ECM" SG_ 254 DATA1 0;
BA_ "GenSigTimeoutTime_IPC" SG_ 254 DATA1 0;
BA_ "GenSigTimeoutTime_RFHM" SG_ 254 DATA1 0;
BA_ "GenSigTimeoutTime_SGW" SG_ 254 DATA1 0;
BA_ "GenSigTimeoutTime_TCM" SG_ 254 DATA1 0;
BA_ "GenSigTimeoutTime_AGSM" SG_ 254 DATA2 0;
BA_ "GenSigTimeoutTime_ASBS" SG_ 254 DATA2 0;
BA_ "GenSigTimeoutTime_BSM" SG_ 254 DATA2 0;
BA_ "GenSigTimeoutTime_CADM" SG_ 254 DATA2 0;
BA_ "GenSigTimeoutTime_DTCM" SG_ 254 DATA2 0;
BA_ "GenSigTimeoutTime_ECM" SG_ 254 DATA2 0;
BA_ "GenSigTimeoutTime_IPC" SG_ 254 DATA2 0;
BA_ "GenSigTimeoutTime_RFHM" SG_ 254 DATA2 0;
BA_ "GenSigTimeoutTime_SGW" SG_ 254 DATA2 0;
BA_ "GenSigTimeoutTime_TCM" SG_ 254 DATA2 0;
BA_ "GenSigTimeoutTime_AGSM" SG_ 254 DATA3 0;
BA_ "GenSigTimeoutTime_ASBS" SG_ 254 DATA3 0;
BA_ "GenSigTimeoutTime_BSM" SG_ 254 DATA3 0;
BA_ "GenSigTimeoutTime_CADM" SG_ 254 DATA3 0;
BA_ "GenSigTimeoutTime_DTCM" SG_ 254 DATA3 0;
BA_ "GenSigTimeoutTime_ECM" SG_ 254 DATA3 0;
BA_ "GenSigTimeoutTime_IPC" SG_ 254 DATA3 0;
BA_ "GenSigTimeoutTime_RFHM" SG_ 254 DATA3 0;
BA_ "GenSigTimeoutTime_SGW" SG_ 254 DATA3 0;
BA_ "GenSigTimeoutTime_TCM" SG_ 254 DATA3 0;
BA_ "GenSigTimeoutTime_AGSM" SG_ 254 DATA4 0;
BA_ "GenSigTimeoutTime_ASBS" SG_ 254 DATA4 0;
BA_ "GenSigTimeoutTime_BSM" SG_ 254 DATA4 0;
BA_ "GenSigTimeoutTime_CADM" SG_ 254 DATA4 0;
BA_ "GenSigTimeoutTime_DTCM" SG_ 254 DATA4 0;
BA_ "GenSigTimeoutTime_ECM" SG_ 254 DATA4 0;
BA_ "GenSigTimeoutTime_IPC" SG_ 254 DATA4 0;
BA_ "GenSigTimeoutTime_RFHM" SG_ 254 DATA4 0;
BA_ "GenSigTimeoutTime_SGW" SG_ 254 DATA4 0;
BA_ "GenSigTimeoutTime_TCM" SG_ 254 DATA4 0;
BA_ "GenSigTimeoutTime_AGSM" SG_ 254 DATA5 0;
BA_ "GenSigTimeoutTime_ASBS" SG_ 254 DATA5 0;
BA_ "GenSigTimeoutTime_BSM" SG_ 254 DATA5 0;
BA_ "GenSigTimeoutTime_CADM" SG_ 254 DATA5 0;
BA_ "GenSigTimeoutTime_DTCM" SG_ 254 DATA5 0;
BA_ "GenSigTimeoutTime_ECM" SG_ 254 DATA5 0;
BA_ "GenSigTimeoutTime_IPC" SG_ 254 DATA5 0;
BA_ "GenSigTimeoutTime_RFHM" SG_ 254 DATA5 0;
BA_ "GenSigTimeoutTime_SGW" SG_ 254 DATA5 0;
BA_ "GenSigTimeoutTime_TCM" SG_ 254 DATA5 0;
BA_ "GenSigTimeoutTime_AGSM" SG_ 254 DATA6 0;
BA_ "GenSigTimeoutTime_ASBS" SG_ 254 DATA6 0;
BA_ "GenSigTimeoutTime_BSM" SG_ 254 DATA6 0;
BA_ "GenSigTimeoutTime_CADM" SG_ 254 DATA6 0;
BA_ "GenSigTimeoutTime_DTCM" SG_ 254 DATA6 0;
BA_ "GenSigTimeoutTime_ECM" SG_ 254 DATA6 0;
BA_ "GenSigTimeoutTime_IPC" SG_ 254 DATA6 0;
BA_ "GenSigTimeoutTime_RFHM" SG_ 254 DATA6 0;
BA_ "GenSigTimeoutTime_SGW" SG_ 254 DATA6 0;
BA_ "GenSigTimeoutTime_TCM" SG_ 254 DATA6 0;
BA_ "GenSigTimeoutTime_AGSM" SG_ 254 DATA7 0;
BA_ "GenSigTimeoutTime_ASBS" SG_ 254 DATA7 0;
BA_ "GenSigTimeoutTime_BSM" SG_ 254 DATA7 0;
BA_ "GenSigTimeoutTime_CADM" SG_ 254 DATA7 0;
BA_ "GenSigTimeoutTime_DTCM" SG_ 254 DATA7 0;
BA_ "GenSigTimeoutTime_ECM" SG_ 254 DATA7 0;
BA_ "GenSigTimeoutTime_IPC" SG_ 254 DATA7 0;
BA_ "GenSigTimeoutTime_RFHM" SG_ 254 DATA7 0;
BA_ "GenSigTimeoutTime_SGW" SG_ 254 DATA7 0;
BA_ "GenSigTimeoutTime_TCM" SG_ 254 DATA7 0;
BA_ "GenSigSendType" SG_ 254 FrameNumber 1;
BA_ "GenSigTimeoutTime_AGSM" SG_ 254 FrameNumber 0;
BA_ "GenSigTimeoutTime_ASBS" SG_ 254 FrameNumber 0;
BA_ "GenSigTimeoutTime_BSM" SG_ 254 FrameNumber 0;
BA_ "GenSigTimeoutTime_CADM" SG_ 254 FrameNumber 0;
BA_ "GenSigTimeoutTime_DTCM" SG_ 254 FrameNumber 0;
BA_ "GenSigTimeoutTime_ECM" SG_ 254 FrameNumber 0;
BA_ "GenSigTimeoutTime_IPC" SG_ 254 FrameNumber 0;
BA_ "GenSigTimeoutTime_RFHM" SG_ 254 FrameNumber 0;
BA_ "GenSigTimeoutTime_SGW" SG_ 254 FrameNumber 0;
BA_ "GenSigTimeoutTime_TCM" SG_ 254 FrameNumber 0;
BA_ "GenSigTimeoutTime_AGSM" SG_ 254 TotalFrameNumber 0;
BA_ "GenSigTimeoutTime_ASBS" SG_ 254 TotalFrameNumber 0;
BA_ "GenSigTimeoutTime_BSM" SG_ 254 TotalFrameNumber 0;
BA_ "GenSigTimeoutTime_CADM" SG_ 254 TotalFrameNumber 0;
BA_ "GenSigTimeoutTime_DTCM" SG_ 254 TotalFrameNumber 0;
BA_ "GenSigTimeoutTime_ECM" SG_ 254 TotalFrameNumber 0;
BA_ "GenSigTimeoutTime_IPC" SG_ 254 TotalFrameNumber 0;
BA_ "GenSigTimeoutTime_RFHM" SG_ 254 TotalFrameNumber 0;
BA_ "GenSigTimeoutTime_SGW" SG_ 254 TotalFrameNumber 0;
BA_ "GenSigTimeoutTime_TCM" SG_ 254 TotalFrameNumber 0;
BA_ "GenSigTimeoutTime_AGSM" SG_ 1472 CRC_TRSCM1 0;
BA_ "GenSigTimeoutTime_ASBS" SG_ 1472 CRC_TRSCM1 0;
BA_ "GenSigTimeoutTime_BCM" SG_ 1472 CRC_TRSCM1 0;
BA_ "GenSigTimeoutTime_CADM" SG_ 1472 CRC_TRSCM1 0;
BA_ "GenSigTimeoutTime_DTCM" SG_ 1472 CRC_TRSCM1 0;
BA_ "GenSigTimeoutTime_IPC" SG_ 1472 CRC_TRSCM1 0;
BA_ "GenSigTimeoutTime_RFHM" SG_ 1472 CRC_TRSCM1 0;
BA_ "GenSigTimeoutTime_SGW" SG_ 1472 CRC_TRSCM1 0;
BA_ "GenSigTimeoutTime_TCM" SG_ 1472 CRC_TRSCM1 0;
BA_ "GenSigTimeoutTime_AGSM" SG_ 1472 MessageCounter_TRSCM1 0;
BA_ "GenSigTimeoutTime_ASBS" SG_ 1472 MessageCounter_TRSCM1 0;
BA_ "GenSigTimeoutTime_BCM" SG_ 1472 MessageCounter_TRSCM1 0;
BA_ "GenSigTimeoutTime_CADM" SG_ 1472 MessageCounter_TRSCM1 0;
BA_ "GenSigTimeoutTime_DTCM" SG_ 1472 MessageCounter_TRSCM1 0;
BA_ "GenSigTimeoutTime_IPC" SG_ 1472 MessageCounter_TRSCM1 0;
BA_ "GenSigTimeoutTime_RFHM" SG_ 1472 MessageCounter_TRSCM1 0;
BA_ "GenSigTimeoutTime_SGW" SG_ 1472 MessageCounter_TRSCM1 0;
BA_ "GenSigTimeoutTime_TCM" SG_ 1472 MessageCounter_TRSCM1 0;
BA_ "GenSigSendType" SG_ 1472 TRSC_PopupDisp_Info2 3;
BA_ "GenSigTimeoutTime_AGSM" SG_ 1472 TRSC_PopupDisp_Info2 0;
BA_ "GenSigTimeoutTime_ASBS" SG_ 1472 TRSC_PopupDisp_Info2 0;
BA_ "GenSigTimeoutTime_BCM" SG_ 1472 TRSC_PopupDisp_Info2 0;
BA_ "GenSigTimeoutTime_BSM" SG_ 1472 TRSC_PopupDisp_Info2 0;
BA_ "GenSigTimeoutTime_CADM" SG_ 1472 TRSC_PopupDisp_Info2 0;
BA_ "GenSigTimeoutTime_DTCM" SG_ 1472 TRSC_PopupDisp_Info2 0;
BA_ "GenSigTimeoutTime_ECM" SG_ 1472 TRSC_PopupDisp_Info2 0;
BA_ "GenSigTimeoutTime_RFHM" SG_ 1472 TRSC_PopupDisp_Info2 0;
BA_ "GenSigTimeoutTime_SGW" SG_ 1472 TRSC_PopupDisp_Info2 0;
BA_ "GenSigTimeoutTime_TCM" SG_ 1472 TRSC_PopupDisp_Info2 0;
BA_ "GenSigStartValue" SG_ 1472 TRSC_STAT 1;
BA_ "GenSigSendType" SG_ 1472 TRSC_STAT 3;
BA_ "GenSigTimeoutTime_AGSM" SG_ 1472 TRSC_STAT 0;
BA_ "GenSigTimeoutTime_ASBS" SG_ 1472 TRSC_STAT 0;
BA_ "GenSigTimeoutTime_BCM" SG_ 1472 TRSC_STAT 0;
BA_ "GenSigTimeoutTime_BSM" SG_ 1472 TRSC_STAT 0;
BA_ "GenSigTimeoutTime_CADM" SG_ 1472 TRSC_STAT 0;
BA_ "GenSigTimeoutTime_DTCM" SG_ 1472 TRSC_STAT 0;
BA_ "GenSigTimeoutTime_ECM" SG_ 1472 TRSC_STAT 0;
BA_ "GenSigTimeoutTime_IPC" SG_ 1472 TRSC_STAT 0;
BA_ "GenSigTimeoutTime_RFHM" SG_ 1472 TRSC_STAT 0;
BA_ "GenSigTimeoutTime_TCM" SG_ 1472 TRSC_STAT 0;
BA_ "GenSigSendType" SG_ 951 UConnReq_TBM 6;
BA_ "GenSigTimeoutTime_AGSM" SG_ 951 UConnReq_TBM 0;
BA_ "GenSigTimeoutTime_ASBS" SG_ 951 UConnReq_TBM 0;
BA_ "GenSigTimeoutTime_BCM" SG_ 951 UConnReq_TBM 0;
BA_ "GenSigTimeoutTime_BSM" SG_ 951 UConnReq_TBM 0;
BA_ "GenSigTimeoutTime_CADM" SG_ 951 UConnReq_TBM 0;
BA_ "GenSigTimeoutTime_DTCM" SG_ 951 UConnReq_TBM 0;
BA_ "GenSigTimeoutTime_ECM" SG_ 951 UConnReq_TBM 0;
BA_ "GenSigTimeoutTime_IPC" SG_ 951 UConnReq_TBM 0;
BA_ "GenSigTimeoutTime_SGW" SG_ 951 UConnReq_TBM 0;
BA_ "GenSigTimeoutTime_TCM" SG_ 951 UConnReq_TBM 0;
BA_ "GenSigTimeoutTime_AGSM" SG_ 951 UConnReqAuthCode_TBM 0;
BA_ "GenSigTimeoutTime_ASBS" SG_ 951 UConnReqAuthCode_TBM 0;
BA_ "GenSigTimeoutTime_BCM" SG_ 951 UConnReqAuthCode_TBM 0;
BA_ "GenSigTimeoutTime_BSM" SG_ 951 UConnReqAuthCode_TBM 0;
BA_ "GenSigTimeoutTime_CADM" SG_ 951 UConnReqAuthCode_TBM 0;
BA_ "GenSigTimeoutTime_DTCM" SG_ 951 UConnReqAuthCode_TBM 0;
BA_ "GenSigTimeoutTime_ECM" SG_ 951 UConnReqAuthCode_TBM 0;
BA_ "GenSigTimeoutTime_IPC" SG_ 951 UConnReqAuthCode_TBM 0;
BA_ "GenSigTimeoutTime_SGW" SG_ 951 UConnReqAuthCode_TBM 0;
BA_ "GenSigTimeoutTime_TCM" SG_ 951 UConnReqAuthCode_TBM 0;
BA_ "GenSigTimeoutTime_AGSM" SG_ 951 UConnReqFOBNum_TBM 0;
BA_ "GenSigTimeoutTime_ASBS" SG_ 951 UConnReqFOBNum_TBM 0;
BA_ "GenSigTimeoutTime_BCM" SG_ 951 UConnReqFOBNum_TBM 0;
BA_ "GenSigTimeoutTime_BSM" SG_ 951 UConnReqFOBNum_TBM 0;
BA_ "GenSigTimeoutTime_CADM" SG_ 951 UConnReqFOBNum_TBM 0;
BA_ "GenSigTimeoutTime_DTCM" SG_ 951 UConnReqFOBNum_TBM 0;
BA_ "GenSigTimeoutTime_ECM" SG_ 951 UConnReqFOBNum_TBM 0;
BA_ "GenSigTimeoutTime_IPC" SG_ 951 UConnReqFOBNum_TBM 0;
BA_ "GenSigTimeoutTime_SGW" SG_ 951 UConnReqFOBNum_TBM 0;
BA_ "GenSigTimeoutTime_TCM" SG_ 951 UConnReqFOBNum_TBM 0;
BA_ "GenSigTimeoutTime_AGSM" SG_ 2566846208 VEP1_SIG 0;
BA_ "GenSigTimeoutTime_ASBS" SG_ 2566846208 VEP1_SIG 0;
BA_ "GenSigTimeoutTime_BCM" SG_ 2566846208 VEP1_SIG 0;
BA_ "GenSigTimeoutTime_BSM" SG_ 2566846208 VEP1_SIG 0;
BA_ "GenSigTimeoutTime_CADM" SG_ 2566846208 VEP1_SIG 0;
BA_ "GenSigTimeoutTime_DTCM" SG_ 2566846208 VEP1_SIG 0;
BA_ "GenSigTimeoutTime_ECM" SG_ 2566846208 VEP1_SIG 0;
BA_ "GenSigTimeoutTime_IPC" SG_ 2566846208 VEP1_SIG 0;
BA_ "GenSigTimeoutTime_RFHM" SG_ 2566846208 VEP1_SIG 0;
BA_ "GenSigTimeoutTime_TCM" SG_ 2566846208 VEP1_SIG 0;
BA_ "GenSigSendType" SG_ 2566842112 VH_SIG 1;
BA_ "GenSigTimeoutTime_AGSM" SG_ 2566842112 VH_SIG 0;
BA_ "GenSigTimeoutTime_ASBS" SG_ 2566842112 VH_SIG 0;
BA_ "GenSigTimeoutTime_BCM" SG_ 2566842112 VH_SIG 0;
BA_ "GenSigTimeoutTime_BSM" SG_ 2566842112 VH_SIG 0;
BA_ "GenSigTimeoutTime_CADM" SG_ 2566842112 VH_SIG 0;
BA_ "GenSigTimeoutTime_DTCM" SG_ 2566842112 VH_SIG 0;
BA_ "GenSigTimeoutTime_ECM" SG_ 2566842112 VH_SIG 0;
BA_ "GenSigTimeoutTime_IPC" SG_ 2566842112 VH_SIG 0;
BA_ "GenSigTimeoutTime_RFHM" SG_ 2566842112 VH_SIG 0;
BA_ "GenSigTimeoutTime_TCM" SG_ 2566842112 VH_SIG 0;
BA_ "GenSigSendType" SG_ 2566843392 VI_SIG 1;
BA_ "GenSigTimeoutTime_AGSM" SG_ 2566843392 VI_SIG 0;
BA_ "GenSigTimeoutTime_ASBS" SG_ 2566843392 VI_SIG 0;
BA_ "GenSigTimeoutTime_BCM" SG_ 2566843392 VI_SIG 0;
BA_ "GenSigTimeoutTime_BSM" SG_ 2566843392 VI_SIG 0;
BA_ "GenSigTimeoutTime_CADM" SG_ 2566843392 VI_SIG 0;
BA_ "GenSigTimeoutTime_DTCM" SG_ 2566843392 VI_SIG 0;
BA_ "GenSigTimeoutTime_ECM" SG_ 2566843392 VI_SIG 0;
BA_ "GenSigTimeoutTime_IPC" SG_ 2566843392 VI_SIG 0;
BA_ "GenSigTimeoutTime_RFHM" SG_ 2566843392 VI_SIG 0;
BA_ "GenSigTimeoutTime_TCM" SG_ 2566843392 VI_SIG 0;
BA_ "GenSigTimeoutTime_BCM" SG_ 1053 VIN_DATA 0;
BA_ "GenSigStartValue" SG_ 1053 VIN_MSG 3;
BA_ "GenSigTimeoutTime_BCM" SG_ 1053 VIN_MSG 0;
BA_ "GenSigTimeoutTime_AGSM" SG_ 1098 DoorLkAllRq 0;
BA_ "GenSigTimeoutTime_ASBS" SG_ 1098 DoorLkAllRq 0;
BA_ "GenSigTimeoutTime_BSM" SG_ 1098 DoorLkAllRq 0;
BA_ "GenSigTimeoutTime_CADM" SG_ 1098 DoorLkAllRq 0;
BA_ "GenSigTimeoutTime_DTCM" SG_ 1098 DoorLkAllRq 0;
BA_ "GenSigTimeoutTime_ECM" SG_ 1098 DoorLkAllRq 0;
BA_ "GenSigTimeoutTime_IPC" SG_ 1098 DoorLkAllRq 0;
BA_ "GenSigTimeoutTime_RFHM" SG_ 1098 DoorLkAllRq 0;
BA_ "GenSigTimeoutTime_SGW" SG_ 1098 DoorLkAllRq 0;
BA_ "GenSigTimeoutTime_TCM" SG_ 1098 DoorLkAllRq 0;
BA_ "GenSigTimeoutTime_AGSM" SG_ 1098 DoorUnlkAllRq 0;
BA_ "GenSigTimeoutTime_ASBS" SG_ 1098 DoorUnlkAllRq 0;
BA_ "GenSigTimeoutTime_BSM" SG_ 1098 DoorUnlkAllRq 0;
BA_ "GenSigTimeoutTime_CADM" SG_ 1098 DoorUnlkAllRq 0;
BA_ "GenSigTimeoutTime_DTCM" SG_ 1098 DoorUnlkAllRq 0;
BA_ "GenSigTimeoutTime_ECM" SG_ 1098 DoorUnlkAllRq 0;
BA_ "GenSigTimeoutTime_IPC" SG_ 1098 DoorUnlkAllRq 0;
BA_ "GenSigTimeoutTime_RFHM" SG_ 1098 DoorUnlkAllRq 0;
BA_ "GenSigTimeoutTime_SGW" SG_ 1098 DoorUnlkAllRq 0;
BA_ "GenSigTimeoutTime_TCM" SG_ 1098 DoorUnlkAllRq 0;
BA_ "GenSigTimeoutTime_AGSM" SG_ 1098 DsblTurnLmpFlt 0;
BA_ "GenSigTimeoutTime_ASBS" SG_ 1098 DsblTurnLmpFlt 0;
BA_ "GenSigTimeoutTime_BSM" SG_ 1098 DsblTurnLmpFlt 0;
BA_ "GenSigTimeoutTime_CADM" SG_ 1098 DsblTurnLmpFlt 0;
BA_ "GenSigTimeoutTime_DTCM" SG_ 1098 DsblTurnLmpFlt 0;
BA_ "GenSigTimeoutTime_ECM" SG_ 1098 DsblTurnLmpFlt 0;
BA_ "GenSigTimeoutTime_IPC" SG_ 1098 DsblTurnLmpFlt 0;
BA_ "GenSigTimeoutTime_RFHM" SG_ 1098 DsblTurnLmpFlt 0;
BA_ "GenSigTimeoutTime_SGW" SG_ 1098 DsblTurnLmpFlt 0;
BA_ "GenSigTimeoutTime_TCM" SG_ 1098 DsblTurnLmpFlt 0;
BA_ "GenSigTimeoutTime_AGSM" SG_ 1098 FtWigWagRq 0;
BA_ "GenSigTimeoutTime_ASBS" SG_ 1098 FtWigWagRq 0;
BA_ "GenSigTimeoutTime_BSM" SG_ 1098 FtWigWagRq 0;
BA_ "GenSigTimeoutTime_CADM" SG_ 1098 FtWigWagRq 0;
BA_ "GenSigTimeoutTime_DTCM" SG_ 1098 FtWigWagRq 0;
BA_ "GenSigTimeoutTime_ECM" SG_ 1098 FtWigWagRq 0;
BA_ "GenSigTimeoutTime_IPC" SG_ 1098 FtWigWagRq 0;
BA_ "GenSigTimeoutTime_RFHM" SG_ 1098 FtWigWagRq 0;
BA_ "GenSigTimeoutTime_SGW" SG_ 1098 FtWigWagRq 0;
BA_ "GenSigTimeoutTime_TCM" SG_ 1098 FtWigWagRq 0;
BA_ "GenSigTimeoutTime_AGSM" SG_ 1098 IdleShutDown_Disable 0;
BA_ "GenSigTimeoutTime_ASBS" SG_ 1098 IdleShutDown_Disable 0;
BA_ "GenSigTimeoutTime_BCM" SG_ 1098 IdleShutDown_Disable 0;
BA_ "GenSigTimeoutTime_BSM" SG_ 1098 IdleShutDown_Disable 0;
BA_ "GenSigTimeoutTime_CADM" SG_ 1098 IdleShutDown_Disable 0;
BA_ "GenSigTimeoutTime_DTCM" SG_ 1098 IdleShutDown_Disable 0;
BA_ "GenSigTimeoutTime_IPC" SG_ 1098 IdleShutDown_Disable 0;
BA_ "GenSigTimeoutTime_RFHM" SG_ 1098 IdleShutDown_Disable 0;
BA_ "GenSigTimeoutTime_SGW" SG_ 1098 IdleShutDown_Disable 0;
BA_ "GenSigTimeoutTime_TCM" SG_ 1098 IdleShutDown_Disable 0;
BA_ "GenSigTimeoutTime_AGSM" SG_ 1098 J1939_RPM_RQ 0;
BA_ "GenSigTimeoutTime_ASBS" SG_ 1098 J1939_RPM_RQ 0;
BA_ "GenSigTimeoutTime_BCM" SG_ 1098 J1939_RPM_RQ 0;
BA_ "GenSigTimeoutTime_BSM" SG_ 1098 J1939_RPM_RQ 0;
BA_ "GenSigTimeoutTime_CADM" SG_ 1098 J1939_RPM_RQ 0;
BA_ "GenSigTimeoutTime_DTCM" SG_ 1098 J1939_RPM_RQ 0;
BA_ "GenSigTimeoutTime_IPC" SG_ 1098 J1939_RPM_RQ 0;
BA_ "GenSigTimeoutTime_RFHM" SG_ 1098 J1939_RPM_RQ 0;
BA_ "GenSigTimeoutTime_SGW" SG_ 1098 J1939_RPM_RQ 0;
BA_ "GenSigTimeoutTime_TCM" SG_ 1098 J1939_RPM_RQ 0;
BA_ "GenSigTimeoutTime_AGSM" SG_ 1098 PosEngdSwStat 0;
BA_ "GenSigTimeoutTime_ASBS" SG_ 1098 PosEngdSwStat 0;
BA_ "GenSigTimeoutTime_BCM" SG_ 1098 PosEngdSwStat 0;
BA_ "GenSigTimeoutTime_BSM" SG_ 1098 PosEngdSwStat 0;
BA_ "GenSigTimeoutTime_CADM" SG_ 1098 PosEngdSwStat 0;
BA_ "GenSigTimeoutTime_DTCM" SG_ 1098 PosEngdSwStat 0;
BA_ "GenSigTimeoutTime_IPC" SG_ 1098 PosEngdSwStat 0;
BA_ "GenSigTimeoutTime_RFHM" SG_ 1098 PosEngdSwStat 0;
BA_ "GenSigTimeoutTime_SGW" SG_ 1098 PosEngdSwStat 0;
BA_ "GenSigTimeoutTime_AGSM" SG_ 1098 PTO_IdleSpd1 0;
BA_ "GenSigTimeoutTime_ASBS" SG_ 1098 PTO_IdleSpd1 0;
BA_ "GenSigTimeoutTime_BCM" SG_ 1098 PTO_IdleSpd1 0;
BA_ "GenSigTimeoutTime_BSM" SG_ 1098 PTO_IdleSpd1 0;
BA_ "GenSigTimeoutTime_CADM" SG_ 1098 PTO_IdleSpd1 0;
BA_ "GenSigTimeoutTime_DTCM" SG_ 1098 PTO_IdleSpd1 0;
BA_ "GenSigTimeoutTime_IPC" SG_ 1098 PTO_IdleSpd1 0;
BA_ "GenSigTimeoutTime_RFHM" SG_ 1098 PTO_IdleSpd1 0;
BA_ "GenSigTimeoutTime_SGW" SG_ 1098 PTO_IdleSpd1 0;
BA_ "GenSigTimeoutTime_TCM" SG_ 1098 PTO_IdleSpd1 0;
BA_ "GenSigTimeoutTime_AGSM" SG_ 1098 PTO_IdleSpd2 0;
BA_ "GenSigTimeoutTime_ASBS" SG_ 1098 PTO_IdleSpd2 0;
BA_ "GenSigTimeoutTime_BCM" SG_ 1098 PTO_IdleSpd2 0;
BA_ "GenSigTimeoutTime_BSM" SG_ 1098 PTO_IdleSpd2 0;
BA_ "GenSigTimeoutTime_CADM" SG_ 1098 PTO_IdleSpd2 0;
BA_ "GenSigTimeoutTime_DTCM" SG_ 1098 PTO_IdleSpd2 0;
BA_ "GenSigTimeoutTime_IPC" SG_ 1098 PTO_IdleSpd2 0;
BA_ "GenSigTimeoutTime_RFHM" SG_ 1098 PTO_IdleSpd2 0;
BA_ "GenSigTimeoutTime_SGW" SG_ 1098 PTO_IdleSpd2 0;
BA_ "GenSigTimeoutTime_TCM" SG_ 1098 PTO_IdleSpd2 0;
BA_ "GenSigTimeoutTime_AGSM" SG_ 1098 PTO_IdleSpd3 0;
BA_ "GenSigTimeoutTime_ASBS" SG_ 1098 PTO_IdleSpd3 0;
BA_ "GenSigTimeoutTime_BCM" SG_ 1098 PTO_IdleSpd3 0;
BA_ "GenSigTimeoutTime_BSM" SG_ 1098 PTO_IdleSpd3 0;
BA_ "GenSigTimeoutTime_CADM" SG_ 1098 PTO_IdleSpd3 0;
BA_ "GenSigTimeoutTime_DTCM" SG_ 1098 PTO_IdleSpd3 0;
BA_ "GenSigTimeoutTime_IPC" SG_ 1098 PTO_IdleSpd3 0;
BA_ "GenSigTimeoutTime_RFHM" SG_ 1098 PTO_IdleSpd3 0;
BA_ "GenSigTimeoutTime_SGW" SG_ 1098 PTO_IdleSpd3 0;
BA_ "GenSigTimeoutTime_TCM" SG_ 1098 PTO_IdleSpd3 0;
BA_ "GenSigTimeoutTime_AGSM" SG_ 1098 R_AC_Enable 0;
BA_ "GenSigTimeoutTime_ASBS" SG_ 1098 R_AC_Enable 0;
BA_ "GenSigTimeoutTime_BSM" SG_ 1098 R_AC_Enable 0;
BA_ "GenSigTimeoutTime_CADM" SG_ 1098 R_AC_Enable 0;
BA_ "GenSigTimeoutTime_DTCM" SG_ 1098 R_AC_Enable 0;
BA_ "GenSigTimeoutTime_ECM" SG_ 1098 R_AC_Enable 0;
BA_ "GenSigTimeoutTime_IPC" SG_ 1098 R_AC_Enable 0;
BA_ "GenSigTimeoutTime_RFHM" SG_ 1098 R_AC_Enable 0;
BA_ "GenSigTimeoutTime_SGW" SG_ 1098 R_AC_Enable 0;
BA_ "GenSigTimeoutTime_TCM" SG_ 1098 R_AC_Enable 0;
BA_ "GenSigTimeoutTime_AGSM" SG_ 1098 RrWigWagRq 0;
BA_ "GenSigTimeoutTime_ASBS" SG_ 1098 RrWigWagRq 0;
BA_ "GenSigTimeoutTime_BSM" SG_ 1098 RrWigWagRq 0;
BA_ "GenSigTimeoutTime_CADM" SG_ 1098 RrWigWagRq 0;
BA_ "GenSigTimeoutTime_DTCM" SG_ 1098 RrWigWagRq 0;
BA_ "GenSigTimeoutTime_ECM" SG_ 1098 RrWigWagRq 0;
BA_ "GenSigTimeoutTime_IPC" SG_ 1098 RrWigWagRq 0;
BA_ "GenSigTimeoutTime_RFHM" SG_ 1098 RrWigWagRq 0;
BA_ "GenSigTimeoutTime_SGW" SG_ 1098 RrWigWagRq 0;
BA_ "GenSigTimeoutTime_TCM" SG_ 1098 RrWigWagRq 0;
BA_ "GenSigTimeoutTime_AGSM" SG_ 1098 SprtRearLtg 0;
BA_ "GenSigTimeoutTime_ASBS" SG_ 1098 SprtRearLtg 0;
BA_ "GenSigTimeoutTime_BSM" SG_ 1098 SprtRearLtg 0;
BA_ "GenSigTimeoutTime_CADM" SG_ 1098 SprtRearLtg 0;
BA_ "GenSigTimeoutTime_DTCM" SG_ 1098 SprtRearLtg 0;
BA_ "GenSigTimeoutTime_ECM" SG_ 1098 SprtRearLtg 0;
BA_ "GenSigTimeoutTime_IPC" SG_ 1098 SprtRearLtg 0;
BA_ "GenSigTimeoutTime_RFHM" SG_ 1098 SprtRearLtg 0;
BA_ "GenSigTimeoutTime_SGW" SG_ 1098 SprtRearLtg 0;
BA_ "GenSigTimeoutTime_TCM" SG_ 1098 SprtRearLtg 0;
BA_ "GenSigTimeoutTime_AGSM" SG_ 1098 SupHrnRq 0;
BA_ "GenSigTimeoutTime_ASBS" SG_ 1098 SupHrnRq 0;
BA_ "GenSigTimeoutTime_BSM" SG_ 1098 SupHrnRq 0;
BA_ "GenSigTimeoutTime_CADM" SG_ 1098 SupHrnRq 0;
BA_ "GenSigTimeoutTime_DTCM" SG_ 1098 SupHrnRq 0;
BA_ "GenSigTimeoutTime_ECM" SG_ 1098 SupHrnRq 0;
BA_ "GenSigTimeoutTime_IPC" SG_ 1098 SupHrnRq 0;
BA_ "GenSigTimeoutTime_RFHM" SG_ 1098 SupHrnRq 0;
BA_ "GenSigTimeoutTime_SGW" SG_ 1098 SupHrnRq 0;
BA_ "GenSigTimeoutTime_TCM" SG_ 1098 SupHrnRq 0;
BA_ "GenSigTimeoutTime_AGSM" SG_ 1098 VSIMEngineOffRequest 0;
BA_ "GenSigTimeoutTime_ASBS" SG_ 1098 VSIMEngineOffRequest 0;
BA_ "GenSigTimeoutTime_BCM" SG_ 1098 VSIMEngineOffRequest 0;
BA_ "GenSigTimeoutTime_BSM" SG_ 1098 VSIMEngineOffRequest 0;
BA_ "GenSigTimeoutTime_CADM" SG_ 1098 VSIMEngineOffRequest 0;
BA_ "GenSigTimeoutTime_DTCM" SG_ 1098 VSIMEngineOffRequest 0;
BA_ "GenSigTimeoutTime_ECM" SG_ 1098 VSIMEngineOffRequest 0;
BA_ "GenSigTimeoutTime_IPC" SG_ 1098 VSIMEngineOffRequest 0;
BA_ "GenSigTimeoutTime_SGW" SG_ 1098 VSIMEngineOffRequest 0;
BA_ "GenSigTimeoutTime_TCM" SG_ 1098 VSIMEngineOffRequest 0;
VAL_ 1450 CrankEnable 0 "Disabled" 1 "Enabled";
VAL_ 1450 DriveModeSts 0 "No_programs_available_selected" 1 "Eco" 2 "Sport" 3 "Valet" 4 "Ice_Winter" 5 "Tow_Haul" 6 "Track" 7 "4LowMode" 8 "HDC/SSC" 9 "Rock" 10 "Sand" 11 "Mud" 12 "Normal" 13 "Mud_Sand" 14 "RRCC" 15 "Drag";
VAL_ 1450 GearDisplayForCluster 0 "Blank" 1 "Current_gear_1" 2 "Current_gear_2" 3 "Current_gear_3" 4 "Current_gear_4" 5 "Current_gear_5" 6 "Current_gear_6" 7 "Current_gear_7" 8 "Current_gear_8" 9 "Current_gear_9" 10 "Current_gear_P" 11 "Current_gear_N" 12 "Current_gear_R" 15 "SNA";
VAL_ 1450 GearEngaged 0 "Neutral" 1 "ForwardGear_1" 2 "ForwardGear_2" 3 "ForwardGear_3" 4 "ForwardGear_4" 5 "ForwardGear_5" 6 "ForwardGear_6" 7 "ForwardGear_7" 8 "ForwardGear_8" 9 "ForwardGear_9" 13 "Parking" 14 "ReverseGear" 15 "SNA";
VAL_ 1450 GearIndicationSts 0 "Normal" 1 "Blinking";
VAL_ 1450 HAS_SoH_TCM 0 "No Fault" 1 "Fault";
VAL_ 1450 LimpHomeSts 0 "NotActive" 1 "Active";
VAL_ 1450 MIReq 0 "No_EOBD_error" 1 "EOBD_error";
VAL_ 1450 OilTemperatureSts 0 "Normal" 1 "High";
VAL_ 1450 R_SHFT_LOCK 0 "Unlocked" 1 "Locked";
VAL_ 1450 Secure_Idle_HMI 0 "MSG_DEFAULT" 1 "MSG_ACTIVE" 3 "SNA";
VAL_ 1450 ShiftInProgress 0 "No Shift in progress" 1 "Shift in progress";
VAL_ 1450 ShiftLeverLockReq 0 "Not_Active" 1 "Active";
VAL_ 1450 ShiftLeverPosition 0 "No_Selection_Active_Or_Available" 1 "P" 2 "R" 3 "N" 4 "D" 5 "L" 6 "TIP_Autostick" 7 "Plus" 8 "Minus" 9 "Sport" 10 "Not_Used" 11 "Not_Used" 12 "Not_Used" 13 "Not_Used" 14 "Not_Used" 15 "SNA";
VAL_ 1450 ShiftMapNotAchieved 0 "Achieved" 1 "Not_Achieved";
VAL_ 1450 ShiftModeSts 0 "Manual" 1 "Automatic";
VAL_ 1450 TransmissionFailSts 0 "Fail_not_present" 1 "Fail_present";
VAL_ 1450 TransmissionWarnings 0 "No_Warning" 1 "Press_Brake_Pedal" 2 "Tip_Not_Available" 3 "Lower_Gear_Shifts" 4 "Manual_Mode_Not_Available" 5 "Insert_N" 6 "Automatic_Mode_Not_Available" 7 "Press_Brake_Delayed_Startup_Warning" 8 "Clutch_Overtemperature" 9 "Manoeuvre_Not_Allowed" 10 "Press_Brake_Pedal_Repeat" 11 "Gear_Not_Available" 12 "Shift_Not_Allowed" 13 "Shift_to_Neutral_Then_DR" 14 "Reduce_Gear_Changes" 15 "Clutch_Overheater_Must_Cool" 16 "Service_Transmission" 17 "Service_Shifter" 18 "Engage_Park_Brake" 19 "Trans_Too_Cold_Pls_Wait" 20 "Push_Button_to_Shift" 21 "Return_Shifter_To_Home" 22 "Press_Brake_Push_Button_Shift" 23 "Service_Trans_Shut_Off" 24 "Already_in_Des_Gear" 25 "Start_Engine_to_Shift" 26 "Service_Trans_Use_Pk_Brk" 27 "Vehicle_Speed_Too_High" 28 "Tow_Haul_Not_available" 29 "Tow_Haul_Disengaged" 30 "Trans_Cool_Ready_to_Drive" 31 "Vehicle_Speed_Too_High_to_Shift_P" 32 "Vehicle_Speed_Too_High_to_Shift_R" 33 "Vehicle_Speed_Too_High_to_Shift_D" 34 "Manual_Shift_Temp_Not_Available" 35 "Vehicle_Speed_Too_High_to_Shift_L/S" 36 "Shift_to_Park_to_ obtain_drivability" 37 "Shift_to_Park_to_Start" 38 "APCM_in_Progress" 39 "Stop Vehicle to Shift" 40 "Service Transmission_Stop Vehicle to Shift " 41 "Service Transmission__Stop Vehicle_Restart Vehicle in P to Continue Driving" 42 "Service Transmission_Stop Vehicle to Shift _Restart Vehicle in P to Continue Driving" 43 "Press Brake To Prevent Vehicle From Rolling" 44 "Clutch_Too_Hot_Performance_Limited_Part_1" 45 "Trans_Recover_Mode_Warning" 46 "Press_Brake_To_Start" 47 "Unintentional park disengagement" 48 "paddles_shift_not_available " 49 "manual_mode_exit_hold_right_paddles" 50 "Vehicle_Speed_Too_High_to_Shift_Manual_gate" 51 "Manual_Mode_Active_Hold_Plus_to_Exit" 52 "Paddles_Disabled_by_User_Selection" 53 "Launch_Clutch_Over_Temp" 54 "Pull_Over_Safely" 55 "Clutch_Too_Hot_Performance_Limited_Part_2" 56 "Shift_To_D_To_Engage_L_Mode" 57 "Low_Mode_Not_Available";
VAL_ 1059 CodeCheckSts_TRM 0 "No_Code" 1 "CodeCheck_OK" 2 "CodeCheck_Fault" 3 "Not_Used";
VAL_ 1059 ProgrammedSts_TRM 0 "Not_Programmed" 1 "Programmed";
VAL_ 1059 TxpFound 0 "Transponder_Read" 1 "Transponder_Absent";
VAL_ 1059 TxpID3 0 "Transponder_Not_Authenticated" 1 "Transponder_1_Authenticated" 2 "Transponder_2_Authenticated" 3 "Transponder_3_Authenticated" 4 "Transponder_4_Authenticated" 5 "Transponder_5_Authenticated" 6 "Transponder_6_Authenticated" 7 "Transponder_7_Authenticated" 8 "Transponder_8_Authenticated" 9 "Transponder_9_Authenticated" 10 "Transponder_10_Authenticated" 11 "Transponder_11_Authenticated" 12 "Transponder_12_Authenticated" 13 "Transponder_13_Authenticated" 14 "Transponder_14_Authenticated" 15 "Transponder_15_Authenticated" 16 "Transponder_16_Authenticated" 17 "Transponder_17_Authenticated" 18 "Transponder_18_Authenticated" 19 "Transponder_19_Authenticated" 20 "Transponder_20_Authenticated" 21 "Transponder_21_Authenticated" 22 "Transponder_22_Authenticated" 23 "Transponder_23_Authenticated" 24 "Transponder_24_Authenticated" 25 "Transponder_25_Authenticated" 26 "Transponder_26_Authenticated" 27 "Transponder_27_Authenticated" 28 "Transponder_28_Authenticated" 29 "Transponder_29_Authenticated" 30 "Transponder_30_Authenticated" 31 "Transponder_31_Authenticated" 32 "Transponder_32_Authenticated" 33 "Transponder_33_Authenticated" 34 "Transponder_34_Authenticated" 35 "Transponder_35_Authenticated" 36 "Transponder_36_Authenticated" 37 "Transponder_37_Authenticated" 38 "Transponder_38_Authenticated" 39 "Transponder_39_Authenticated" 40 "Transponder_40_Authenticated" 41 "Transponder_41_Authenticated" 42 "Transponder_42_Authenticated" 43 "Transponder_43_Authenticated" 44 "Transponder_44_Authenticated" 45 "Transponder_45_Authenticated" 46 "Transponder_46_Authenticated" 47 "Transponder_47_Authenticated" 48 "Transponder_48_Authenticated" 49 "Transponder_49_Authenticated" 50 "Transponder_50_Authenticated" 51 "Transponder_51_Authenticated" 52 "Transponder_52_Authenticated" 53 "Transponder_53_Authenticated" 54 "Transponder_54_Authenticated" 55 "Transponder_55_Authenticated" 56 "Transponder_56_Authenticated" 57 "Transponder_57_Authenticated" 58 "Transponder_58_Authenticated" 59 "Transponder_59_Authenticated" 60 "Transponder_60_Authenticated" 61 "Transponder_61_Authenticated" 62 "Transponder_62_Authenticated" 63 "Transponder_63_Authenticated" 64 "Transponder_64_Authenticated" 65 "Transponder_65_Authenticated" 66 "Transponder_66_Authenticated" 67 "Transponder_67_Authenticated" 68 "Transponder_68_Authenticated" 69 "Transponder_69_Authenticated" 70 "Transponder_70_Authenticated" 71 "Transponder_71_Authenticated" 72 "Transponder_72_Authenticated" 73 "Transponder_73_Authenticated" 74 "Transponder_74_Authenticated" 75 "Transponder_75_Authenticated" 76 "Transponder_76_Authenticated" 77 "Transponder_77_Authenticated" 78 "Transponder_78_Authenticated" 79 "Transponder_79_Authenticated" 80 "Transponder_80_Authenticated" 81 "Transponder_81_Authenticated" 82 "Transponder_82_Authenticated" 83 "Transponder_83_Authenticated" 84 "Transponder_84_Authenticated" 85 "Transponder_85_Authenticated" 86 "Transponder_86_Authenticated" 87 "Transponder_87_Authenticated" 88 "Transponder_88_Authenticated" 89 "Transponder_89_Authenticated" 90 "Transponder_90_Authenticated" 91 "Transponder_91_Authenticated" 92 "Transponder_92_Authenticated" 93 "Transponder_93_Authenticated" 94 "Transponder_94_Authenticated" 95 "Transponder_95_Authenticated" 96 "Transponder_96_Authenticated" 97 "Transponder_97_Authenticated" 98 "Transponder_98_Authenticated" 99 "Transponder_99_Authenticated" 100 "Transponder_100_Authenticated" 101 "Transponder_101_Authenticated";
VAL_ 254 FrameNumber 0 "Frame_1" 1 "Frame_2" 2 "Frame_3" 3 "Frame_4" 4 "Frame_5" 5 "Frame_6" 6 "Frame_7" 7 "Frame_8" 8 "Frame_9" 9 "Frame_10" 10 "Frame_11" 11 "Frame_12" 12 "Frame_13" 13 "Frame_14" 14 "Frame_15" 15 "Frame_16";
VAL_ 254 TotalFrameNumber 0 "One_Frame" 1 "Two_Frames" 2 "Three_Frames" 3 "Four_Frames" 4 "Five_Frames" 5 "Six_Frames" 6 "Seven_Frames" 7 "Eight_Frame" 8 "Nine_Frames" 9 "Ten_Frames" 10 "Eleven_Frames" 11 "Twelve_Frames" 12 "Thirteen_Frames" 13 "Fourteen_Frames" 14 "Fifteen_Frames" 15 "Sixteen_Frames";
VAL_ 1472 TRSC_PopupDisp_Info2 0 "DISP_0" 1 "DISP_1" 2 "DISP_2" 3 "DISP_3" 4 "DISP_4" 5 "DISP_5" 6 "DISP_6" 7 "DISP_7" 8 "DISP_8" 9 "DISP_9" 10 "DISP_10" 11 "DISP_11" 12 "DISP_12" 13 "DISP_13" 14 "DISP_14" 15 "DISP_15" 16 "DISP_16" 17 "DISP_17" 18 "DISP_18" 19 "DISP_19" 20 "DISP_20" 21 "DISP_21" 22 "DISP_22" 23 "DISP_23" 24 "DISP_24" 25 "DISP_25" 26 "DISP_26" 27 "DISP_27" 28 "DISP_28" 29 "DISP_29" 30 "DISP_30" 31 "DISP_31" 32 "DISP_32" 33 "DISP_33" 34 "DISP_34" 35 "DISP_35" 36 "DISP_36" 37 "DISP_37" 38 "DISP_38" 39 "DISP_39" 40 "DISP_40" 41 "DISP_41" 42 "DISP_42" 43 "DISP_43" 44 "DISP_44" 45 "DISP_45" 46 "DISP_46" 47 "DISP_47" 48 "DISP_48" 49 "DISP_49" 50 "DISP_50" 51 "DISP_51" 52 "DISP_52" 53 "DISP_53" 54 "DISP_54" 55 "DISP_55" 56 "DISP_56" 57 "DISP_57" 58 "DISP_58" 59 "DISP_59" 60 "DISP_60" 61 "DISP_61" 62 "DISP_62" 63 "SNA";
VAL_ 1472 TRSC_STAT 0 "Standby" 1 "Calibrating" 2 "PreActive" 3 "Active" 4 "OFF" 7 "SNA";
VAL_ 951 UConnReq_TBM 0 "NO_BASIC_REQUEST" 1 "LOCK_REQUEST" 2 "RELOCK_REQUEST" 3 "DRIVER_UNLOCK_REQUEST" 4 "ALL_UNLOCK_REQUEST" 5 "TRUNK_PLG_TOGGLE_REQUEST" 6 "LEFT_SLIDER_TOGGLE_REQUEST" 7 "RIGHT_SLIDER_TOGGLE_REQUEST" 8 "FLIPPER_GLASS_REQUEST" 9 "REMOTE_START_ON" 10 "REMOTE_START_OFF" 11 "GLOBAL_WINDOW_DOWN_REQUEST" 12 "OPEN_CONVERTIBLE_TOP" 13 "CLOSE_CONVERTIBLE_TOP" 14 "PANIC_TOGGLE_REQUEST" 15 "DRIVER_TOGGLE_REQUEST" 16 "PASSENGER_TOGGLE_REQUEST" 17 "ExtLightReq" 18 "AirSuspReq" 19 "AirSuspCancel" 20 "GLBL_WIN_UP_RQ" 21 "CAR_FINDER_REQUEST" 22 "TRUNK_PLG_BTN_PRESSED" 23 "TRUNK_PLG_STOP_REQUEST" 24 "TRUNK_PLG_OPEN_REQUEST" 25 "TRUNK_PLG_CLOSE_REQUEST" 26 "VTA_RQ" 27 "RAP_UNLOCK_REQUEST" 28 "ABORT_CRANKING_ON_REQUEST" 29 "ABORT_CRANKING_OFF_REQUEST" 30 "Remote_Headlights" 31 "SNA";
VAL_ 951 UConnReqFOBNum_TBM 0 "FOB_DEFAULT" 1 "FOB_1" 2 "FOB_2" 3 "FOB_3" 4 "FOB_4" 5 "FOB_5" 6 "FOB_6" 7 "FOB_7" 8 "FOB_8" 15 "SNA";
VAL_ 1053 VIN_MSG 0 "VIN_LO" 1 "VIN_MID" 2 "VIN_HI" 3 "SNA";
VAL_ 1098 DoorLkAllRq 0 "Request_Not_Active" 1 "Request_Active";
VAL_ 1098 DoorUnlkAllRq 0 "Request_Not_Active" 1 "Request_Active";
VAL_ 1098 DsblTurnLmpFlt 0 "False" 1 "True";
VAL_ 1098 FtWigWagRq 0 "Disabled" 1 "Enabled";
VAL_ 1098 IdleShutDown_Disable 0 "False" 1 "True";
VAL_ 1098 J1939_RPM_RQ 65535 "SNA";
VAL_ 1098 PosEngdSwStat 0 "Off" 1 "On";
VAL_ 1098 PTO_IdleSpd1 0 "Not_Selected" 1 "Selected";
VAL_ 1098 PTO_IdleSpd2 0 "Not_Selected" 1 "Selected";
VAL_ 1098 PTO_IdleSpd3 0 "Not_Selected" 1 "Selected";
VAL_ 1098 R_AC_Enable 0 "Off" 1 "On";
VAL_ 1098 RrWigWagRq 0 "Disabled" 1 "Enabled";
VAL_ 1098 SprtRearLtg 0 "False" 1 "True";
VAL_ 1098 SupHrnRq 0 "False" 1 "True";
VAL_ 1098 VSIMEngineOffRequest 0 "Not_Active" 1 "Active";
