VERSION ""

NS_ :

BS_:

BU_: AGSM BCM BSM CADM DMSM DTCM ECM EVCU2 GNMM HCP IPC RFHM SGW TCM
BO_ 2564485756 DIAGNOSTIC_RESPONSE_FD_SGCP: 64 EVCU2
 SG_ N_PDU : 7|64@0+ (1,0) [0|0] "" SGW

BO_ 2564485663 DIAGNOSTIC_RESPONSE_FD_SHIFTER: 64 AGSM
 SG_ N_PDU : 7|64@0+ (1,0) [0|0] "" SGW

BO_ 2564485656 DIAGNOSTIC_RESPONSE_FD_TRANSM: 64 TCM
 SG_ N_PDU : 7|64@0+ (1,0) [0|0] "" SGW

BO_ 2564485747 DIAGNOSTIC_RESPONSE_FD_WCPM2: 64 RFHM
 SG_ N_PDU : 7|64@0+ (1,0) [0|0] "" SGW

BO_ 2564485391 DIAGNOSTIC_RESPONSE_FLDHM: 8 RFHM
 SG_ N_PDU : 7|64@0+ (1,0) [0|0] "" SGW

BO_ 2564486464 DIAGNOSTIC_RESPONSE_FOTA_BCM: 64 BCM
 SG_ N_PDU : 7|64@0+ (1,0) [0|0] "" SGW

BO_ 2564486440 DIAGNOSTIC_RESPONSE_FOTA_BSM: 64 BSM
 SG_ N_PDU : 7|64@0+ (1,0) [0|0] "" SGW

BO_ 2564486446 DIAGNOSTIC_RESPONSE_FOTA_CADM: 64 CADM
 SG_ N_PDU : 7|64@0+ (1,0) [0|0] "" SGW

BO_ 2564486416 DIAGNOSTIC_RESPONSE_FOTA_ECM: 64 ECM
 SG_ N_PDU : 7|64@0+ (1,0) [0|0] "" SGW

BO_ 2564487440 DIAGNOSTIC_RESPONSE_FOTA_ECM_KWP: 8 ECM
 SG_ N_PDU : 7|64@0+ (1,0) [0|0] "" SGW

BO_ 2564486424 DIAGNOSTIC_RESPONSE_FOTA_TRANSM: 64 TCM
 SG_ N_PDU : 7|64@0+ (1,0) [0|0] "" SGW

BO_ 2564485390 DIAGNOSTIC_RESPONSE_FRDHM: 8 RFHM
 SG_ N_PDU : 7|64@0+ (1,0) [0|0] "" SGW

BO_ 2564485428 DIAGNOSTIC_RESPONSE_GNMM: 8 GNMM
 SG_ N_PDU : 7|64@0+ (1,0) [0|0] "" SGW

BO_ 2564485472 DIAGNOSTIC_RESPONSE_IPC: 8 IPC
 SG_ N_PDU : 7|64@0+ (1,0) [0|0] "" SGW

BO_ 2564485597 DIAGNOSTIC_RESPONSE_ISCM: 8 ECM
 SG_ N_PDU : 7|64@0+ (1,0) [0|0] "" SGW

BO_ 2564485396 DIAGNOSTIC_RESPONSE_MCPA: 8 EVCU2
 SG_ N_PDU : 7|64@0+ (1,0) [0|0] "" SGW

BO_ 2564485397 DIAGNOSTIC_RESPONSE_MCPB: 8 EVCU2
 SG_ N_PDU : 7|64@0+ (1,0) [0|0] "" SGW

BO_ 2564485575 DIAGNOSTIC_RESPONSE_RFHM: 8 RFHM
 SG_ N_PDU : 7|64@0+ (1,0) [0|0] "" SGW

BO_ 2564485500 DIAGNOSTIC_RESPONSE_SGCP: 8 EVCU2
 SG_ N_PDU : 7|64@0+ (1,0) [0|0] "" SGW

BO_ 2564485407 DIAGNOSTIC_RESPONSE_SHIFTER: 8 AGSM
 SG_ N_PDU : 7|64@0+ (1,0) [0|0] "" SGW

BO_ 2564485400 DIAGNOSTIC_RESPONSE_TRANSMISSION: 8 TCM
 SG_ N_PDU : 7|64@0+ (1,0) [0|0] "" SGW

BO_ 2564485491 DIAGNOSTIC_RESPONSE_WCPM2: 8 RFHM
 SG_ N_PDU : 7|64@0+ (1,0) [0|0] "" SGW

BO_ 2564682048 DIAGNOSTIC_ROE_BCM: 8 BCM
 SG_ N_PDU : 7|64@0+ (1,0) [0|0] "" SGW

BO_ 2564682024 DIAGNOSTIC_ROE_BSM: 8 BSM
 SG_ N_PDU : 7|64@0+ (1,0) [0|0] "" SGW

BO_ 2564682030 DIAGNOSTIC_ROE_CADM: 8 CADM
 SG_ N_PDU : 7|64@0+ (1,0) [0|0] "" SGW

BO_ 2564682135 DIAGNOSTIC_ROE_DMSM: 8 DMSM
 SG_ N_PDU : 7|64@0+ (1,0) [0|0] "" SGW

BO_ 2564682010 DIAGNOSTIC_ROE_DTCM: 8 DTCM
 SG_ N_PDU : 7|64@0+ (1,0) [0|0] "" SGW

BO_ 2564682000 DIAGNOSTIC_ROE_ECM: 8 ECM
 SG_ N_PDU : 7|64@0+ (1,0) [0|0] "" SGW

BO_ 2564682304 DIAGNOSTIC_ROE_FD_BCM: 64 BCM
 SG_ N_PDU : 7|64@0+ (1,0) [0|0] "" SGW

BO_ 2564682280 DIAGNOSTIC_ROE_FD_BSM: 64 BSM
 SG_ N_PDU : 7|64@0+ (1,0) [0|0] "" SGW

BO_ 2564682286 DIAGNOSTIC_ROE_FD_CADM: 64 CADM
 SG_ N_PDU : 7|64@0+ (1,0) [0|0] "" SGW

BO_ 2564682391 DIAGNOSTIC_ROE_FD_DMSM: 64 DMSM
 SG_ N_PDU : 7|64@0+ (1,0) [0|0] "" SGW

BO_ 2564682266 DIAGNOSTIC_ROE_FD_DTCM: 64 DTCM
 SG_ N_PDU : 7|64@0+ (1,0) [0|0] "" SGW

BO_ 2564682256 DIAGNOSTIC_ROE_FD_ECM: 64 ECM
 SG_ N_PDU : 7|64@0+ (1,0) [0|0] "" SGW

BO_ 2564682255 DIAGNOSTIC_ROE_FD_FLDHM: 64 RFHM
 SG_ N_PDU : 7|64@0+ (1,0) [0|0] "" SGW

BO_ 2564682254 DIAGNOSTIC_ROE_FD_FRDHM: 64 RFHM
 SG_ N_PDU : 7|64@0+ (1,0) [0|0] "" SGW

BO_ 2564682292 DIAGNOSTIC_ROE_FD_GNMM: 64 GNMM
 SG_ N_PDU : 7|64@0+ (1,0) [0|0] "" SGW

BO_ 2564682336 DIAGNOSTIC_ROE_FD_IPC: 64 IPC
 SG_ N_PDU : 7|64@0+ (1,0) [0|0] "" SGW

BO_ 2564682260 DIAGNOSTIC_ROE_FD_MCPA: 64 EVCU2
 SG_ N_PDU : 7|64@0+ (1,0) [0|0] "" SGW

BO_ 2564682261 DIAGNOSTIC_ROE_FD_MCPB: 64 EVCU2
 SG_ N_PDU : 7|64@0+ (1,0) [0|0] "" SGW

BO_ 2564682439 DIAGNOSTIC_ROE_FD_RFHM: 64 RFHM
 SG_ N_PDU : 7|64@0+ (1,0) [0|0] "" SGW

BO_ 2564682364 DIAGNOSTIC_ROE_FD_SGCP: 64 EVCU2
 SG_ N_PDU : 7|64@0+ (1,0) [0|0] "" SGW

BO_ 2564682271 DIAGNOSTIC_ROE_FD_SHIFTER: 64 AGSM
 SG_ N_PDU : 7|64@0+ (1,0) [0|0] "" SGW

BO_ 2564682264 DIAGNOSTIC_ROE_FD_TRANSMISSION: 64 TCM
 SG_ N_PDU : 7|64@0+ (1,0) [0|0] "" SGW

BO_ 2564682355 DIAGNOSTIC_ROE_FD_WCPM2: 64 RFHM
 SG_ N_PDU : 7|64@0+ (1,0) [0|0] "" SGW

BO_ 2564681999 DIAGNOSTIC_ROE_FLDHM: 8 RFHM
 SG_ N_PDU : 7|64@0+ (1,0) [0|0] "" SGW

BO_ 2564681998 DIAGNOSTIC_ROE_FRDHM: 8 RFHM
 SG_ N_PDU : 7|64@0+ (1,0) [0|0] "" SGW

BO_ 2564682036 DIAGNOSTIC_ROE_GNMM: 8 GNMM
 SG_ N_PDU : 7|64@0+ (1,0) [0|0] "" SGW

BO_ 2564682080 DIAGNOSTIC_ROE_IPC: 8 IPC
 SG_ N_PDU : 7|64@0+ (1,0) [0|0] "" SGW

BO_ 2564682004 DIAGNOSTIC_ROE_MCPA: 8 EVCU2
 SG_ N_PDU : 7|64@0+ (1,0) [0|0] "" SGW

BO_ 2564682005 DIAGNOSTIC_ROE_MCPB: 8 EVCU2
 SG_ N_PDU : 7|64@0+ (1,0) [0|0] "" SGW

BO_ 2564682183 DIAGNOSTIC_ROE_RFHM: 8 RFHM
 SG_ N_PDU : 7|64@0+ (1,0) [0|0] "" SGW

BO_ 2564682108 DIAGNOSTIC_ROE_SGCP: 8 EVCU2
 SG_ N_PDU : 7|64@0+ (1,0) [0|0] "" SGW

BO_ 2564682015 DIAGNOSTIC_ROE_SHIFTER: 8 AGSM
 SG_ N_PDU : 7|64@0+ (1,0) [0|0] "" SGW

BO_ 2564682008 DIAGNOSTIC_ROE_TRANSMISSION: 8 TCM
 SG_ N_PDU : 7|64@0+ (1,0) [0|0] "" SGW

BO_ 2564682099 DIAGNOSTIC_ROE_WCPM2: 8 RFHM
 SG_ N_PDU : 7|64@0+ (1,0) [0|0] "" SGW

BO_ 517 DRIVETRAIN_FD_1: 32 DTCM
 SG_ AWDSysStat : 87|3@0+ (1,0) [0|7] "-" BCM,BSM,ECM,GNMM,HCP,IPC,RFHM,SGW,TCM
 SG_ CCMFailSts : 83|1@0+ (1,0) [0|1] "-" BCM,BSM,IPC,SGW
 SG_ CRC_DRIVETRAIN1 : 191|8@0+ (1,0) [0|255] "-" BCM,BSM,ECM,GNMM,HCP,TCM
 SG_ DrvLnMinTrqMd : 84|1@0+ (1,0) [0|1] "-" ECM
 SG_ DrvLnTrqRq : 80|9@0+ (2,0) [0|1020] "Nm" ECM
 SG_ Ft_RrCouplingTrq_Actual : 103|8@0+ (12,0) [1|3000] "Nm" BCM,BSM,SGW
 SG_ Ft_RrCouplingTrq_Desired : 111|8@0+ (12,0) [1|3000] "Nm" SGW
 SG_ MessageCounter_DRIVETRAIN1 : 179|4@0+ (1,0) [0|15] "-" BCM,BSM,ECM,GNMM,HCP,TCM

BO_ 1447 DRIVETRAIN_FD_2: 32 DTCM
 SG_ CNT_DIFF_MOD : 123|3@0+ (1,0) [0|7] "-" Vector__XXX
 SG_ DTCM_HMI_Rq : 109|5@0+ (1,0) [0|31] "-" IPC
 SG_ TerSt_SWITCH1 : 85|2@0+ (1,0) [0|3] "-" BCM,IPC,SGW
 SG_ TerSt_SWITCH2 : 87|2@0+ (1,0) [0|3] "-" BCM,IPC,SGW

BO_ 1068 DRIVETRAIN_FD_3: 32 DTCM
 SG_ AxleLckr_SRV_RQ : 1|2@0+ (1,0) [0|2] "" IPC
 SG_ AxleLckr_Stat : 7|2@0+ (1,0) [0|2] "" BSM,IPC,SGW
 SG_ AxleLckrEvicDisp : 23|5@0+ (1,0) [0|30] "" IPC
 SG_ CRC__DRIVETRAIN3 : 191|8@0+ (1,0) [0|255] "-" BCM,BSM,CADM,ECM,TCM
 SG_ DTCM_Vehicle_Hold_Rq : 103|1@0+ (1,0) [0|1] "" BSM
 SG_ MessageCounter_DRIVETRAIN3 : 179|4@0+ (1,0) [0|15] "-" BCM,BSM,CADM,ECM,TCM
 SG_ RrAxleLockerIndRq : 5|2@0+ (1,0) [0|2] "" BCM,IPC
 SG_ Tcase2WD_Stat : 91|2@0+ (1,0) [0|3] "" BCM,IPC,SGW
 SG_ Tcase4Lock : 86|2@0+ (1,0) [0|3] "" BCM,IPC,SGW
 SG_ Tcase4Low : 84|2@0+ (1,0) [0|0] "" BCM
 SG_ TcaseAWD : 95|2@0+ (1,0) [0|3] "" BCM,IPC,SGW
 SG_ TCASERANGESTATUS : 89|2@0+ (1,0) [0|2] "" BCM,BSM,CADM,ECM,IPC,SGW,TCM

BO_ 1438 DRV_MONITOR1_FD: 32 DMSM
 SG_ CRC_DRV_MONITOR1 : 191|8@0+ (1,0) [0|255] "-" CADM
 SG_ DM_Camera_Blind : 31|2@0+ (1,0) [0|3] "" CADM
 SG_ DM_Distract_Conf : 19|4@0+ (10,0) [0|150] "%" CADM
 SG_ DM_Distract_Instant : 6|7@0+ (1,0) [0|127] "%" CADM
 SG_ DM_Distract_State : 39|2@0+ (1,0) [0|3] "" BCM,CADM,SGW
 SG_ DM_Drowsy_Conf : 23|4@0+ (10,0) [0|150] "%" CADM
 SG_ DM_Drowsy_Instant : 14|7@0+ (1,0) [0|127] "%" CADM
 SG_ DM_Drowsy_Micro : 7|1@0+ (1,0) [0|1] "" CADM
 SG_ DM_Drowsy_State : 37|2@0+ (1,0) [0|3] "" BCM,CADM,SGW
 SG_ DM_Eyes_Tracked : 32|1@0+ (1,0) [0|1] "" CADM
 SG_ DM_Steering_Angle_Blockage : 47|1@0+ (1,0) [0|1] "" CADM
 SG_ DM_Zone_Track : 35|3@0+ (1,0) [0|7] "" BCM,CADM
 SG_ DM_Zone_Track_Conf : 27|4@0+ (10,0) [0|150] "%" CADM
 SG_ DMSM_System_Stat : 29|2@0+ (1,0) [0|3] "" CADM
 SG_ Driver_Presence : 15|1@0+ (1,0) [0|1] "" CADM,SGW
 SG_ MessageCounter_DRV_MONITOR1 : 179|4@0+ (1,0) [0|15] "-" CADM

BO_ 2654814209 ECM_APPL1: 8 ECM
 SG_ ECM_APPL1 : 7|64@0+ (1,0) [0|0] "" SGW

BO_ 2654817823 ECU_APPL_FD_AGSM: 64 AGSM
 SG_ ECU_APPL_FD_AGSM : 455|64@0+ (1,0) [0|0] "" SGW

BO_ 2654817818 ECU_APPL_FD_DTCM: 64 DTCM
 SG_ ECU_APPL_FD_DTCM : 455|64@0+ (1,0) [0|0] "" SGW

BO_ 2654817808 ECU_APPL_FD_ECM: 64 ECM
 SG_ ECU_APPL_FD_ECM : 455|64@0+ (1,0) [0|0] "" SGW

BO_ 2654817991 ECU_APPL_FD_RFHM: 64 RFHM
 SG_ ECU_APPL_FD_RFHM : 455|64@0+ (1,0) [0|0] "" Vector__XXX

BO_ 2654817816 ECU_APPL_FD_TCM: 64 TCM
 SG_ ECU_APPL_FD_TCM : 455|64@0+ (1,0) [0|0] "" SGW

BO_ 1054 ENGINE_FD_1: 32 ECM
 SG_ ACPressure : 88|9@0+ (0.1,0) [0|40] "bar" BCM
 SG_ ACPressureFailSts : 22|1@0+ (1,0) [0|1] "-" Vector__XXX
 SG_ AGS2Posn : 134|7@0+ (1,0) [0|100] "%" Vector__XXX
 SG_ AtmosphericPressure_W : 143|8@0+ (3.6,300) [300|1214.4] "mbar" BCM,BSM,RFHM,SGW,TCM
 SG_ AtmosphericPressureFailSts_W : 0|1@0+ (1,0) [0|1] "-" SGW,TCM
 SG_ BoostVacGauge : 71|8@0+ (2,-200) [-200|310] "kPa" IPC,SGW
 SG_ BrkSw1Stat : 4|1@0+ (1,0) [0|1] "-" BCM,SGW
 SG_ BrkSw2Stat : 5|1@0+ (1,0) [0|1] "-" BCM,SGW
 SG_ CRC_ENGINE1 : 191|8@0+ (1,0) [0|255] "-" BCM,EVCU2,HCP,RFHM,TCM
 SG_ EngMaxRPM_W : 127|8@0+ (50,0) [0|10000] "-" EVCU2,TCM
 SG_ ESP_TrqRqEnabl : 6|1@0+ (1,0) [0|1] "-" BCM,SGW
 SG_ HighPressureFuelSystemFailure : 2|1@0+ (1,0) [0|1] "-" IPC
 SG_ Lv1CrsCtrlOff : 7|1@0+ (1,0) [0|1] "-" BCM,SGW
 SG_ MessageCounter_ENGINE1 : 179|4@0+ (1,0) [0|15] "-" BCM,EVCU2,HCP,RFHM,TCM
 SG_ RawPVS1 : 167|8@0+ (0.019607843,0) [0|4.98] "V" BCM,SGW
 SG_ RawPVS2 : 175|8@0+ (0.019607843,0) [0|4.98] "V" BCM,SGW
 SG_ RawTPS1 : 63|8@0+ (0.019607843,0) [0|4.98] "V" BCM,SGW
 SG_ RawTPS2 : 55|8@0+ (0.019607843,0) [0|4.98] "V" BCM,SGW
 SG_ ThermalManagementActive_W : 1|1@0+ (1,0) [0|1] "-" TCM
 SG_ ThrottlePosition : 87|8@0+ (0.392,0) [0|99.96] "%" BCM,SGW
 SG_ TransWarmUpMin_RPM : 159|8@0+ (25,0) [0|6375] "rpm" TCM
 SG_ TransWarmUpReq : 3|1@0+ (1,0) [0|1] "-" TCM

BO_ 262 ENGINE_FD_2: 64 ECM
 SG_ AlternatorFail_W : 114|1@0+ (1,0) [0|1] "-" IPC,SGW
 SG_ CrankHold_W : 179|1@0+ (1,0) [0|1] "-" BCM,SGW
 SG_ CRC_ENGINE2 : 447|8@0+ (1,0) [0|255] "-" BCM,BSM,CADM,DMSM,DTCM,EVCU2,HCP,IPC,TCM
 SG_ ECM_Ack_DriveMode : 52|4@0+ (1,0) [0|15] "-" Vector__XXX
 SG_ ECM_LHOM_Trans_W : 117|2@0+ (1,0) [0|3] "-" TCM
 SG_ ECM_LHOM_W : 188|1@0+ (1,0) [0|1] "-" TCM
 SG_ EngineFrictionTorque_W : 112|9@0+ (1,0) [0|510] "Nm" BCM,SGW
 SG_ EngineIdleRefSpeed : 35|12@0+ (1,0) [0|4094] "1/min" BSM,TCM
 SG_ EngineSailingRq : 185|1@0+ (1,0) [0|1] "-" TCM
 SG_ EngineSpeed_W : 21|14@0+ (1,0) [0|16382] "1/min" AGSM,BCM,BSM,CADM,DMSM,DTCM,ECM,EVCU2,GNMM,HCP,IPC,RFHM,SGW,TCM
 SG_ EngineSpeedFailSts_W : 168|1@0+ (1,0) [0|1] "-" BCM,DTCM,EVCU2,IPC,SGW
 SG_ EngineSts_W : 87|2@0+ (1,0) [0|3] "-" BCM,BSM,ECM,EVCU2,IPC,SGW,TCM
 SG_ EngRPM_Tach : 7|16@0+ (1,0) [0|65534] "rpm" IPC
 SG_ EngTrq_Enbl_Rq_TCM_W : 178|1@0+ (1,0) [0|1] "-" BCM,TCM
 SG_ ESS_EBOOST_BRKHLD_STATUS : 279|3@0+ (1,0) [0|6] "-" BSM
 SG_ ESS_ENG_ST_W : 175|4@0+ (1,0) [0|15] "-" BCM,BSM,DMSM,DTCM,IPC,SGW,TCM
 SG_ ESS_RqShftPark_W : 115|1@0+ (1,0) [0|0] "-" BCM,BSM,TCM
 SG_ EVRDesiredSetpoint : 135|8@0+ (0.0625,0) [0|15.875] "V" EVCU2,HCP
 SG_ FuelConsumption_GAG_3 : 251|20@0+ (0.0022,0) [0|2306.865] "Liter / hour" EVCU2,IPC,SGW
 SG_ FullOFC_Actv : 183|1@0+ (1,0) [0|1] "" Vector__XXX
 SG_ GasPedalGradient_W : 159|8@0+ (0.195,-25) [-25|24.53] "% /10ms" BCM
 SG_ GasPedalPosition_W : 143|8@0+ (0.392,0) [0|99.568] "%" BCM,BSM,DTCM,ECM,HCP,SGW,TCM
 SG_ GasPedalPositionFailSts_W : 169|1@0+ (1,0) [0|1] "-" BCM,BSM,DTCM,SGW,TCM
 SG_ IntakeAirTemperature_W : 151|8@0+ (1,-40) [-40|214] "C" IPC,SGW,TCM
 SG_ KickDownRequest_W : 182|1@0+ (1,0) [0|1] "-" TCM
 SG_ LV12PwrFreeRq_W : 176|1@0+ (1,0) [0|1] "-" EVCU2,TCM
 SG_ MessageCounter_ENGINE2 : 435|4@0+ (1,0) [0|15] "-" BCM,BSM,CADM,DMSM,DTCM,EVCU2,HCP,IPC,TCM
 SG_ PowertrainPrplsnActv : 181|1@0+ (1,0) [0|1] "" BCM,BSM,CADM,IPC,RFHM,SGW,TCM
 SG_ StartRelayBCMCmd_W : 187|1@0+ (1,0) [0|1] "-" BCM
 SG_ TRANS_CLU_SLIP_MODE_W : 71|3@0+ (1,0) [0|7] "-" TCM
 SG_ TxAC_EMCC_rq_W : 189|1@0+ (1,0) [0|1] "-" TCM

BO_ 1036 ENGINE_FD_3: 32 ECM
 SG_ AfterRunCoolantPumpFailSts : 166|1@0+ (1,0) [0|1] "-" IPC
 SG_ AxleInAir_Stat : 23|3@0+ (1,0) [0|7] "-" BCM,BSM,DTCM,TCM
 SG_ CODE_1CHAR : 37|2@0+ (1,0) [0|3] "" IPC
 SG_ CODE_2CHAR : 35|4@0+ (1,0) [0|15] "" IPC
 SG_ CODE_3CHAR : 47|4@0+ (1,0) [0|15] "" IPC
 SG_ CODE_4CHAR : 43|4@0+ (1,0) [0|15] "" IPC
 SG_ CODE_CTGY : 39|2@0+ (1,0) [0|3] "" IPC
 SG_ CoolVlvPos : 31|8@0+ (0.39374,0) [0|100.00996] "%" BCM
 SG_ CRC_ENGINE3 : 191|8@0+ (1,0) [0|255] "-" BSM,TCM
 SG_ DefFuelEcon : 7|8@0+ (0.2,0) [0|50] "kmpl" IPC,SGW
 SG_ DistOilLifeRst : 143|16@0+ (1,0) [0|65535] "km" BCM,IPC
 SG_ ECM_Thermal_AAD_Request : 9|1@0+ (1,0) [0|1] "-" EVCU2
 SG_ EngineOilCritical : 175|1@0+ (1,0) [0|1] "-" IPC
 SG_ EngineOilLevel : 84|5@0+ (1,0) [0|31] "" IPC
 SG_ EngineOilMin : 86|1@0+ (1,0) [0|1] "-" IPC
 SG_ EngineOilOverfill : 85|1@0+ (1,0) [0|1] "-" IPC
 SG_ EngineOilTemperature : 103|8@0+ (1,-40) [-40|214] "°C" EVCU2,IPC,SGW,TCM
 SG_ FANStatus : 174|7@0+ (1,0) [0|100] "%" Vector__XXX
 SG_ MessageCounter_ENGINE3 : 179|4@0+ (1,0) [0|15] "-" BSM,TCM
 SG_ OIL_IND_LMP_FLSH : 154|1@0+ (1,0) [0|1] "-" IPC,SGW
 SG_ OIL_TEMP_CHM_RQ : 156|2@0+ (1,0) [0|3] "-" SGW
 SG_ OIL_TEMP_IND_RQ : 161|2@0+ (1,0) [0|3] "-" IPC,SGW
 SG_ OilLifeLeft : 135|8@0+ (1,0) [0|255] "%" IPC,SGW
 SG_ OilLifeLeftRst : 165|1@0+ (1,0) [0|1] "-" IPC
 SG_ PT_WorkSite_Invtr_Capacity_ECM : 20|5@0+ (100,0) [0|3100] "W" BCM
 SG_ PT_WorkSite_Invtr_Sts_ECM : 153|2@0+ (1,0) [0|3] "-" BCM

BO_TX_BU_ 1068 : DTCM,EVCU2;
CM_ SG_ 2564485756 N_PDU "This signal is used for diagnostic purposes";
CM_ SG_ 2564485663 N_PDU "This signal is used for diagnostic purposes";
CM_ SG_ 2564485656 N_PDU "This signal is used for diagnostic purposes";
CM_ SG_ 2564485747 N_PDU "This signal is used for diagnostic purposes";
CM_ SG_ 2564485391 N_PDU "This signal is used for diagnostic purposes";
CM_ SG_ 2564486464 N_PDU "This signal is used for diagnostic purposes";
CM_ SG_ 2564486440 N_PDU "This signal is used for diagnostic purposes";
CM_ SG_ 2564486446 N_PDU "This signal is used for diagnostic purposes";
CM_ SG_ 2564486416 N_PDU "This signal is used for diagnostic purposes";
CM_ SG_ 2564487440 N_PDU "This signal is used for diagnostic purposes";
CM_ SG_ 2564486424 N_PDU "This signal is used for diagnostic purposes";
CM_ SG_ 2564485390 N_PDU "This signal is used for diagnostic purposes";
CM_ SG_ 2564485428 N_PDU "This signal is used for diagnostic purposes";
CM_ SG_ 2564485472 N_PDU "This signal is used for diagnostic purposes";
CM_ SG_ 2564485597 N_PDU "This signal is used for diagnostic purposes";
CM_ SG_ 2564485396 N_PDU "This signal is used for diagnostic purposes";
CM_ SG_ 2564485397 N_PDU "This signal is used for diagnostic purposes";
CM_ SG_ 2564485575 N_PDU "This signal is used for diagnostic purposes";
CM_ SG_ 2564485500 N_PDU "This signal is used for diagnostic purposes";
CM_ SG_ 2564485407 N_PDU "This signal is used for diagnostic purposes";
CM_ SG_ 2564485400 N_PDU "This signal is used for diagnostic purposes";
CM_ SG_ 2564485491 N_PDU "This signal is used for diagnostic purposes";
CM_ SG_ 2564682048 N_PDU "This signal is used for diagnostic purposes";
CM_ SG_ 2564682024 N_PDU "This signal is used for diagnostic purposes";
CM_ SG_ 2564682030 N_PDU "This signal is used for diagnostic purposes";
CM_ SG_ 2564682135 N_PDU "This signal is used for diagnostic purposes";
CM_ SG_ 2564682010 N_PDU "This signal is used for diagnostic purposes";
CM_ SG_ 2564682000 N_PDU "This signal is used for diagnostic purposes";
CM_ SG_ 2564682304 N_PDU "This signal is used for diagnostic purposes";
CM_ SG_ 2564682280 N_PDU "This signal is used for diagnostic purposes";
CM_ SG_ 2564682286 N_PDU "This signal is used for diagnostic purposes";
CM_ SG_ 2564682391 N_PDU "This signal is used for diagnostic purposes";
CM_ SG_ 2564682266 N_PDU "This signal is used for diagnostic purposes";
CM_ SG_ 2564682256 N_PDU "This signal is used for diagnostic purposes";
CM_ SG_ 2564682255 N_PDU "This signal is used for diagnostic purposes";
CM_ SG_ 2564682254 N_PDU "This signal is used for diagnostic purposes";
CM_ SG_ 2564682292 N_PDU "This signal is used for diagnostic purposes";
CM_ SG_ 2564682336 N_PDU "This signal is used for diagnostic purposes";
CM_ SG_ 2564682260 N_PDU "This signal is used for diagnostic purposes";
CM_ SG_ 2564682261 N_PDU "This signal is used for diagnostic purposes";
CM_ SG_ 2564682439 N_PDU "This signal is used for diagnostic purposes";
CM_ SG_ 2564682364 N_PDU "This signal is used for diagnostic purposes";
CM_ SG_ 2564682271 N_PDU "This signal is used for diagnostic purposes";
CM_ SG_ 2564682264 N_PDU "This signal is used for diagnostic purposes";
CM_ SG_ 2564682355 N_PDU "This signal is used for diagnostic purposes";
CM_ SG_ 2564681999 N_PDU "This signal is used for diagnostic purposes";
CM_ SG_ 2564681998 N_PDU "This signal is used for diagnostic purposes";
CM_ SG_ 2564682036 N_PDU "This signal is used for diagnostic purposes";
CM_ SG_ 2564682080 N_PDU "This signal is used for diagnostic purposes";
CM_ SG_ 2564682004 N_PDU "This signal is used for diagnostic purposes";
CM_ SG_ 2564682005 N_PDU "This signal is used for diagnostic purposes";
CM_ SG_ 2564682183 N_PDU "This signal is used for diagnostic purposes";
CM_ SG_ 2564682108 N_PDU "This signal is used for diagnostic purposes";
CM_ SG_ 2564682015 N_PDU "This signal is used for diagnostic purposes";
CM_ SG_ 2564682008 N_PDU "This signal is used for diagnostic purposes";
CM_ SG_ 2564682099 N_PDU "This signal is used for diagnostic purposes";
CM_ SG_ 517 AWDSysStat "-";
CM_ SG_ 517 CCMFailSts "-";
CM_ SG_ 517 CRC_DRIVETRAIN1 "CRC according to SAE J1850 standard at each frame transmission.";
CM_ SG_ 517 DrvLnMinTrqMd "-";
CM_ SG_ 517 DrvLnTrqRq "-";
CM_ SG_ 517 Ft_RrCouplingTrq_Actual "-";
CM_ SG_ 517 Ft_RrCouplingTrq_Desired "-";
CM_ SG_ 517 MessageCounter_DRIVETRAIN1 "This signal is a counter used for safety checks strategies. This counter is incremented of 1 (one) unit at each frame transmission.";
CM_ SG_ 1447 CNT_DIFF_MOD "Actual mode of center differential";
CM_ SG_ 1447 DTCM_HMI_Rq "DTCM AWD_4WD HMI display request";
CM_ SG_ 1447 TerSt_SWITCH1 "Used to manage the signaling switch status";
CM_ SG_ 1447 TerSt_SWITCH2 "Used to manage the signaling switch status";
CM_ SG_ 1068 AxleLckr_SRV_RQ "Axle Locker Service Request";
CM_ SG_ 1068 AxleLckr_Stat "Axle locker status";
CM_ SG_ 1068 AxleLckrEvicDisp "Axle Locker EVIC Display";
CM_ SG_ 1068 CRC__DRIVETRAIN3 "CRC according to SAE J1850 standard at each frame transmission.";
CM_ SG_ 1068 DTCM_Vehicle_Hold_Rq "DTCM receives EPB status and triggers, then sends EPB hold request.";
CM_ SG_ 1068 MessageCounter_DRIVETRAIN3 "This signal is a counter used for safety checks strategies. This counter is incremented of 1 (one) unit at each frame transmission.";
CM_ SG_ 1068 RrAxleLockerIndRq "Rear Axle Locker LED Indicator";
CM_ SG_ 1068 Tcase2WD_Stat "Transfer case 2 wheel drive status";
CM_ SG_ 1068 Tcase4Lock "Transfer case 4WD locked status";
CM_ SG_ 1068 Tcase4Low "Transfer case low range LED status";
CM_ SG_ 1068 TcaseAWD "Transfer case High range / AWD LED status";
CM_ SG_ 1068 TCASERANGESTATUS "This signal is used for update the Transfer case Range status";
CM_ SG_ 1438 CRC_DRV_MONITOR1 "CRC according to SAE J1850 standard at each frame transmission.";
CM_ SG_ 1438 DM_Camera_Blind "Degree of driver monitoring camera blindness";
CM_ SG_ 1438 DM_Distract_Conf "Confidence in driver DM_Distract_State value";
CM_ SG_ 1438 DM_Distract_Instant "Instantaneous measurement of driver distraction level";
CM_ SG_ 1438 DM_Distract_State "Classification of driver distraction after debounce and filtering";
CM_ SG_ 1438 DM_Drowsy_Conf "Confidence in driver DM_Drowsy_State value";
CM_ SG_ 1438 DM_Drowsy_Instant "Instantaneous measurement of driver drowsiness level";
CM_ SG_ 1438 DM_Drowsy_Micro "Microsleep detected";
CM_ SG_ 1438 DM_Drowsy_State "Classification of driver drowsiness after debounce and filtering";
CM_ SG_ 1438 DM_Eyes_Tracked "DM_Eyes_Tracked";
CM_ SG_ 1438 DM_Steering_Angle_Blockage "Driver monitoring camera blocked by steering wheel";
CM_ SG_ 1438 DM_Zone_Track "Estimate of where driver is looking";
CM_ SG_ 1438 DM_Zone_Track_Conf "Confidence in DM_Zone_Track value";
CM_ SG_ 1438 DMSM_System_Stat "Reported capability of DMSM to provide monitoring information";
CM_ SG_ 1438 Driver_Presence "Indication of whether driver is detected by the monitoring system";
CM_ SG_ 1438 MessageCounter_DRV_MONITOR1 "This signal is a counter used for safety checks strategies. This counter is incremented of 1 (one) unit at each frame transmission.";
CM_ SG_ 2654817823 ECU_APPL_FD_AGSM "ECU to external application";
CM_ SG_ 2654817818 ECU_APPL_FD_DTCM "ECU to external application";
CM_ SG_ 2654817808 ECU_APPL_FD_ECM "ECU to external application";
CM_ SG_ 2654817991 ECU_APPL_FD_RFHM "ECU to external application";
CM_ SG_ 2654817816 ECU_APPL_FD_TCM "ECU to external application";
CM_ SG_ 1054 ACPressure "It indicates air conditioning pressure read from the AC linear pressure sensor.";
CM_ SG_ 1054 ACPressureFailSts "This signal indicates if the ACpressure sensor is in fail.";
CM_ SG_ 1054 AGS2Posn "ECM AGS2 feedback";
CM_ SG_ 1054 AtmosphericPressure_W "-";
CM_ SG_ 1054 AtmosphericPressureFailSts_W "-";
CM_ SG_ 1054 BoostVacGauge "Gauge input for calculated boost/vacuum pressure";
CM_ SG_ 1054 BrkSw1Stat "EDR ONLY - Brake switch1 status, off = [0]";
CM_ SG_ 1054 BrkSw2Stat "EDR ONLY - Brake switch2 status, off = [0]";
CM_ SG_ 1054 CRC_ENGINE1 "CRC according to SAE J1850 standard at each frame transmission.";
CM_ SG_ 1054 EngMaxRPM_W "-";
CM_ SG_ 1054 ESP_TrqRqEnabl "EDR ONLY - ESP torque requests are allowed = [1]";
CM_ SG_ 1054 HighPressureFuelSystemFailure "High Pressure Fuel Pump (HPFP) system failure where torque is limited to the amount of available fuel from supply pump.";
CM_ SG_ 1054 Lv1CrsCtrlOff "EDR ONLY - Level is requested cruise off";
CM_ SG_ 1054 MessageCounter_ENGINE1 "This signal is a counter used for safety checks strategies. This counter is incremented of 1 (one) unit at each frame transmission.";
CM_ SG_ 1054 RawPVS1 "EDR ONLY - Raw pedal value sensor #1";
CM_ SG_ 1054 RawPVS2 "EDR ONLY - Raw pedal value sensor #2";
CM_ SG_ 1054 RawTPS1 "EDR ONLY - Raw throttle position sensor #1";
CM_ SG_ 1054 RawTPS2 "EDR ONLY - Raw throttle position sensor #2";
CM_ SG_ 1054 ThermalManagementActive_W "-";
CM_ SG_ 1054 ThrottlePosition "GASOLINE APPLICATION ONLY This signal represents throttle position evaluated on the basis of throttle position sensor.";
CM_ SG_ 1054 TransWarmUpMin_RPM "Minimum engine speed for transmission warm-up strategy.";
CM_ SG_ 1054 TransWarmUpReq "ECM enable flag for transmission warm-up strategy.";
CM_ SG_ 262 AlternatorFail_W "Indicates if the alternator is in fail condition";
CM_ SG_ 262 CrankHold_W "Used by ECM to command an action to the BCM cranking relay during cranking phase";
CM_ SG_ 262 CRC_ENGINE2 "CRC according to SAE J1850 standard at each frame transmission.";
CM_ SG_ 262 ECM_Ack_DriveMode "ECM ratio manager acknowledged drive mode status";
CM_ SG_ 262 ECM_LHOM_Trans_W "Indicates to the transmission the Limp Home Status of ECM and Torque Accuracy";
CM_ SG_ 262 ECM_LHOM_W "-";
CM_ SG_ 262 EngineFrictionTorque_W "-";
CM_ SG_ 262 EngineIdleRefSpeed "This signal represents target of engine speed for the idle control function, at the end of dynamic transient conditions. It takes into account changes of idle speed due to temperature and auxiliary loads. It is updated even when the engine is ou(...)";
CM_ SG_ 262 EngineSailingRq "This signal indicates the request for Sailing functionality";
CM_ SG_ 262 EngineSpeed_W "It gives information on C-CAN network about  engine speed";
CM_ SG_ 262 EngineSpeedFailSts_W "Used to indicate if a Fail is present for the engine speed";
CM_ SG_ 262 EngineSts_W "-";
CM_ SG_ 262 EngRPM_Tach "Engine revolutions per minute for indication";
CM_ SG_ 262 EngTrq_Enbl_Rq_TCM_W "Allow TRANS torque request";
CM_ SG_ 262 ESS_EBOOST_BRKHLD_STATUS "ESS brake hold release status";
CM_ SG_ 262 ESS_ENG_ST_W "ESS Engine State";
CM_ SG_ 262 ESS_RqShftPark_W "ESS Request shift to Park.  1 = True, 0 = False";
CM_ SG_ 262 EVRDesiredSetpoint "Electronic Voltage Regulator Desired Voltage Set-Point.";
CM_ SG_ 262 FuelConsumption_GAG_3 "Fuel consumption";
CM_ SG_ 262 FullOFC_Actv "Cylinder cut-out";
CM_ SG_ 262 GasPedalGradient_W "-";
CM_ SG_ 262 GasPedalPosition_W "-";
CM_ SG_ 262 GasPedalPositionFailSts_W "-";
CM_ SG_ 262 KickDownRequest_W "It is set to KD_requested whenever the Kick-Down condition is detected by the ECM.";
CM_ SG_ 262 LV12PwrFreeRq_W "-";
CM_ SG_ 262 MessageCounter_ENGINE2 "This signal is a counter used for safety checks strategies. This counter is incremented of 1 (one) unit at each frame transmission.";
CM_ SG_ 262 PowertrainPrplsnActv "Powertrain Propulsion Status.";
CM_ SG_ 262 StartRelayBCMCmd_W "Used by ECM to command an action to the BCM cranking relay.";
CM_ SG_ 262 TRANS_CLU_SLIP_MODE_W "-";
CM_ SG_ 262 TxAC_EMCC_rq_W "-";
CM_ SG_ 1036 AfterRunCoolantPumpFailSts "The signal indicates a fault on AfterRunCoolant Pump";
CM_ SG_ 1036 AxleInAir_Stat "Used to indicate that the ECM has detected axle(s) in the air";
CM_ SG_ 1036 CODE_1CHAR "Flash code 1st character";
CM_ SG_ 1036 CODE_2CHAR "Flash code 2nd character";
CM_ SG_ 1036 CODE_3CHAR "Flash code 3rd character";
CM_ SG_ 1036 CODE_4CHAR "Flash code 4th character";
CM_ SG_ 1036 CODE_CTGY "Flash code category";
CM_ SG_ 1036 CoolVlvPos "Coolant Valve Position";
CM_ SG_ 1036 CRC_ENGINE3 "CRC according to SAE J1850 standard at each frame transmission.";
CM_ SG_ 1036 DefFuelEcon "Provides defined fuel economy for display in the cluster";
CM_ SG_ 1036 DistOilLifeRst "This signal sends the distance since oil life reset.";
CM_ SG_ 1036 ECM_Thermal_AAD_Request "This signal is sent from the ECM to EVCU2 indicating an over temperature condition. 0x0 False 0x1 True";
CM_ SG_ 1036 EngineOilCritical "Engine Oil Level Critically low";
CM_ SG_ 1036 EngineOilLevel "Engine Oil Level";
CM_ SG_ 1036 EngineOilMin "Oil Minimum indicator";
CM_ SG_ 1036 EngineOilOverfill "Oil Overfill indicator";
CM_ SG_ 1036 EngineOilTemperature "Engine Oil Temperature";
CM_ SG_ 1036 FANStatus "ECM Fan status feedback";
CM_ SG_ 1036 MessageCounter_ENGINE3 "This signal is a counter used for safety checks strategies. This counter is incremented of 1 (one) unit at each frame transmission.";
CM_ SG_ 1036 OIL_IND_LMP_FLSH "Oil indicator lamp flash (for in plant use)";
CM_ SG_ 1036 OIL_TEMP_CHM_RQ "Oil temperature chime request";
CM_ SG_ 1036 OIL_TEMP_IND_RQ "Oil temperature indicator request";
CM_ SG_ 1036 OilLifeLeft "This signal sends the oil life left percentage.";
CM_ SG_ 1036 OilLifeLeftRst "This signal is the reset acknowledge";
CM_ SG_ 1036 PT_WorkSite_Invtr_Capacity_ECM "Powertrain power support capacity for the 2KW Inverter";
CM_ SG_ 1036 PT_WorkSite_Invtr_Sts_ECM "Powertrain 2KW Inverter support status";

BA_DEF_ SG_ "GenSigStartValue" INT 0 2147483647;
BA_DEF_ SG_ "GenSigInactiveValue" INT 0 2147483647;
BA_DEF_ SG_ "GenSigSendType" ENUM "NotUsed","OnWrite","OnWriteWithRepetition","OnChange","OnChangeWithRepetition","IfActive","IfActiveWithRepetition","NoSigSendType";
BA_DEF_ SG_ "SystemSignalLongSymbol" STRING ;
BA_DEF_ SG_ "GenSigTimeoutTime_AGSM" INT 0 65535;
BA_DEF_ SG_ "GenSigTimeoutTime_BCM" INT 0 65535;
BA_DEF_ SG_ "GenSigTimeoutTime_BSM" INT 0 65535;
BA_DEF_ SG_ "GenSigTimeoutTime_CADM" INT 0 65535;
BA_DEF_ SG_ "GenSigTimeoutTime_DMSM" INT 0 65535;
BA_DEF_ SG_ "GenSigTimeoutTime_DTCM" INT 0 65535;
BA_DEF_ SG_ "GenSigTimeoutTime_ECM" INT 0 65535;
BA_DEF_ SG_ "GenSigTimeoutTime_EVCU2" INT 0 65535;
BA_DEF_ SG_ "GenSigTimeoutTime_GNMM" INT 0 65535;
BA_DEF_ SG_ "GenSigTimeoutTime_HCP" INT 0 65535;
BA_DEF_ SG_ "GenSigTimeoutTime_IPC" INT 0 65535;
BA_DEF_ SG_ "GenSigTimeoutTime_RFHM" INT 0 65535;
BA_DEF_ SG_ "GenSigTimeoutTime_SGW" INT 0 65535;
BA_DEF_ SG_ "GenSigTimeoutTime_TCM" INT 0 65535;
BA_DEF_ BO_ "DiagRequest" ENUM "No","Yes";
BA_DEF_ BO_ "Type" ENUM "P","C","PE","COC","PE_Cntrl","E","E_Cntrl","OC","S","BAF","DC","EM","MM","ISO-TP","-";
BA_DEF_ BO_ "DiagResponse" ENUM "No","Yes";
BA_DEF_ BO_ "NmMessage" ENUM "No","Yes";
BA_DEF_ BO_ "GenMsgSendType" ENUM "Cyclic","NotUsed","NotUsed","NotUsed","NotUsed","NotUsed","NotUsed","NotUsed","NoMsgSendType";
BA_DEF_ BO_ "GenMsgNrOfRepetition" INT 0 255;
BA_DEF_ BO_ "GenMsgILSupport" ENUM "No","Yes";
BA_DEF_ BO_ "GenMsgStartDelayTime" INT 0 65535;
BA_DEF_ BO_ "GenMsgCycleTimeFast" INT 0 65535;
BA_DEF_ BO_ "GenMsgCycleTime" INT 0 65535;
BA_DEF_ BO_ "GenMsgDelayTime" INT 0 65535;
BA_DEF_ BO_ "NmAsrMessage" ENUM "No","Yes";
BA_DEF_ BO_ "DiagState" ENUM "No","Yes";
BA_DEF_ BO_ "DiagConnection" HEX 0 65535;
BA_DEF_ BO_ "VFrameFormat" ENUM "StandardCAN","ExtendedCAN","reserved","reserved","reserved","reserved","reserved","reserved","reserved","reserved","reserved","reserved","reserved","reserved","StandardCAN_FD","ExtendedCAN_FD";
BA_DEF_ BO_ "CANFD_BRS" ENUM "0","1";
BA_DEF_DEF_ "DiagRequest" "No";
BA_DEF_DEF_ "Type" "-";
BA_DEF_DEF_ "DiagResponse" "No";
BA_DEF_DEF_ "NmMessage" "No";
BA_DEF_DEF_ "GenMsgSendType" "NoMsgSendType";
BA_DEF_DEF_ "GenMsgNrOfRepetition" 0;
BA_DEF_DEF_ "GenMsgILSupport" "No";
BA_DEF_DEF_ "GenMsgStartDelayTime" 0;
BA_DEF_DEF_ "GenMsgCycleTimeFast" 0;
BA_DEF_DEF_ "GenMsgCycleTime" 0;
BA_DEF_DEF_ "GenMsgDelayTime" 0;
BA_DEF_DEF_ "NmAsrMessage" "No";
BA_DEF_DEF_ "DiagState" "No";
BA_DEF_DEF_ "DiagConnection" 0;
BA_DEF_DEF_ "VFrameFormat" "StandardCAN_FD";
BA_DEF_DEF_ "CANFD_BRS" "0";
BA_DEF_DEF_ "GenSigStartValue" 0;
BA_DEF_DEF_ "GenSigInactiveValue" 0;
BA_DEF_DEF_ "GenSigSendType" "NoSigSendType";
BA_DEF_DEF_ "SystemSignalLongSymbol" "";
BA_DEF_DEF_ "GenSigTimeoutTime_AGSM" 2500;
BA_DEF_DEF_ "GenSigTimeoutTime_BCM" 2500;
BA_DEF_DEF_ "GenSigTimeoutTime_BSM" 2500;
BA_DEF_DEF_ "GenSigTimeoutTime_CADM" 2500;
BA_DEF_DEF_ "GenSigTimeoutTime_DMSM" 2500;
BA_DEF_DEF_ "GenSigTimeoutTime_DTCM" 2500;
BA_DEF_DEF_ "GenSigTimeoutTime_ECM" 2500;
BA_DEF_DEF_ "GenSigTimeoutTime_EVCU2" 2500;
BA_DEF_DEF_ "GenSigTimeoutTime_GNMM" 2500;
BA_DEF_DEF_ "GenSigTimeoutTime_HCP" 2500;
BA_DEF_DEF_ "GenSigTimeoutTime_IPC" 2500;
BA_DEF_DEF_ "GenSigTimeoutTime_RFHM" 2500;
BA_DEF_DEF_ "GenSigTimeoutTime_SGW" 2500;
BA_DEF_DEF_ "GenSigTimeoutTime_TCM" 2500;
BA_ "Type" BO_ 2564485756 8;
BA_ "DiagResponse" BO_ 2564485756 1;
BA_ "DiagConnection" BO_ 2564485756 62076;
BA_ "VFrameFormat" BO_ 2564485756 15;
BA_ "CANFD_BRS" BO_ 2564485756 1;
BA_ "Type" BO_ 2564485663 8;
BA_ "DiagResponse" BO_ 2564485663 1;
BA_ "DiagConnection" BO_ 2564485663 61983;
BA_ "VFrameFormat" BO_ 2564485663 15;
BA_ "CANFD_BRS" BO_ 2564485663 1;
BA_ "Type" BO_ 2564485656 8;
BA_ "DiagResponse" BO_ 2564485656 1;
BA_ "DiagConnection" BO_ 2564485656 61976;
BA_ "VFrameFormat" BO_ 2564485656 15;
BA_ "CANFD_BRS" BO_ 2564485656 1;
BA_ "Type" BO_ 2564485747 8;
BA_ "DiagResponse" BO_ 2564485747 1;
BA_ "DiagConnection" BO_ 2564485747 62067;
BA_ "VFrameFormat" BO_ 2564485747 15;
BA_ "CANFD_BRS" BO_ 2564485747 1;
BA_ "Type" BO_ 2564485391 8;
BA_ "DiagResponse" BO_ 2564485391 1;
BA_ "DiagConnection" BO_ 2564485391 61711;
BA_ "VFrameFormat" BO_ 2564485391 1;
BA_ "Type" BO_ 2564486464 8;
BA_ "DiagResponse" BO_ 2564486464 1;
BA_ "DiagConnection" BO_ 2564486464 62784;
BA_ "VFrameFormat" BO_ 2564486464 15;
BA_ "CANFD_BRS" BO_ 2564486464 1;
BA_ "Type" BO_ 2564486440 8;
BA_ "DiagResponse" BO_ 2564486440 1;
BA_ "DiagConnection" BO_ 2564486440 62760;
BA_ "VFrameFormat" BO_ 2564486440 15;
BA_ "CANFD_BRS" BO_ 2564486440 1;
BA_ "Type" BO_ 2564486446 8;
BA_ "DiagResponse" BO_ 2564486446 1;
BA_ "DiagConnection" BO_ 2564486446 62766;
BA_ "VFrameFormat" BO_ 2564486446 15;
BA_ "CANFD_BRS" BO_ 2564486446 1;
BA_ "Type" BO_ 2564486416 8;
BA_ "DiagResponse" BO_ 2564486416 1;
BA_ "DiagConnection" BO_ 2564486416 62736;
BA_ "VFrameFormat" BO_ 2564486416 15;
BA_ "CANFD_BRS" BO_ 2564486416 1;
BA_ "Type" BO_ 2564487440 8;
BA_ "DiagResponse" BO_ 2564487440 1;
BA_ "DiagConnection" BO_ 2564487440 63760;
BA_ "VFrameFormat" BO_ 2564487440 1;
BA_ "Type" BO_ 2564486424 8;
BA_ "DiagResponse" BO_ 2564486424 1;
BA_ "DiagConnection" BO_ 2564486424 62744;
BA_ "VFrameFormat" BO_ 2564486424 15;
BA_ "CANFD_BRS" BO_ 2564486424 1;
BA_ "Type" BO_ 2564485390 8;
BA_ "DiagResponse" BO_ 2564485390 1;
BA_ "DiagConnection" BO_ 2564485390 61710;
BA_ "VFrameFormat" BO_ 2564485390 1;
BA_ "Type" BO_ 2564485428 8;
BA_ "DiagResponse" BO_ 2564485428 1;
BA_ "DiagConnection" BO_ 2564485428 61748;
BA_ "VFrameFormat" BO_ 2564485428 1;
BA_ "Type" BO_ 2564485472 8;
BA_ "DiagResponse" BO_ 2564485472 1;
BA_ "DiagConnection" BO_ 2564485472 61792;
BA_ "VFrameFormat" BO_ 2564485472 1;
BA_ "Type" BO_ 2564485597 8;
BA_ "DiagResponse" BO_ 2564485597 1;
BA_ "DiagConnection" BO_ 2564485597 61917;
BA_ "VFrameFormat" BO_ 2564485597 1;
BA_ "Type" BO_ 2564485396 8;
BA_ "DiagResponse" BO_ 2564485396 1;
BA_ "DiagConnection" BO_ 2564485396 61716;
BA_ "VFrameFormat" BO_ 2564485396 1;
BA_ "Type" BO_ 2564485397 8;
BA_ "DiagResponse" BO_ 2564485397 1;
BA_ "DiagConnection" BO_ 2564485397 61717;
BA_ "VFrameFormat" BO_ 2564485397 1;
BA_ "Type" BO_ 2564485575 8;
BA_ "DiagResponse" BO_ 2564485575 1;
BA_ "DiagConnection" BO_ 2564485575 61895;
BA_ "VFrameFormat" BO_ 2564485575 1;
BA_ "Type" BO_ 2564485500 8;
BA_ "DiagResponse" BO_ 2564485500 1;
BA_ "DiagConnection" BO_ 2564485500 61820;
BA_ "VFrameFormat" BO_ 2564485500 1;
BA_ "Type" BO_ 2564485407 8;
BA_ "DiagResponse" BO_ 2564485407 1;
BA_ "DiagConnection" BO_ 2564485407 61727;
BA_ "VFrameFormat" BO_ 2564485407 1;
BA_ "Type" BO_ 2564485400 8;
BA_ "DiagResponse" BO_ 2564485400 1;
BA_ "DiagConnection" BO_ 2564485400 61720;
BA_ "VFrameFormat" BO_ 2564485400 1;
BA_ "Type" BO_ 2564485491 8;
BA_ "DiagResponse" BO_ 2564485491 1;
BA_ "DiagConnection" BO_ 2564485491 61811;
BA_ "VFrameFormat" BO_ 2564485491 1;
BA_ "Type" BO_ 2564682048 8;
BA_ "DiagResponse" BO_ 2564682048 1;
BA_ "DiagConnection" BO_ 2564682048 61760;
BA_ "VFrameFormat" BO_ 2564682048 1;
BA_ "Type" BO_ 2564682024 8;
BA_ "DiagResponse" BO_ 2564682024 1;
BA_ "DiagConnection" BO_ 2564682024 61736;
BA_ "VFrameFormat" BO_ 2564682024 1;
BA_ "Type" BO_ 2564682030 8;
BA_ "DiagResponse" BO_ 2564682030 1;
BA_ "DiagConnection" BO_ 2564682030 61742;
BA_ "VFrameFormat" BO_ 2564682030 1;
BA_ "Type" BO_ 2564682135 8;
BA_ "DiagResponse" BO_ 2564682135 1;
BA_ "DiagConnection" BO_ 2564682135 61847;
BA_ "VFrameFormat" BO_ 2564682135 1;
BA_ "Type" BO_ 2564682010 8;
BA_ "DiagResponse" BO_ 2564682010 1;
BA_ "DiagConnection" BO_ 2564682010 61722;
BA_ "VFrameFormat" BO_ 2564682010 1;
BA_ "Type" BO_ 2564682000 8;
BA_ "DiagResponse" BO_ 2564682000 1;
BA_ "DiagConnection" BO_ 2564682000 61712;
BA_ "VFrameFormat" BO_ 2564682000 1;
BA_ "Type" BO_ 2564682304 8;
BA_ "DiagResponse" BO_ 2564682304 1;
BA_ "DiagConnection" BO_ 2564682304 62016;
BA_ "VFrameFormat" BO_ 2564682304 15;
BA_ "CANFD_BRS" BO_ 2564682304 1;
BA_ "Type" BO_ 2564682280 8;
BA_ "DiagResponse" BO_ 2564682280 1;
BA_ "DiagConnection" BO_ 2564682280 61992;
BA_ "VFrameFormat" BO_ 2564682280 15;
BA_ "CANFD_BRS" BO_ 2564682280 1;
BA_ "Type" BO_ 2564682286 8;
BA_ "DiagResponse" BO_ 2564682286 1;
BA_ "DiagConnection" BO_ 2564682286 61998;
BA_ "VFrameFormat" BO_ 2564682286 15;
BA_ "CANFD_BRS" BO_ 2564682286 1;
BA_ "Type" BO_ 2564682391 8;
BA_ "DiagResponse" BO_ 2564682391 1;
BA_ "DiagConnection" BO_ 2564682391 62103;
BA_ "VFrameFormat" BO_ 2564682391 15;
BA_ "CANFD_BRS" BO_ 2564682391 1;
BA_ "Type" BO_ 2564682266 8;
BA_ "DiagResponse" BO_ 2564682266 1;
BA_ "DiagConnection" BO_ 2564682266 61978;
BA_ "VFrameFormat" BO_ 2564682266 15;
BA_ "CANFD_BRS" BO_ 2564682266 1;
BA_ "Type" BO_ 2564682256 8;
BA_ "DiagResponse" BO_ 2564682256 1;
BA_ "DiagConnection" BO_ 2564682256 61968;
BA_ "VFrameFormat" BO_ 2564682256 15;
BA_ "CANFD_BRS" BO_ 2564682256 1;
BA_ "Type" BO_ 2564682255 8;
BA_ "DiagResponse" BO_ 2564682255 1;
BA_ "DiagConnection" BO_ 2564682255 61967;
BA_ "VFrameFormat" BO_ 2564682255 15;
BA_ "CANFD_BRS" BO_ 2564682255 1;
BA_ "Type" BO_ 2564682254 8;
BA_ "DiagResponse" BO_ 2564682254 1;
BA_ "DiagConnection" BO_ 2564682254 61966;
BA_ "VFrameFormat" BO_ 2564682254 15;
BA_ "CANFD_BRS" BO_ 2564682254 1;
BA_ "Type" BO_ 2564682292 8;
BA_ "DiagResponse" BO_ 2564682292 1;
BA_ "DiagConnection" BO_ 2564682292 62004;
BA_ "VFrameFormat" BO_ 2564682292 15;
BA_ "CANFD_BRS" BO_ 2564682292 1;
BA_ "Type" BO_ 2564682336 8;
BA_ "DiagResponse" BO_ 2564682336 1;
BA_ "DiagConnection" BO_ 2564682336 62048;
BA_ "VFrameFormat" BO_ 2564682336 15;
BA_ "CANFD_BRS" BO_ 2564682336 1;
BA_ "Type" BO_ 2564682260 8;
BA_ "DiagResponse" BO_ 2564682260 1;
BA_ "DiagConnection" BO_ 2564682260 61972;
BA_ "VFrameFormat" BO_ 2564682260 15;
BA_ "CANFD_BRS" BO_ 2564682260 1;
BA_ "Type" BO_ 2564682261 8;
BA_ "DiagResponse" BO_ 2564682261 1;
BA_ "DiagConnection" BO_ 2564682261 61973;
BA_ "VFrameFormat" BO_ 2564682261 15;
BA_ "CANFD_BRS" BO_ 2564682261 1;
BA_ "Type" BO_ 2564682439 8;
BA_ "DiagResponse" BO_ 2564682439 1;
BA_ "DiagConnection" BO_ 2564682439 62151;
BA_ "VFrameFormat" BO_ 2564682439 15;
BA_ "CANFD_BRS" BO_ 2564682439 1;
BA_ "Type" BO_ 2564682364 8;
BA_ "DiagResponse" BO_ 2564682364 1;
BA_ "DiagConnection" BO_ 2564682364 62076;
BA_ "VFrameFormat" BO_ 2564682364 15;
BA_ "CANFD_BRS" BO_ 2564682364 1;
BA_ "Type" BO_ 2564682271 8;
BA_ "DiagResponse" BO_ 2564682271 1;
BA_ "DiagConnection" BO_ 2564682271 61983;
BA_ "VFrameFormat" BO_ 2564682271 15;
BA_ "CANFD_BRS" BO_ 2564682271 1;
BA_ "Type" BO_ 2564682264 8;
BA_ "DiagResponse" BO_ 2564682264 1;
BA_ "DiagConnection" BO_ 2564682264 61976;
BA_ "VFrameFormat" BO_ 2564682264 15;
BA_ "CANFD_BRS" BO_ 2564682264 1;
BA_ "Type" BO_ 2564682355 8;
BA_ "DiagResponse" BO_ 2564682355 1;
BA_ "DiagConnection" BO_ 2564682355 62067;
BA_ "VFrameFormat" BO_ 2564682355 15;
BA_ "CANFD_BRS" BO_ 2564682355 1;
BA_ "Type" BO_ 2564681999 8;
BA_ "DiagResponse" BO_ 2564681999 1;
BA_ "DiagConnection" BO_ 2564681999 61711;
BA_ "VFrameFormat" BO_ 2564681999 1;
BA_ "Type" BO_ 2564681998 8;
BA_ "DiagResponse" BO_ 2564681998 1;
BA_ "DiagConnection" BO_ 2564681998 61710;
BA_ "VFrameFormat" BO_ 2564681998 1;
BA_ "Type" BO_ 2564682036 8;
BA_ "DiagResponse" BO_ 2564682036 1;
BA_ "DiagConnection" BO_ 2564682036 61748;
BA_ "VFrameFormat" BO_ 2564682036 1;
BA_ "Type" BO_ 2564682080 8;
BA_ "DiagResponse" BO_ 2564682080 1;
BA_ "DiagConnection" BO_ 2564682080 61792;
BA_ "VFrameFormat" BO_ 2564682080 1;
BA_ "Type" BO_ 2564682004 8;
BA_ "DiagResponse" BO_ 2564682004 1;
BA_ "DiagConnection" BO_ 2564682004 61716;
BA_ "VFrameFormat" BO_ 2564682004 1;
BA_ "Type" BO_ 2564682005 8;
BA_ "DiagResponse" BO_ 2564682005 1;
BA_ "DiagConnection" BO_ 2564682005 61717;
BA_ "VFrameFormat" BO_ 2564682005 1;
BA_ "Type" BO_ 2564682183 8;
BA_ "DiagResponse" BO_ 2564682183 1;
BA_ "DiagConnection" BO_ 2564682183 61895;
BA_ "VFrameFormat" BO_ 2564682183 1;
BA_ "Type" BO_ 2564682108 8;
BA_ "DiagResponse" BO_ 2564682108 1;
BA_ "DiagConnection" BO_ 2564682108 61820;
BA_ "VFrameFormat" BO_ 2564682108 1;
BA_ "Type" BO_ 2564682015 8;
BA_ "DiagResponse" BO_ 2564682015 1;
BA_ "DiagConnection" BO_ 2564682015 61727;
BA_ "VFrameFormat" BO_ 2564682015 1;
BA_ "Type" BO_ 2564682008 8;
BA_ "DiagResponse" BO_ 2564682008 1;
BA_ "DiagConnection" BO_ 2564682008 61720;
BA_ "VFrameFormat" BO_ 2564682008 1;
BA_ "Type" BO_ 2564682099 8;
BA_ "DiagResponse" BO_ 2564682099 1;
BA_ "DiagConnection" BO_ 2564682099 61811;
BA_ "VFrameFormat" BO_ 2564682099 1;
BA_ "Type" BO_ 517 1;
BA_ "GenMsgSendType" BO_ 517 0;
BA_ "GenMsgILSupport" BO_ 517 1;
BA_ "GenMsgCycleTime" BO_ 517 20;
BA_ "CANFD_BRS" BO_ 517 1;
BA_ "Type" BO_ 1447 3;
BA_ "GenMsgSendType" BO_ 1447 0;
BA_ "GenMsgNrOfRepetition" BO_ 1447 2;
BA_ "GenMsgILSupport" BO_ 1447 1;
BA_ "GenMsgCycleTimeFast" BO_ 1447 20;
BA_ "GenMsgCycleTime" BO_ 1447 1000;
BA_ "GenMsgDelayTime" BO_ 1447 20;
BA_ "CANFD_BRS" BO_ 1447 1;
BA_ "Type" BO_ 1068 3;
BA_ "GenMsgSendType" BO_ 1068 0;
BA_ "GenMsgNrOfRepetition" BO_ 1068 2;
BA_ "GenMsgILSupport" BO_ 1068 1;
BA_ "GenMsgCycleTimeFast" BO_ 1068 20;
BA_ "GenMsgCycleTime" BO_ 1068 100;
BA_ "GenMsgDelayTime" BO_ 1068 20;
BA_ "CANFD_BRS" BO_ 1068 1;
BA_ "Type" BO_ 1438 3;
BA_ "GenMsgSendType" BO_ 1438 0;
BA_ "GenMsgNrOfRepetition" BO_ 1438 2;
BA_ "GenMsgILSupport" BO_ 1438 1;
BA_ "GenMsgCycleTimeFast" BO_ 1438 20;
BA_ "GenMsgCycleTime" BO_ 1438 1000;
BA_ "GenMsgDelayTime" BO_ 1438 20;
BA_ "CANFD_BRS" BO_ 1438 1;
BA_ "Type" BO_ 2654814209 8;
BA_ "GenMsgILSupport" BO_ 2654814209 1;
BA_ "VFrameFormat" BO_ 2654814209 1;
BA_ "Type" BO_ 2654817823 8;
BA_ "GenMsgILSupport" BO_ 2654817823 1;
BA_ "VFrameFormat" BO_ 2654817823 15;
BA_ "CANFD_BRS" BO_ 2654817823 1;
BA_ "Type" BO_ 2654817818 8;
BA_ "GenMsgILSupport" BO_ 2654817818 1;
BA_ "VFrameFormat" BO_ 2654817818 15;
BA_ "CANFD_BRS" BO_ 2654817818 1;
BA_ "Type" BO_ 2654817808 8;
BA_ "GenMsgILSupport" BO_ 2654817808 1;
BA_ "VFrameFormat" BO_ 2654817808 15;
BA_ "CANFD_BRS" BO_ 2654817808 1;
BA_ "Type" BO_ 2654817991 8;
BA_ "GenMsgILSupport" BO_ 2654817991 1;
BA_ "VFrameFormat" BO_ 2654817991 15;
BA_ "CANFD_BRS" BO_ 2654817991 1;
BA_ "Type" BO_ 2654817816 8;
BA_ "VFrameFormat" BO_ 2654817816 15;
BA_ "CANFD_BRS" BO_ 2654817816 1;
BA_ "Type" BO_ 1054 1;
BA_ "GenMsgSendType" BO_ 1054 0;
BA_ "GenMsgILSupport" BO_ 1054 1;
BA_ "GenMsgCycleTime" BO_ 1054 100;
BA_ "CANFD_BRS" BO_ 1054 1;
BA_ "Type" BO_ 262 1;
BA_ "GenMsgSendType" BO_ 262 0;
BA_ "GenMsgILSupport" BO_ 262 1;
BA_ "GenMsgCycleTime" BO_ 262 10;
BA_ "CANFD_BRS" BO_ 262 1;
BA_ "Type" BO_ 1036 3;
BA_ "GenMsgSendType" BO_ 1036 0;
BA_ "GenMsgNrOfRepetition" BO_ 1036 2;
BA_ "GenMsgILSupport" BO_ 1036 1;
BA_ "GenMsgCycleTimeFast" BO_ 1036 20;
BA_ "GenMsgCycleTime" BO_ 1036 100;
BA_ "GenMsgDelayTime" BO_ 1036 20;
BA_ "CANFD_BRS" BO_ 1036 1;
BA_ "GenSigTimeoutTime_AGSM" SG_ 2564485756 N_PDU 0;
BA_ "GenSigTimeoutTime_BCM" SG_ 2564485756 N_PDU 0;
BA_ "GenSigTimeoutTime_BSM" SG_ 2564485756 N_PDU 0;
BA_ "GenSigTimeoutTime_CADM" SG_ 2564485756 N_PDU 0;
BA_ "GenSigTimeoutTime_DMSM" SG_ 2564485756 N_PDU 0;
BA_ "GenSigTimeoutTime_DTCM" SG_ 2564485756 N_PDU 0;
BA_ "GenSigTimeoutTime_ECM" SG_ 2564485756 N_PDU 0;
BA_ "GenSigTimeoutTime_EVCU2" SG_ 2564485756 N_PDU 0;
BA_ "GenSigTimeoutTime_GNMM" SG_ 2564485756 N_PDU 0;
BA_ "GenSigTimeoutTime_HCP" SG_ 2564485756 N_PDU 0;
BA_ "GenSigTimeoutTime_IPC" SG_ 2564485756 N_PDU 0;
BA_ "GenSigTimeoutTime_RFHM" SG_ 2564485756 N_PDU 0;
BA_ "GenSigTimeoutTime_SGW" SG_ 2564485756 N_PDU 0;
BA_ "GenSigTimeoutTime_TCM" SG_ 2564485756 N_PDU 0;
BA_ "GenSigTimeoutTime_AGSM" SG_ 2564485663 N_PDU 0;
BA_ "GenSigTimeoutTime_BCM" SG_ 2564485663 N_PDU 0;
BA_ "GenSigTimeoutTime_BSM" SG_ 2564485663 N_PDU 0;
BA_ "GenSigTimeoutTime_CADM" SG_ 2564485663 N_PDU 0;
BA_ "GenSigTimeoutTime_DMSM" SG_ 2564485663 N_PDU 0;
BA_ "GenSigTimeoutTime_DTCM" SG_ 2564485663 N_PDU 0;
BA_ "GenSigTimeoutTime_ECM" SG_ 2564485663 N_PDU 0;
BA_ "GenSigTimeoutTime_EVCU2" SG_ 2564485663 N_PDU 0;
BA_ "GenSigTimeoutTime_GNMM" SG_ 2564485663 N_PDU 0;
BA_ "GenSigTimeoutTime_HCP" SG_ 2564485663 N_PDU 0;
BA_ "GenSigTimeoutTime_IPC" SG_ 2564485663 N_PDU 0;
BA_ "GenSigTimeoutTime_RFHM" SG_ 2564485663 N_PDU 0;
BA_ "GenSigTimeoutTime_SGW" SG_ 2564485663 N_PDU 0;
BA_ "GenSigTimeoutTime_TCM" SG_ 2564485663 N_PDU 0;
BA_ "GenSigTimeoutTime_AGSM" SG_ 2564485656 N_PDU 0;
BA_ "GenSigTimeoutTime_BCM" SG_ 2564485656 N_PDU 0;
BA_ "GenSigTimeoutTime_BSM" SG_ 2564485656 N_PDU 0;
BA_ "GenSigTimeoutTime_CADM" SG_ 2564485656 N_PDU 0;
BA_ "GenSigTimeoutTime_DMSM" SG_ 2564485656 N_PDU 0;
BA_ "GenSigTimeoutTime_DTCM" SG_ 2564485656 N_PDU 0;
BA_ "GenSigTimeoutTime_ECM" SG_ 2564485656 N_PDU 0;
BA_ "GenSigTimeoutTime_EVCU2" SG_ 2564485656 N_PDU 0;
BA_ "GenSigTimeoutTime_GNMM" SG_ 2564485656 N_PDU 0;
BA_ "GenSigTimeoutTime_HCP" SG_ 2564485656 N_PDU 0;
BA_ "GenSigTimeoutTime_IPC" SG_ 2564485656 N_PDU 0;
BA_ "GenSigTimeoutTime_RFHM" SG_ 2564485656 N_PDU 0;
BA_ "GenSigTimeoutTime_SGW" SG_ 2564485656 N_PDU 0;
BA_ "GenSigTimeoutTime_TCM" SG_ 2564485656 N_PDU 0;
BA_ "GenSigTimeoutTime_AGSM" SG_ 2564485747 N_PDU 0;
BA_ "GenSigTimeoutTime_BCM" SG_ 2564485747 N_PDU 0;
BA_ "GenSigTimeoutTime_BSM" SG_ 2564485747 N_PDU 0;
BA_ "GenSigTimeoutTime_CADM" SG_ 2564485747 N_PDU 0;
BA_ "GenSigTimeoutTime_DMSM" SG_ 2564485747 N_PDU 0;
BA_ "GenSigTimeoutTime_DTCM" SG_ 2564485747 N_PDU 0;
BA_ "GenSigTimeoutTime_ECM" SG_ 2564485747 N_PDU 0;
BA_ "GenSigTimeoutTime_EVCU2" SG_ 2564485747 N_PDU 0;
BA_ "GenSigTimeoutTime_GNMM" SG_ 2564485747 N_PDU 0;
BA_ "GenSigTimeoutTime_HCP" SG_ 2564485747 N_PDU 0;
BA_ "GenSigTimeoutTime_IPC" SG_ 2564485747 N_PDU 0;
BA_ "GenSigTimeoutTime_RFHM" SG_ 2564485747 N_PDU 0;
BA_ "GenSigTimeoutTime_SGW" SG_ 2564485747 N_PDU 0;
BA_ "GenSigTimeoutTime_TCM" SG_ 2564485747 N_PDU 0;
BA_ "GenSigTimeoutTime_AGSM" SG_ 2564485391 N_PDU 0;
BA_ "GenSigTimeoutTime_BCM" SG_ 2564485391 N_PDU 0;
BA_ "GenSigTimeoutTime_BSM" SG_ 2564485391 N_PDU 0;
BA_ "GenSigTimeoutTime_CADM" SG_ 2564485391 N_PDU 0;
BA_ "GenSigTimeoutTime_DMSM" SG_ 2564485391 N_PDU 0;
BA_ "GenSigTimeoutTime_DTCM" SG_ 2564485391 N_PDU 0;
BA_ "GenSigTimeoutTime_ECM" SG_ 2564485391 N_PDU 0;
BA_ "GenSigTimeoutTime_EVCU2" SG_ 2564485391 N_PDU 0;
BA_ "GenSigTimeoutTime_GNMM" SG_ 2564485391 N_PDU 0;
BA_ "GenSigTimeoutTime_HCP" SG_ 2564485391 N_PDU 0;
BA_ "GenSigTimeoutTime_IPC" SG_ 2564485391 N_PDU 0;
BA_ "GenSigTimeoutTime_RFHM" SG_ 2564485391 N_PDU 0;
BA_ "GenSigTimeoutTime_SGW" SG_ 2564485391 N_PDU 0;
BA_ "GenSigTimeoutTime_TCM" SG_ 2564485391 N_PDU 0;
BA_ "GenSigTimeoutTime_AGSM" SG_ 2564486464 N_PDU 0;
BA_ "GenSigTimeoutTime_BCM" SG_ 2564486464 N_PDU 0;
BA_ "GenSigTimeoutTime_BSM" SG_ 2564486464 N_PDU 0;
BA_ "GenSigTimeoutTime_CADM" SG_ 2564486464 N_PDU 0;
BA_ "GenSigTimeoutTime_DMSM" SG_ 2564486464 N_PDU 0;
BA_ "GenSigTimeoutTime_DTCM" SG_ 2564486464 N_PDU 0;
BA_ "GenSigTimeoutTime_ECM" SG_ 2564486464 N_PDU 0;
BA_ "GenSigTimeoutTime_EVCU2" SG_ 2564486464 N_PDU 0;
BA_ "GenSigTimeoutTime_GNMM" SG_ 2564486464 N_PDU 0;
BA_ "GenSigTimeoutTime_HCP" SG_ 2564486464 N_PDU 0;
BA_ "GenSigTimeoutTime_IPC" SG_ 2564486464 N_PDU 0;
BA_ "GenSigTimeoutTime_RFHM" SG_ 2564486464 N_PDU 0;
BA_ "GenSigTimeoutTime_SGW" SG_ 2564486464 N_PDU 0;
BA_ "GenSigTimeoutTime_TCM" SG_ 2564486464 N_PDU 0;
BA_ "GenSigTimeoutTime_AGSM" SG_ 2564486440 N_PDU 0;
BA_ "GenSigTimeoutTime_BCM" SG_ 2564486440 N_PDU 0;
BA_ "GenSigTimeoutTime_BSM" SG_ 2564486440 N_PDU 0;
BA_ "GenSigTimeoutTime_CADM" SG_ 2564486440 N_PDU 0;
BA_ "GenSigTimeoutTime_DMSM" SG_ 2564486440 N_PDU 0;
BA_ "GenSigTimeoutTime_DTCM" SG_ 2564486440 N_PDU 0;
BA_ "GenSigTimeoutTime_ECM" SG_ 2564486440 N_PDU 0;
BA_ "GenSigTimeoutTime_EVCU2" SG_ 2564486440 N_PDU 0;
BA_ "GenSigTimeoutTime_GNMM" SG_ 2564486440 N_PDU 0;
BA_ "GenSigTimeoutTime_HCP" SG_ 2564486440 N_PDU 0;
BA_ "GenSigTimeoutTime_IPC" SG_ 2564486440 N_PDU 0;
BA_ "GenSigTimeoutTime_RFHM" SG_ 2564486440 N_PDU 0;
BA_ "GenSigTimeoutTime_SGW" SG_ 2564486440 N_PDU 0;
BA_ "GenSigTimeoutTime_TCM" SG_ 2564486440 N_PDU 0;
BA_ "GenSigTimeoutTime_AGSM" SG_ 2564486446 N_PDU 0;
BA_ "GenSigTimeoutTime_BCM" SG_ 2564486446 N_PDU 0;
BA_ "GenSigTimeoutTime_BSM" SG_ 2564486446 N_PDU 0;
BA_ "GenSigTimeoutTime_CADM" SG_ 2564486446 N_PDU 0;
BA_ "GenSigTimeoutTime_DMSM" SG_ 2564486446 N_PDU 0;
BA_ "GenSigTimeoutTime_DTCM" SG_ 2564486446 N_PDU 0;
BA_ "GenSigTimeoutTime_ECM" SG_ 2564486446 N_PDU 0;
BA_ "GenSigTimeoutTime_EVCU2" SG_ 2564486446 N_PDU 0;
BA_ "GenSigTimeoutTime_GNMM" SG_ 2564486446 N_PDU 0;
BA_ "GenSigTimeoutTime_HCP" SG_ 2564486446 N_PDU 0;
BA_ "GenSigTimeoutTime_IPC" SG_ 2564486446 N_PDU 0;
BA_ "GenSigTimeoutTime_RFHM" SG_ 2564486446 N_PDU 0;
BA_ "GenSigTimeoutTime_SGW" SG_ 2564486446 N_PDU 0;
BA_ "GenSigTimeoutTime_TCM" SG_ 2564486446 N_PDU 0;
BA_ "GenSigTimeoutTime_AGSM" SG_ 2564486416 N_PDU 0;
BA_ "GenSigTimeoutTime_BCM" SG_ 2564486416 N_PDU 0;
BA_ "GenSigTimeoutTime_BSM" SG_ 2564486416 N_PDU 0;
BA_ "GenSigTimeoutTime_CADM" SG_ 2564486416 N_PDU 0;
BA_ "GenSigTimeoutTime_DMSM" SG_ 2564486416 N_PDU 0;
BA_ "GenSigTimeoutTime_DTCM" SG_ 2564486416 N_PDU 0;
BA_ "GenSigTimeoutTime_ECM" SG_ 2564486416 N_PDU 0;
BA_ "GenSigTimeoutTime_EVCU2" SG_ 2564486416 N_PDU 0;
BA_ "GenSigTimeoutTime_GNMM" SG_ 2564486416 N_PDU 0;
BA_ "GenSigTimeoutTime_HCP" SG_ 2564486416 N_PDU 0;
BA_ "GenSigTimeoutTime_IPC" SG_ 2564486416 N_PDU 0;
BA_ "GenSigTimeoutTime_RFHM" SG_ 2564486416 N_PDU 0;
BA_ "GenSigTimeoutTime_SGW" SG_ 2564486416 N_PDU 0;
BA_ "GenSigTimeoutTime_TCM" SG_ 2564486416 N_PDU 0;
BA_ "GenSigTimeoutTime_AGSM" SG_ 2564487440 N_PDU 0;
BA_ "GenSigTimeoutTime_BCM" SG_ 2564487440 N_PDU 0;
BA_ "GenSigTimeoutTime_BSM" SG_ 2564487440 N_PDU 0;
BA_ "GenSigTimeoutTime_CADM" SG_ 2564487440 N_PDU 0;
BA_ "GenSigTimeoutTime_DMSM" SG_ 2564487440 N_PDU 0;
BA_ "GenSigTimeoutTime_DTCM" SG_ 2564487440 N_PDU 0;
BA_ "GenSigTimeoutTime_ECM" SG_ 2564487440 N_PDU 0;
BA_ "GenSigTimeoutTime_EVCU2" SG_ 2564487440 N_PDU 0;
BA_ "GenSigTimeoutTime_GNMM" SG_ 2564487440 N_PDU 0;
BA_ "GenSigTimeoutTime_HCP" SG_ 2564487440 N_PDU 0;
BA_ "GenSigTimeoutTime_IPC" SG_ 2564487440 N_PDU 0;
BA_ "GenSigTimeoutTime_RFHM" SG_ 2564487440 N_PDU 0;
BA_ "GenSigTimeoutTime_SGW" SG_ 2564487440 N_PDU 0;
BA_ "GenSigTimeoutTime_TCM" SG_ 2564487440 N_PDU 0;
BA_ "GenSigTimeoutTime_AGSM" SG_ 2564486424 N_PDU 0;
BA_ "GenSigTimeoutTime_BCM" SG_ 2564486424 N_PDU 0;
BA_ "GenSigTimeoutTime_BSM" SG_ 2564486424 N_PDU 0;
BA_ "GenSigTimeoutTime_CADM" SG_ 2564486424 N_PDU 0;
BA_ "GenSigTimeoutTime_DMSM" SG_ 2564486424 N_PDU 0;
BA_ "GenSigTimeoutTime_DTCM" SG_ 2564486424 N_PDU 0;
BA_ "GenSigTimeoutTime_ECM" SG_ 2564486424 N_PDU 0;
BA_ "GenSigTimeoutTime_EVCU2" SG_ 2564486424 N_PDU 0;
BA_ "GenSigTimeoutTime_GNMM" SG_ 2564486424 N_PDU 0;
BA_ "GenSigTimeoutTime_HCP" SG_ 2564486424 N_PDU 0;
BA_ "GenSigTimeoutTime_IPC" SG_ 2564486424 N_PDU 0;
BA_ "GenSigTimeoutTime_RFHM" SG_ 2564486424 N_PDU 0;
BA_ "GenSigTimeoutTime_SGW" SG_ 2564486424 N_PDU 0;
BA_ "GenSigTimeoutTime_TCM" SG_ 2564486424 N_PDU 0;
BA_ "GenSigTimeoutTime_AGSM" SG_ 2564485390 N_PDU 0;
BA_ "GenSigTimeoutTime_BCM" SG_ 2564485390 N_PDU 0;
BA_ "GenSigTimeoutTime_BSM" SG_ 2564485390 N_PDU 0;
BA_ "GenSigTimeoutTime_CADM" SG_ 2564485390 N_PDU 0;
BA_ "GenSigTimeoutTime_DMSM" SG_ 2564485390 N_PDU 0;
BA_ "GenSigTimeoutTime_DTCM" SG_ 2564485390 N_PDU 0;
BA_ "GenSigTimeoutTime_ECM" SG_ 2564485390 N_PDU 0;
BA_ "GenSigTimeoutTime_EVCU2" SG_ 2564485390 N_PDU 0;
BA_ "GenSigTimeoutTime_GNMM" SG_ 2564485390 N_PDU 0;
BA_ "GenSigTimeoutTime_HCP" SG_ 2564485390 N_PDU 0;
BA_ "GenSigTimeoutTime_IPC" SG_ 2564485390 N_PDU 0;
BA_ "GenSigTimeoutTime_RFHM" SG_ 2564485390 N_PDU 0;
BA_ "GenSigTimeoutTime_SGW" SG_ 2564485390 N_PDU 0;
BA_ "GenSigTimeoutTime_TCM" SG_ 2564485390 N_PDU 0;
BA_ "GenSigTimeoutTime_AGSM" SG_ 2564485428 N_PDU 0;
BA_ "GenSigTimeoutTime_BCM" SG_ 2564485428 N_PDU 0;
BA_ "GenSigTimeoutTime_BSM" SG_ 2564485428 N_PDU 0;
BA_ "GenSigTimeoutTime_CADM" SG_ 2564485428 N_PDU 0;
BA_ "GenSigTimeoutTime_DMSM" SG_ 2564485428 N_PDU 0;
BA_ "GenSigTimeoutTime_DTCM" SG_ 2564485428 N_PDU 0;
BA_ "GenSigTimeoutTime_ECM" SG_ 2564485428 N_PDU 0;
BA_ "GenSigTimeoutTime_EVCU2" SG_ 2564485428 N_PDU 0;
BA_ "GenSigTimeoutTime_GNMM" SG_ 2564485428 N_PDU 0;
BA_ "GenSigTimeoutTime_HCP" SG_ 2564485428 N_PDU 0;
BA_ "GenSigTimeoutTime_IPC" SG_ 2564485428 N_PDU 0;
BA_ "GenSigTimeoutTime_RFHM" SG_ 2564485428 N_PDU 0;
BA_ "GenSigTimeoutTime_SGW" SG_ 2564485428 N_PDU 0;
BA_ "GenSigTimeoutTime_TCM" SG_ 2564485428 N_PDU 0;
BA_ "GenSigTimeoutTime_AGSM" SG_ 2564485472 N_PDU 0;
BA_ "GenSigTimeoutTime_BCM" SG_ 2564485472 N_PDU 0;
BA_ "GenSigTimeoutTime_BSM" SG_ 2564485472 N_PDU 0;
BA_ "GenSigTimeoutTime_CADM" SG_ 2564485472 N_PDU 0;
BA_ "GenSigTimeoutTime_DMSM" SG_ 2564485472 N_PDU 0;
BA_ "GenSigTimeoutTime_DTCM" SG_ 2564485472 N_PDU 0;
BA_ "GenSigTimeoutTime_ECM" SG_ 2564485472 N_PDU 0;
BA_ "GenSigTimeoutTime_EVCU2" SG_ 2564485472 N_PDU 0;
BA_ "GenSigTimeoutTime_GNMM" SG_ 2564485472 N_PDU 0;
BA_ "GenSigTimeoutTime_HCP" SG_ 2564485472 N_PDU 0;
BA_ "GenSigTimeoutTime_IPC" SG_ 2564485472 N_PDU 0;
BA_ "GenSigTimeoutTime_RFHM" SG_ 2564485472 N_PDU 0;
BA_ "GenSigTimeoutTime_SGW" SG_ 2564485472 N_PDU 0;
BA_ "GenSigTimeoutTime_TCM" SG_ 2564485472 N_PDU 0;
BA_ "GenSigTimeoutTime_AGSM" SG_ 2564485597 N_PDU 0;
BA_ "GenSigTimeoutTime_BCM" SG_ 2564485597 N_PDU 0;
BA_ "GenSigTimeoutTime_BSM" SG_ 2564485597 N_PDU 0;
BA_ "GenSigTimeoutTime_CADM" SG_ 2564485597 N_PDU 0;
BA_ "GenSigTimeoutTime_DMSM" SG_ 2564485597 N_PDU 0;
BA_ "GenSigTimeoutTime_DTCM" SG_ 2564485597 N_PDU 0;
BA_ "GenSigTimeoutTime_ECM" SG_ 2564485597 N_PDU 0;
BA_ "GenSigTimeoutTime_EVCU2" SG_ 2564485597 N_PDU 0;
BA_ "GenSigTimeoutTime_GNMM" SG_ 2564485597 N_PDU 0;
BA_ "GenSigTimeoutTime_HCP" SG_ 2564485597 N_PDU 0;
BA_ "GenSigTimeoutTime_IPC" SG_ 2564485597 N_PDU 0;
BA_ "GenSigTimeoutTime_RFHM" SG_ 2564485597 N_PDU 0;
BA_ "GenSigTimeoutTime_SGW" SG_ 2564485597 N_PDU 0;
BA_ "GenSigTimeoutTime_TCM" SG_ 2564485597 N_PDU 0;
BA_ "GenSigTimeoutTime_AGSM" SG_ 2564485396 N_PDU 0;
BA_ "GenSigTimeoutTime_BCM" SG_ 2564485396 N_PDU 0;
BA_ "GenSigTimeoutTime_BSM" SG_ 2564485396 N_PDU 0;
BA_ "GenSigTimeoutTime_CADM" SG_ 2564485396 N_PDU 0;
BA_ "GenSigTimeoutTime_DMSM" SG_ 2564485396 N_PDU 0;
BA_ "GenSigTimeoutTime_DTCM" SG_ 2564485396 N_PDU 0;
BA_ "GenSigTimeoutTime_ECM" SG_ 2564485396 N_PDU 0;
BA_ "GenSigTimeoutTime_EVCU2" SG_ 2564485396 N_PDU 0;
BA_ "GenSigTimeoutTime_GNMM" SG_ 2564485396 N_PDU 0;
BA_ "GenSigTimeoutTime_HCP" SG_ 2564485396 N_PDU 0;
BA_ "GenSigTimeoutTime_IPC" SG_ 2564485396 N_PDU 0;
BA_ "GenSigTimeoutTime_RFHM" SG_ 2564485396 N_PDU 0;
BA_ "GenSigTimeoutTime_SGW" SG_ 2564485396 N_PDU 0;
BA_ "GenSigTimeoutTime_TCM" SG_ 2564485396 N_PDU 0;
BA_ "GenSigTimeoutTime_AGSM" SG_ 2564485397 N_PDU 0;
BA_ "GenSigTimeoutTime_BCM" SG_ 2564485397 N_PDU 0;
BA_ "GenSigTimeoutTime_BSM" SG_ 2564485397 N_PDU 0;
BA_ "GenSigTimeoutTime_CADM" SG_ 2564485397 N_PDU 0;
BA_ "GenSigTimeoutTime_DMSM" SG_ 2564485397 N_PDU 0;
BA_ "GenSigTimeoutTime_DTCM" SG_ 2564485397 N_PDU 0;
BA_ "GenSigTimeoutTime_ECM" SG_ 2564485397 N_PDU 0;
BA_ "GenSigTimeoutTime_EVCU2" SG_ 2564485397 N_PDU 0;
BA_ "GenSigTimeoutTime_GNMM" SG_ 2564485397 N_PDU 0;
BA_ "GenSigTimeoutTime_HCP" SG_ 2564485397 N_PDU 0;
BA_ "GenSigTimeoutTime_IPC" SG_ 2564485397 N_PDU 0;
BA_ "GenSigTimeoutTime_RFHM" SG_ 2564485397 N_PDU 0;
BA_ "GenSigTimeoutTime_SGW" SG_ 2564485397 N_PDU 0;
BA_ "GenSigTimeoutTime_TCM" SG_ 2564485397 N_PDU 0;
BA_ "GenSigTimeoutTime_AGSM" SG_ 2564485575 N_PDU 0;
BA_ "GenSigTimeoutTime_BCM" SG_ 2564485575 N_PDU 0;
BA_ "GenSigTimeoutTime_BSM" SG_ 2564485575 N_PDU 0;
BA_ "GenSigTimeoutTime_CADM" SG_ 2564485575 N_PDU 0;
BA_ "GenSigTimeoutTime_DMSM" SG_ 2564485575 N_PDU 0;
BA_ "GenSigTimeoutTime_DTCM" SG_ 2564485575 N_PDU 0;
BA_ "GenSigTimeoutTime_ECM" SG_ 2564485575 N_PDU 0;
BA_ "GenSigTimeoutTime_EVCU2" SG_ 2564485575 N_PDU 0;
BA_ "GenSigTimeoutTime_GNMM" SG_ 2564485575 N_PDU 0;
BA_ "GenSigTimeoutTime_HCP" SG_ 2564485575 N_PDU 0;
BA_ "GenSigTimeoutTime_IPC" SG_ 2564485575 N_PDU 0;
BA_ "GenSigTimeoutTime_RFHM" SG_ 2564485575 N_PDU 0;
BA_ "GenSigTimeoutTime_SGW" SG_ 2564485575 N_PDU 0;
BA_ "GenSigTimeoutTime_TCM" SG_ 2564485575 N_PDU 0;
BA_ "GenSigTimeoutTime_AGSM" SG_ 2564485500 N_PDU 0;
BA_ "GenSigTimeoutTime_BCM" SG_ 2564485500 N_PDU 0;
BA_ "GenSigTimeoutTime_BSM" SG_ 2564485500 N_PDU 0;
BA_ "GenSigTimeoutTime_CADM" SG_ 2564485500 N_PDU 0;
BA_ "GenSigTimeoutTime_DMSM" SG_ 2564485500 N_PDU 0;
BA_ "GenSigTimeoutTime_DTCM" SG_ 2564485500 N_PDU 0;
BA_ "GenSigTimeoutTime_ECM" SG_ 2564485500 N_PDU 0;
BA_ "GenSigTimeoutTime_EVCU2" SG_ 2564485500 N_PDU 0;
BA_ "GenSigTimeoutTime_GNMM" SG_ 2564485500 N_PDU 0;
BA_ "GenSigTimeoutTime_HCP" SG_ 2564485500 N_PDU 0;
BA_ "GenSigTimeoutTime_IPC" SG_ 2564485500 N_PDU 0;
BA_ "GenSigTimeoutTime_RFHM" SG_ 2564485500 N_PDU 0;
BA_ "GenSigTimeoutTime_SGW" SG_ 2564485500 N_PDU 0;
BA_ "GenSigTimeoutTime_TCM" SG_ 2564485500 N_PDU 0;
BA_ "GenSigTimeoutTime_AGSM" SG_ 2564485407 N_PDU 0;
BA_ "GenSigTimeoutTime_BCM" SG_ 2564485407 N_PDU 0;
BA_ "GenSigTimeoutTime_BSM" SG_ 2564485407 N_PDU 0;
BA_ "GenSigTimeoutTime_CADM" SG_ 2564485407 N_PDU 0;
BA_ "GenSigTimeoutTime_DMSM" SG_ 2564485407 N_PDU 0;
BA_ "GenSigTimeoutTime_DTCM" SG_ 2564485407 N_PDU 0;
BA_ "GenSigTimeoutTime_ECM" SG_ 2564485407 N_PDU 0;
BA_ "GenSigTimeoutTime_EVCU2" SG_ 2564485407 N_PDU 0;
BA_ "GenSigTimeoutTime_GNMM" SG_ 2564485407 N_PDU 0;
BA_ "GenSigTimeoutTime_HCP" SG_ 2564485407 N_PDU 0;
BA_ "GenSigTimeoutTime_IPC" SG_ 2564485407 N_PDU 0;
BA_ "GenSigTimeoutTime_RFHM" SG_ 2564485407 N_PDU 0;
BA_ "GenSigTimeoutTime_SGW" SG_ 2564485407 N_PDU 0;
BA_ "GenSigTimeoutTime_TCM" SG_ 2564485407 N_PDU 0;
BA_ "GenSigTimeoutTime_AGSM" SG_ 2564485400 N_PDU 0;
BA_ "GenSigTimeoutTime_BCM" SG_ 2564485400 N_PDU 0;
BA_ "GenSigTimeoutTime_BSM" SG_ 2564485400 N_PDU 0;
BA_ "GenSigTimeoutTime_CADM" SG_ 2564485400 N_PDU 0;
BA_ "GenSigTimeoutTime_DMSM" SG_ 2564485400 N_PDU 0;
BA_ "GenSigTimeoutTime_DTCM" SG_ 2564485400 N_PDU 0;
BA_ "GenSigTimeoutTime_ECM" SG_ 2564485400 N_PDU 0;
BA_ "GenSigTimeoutTime_EVCU2" SG_ 2564485400 N_PDU 0;
BA_ "GenSigTimeoutTime_GNMM" SG_ 2564485400 N_PDU 0;
BA_ "GenSigTimeoutTime_HCP" SG_ 2564485400 N_PDU 0;
BA_ "GenSigTimeoutTime_IPC" SG_ 2564485400 N_PDU 0;
BA_ "GenSigTimeoutTime_RFHM" SG_ 2564485400 N_PDU 0;
BA_ "GenSigTimeoutTime_SGW" SG_ 2564485400 N_PDU 0;
BA_ "GenSigTimeoutTime_TCM" SG_ 2564485400 N_PDU 0;
BA_ "GenSigTimeoutTime_AGSM" SG_ 2564485491 N_PDU 0;
BA_ "GenSigTimeoutTime_BCM" SG_ 2564485491 N_PDU 0;
BA_ "GenSigTimeoutTime_BSM" SG_ 2564485491 N_PDU 0;
BA_ "GenSigTimeoutTime_CADM" SG_ 2564485491 N_PDU 0;
BA_ "GenSigTimeoutTime_DMSM" SG_ 2564485491 N_PDU 0;
BA_ "GenSigTimeoutTime_DTCM" SG_ 2564485491 N_PDU 0;
BA_ "GenSigTimeoutTime_ECM" SG_ 2564485491 N_PDU 0;
BA_ "GenSigTimeoutTime_EVCU2" SG_ 2564485491 N_PDU 0;
BA_ "GenSigTimeoutTime_GNMM" SG_ 2564485491 N_PDU 0;
BA_ "GenSigTimeoutTime_HCP" SG_ 2564485491 N_PDU 0;
BA_ "GenSigTimeoutTime_IPC" SG_ 2564485491 N_PDU 0;
BA_ "GenSigTimeoutTime_RFHM" SG_ 2564485491 N_PDU 0;
BA_ "GenSigTimeoutTime_SGW" SG_ 2564485491 N_PDU 0;
BA_ "GenSigTimeoutTime_TCM" SG_ 2564485491 N_PDU 0;
BA_ "GenSigTimeoutTime_AGSM" SG_ 2564682048 N_PDU 0;
BA_ "GenSigTimeoutTime_BCM" SG_ 2564682048 N_PDU 0;
BA_ "GenSigTimeoutTime_BSM" SG_ 2564682048 N_PDU 0;
BA_ "GenSigTimeoutTime_CADM" SG_ 2564682048 N_PDU 0;
BA_ "GenSigTimeoutTime_DMSM" SG_ 2564682048 N_PDU 0;
BA_ "GenSigTimeoutTime_DTCM" SG_ 2564682048 N_PDU 0;
BA_ "GenSigTimeoutTime_ECM" SG_ 2564682048 N_PDU 0;
BA_ "GenSigTimeoutTime_EVCU2" SG_ 2564682048 N_PDU 0;
BA_ "GenSigTimeoutTime_GNMM" SG_ 2564682048 N_PDU 0;
BA_ "GenSigTimeoutTime_HCP" SG_ 2564682048 N_PDU 0;
BA_ "GenSigTimeoutTime_IPC" SG_ 2564682048 N_PDU 0;
BA_ "GenSigTimeoutTime_RFHM" SG_ 2564682048 N_PDU 0;
BA_ "GenSigTimeoutTime_SGW" SG_ 2564682048 N_PDU 0;
BA_ "GenSigTimeoutTime_TCM" SG_ 2564682048 N_PDU 0;
BA_ "GenSigTimeoutTime_AGSM" SG_ 2564682024 N_PDU 0;
BA_ "GenSigTimeoutTime_BCM" SG_ 2564682024 N_PDU 0;
BA_ "GenSigTimeoutTime_BSM" SG_ 2564682024 N_PDU 0;
BA_ "GenSigTimeoutTime_CADM" SG_ 2564682024 N_PDU 0;
BA_ "GenSigTimeoutTime_DMSM" SG_ 2564682024 N_PDU 0;
BA_ "GenSigTimeoutTime_DTCM" SG_ 2564682024 N_PDU 0;
BA_ "GenSigTimeoutTime_ECM" SG_ 2564682024 N_PDU 0;
BA_ "GenSigTimeoutTime_EVCU2" SG_ 2564682024 N_PDU 0;
BA_ "GenSigTimeoutTime_GNMM" SG_ 2564682024 N_PDU 0;
BA_ "GenSigTimeoutTime_HCP" SG_ 2564682024 N_PDU 0;
BA_ "GenSigTimeoutTime_IPC" SG_ 2564682024 N_PDU 0;
BA_ "GenSigTimeoutTime_RFHM" SG_ 2564682024 N_PDU 0;
BA_ "GenSigTimeoutTime_SGW" SG_ 2564682024 N_PDU 0;
BA_ "GenSigTimeoutTime_TCM" SG_ 2564682024 N_PDU 0;
BA_ "GenSigTimeoutTime_AGSM" SG_ 2564682030 N_PDU 0;
BA_ "GenSigTimeoutTime_BCM" SG_ 2564682030 N_PDU 0;
BA_ "GenSigTimeoutTime_BSM" SG_ 2564682030 N_PDU 0;
BA_ "GenSigTimeoutTime_CADM" SG_ 2564682030 N_PDU 0;
BA_ "GenSigTimeoutTime_DMSM" SG_ 2564682030 N_PDU 0;
BA_ "GenSigTimeoutTime_DTCM" SG_ 2564682030 N_PDU 0;
BA_ "GenSigTimeoutTime_ECM" SG_ 2564682030 N_PDU 0;
BA_ "GenSigTimeoutTime_EVCU2" SG_ 2564682030 N_PDU 0;
BA_ "GenSigTimeoutTime_GNMM" SG_ 2564682030 N_PDU 0;
BA_ "GenSigTimeoutTime_HCP" SG_ 2564682030 N_PDU 0;
BA_ "GenSigTimeoutTime_IPC" SG_ 2564682030 N_PDU 0;
BA_ "GenSigTimeoutTime_RFHM" SG_ 2564682030 N_PDU 0;
BA_ "GenSigTimeoutTime_SGW" SG_ 2564682030 N_PDU 0;
BA_ "GenSigTimeoutTime_TCM" SG_ 2564682030 N_PDU 0;
BA_ "GenSigTimeoutTime_AGSM" SG_ 2564682135 N_PDU 0;
BA_ "GenSigTimeoutTime_BCM" SG_ 2564682135 N_PDU 0;
BA_ "GenSigTimeoutTime_BSM" SG_ 2564682135 N_PDU 0;
BA_ "GenSigTimeoutTime_CADM" SG_ 2564682135 N_PDU 0;
BA_ "GenSigTimeoutTime_DMSM" SG_ 2564682135 N_PDU 0;
BA_ "GenSigTimeoutTime_DTCM" SG_ 2564682135 N_PDU 0;
BA_ "GenSigTimeoutTime_ECM" SG_ 2564682135 N_PDU 0;
BA_ "GenSigTimeoutTime_EVCU2" SG_ 2564682135 N_PDU 0;
BA_ "GenSigTimeoutTime_GNMM" SG_ 2564682135 N_PDU 0;
BA_ "GenSigTimeoutTime_HCP" SG_ 2564682135 N_PDU 0;
BA_ "GenSigTimeoutTime_IPC" SG_ 2564682135 N_PDU 0;
BA_ "GenSigTimeoutTime_RFHM" SG_ 2564682135 N_PDU 0;
BA_ "GenSigTimeoutTime_SGW" SG_ 2564682135 N_PDU 0;
BA_ "GenSigTimeoutTime_TCM" SG_ 2564682135 N_PDU 0;
BA_ "GenSigTimeoutTime_AGSM" SG_ 2564682010 N_PDU 0;
BA_ "GenSigTimeoutTime_BCM" SG_ 2564682010 N_PDU 0;
BA_ "GenSigTimeoutTime_BSM" SG_ 2564682010 N_PDU 0;
BA_ "GenSigTimeoutTime_CADM" SG_ 2564682010 N_PDU 0;
BA_ "GenSigTimeoutTime_DMSM" SG_ 2564682010 N_PDU 0;
BA_ "GenSigTimeoutTime_DTCM" SG_ 2564682010 N_PDU 0;
BA_ "GenSigTimeoutTime_ECM" SG_ 2564682010 N_PDU 0;
BA_ "GenSigTimeoutTime_EVCU2" SG_ 2564682010 N_PDU 0;
BA_ "GenSigTimeoutTime_GNMM" SG_ 2564682010 N_PDU 0;
BA_ "GenSigTimeoutTime_HCP" SG_ 2564682010 N_PDU 0;
BA_ "GenSigTimeoutTime_IPC" SG_ 2564682010 N_PDU 0;
BA_ "GenSigTimeoutTime_RFHM" SG_ 2564682010 N_PDU 0;
BA_ "GenSigTimeoutTime_SGW" SG_ 2564682010 N_PDU 0;
BA_ "GenSigTimeoutTime_TCM" SG_ 2564682010 N_PDU 0;
BA_ "GenSigTimeoutTime_AGSM" SG_ 2564682000 N_PDU 0;
BA_ "GenSigTimeoutTime_BCM" SG_ 2564682000 N_PDU 0;
BA_ "GenSigTimeoutTime_BSM" SG_ 2564682000 N_PDU 0;
BA_ "GenSigTimeoutTime_CADM" SG_ 2564682000 N_PDU 0;
BA_ "GenSigTimeoutTime_DMSM" SG_ 2564682000 N_PDU 0;
BA_ "GenSigTimeoutTime_DTCM" SG_ 2564682000 N_PDU 0;
BA_ "GenSigTimeoutTime_ECM" SG_ 2564682000 N_PDU 0;
BA_ "GenSigTimeoutTime_EVCU2" SG_ 2564682000 N_PDU 0;
BA_ "GenSigTimeoutTime_GNMM" SG_ 2564682000 N_PDU 0;
BA_ "GenSigTimeoutTime_HCP" SG_ 2564682000 N_PDU 0;
BA_ "GenSigTimeoutTime_IPC" SG_ 2564682000 N_PDU 0;
BA_ "GenSigTimeoutTime_RFHM" SG_ 2564682000 N_PDU 0;
BA_ "GenSigTimeoutTime_SGW" SG_ 2564682000 N_PDU 0;
BA_ "GenSigTimeoutTime_TCM" SG_ 2564682000 N_PDU 0;
BA_ "GenSigTimeoutTime_AGSM" SG_ 2564682304 N_PDU 0;
BA_ "GenSigTimeoutTime_BCM" SG_ 2564682304 N_PDU 0;
BA_ "GenSigTimeoutTime_BSM" SG_ 2564682304 N_PDU 0;
BA_ "GenSigTimeoutTime_CADM" SG_ 2564682304 N_PDU 0;
BA_ "GenSigTimeoutTime_DMSM" SG_ 2564682304 N_PDU 0;
BA_ "GenSigTimeoutTime_DTCM" SG_ 2564682304 N_PDU 0;
BA_ "GenSigTimeoutTime_ECM" SG_ 2564682304 N_PDU 0;
BA_ "GenSigTimeoutTime_EVCU2" SG_ 2564682304 N_PDU 0;
BA_ "GenSigTimeoutTime_GNMM" SG_ 2564682304 N_PDU 0;
BA_ "GenSigTimeoutTime_HCP" SG_ 2564682304 N_PDU 0;
BA_ "GenSigTimeoutTime_IPC" SG_ 2564682304 N_PDU 0;
BA_ "GenSigTimeoutTime_RFHM" SG_ 2564682304 N_PDU 0;
BA_ "GenSigTimeoutTime_SGW" SG_ 2564682304 N_PDU 0;
BA_ "GenSigTimeoutTime_TCM" SG_ 2564682304 N_PDU 0;
BA_ "GenSigTimeoutTime_AGSM" SG_ 2564682280 N_PDU 0;
BA_ "GenSigTimeoutTime_BCM" SG_ 2564682280 N_PDU 0;
BA_ "GenSigTimeoutTime_BSM" SG_ 2564682280 N_PDU 0;
BA_ "GenSigTimeoutTime_CADM" SG_ 2564682280 N_PDU 0;
BA_ "GenSigTimeoutTime_DMSM" SG_ 2564682280 N_PDU 0;
BA_ "GenSigTimeoutTime_DTCM" SG_ 2564682280 N_PDU 0;
BA_ "GenSigTimeoutTime_ECM" SG_ 2564682280 N_PDU 0;
BA_ "GenSigTimeoutTime_EVCU2" SG_ 2564682280 N_PDU 0;
BA_ "GenSigTimeoutTime_GNMM" SG_ 2564682280 N_PDU 0;
BA_ "GenSigTimeoutTime_HCP" SG_ 2564682280 N_PDU 0;
BA_ "GenSigTimeoutTime_IPC" SG_ 2564682280 N_PDU 0;
BA_ "GenSigTimeoutTime_RFHM" SG_ 2564682280 N_PDU 0;
BA_ "GenSigTimeoutTime_SGW" SG_ 2564682280 N_PDU 0;
BA_ "GenSigTimeoutTime_TCM" SG_ 2564682280 N_PDU 0;
BA_ "GenSigTimeoutTime_AGSM" SG_ 2564682286 N_PDU 0;
BA_ "GenSigTimeoutTime_BCM" SG_ 2564682286 N_PDU 0;
BA_ "GenSigTimeoutTime_BSM" SG_ 2564682286 N_PDU 0;
BA_ "GenSigTimeoutTime_CADM" SG_ 2564682286 N_PDU 0;
BA_ "GenSigTimeoutTime_DMSM" SG_ 2564682286 N_PDU 0;
BA_ "GenSigTimeoutTime_DTCM" SG_ 2564682286 N_PDU 0;
BA_ "GenSigTimeoutTime_ECM" SG_ 2564682286 N_PDU 0;
BA_ "GenSigTimeoutTime_EVCU2" SG_ 2564682286 N_PDU 0;
BA_ "GenSigTimeoutTime_GNMM" SG_ 2564682286 N_PDU 0;
BA_ "GenSigTimeoutTime_HCP" SG_ 2564682286 N_PDU 0;
BA_ "GenSigTimeoutTime_IPC" SG_ 2564682286 N_PDU 0;
BA_ "GenSigTimeoutTime_RFHM" SG_ 2564682286 N_PDU 0;
BA_ "GenSigTimeoutTime_SGW" SG_ 2564682286 N_PDU 0;
BA_ "GenSigTimeoutTime_TCM" SG_ 2564682286 N_PDU 0;
BA_ "GenSigTimeoutTime_AGSM" SG_ 2564682391 N_PDU 0;
BA_ "GenSigTimeoutTime_BCM" SG_ 2564682391 N_PDU 0;
BA_ "GenSigTimeoutTime_BSM" SG_ 2564682391 N_PDU 0;
BA_ "GenSigTimeoutTime_CADM" SG_ 2564682391 N_PDU 0;
BA_ "GenSigTimeoutTime_DMSM" SG_ 2564682391 N_PDU 0;
BA_ "GenSigTimeoutTime_DTCM" SG_ 2564682391 N_PDU 0;
BA_ "GenSigTimeoutTime_ECM" SG_ 2564682391 N_PDU 0;
BA_ "GenSigTimeoutTime_EVCU2" SG_ 2564682391 N_PDU 0;
BA_ "GenSigTimeoutTime_GNMM" SG_ 2564682391 N_PDU 0;
BA_ "GenSigTimeoutTime_HCP" SG_ 2564682391 N_PDU 0;
BA_ "GenSigTimeoutTime_IPC" SG_ 2564682391 N_PDU 0;
BA_ "GenSigTimeoutTime_RFHM" SG_ 2564682391 N_PDU 0;
BA_ "GenSigTimeoutTime_SGW" SG_ 2564682391 N_PDU 0;
BA_ "GenSigTimeoutTime_TCM" SG_ 2564682391 N_PDU 0;
BA_ "GenSigTimeoutTime_AGSM" SG_ 2564682266 N_PDU 0;
BA_ "GenSigTimeoutTime_BCM" SG_ 2564682266 N_PDU 0;
BA_ "GenSigTimeoutTime_BSM" SG_ 2564682266 N_PDU 0;
BA_ "GenSigTimeoutTime_CADM" SG_ 2564682266 N_PDU 0;
BA_ "GenSigTimeoutTime_DMSM" SG_ 2564682266 N_PDU 0;
BA_ "GenSigTimeoutTime_DTCM" SG_ 2564682266 N_PDU 0;
BA_ "GenSigTimeoutTime_ECM" SG_ 2564682266 N_PDU 0;
BA_ "GenSigTimeoutTime_EVCU2" SG_ 2564682266 N_PDU 0;
BA_ "GenSigTimeoutTime_GNMM" SG_ 2564682266 N_PDU 0;
BA_ "GenSigTimeoutTime_HCP" SG_ 2564682266 N_PDU 0;
BA_ "GenSigTimeoutTime_IPC" SG_ 2564682266 N_PDU 0;
BA_ "GenSigTimeoutTime_RFHM" SG_ 2564682266 N_PDU 0;
BA_ "GenSigTimeoutTime_SGW" SG_ 2564682266 N_PDU 0;
BA_ "GenSigTimeoutTime_TCM" SG_ 2564682266 N_PDU 0;
BA_ "GenSigTimeoutTime_AGSM" SG_ 2564682256 N_PDU 0;
BA_ "GenSigTimeoutTime_BCM" SG_ 2564682256 N_PDU 0;
BA_ "GenSigTimeoutTime_BSM" SG_ 2564682256 N_PDU 0;
BA_ "GenSigTimeoutTime_CADM" SG_ 2564682256 N_PDU 0;
BA_ "GenSigTimeoutTime_DMSM" SG_ 2564682256 N_PDU 0;
BA_ "GenSigTimeoutTime_DTCM" SG_ 2564682256 N_PDU 0;
BA_ "GenSigTimeoutTime_ECM" SG_ 2564682256 N_PDU 0;
BA_ "GenSigTimeoutTime_EVCU2" SG_ 2564682256 N_PDU 0;
BA_ "GenSigTimeoutTime_GNMM" SG_ 2564682256 N_PDU 0;
BA_ "GenSigTimeoutTime_HCP" SG_ 2564682256 N_PDU 0;
BA_ "GenSigTimeoutTime_IPC" SG_ 2564682256 N_PDU 0;
BA_ "GenSigTimeoutTime_RFHM" SG_ 2564682256 N_PDU 0;
BA_ "GenSigTimeoutTime_SGW" SG_ 2564682256 N_PDU 0;
BA_ "GenSigTimeoutTime_TCM" SG_ 2564682256 N_PDU 0;
BA_ "GenSigTimeoutTime_AGSM" SG_ 2564682255 N_PDU 0;
BA_ "GenSigTimeoutTime_BCM" SG_ 2564682255 N_PDU 0;
BA_ "GenSigTimeoutTime_BSM" SG_ 2564682255 N_PDU 0;
BA_ "GenSigTimeoutTime_CADM" SG_ 2564682255 N_PDU 0;
BA_ "GenSigTimeoutTime_DMSM" SG_ 2564682255 N_PDU 0;
BA_ "GenSigTimeoutTime_DTCM" SG_ 2564682255 N_PDU 0;
BA_ "GenSigTimeoutTime_ECM" SG_ 2564682255 N_PDU 0;
BA_ "GenSigTimeoutTime_EVCU2" SG_ 2564682255 N_PDU 0;
BA_ "GenSigTimeoutTime_GNMM" SG_ 2564682255 N_PDU 0;
BA_ "GenSigTimeoutTime_HCP" SG_ 2564682255 N_PDU 0;
BA_ "GenSigTimeoutTime_IPC" SG_ 2564682255 N_PDU 0;
BA_ "GenSigTimeoutTime_RFHM" SG_ 2564682255 N_PDU 0;
BA_ "GenSigTimeoutTime_SGW" SG_ 2564682255 N_PDU 0;
BA_ "GenSigTimeoutTime_TCM" SG_ 2564682255 N_PDU 0;
BA_ "GenSigTimeoutTime_AGSM" SG_ 2564682254 N_PDU 0;
BA_ "GenSigTimeoutTime_BCM" SG_ 2564682254 N_PDU 0;
BA_ "GenSigTimeoutTime_BSM" SG_ 2564682254 N_PDU 0;
BA_ "GenSigTimeoutTime_CADM" SG_ 2564682254 N_PDU 0;
BA_ "GenSigTimeoutTime_DMSM" SG_ 2564682254 N_PDU 0;
BA_ "GenSigTimeoutTime_DTCM" SG_ 2564682254 N_PDU 0;
BA_ "GenSigTimeoutTime_ECM" SG_ 2564682254 N_PDU 0;
BA_ "GenSigTimeoutTime_EVCU2" SG_ 2564682254 N_PDU 0;
BA_ "GenSigTimeoutTime_GNMM" SG_ 2564682254 N_PDU 0;
BA_ "GenSigTimeoutTime_HCP" SG_ 2564682254 N_PDU 0;
BA_ "GenSigTimeoutTime_IPC" SG_ 2564682254 N_PDU 0;
BA_ "GenSigTimeoutTime_RFHM" SG_ 2564682254 N_PDU 0;
BA_ "GenSigTimeoutTime_SGW" SG_ 2564682254 N_PDU 0;
BA_ "GenSigTimeoutTime_TCM" SG_ 2564682254 N_PDU 0;
BA_ "GenSigTimeoutTime_AGSM" SG_ 2564682292 N_PDU 0;
BA_ "GenSigTimeoutTime_BCM" SG_ 2564682292 N_PDU 0;
BA_ "GenSigTimeoutTime_BSM" SG_ 2564682292 N_PDU 0;
BA_ "GenSigTimeoutTime_CADM" SG_ 2564682292 N_PDU 0;
BA_ "GenSigTimeoutTime_DMSM" SG_ 2564682292 N_PDU 0;
BA_ "GenSigTimeoutTime_DTCM" SG_ 2564682292 N_PDU 0;
BA_ "GenSigTimeoutTime_ECM" SG_ 2564682292 N_PDU 0;
BA_ "GenSigTimeoutTime_EVCU2" SG_ 2564682292 N_PDU 0;
BA_ "GenSigTimeoutTime_GNMM" SG_ 2564682292 N_PDU 0;
BA_ "GenSigTimeoutTime_HCP" SG_ 2564682292 N_PDU 0;
BA_ "GenSigTimeoutTime_IPC" SG_ 2564682292 N_PDU 0;
BA_ "GenSigTimeoutTime_RFHM" SG_ 2564682292 N_PDU 0;
BA_ "GenSigTimeoutTime_SGW" SG_ 2564682292 N_PDU 0;
BA_ "GenSigTimeoutTime_TCM" SG_ 2564682292 N_PDU 0;
BA_ "GenSigTimeoutTime_AGSM" SG_ 2564682336 N_PDU 0;
BA_ "GenSigTimeoutTime_BCM" SG_ 2564682336 N_PDU 0;
BA_ "GenSigTimeoutTime_BSM" SG_ 2564682336 N_PDU 0;
BA_ "GenSigTimeoutTime_CADM" SG_ 2564682336 N_PDU 0;
BA_ "GenSigTimeoutTime_DMSM" SG_ 2564682336 N_PDU 0;
BA_ "GenSigTimeoutTime_DTCM" SG_ 2564682336 N_PDU 0;
BA_ "GenSigTimeoutTime_ECM" SG_ 2564682336 N_PDU 0;
BA_ "GenSigTimeoutTime_EVCU2" SG_ 2564682336 N_PDU 0;
BA_ "GenSigTimeoutTime_GNMM" SG_ 2564682336 N_PDU 0;
BA_ "GenSigTimeoutTime_HCP" SG_ 2564682336 N_PDU 0;
BA_ "GenSigTimeoutTime_IPC" SG_ 2564682336 N_PDU 0;
BA_ "GenSigTimeoutTime_RFHM" SG_ 2564682336 N_PDU 0;
BA_ "GenSigTimeoutTime_SGW" SG_ 2564682336 N_PDU 0;
BA_ "GenSigTimeoutTime_TCM" SG_ 2564682336 N_PDU 0;
BA_ "GenSigTimeoutTime_AGSM" SG_ 2564682260 N_PDU 0;
BA_ "GenSigTimeoutTime_BCM" SG_ 2564682260 N_PDU 0;
BA_ "GenSigTimeoutTime_BSM" SG_ 2564682260 N_PDU 0;
BA_ "GenSigTimeoutTime_CADM" SG_ 2564682260 N_PDU 0;
BA_ "GenSigTimeoutTime_DMSM" SG_ 2564682260 N_PDU 0;
BA_ "GenSigTimeoutTime_DTCM" SG_ 2564682260 N_PDU 0;
BA_ "GenSigTimeoutTime_ECM" SG_ 2564682260 N_PDU 0;
BA_ "GenSigTimeoutTime_EVCU2" SG_ 2564682260 N_PDU 0;
BA_ "GenSigTimeoutTime_GNMM" SG_ 2564682260 N_PDU 0;
BA_ "GenSigTimeoutTime_HCP" SG_ 2564682260 N_PDU 0;
BA_ "GenSigTimeoutTime_IPC" SG_ 2564682260 N_PDU 0;
BA_ "GenSigTimeoutTime_RFHM" SG_ 2564682260 N_PDU 0;
BA_ "GenSigTimeoutTime_SGW" SG_ 2564682260 N_PDU 0;
BA_ "GenSigTimeoutTime_TCM" SG_ 2564682260 N_PDU 0;
BA_ "GenSigTimeoutTime_AGSM" SG_ 2564682261 N_PDU 0;
BA_ "GenSigTimeoutTime_BCM" SG_ 2564682261 N_PDU 0;
BA_ "GenSigTimeoutTime_BSM" SG_ 2564682261 N_PDU 0;
BA_ "GenSigTimeoutTime_CADM" SG_ 2564682261 N_PDU 0;
BA_ "GenSigTimeoutTime_DMSM" SG_ 2564682261 N_PDU 0;
BA_ "GenSigTimeoutTime_DTCM" SG_ 2564682261 N_PDU 0;
BA_ "GenSigTimeoutTime_ECM" SG_ 2564682261 N_PDU 0;
BA_ "GenSigTimeoutTime_EVCU2" SG_ 2564682261 N_PDU 0;
BA_ "GenSigTimeoutTime_GNMM" SG_ 2564682261 N_PDU 0;
BA_ "GenSigTimeoutTime_HCP" SG_ 2564682261 N_PDU 0;
BA_ "GenSigTimeoutTime_IPC" SG_ 2564682261 N_PDU 0;
BA_ "GenSigTimeoutTime_RFHM" SG_ 2564682261 N_PDU 0;
BA_ "GenSigTimeoutTime_SGW" SG_ 2564682261 N_PDU 0;
BA_ "GenSigTimeoutTime_TCM" SG_ 2564682261 N_PDU 0;
BA_ "GenSigTimeoutTime_AGSM" SG_ 2564682439 N_PDU 0;
BA_ "GenSigTimeoutTime_BCM" SG_ 2564682439 N_PDU 0;
BA_ "GenSigTimeoutTime_BSM" SG_ 2564682439 N_PDU 0;
BA_ "GenSigTimeoutTime_CADM" SG_ 2564682439 N_PDU 0;
BA_ "GenSigTimeoutTime_DMSM" SG_ 2564682439 N_PDU 0;
BA_ "GenSigTimeoutTime_DTCM" SG_ 2564682439 N_PDU 0;
BA_ "GenSigTimeoutTime_ECM" SG_ 2564682439 N_PDU 0;
BA_ "GenSigTimeoutTime_EVCU2" SG_ 2564682439 N_PDU 0;
BA_ "GenSigTimeoutTime_GNMM" SG_ 2564682439 N_PDU 0;
BA_ "GenSigTimeoutTime_HCP" SG_ 2564682439 N_PDU 0;
BA_ "GenSigTimeoutTime_IPC" SG_ 2564682439 N_PDU 0;
BA_ "GenSigTimeoutTime_RFHM" SG_ 2564682439 N_PDU 0;
BA_ "GenSigTimeoutTime_SGW" SG_ 2564682439 N_PDU 0;
BA_ "GenSigTimeoutTime_TCM" SG_ 2564682439 N_PDU 0;
BA_ "GenSigTimeoutTime_AGSM" SG_ 2564682364 N_PDU 0;
BA_ "GenSigTimeoutTime_BCM" SG_ 2564682364 N_PDU 0;
BA_ "GenSigTimeoutTime_BSM" SG_ 2564682364 N_PDU 0;
BA_ "GenSigTimeoutTime_CADM" SG_ 2564682364 N_PDU 0;
BA_ "GenSigTimeoutTime_DMSM" SG_ 2564682364 N_PDU 0;
BA_ "GenSigTimeoutTime_DTCM" SG_ 2564682364 N_PDU 0;
BA_ "GenSigTimeoutTime_ECM" SG_ 2564682364 N_PDU 0;
BA_ "GenSigTimeoutTime_EVCU2" SG_ 2564682364 N_PDU 0;
BA_ "GenSigTimeoutTime_GNMM" SG_ 2564682364 N_PDU 0;
BA_ "GenSigTimeoutTime_HCP" SG_ 2564682364 N_PDU 0;
BA_ "GenSigTimeoutTime_IPC" SG_ 2564682364 N_PDU 0;
BA_ "GenSigTimeoutTime_RFHM" SG_ 2564682364 N_PDU 0;
BA_ "GenSigTimeoutTime_SGW" SG_ 2564682364 N_PDU 0;
BA_ "GenSigTimeoutTime_TCM" SG_ 2564682364 N_PDU 0;
BA_ "GenSigTimeoutTime_AGSM" SG_ 2564682271 N_PDU 0;
BA_ "GenSigTimeoutTime_BCM" SG_ 2564682271 N_PDU 0;
BA_ "GenSigTimeoutTime_BSM" SG_ 2564682271 N_PDU 0;
BA_ "GenSigTimeoutTime_CADM" SG_ 2564682271 N_PDU 0;
BA_ "GenSigTimeoutTime_DMSM" SG_ 2564682271 N_PDU 0;
BA_ "GenSigTimeoutTime_DTCM" SG_ 2564682271 N_PDU 0;
BA_ "GenSigTimeoutTime_ECM" SG_ 2564682271 N_PDU 0;
BA_ "GenSigTimeoutTime_EVCU2" SG_ 2564682271 N_PDU 0;
BA_ "GenSigTimeoutTime_GNMM" SG_ 2564682271 N_PDU 0;
BA_ "GenSigTimeoutTime_HCP" SG_ 2564682271 N_PDU 0;
BA_ "GenSigTimeoutTime_IPC" SG_ 2564682271 N_PDU 0;
BA_ "GenSigTimeoutTime_RFHM" SG_ 2564682271 N_PDU 0;
BA_ "GenSigTimeoutTime_SGW" SG_ 2564682271 N_PDU 0;
BA_ "GenSigTimeoutTime_TCM" SG_ 2564682271 N_PDU 0;
BA_ "GenSigTimeoutTime_AGSM" SG_ 2564682264 N_PDU 0;
BA_ "GenSigTimeoutTime_BCM" SG_ 2564682264 N_PDU 0;
BA_ "GenSigTimeoutTime_BSM" SG_ 2564682264 N_PDU 0;
BA_ "GenSigTimeoutTime_CADM" SG_ 2564682264 N_PDU 0;
BA_ "GenSigTimeoutTime_DMSM" SG_ 2564682264 N_PDU 0;
BA_ "GenSigTimeoutTime_DTCM" SG_ 2564682264 N_PDU 0;
BA_ "GenSigTimeoutTime_ECM" SG_ 2564682264 N_PDU 0;
BA_ "GenSigTimeoutTime_EVCU2" SG_ 2564682264 N_PDU 0;
BA_ "GenSigTimeoutTime_GNMM" SG_ 2564682264 N_PDU 0;
BA_ "GenSigTimeoutTime_HCP" SG_ 2564682264 N_PDU 0;
BA_ "GenSigTimeoutTime_IPC" SG_ 2564682264 N_PDU 0;
BA_ "GenSigTimeoutTime_RFHM" SG_ 2564682264 N_PDU 0;
BA_ "GenSigTimeoutTime_SGW" SG_ 2564682264 N_PDU 0;
BA_ "GenSigTimeoutTime_TCM" SG_ 2564682264 N_PDU 0;
BA_ "GenSigTimeoutTime_AGSM" SG_ 2564682355 N_PDU 0;
BA_ "GenSigTimeoutTime_BCM" SG_ 2564682355 N_PDU 0;
BA_ "GenSigTimeoutTime_BSM" SG_ 2564682355 N_PDU 0;
BA_ "GenSigTimeoutTime_CADM" SG_ 2564682355 N_PDU 0;
BA_ "GenSigTimeoutTime_DMSM" SG_ 2564682355 N_PDU 0;
BA_ "GenSigTimeoutTime_DTCM" SG_ 2564682355 N_PDU 0;
BA_ "GenSigTimeoutTime_ECM" SG_ 2564682355 N_PDU 0;
BA_ "GenSigTimeoutTime_EVCU2" SG_ 2564682355 N_PDU 0;
BA_ "GenSigTimeoutTime_GNMM" SG_ 2564682355 N_PDU 0;
BA_ "GenSigTimeoutTime_HCP" SG_ 2564682355 N_PDU 0;
BA_ "GenSigTimeoutTime_IPC" SG_ 2564682355 N_PDU 0;
BA_ "GenSigTimeoutTime_RFHM" SG_ 2564682355 N_PDU 0;
BA_ "GenSigTimeoutTime_SGW" SG_ 2564682355 N_PDU 0;
BA_ "GenSigTimeoutTime_TCM" SG_ 2564682355 N_PDU 0;
BA_ "GenSigTimeoutTime_AGSM" SG_ 2564681999 N_PDU 0;
BA_ "GenSigTimeoutTime_BCM" SG_ 2564681999 N_PDU 0;
BA_ "GenSigTimeoutTime_BSM" SG_ 2564681999 N_PDU 0;
BA_ "GenSigTimeoutTime_CADM" SG_ 2564681999 N_PDU 0;
BA_ "GenSigTimeoutTime_DMSM" SG_ 2564681999 N_PDU 0;
BA_ "GenSigTimeoutTime_DTCM" SG_ 2564681999 N_PDU 0;
BA_ "GenSigTimeoutTime_ECM" SG_ 2564681999 N_PDU 0;
BA_ "GenSigTimeoutTime_EVCU2" SG_ 2564681999 N_PDU 0;
BA_ "GenSigTimeoutTime_GNMM" SG_ 2564681999 N_PDU 0;
BA_ "GenSigTimeoutTime_HCP" SG_ 2564681999 N_PDU 0;
BA_ "GenSigTimeoutTime_IPC" SG_ 2564681999 N_PDU 0;
BA_ "GenSigTimeoutTime_RFHM" SG_ 2564681999 N_PDU 0;
BA_ "GenSigTimeoutTime_SGW" SG_ 2564681999 N_PDU 0;
BA_ "GenSigTimeoutTime_TCM" SG_ 2564681999 N_PDU 0;
BA_ "GenSigTimeoutTime_AGSM" SG_ 2564681998 N_PDU 0;
BA_ "GenSigTimeoutTime_BCM" SG_ 2564681998 N_PDU 0;
BA_ "GenSigTimeoutTime_BSM" SG_ 2564681998 N_PDU 0;
BA_ "GenSigTimeoutTime_CADM" SG_ 2564681998 N_PDU 0;
BA_ "GenSigTimeoutTime_DMSM" SG_ 2564681998 N_PDU 0;
BA_ "GenSigTimeoutTime_DTCM" SG_ 2564681998 N_PDU 0;
BA_ "GenSigTimeoutTime_ECM" SG_ 2564681998 N_PDU 0;
BA_ "GenSigTimeoutTime_EVCU2" SG_ 2564681998 N_PDU 0;
BA_ "GenSigTimeoutTime_GNMM" SG_ 2564681998 N_PDU 0;
BA_ "GenSigTimeoutTime_HCP" SG_ 2564681998 N_PDU 0;
BA_ "GenSigTimeoutTime_IPC" SG_ 2564681998 N_PDU 0;
BA_ "GenSigTimeoutTime_RFHM" SG_ 2564681998 N_PDU 0;
BA_ "GenSigTimeoutTime_SGW" SG_ 2564681998 N_PDU 0;
BA_ "GenSigTimeoutTime_TCM" SG_ 2564681998 N_PDU 0;
BA_ "GenSigTimeoutTime_AGSM" SG_ 2564682036 N_PDU 0;
BA_ "GenSigTimeoutTime_BCM" SG_ 2564682036 N_PDU 0;
BA_ "GenSigTimeoutTime_BSM" SG_ 2564682036 N_PDU 0;
BA_ "GenSigTimeoutTime_CADM" SG_ 2564682036 N_PDU 0;
BA_ "GenSigTimeoutTime_DMSM" SG_ 2564682036 N_PDU 0;
BA_ "GenSigTimeoutTime_DTCM" SG_ 2564682036 N_PDU 0;
BA_ "GenSigTimeoutTime_ECM" SG_ 2564682036 N_PDU 0;
BA_ "GenSigTimeoutTime_EVCU2" SG_ 2564682036 N_PDU 0;
BA_ "GenSigTimeoutTime_GNMM" SG_ 2564682036 N_PDU 0;
BA_ "GenSigTimeoutTime_HCP" SG_ 2564682036 N_PDU 0;
BA_ "GenSigTimeoutTime_IPC" SG_ 2564682036 N_PDU 0;
BA_ "GenSigTimeoutTime_RFHM" SG_ 2564682036 N_PDU 0;
BA_ "GenSigTimeoutTime_SGW" SG_ 2564682036 N_PDU 0;
BA_ "GenSigTimeoutTime_TCM" SG_ 2564682036 N_PDU 0;
BA_ "GenSigTimeoutTime_AGSM" SG_ 2564682080 N_PDU 0;
BA_ "GenSigTimeoutTime_BCM" SG_ 2564682080 N_PDU 0;
BA_ "GenSigTimeoutTime_BSM" SG_ 2564682080 N_PDU 0;
BA_ "GenSigTimeoutTime_CADM" SG_ 2564682080 N_PDU 0;
BA_ "GenSigTimeoutTime_DMSM" SG_ 2564682080 N_PDU 0;
BA_ "GenSigTimeoutTime_DTCM" SG_ 2564682080 N_PDU 0;
BA_ "GenSigTimeoutTime_ECM" SG_ 2564682080 N_PDU 0;
BA_ "GenSigTimeoutTime_EVCU2" SG_ 2564682080 N_PDU 0;
BA_ "GenSigTimeoutTime_GNMM" SG_ 2564682080 N_PDU 0;
BA_ "GenSigTimeoutTime_HCP" SG_ 2564682080 N_PDU 0;
BA_ "GenSigTimeoutTime_IPC" SG_ 2564682080 N_PDU 0;
BA_ "GenSigTimeoutTime_RFHM" SG_ 2564682080 N_PDU 0;
BA_ "GenSigTimeoutTime_SGW" SG_ 2564682080 N_PDU 0;
BA_ "GenSigTimeoutTime_TCM" SG_ 2564682080 N_PDU 0;
BA_ "GenSigTimeoutTime_AGSM" SG_ 2564682004 N_PDU 0;
BA_ "GenSigTimeoutTime_BCM" SG_ 2564682004 N_PDU 0;
BA_ "GenSigTimeoutTime_BSM" SG_ 2564682004 N_PDU 0;
BA_ "GenSigTimeoutTime_CADM" SG_ 2564682004 N_PDU 0;
BA_ "GenSigTimeoutTime_DMSM" SG_ 2564682004 N_PDU 0;
BA_ "GenSigTimeoutTime_DTCM" SG_ 2564682004 N_PDU 0;
BA_ "GenSigTimeoutTime_ECM" SG_ 2564682004 N_PDU 0;
BA_ "GenSigTimeoutTime_EVCU2" SG_ 2564682004 N_PDU 0;
BA_ "GenSigTimeoutTime_GNMM" SG_ 2564682004 N_PDU 0;
BA_ "GenSigTimeoutTime_HCP" SG_ 2564682004 N_PDU 0;
BA_ "GenSigTimeoutTime_IPC" SG_ 2564682004 N_PDU 0;
BA_ "GenSigTimeoutTime_RFHM" SG_ 2564682004 N_PDU 0;
BA_ "GenSigTimeoutTime_SGW" SG_ 2564682004 N_PDU 0;
BA_ "GenSigTimeoutTime_TCM" SG_ 2564682004 N_PDU 0;
BA_ "GenSigTimeoutTime_AGSM" SG_ 2564682005 N_PDU 0;
BA_ "GenSigTimeoutTime_BCM" SG_ 2564682005 N_PDU 0;
BA_ "GenSigTimeoutTime_BSM" SG_ 2564682005 N_PDU 0;
BA_ "GenSigTimeoutTime_CADM" SG_ 2564682005 N_PDU 0;
BA_ "GenSigTimeoutTime_DMSM" SG_ 2564682005 N_PDU 0;
BA_ "GenSigTimeoutTime_DTCM" SG_ 2564682005 N_PDU 0;
BA_ "GenSigTimeoutTime_ECM" SG_ 2564682005 N_PDU 0;
BA_ "GenSigTimeoutTime_EVCU2" SG_ 2564682005 N_PDU 0;
BA_ "GenSigTimeoutTime_GNMM" SG_ 2564682005 N_PDU 0;
BA_ "GenSigTimeoutTime_HCP" SG_ 2564682005 N_PDU 0;
BA_ "GenSigTimeoutTime_IPC" SG_ 2564682005 N_PDU 0;
BA_ "GenSigTimeoutTime_RFHM" SG_ 2564682005 N_PDU 0;
BA_ "GenSigTimeoutTime_SGW" SG_ 2564682005 N_PDU 0;
BA_ "GenSigTimeoutTime_TCM" SG_ 2564682005 N_PDU 0;
BA_ "GenSigTimeoutTime_AGSM" SG_ 2564682183 N_PDU 0;
BA_ "GenSigTimeoutTime_BCM" SG_ 2564682183 N_PDU 0;
BA_ "GenSigTimeoutTime_BSM" SG_ 2564682183 N_PDU 0;
BA_ "GenSigTimeoutTime_CADM" SG_ 2564682183 N_PDU 0;
BA_ "GenSigTimeoutTime_DMSM" SG_ 2564682183 N_PDU 0;
BA_ "GenSigTimeoutTime_DTCM" SG_ 2564682183 N_PDU 0;
BA_ "GenSigTimeoutTime_ECM" SG_ 2564682183 N_PDU 0;
BA_ "GenSigTimeoutTime_EVCU2" SG_ 2564682183 N_PDU 0;
BA_ "GenSigTimeoutTime_GNMM" SG_ 2564682183 N_PDU 0;
BA_ "GenSigTimeoutTime_HCP" SG_ 2564682183 N_PDU 0;
BA_ "GenSigTimeoutTime_IPC" SG_ 2564682183 N_PDU 0;
BA_ "GenSigTimeoutTime_RFHM" SG_ 2564682183 N_PDU 0;
BA_ "GenSigTimeoutTime_SGW" SG_ 2564682183 N_PDU 0;
BA_ "GenSigTimeoutTime_TCM" SG_ 2564682183 N_PDU 0;
BA_ "GenSigTimeoutTime_AGSM" SG_ 2564682108 N_PDU 0;
BA_ "GenSigTimeoutTime_BCM" SG_ 2564682108 N_PDU 0;
BA_ "GenSigTimeoutTime_BSM" SG_ 2564682108 N_PDU 0;
BA_ "GenSigTimeoutTime_CADM" SG_ 2564682108 N_PDU 0;
BA_ "GenSigTimeoutTime_DMSM" SG_ 2564682108 N_PDU 0;
BA_ "GenSigTimeoutTime_DTCM" SG_ 2564682108 N_PDU 0;
BA_ "GenSigTimeoutTime_ECM" SG_ 2564682108 N_PDU 0;
BA_ "GenSigTimeoutTime_EVCU2" SG_ 2564682108 N_PDU 0;
BA_ "GenSigTimeoutTime_GNMM" SG_ 2564682108 N_PDU 0;
BA_ "GenSigTimeoutTime_HCP" SG_ 2564682108 N_PDU 0;
BA_ "GenSigTimeoutTime_IPC" SG_ 2564682108 N_PDU 0;
BA_ "GenSigTimeoutTime_RFHM" SG_ 2564682108 N_PDU 0;
BA_ "GenSigTimeoutTime_SGW" SG_ 2564682108 N_PDU 0;
BA_ "GenSigTimeoutTime_TCM" SG_ 2564682108 N_PDU 0;
BA_ "GenSigTimeoutTime_AGSM" SG_ 2564682015 N_PDU 0;
BA_ "GenSigTimeoutTime_BCM" SG_ 2564682015 N_PDU 0;
BA_ "GenSigTimeoutTime_BSM" SG_ 2564682015 N_PDU 0;
BA_ "GenSigTimeoutTime_CADM" SG_ 2564682015 N_PDU 0;
BA_ "GenSigTimeoutTime_DMSM" SG_ 2564682015 N_PDU 0;
BA_ "GenSigTimeoutTime_DTCM" SG_ 2564682015 N_PDU 0;
BA_ "GenSigTimeoutTime_ECM" SG_ 2564682015 N_PDU 0;
BA_ "GenSigTimeoutTime_EVCU2" SG_ 2564682015 N_PDU 0;
BA_ "GenSigTimeoutTime_GNMM" SG_ 2564682015 N_PDU 0;
BA_ "GenSigTimeoutTime_HCP" SG_ 2564682015 N_PDU 0;
BA_ "GenSigTimeoutTime_IPC" SG_ 2564682015 N_PDU 0;
BA_ "GenSigTimeoutTime_RFHM" SG_ 2564682015 N_PDU 0;
BA_ "GenSigTimeoutTime_SGW" SG_ 2564682015 N_PDU 0;
BA_ "GenSigTimeoutTime_TCM" SG_ 2564682015 N_PDU 0;
BA_ "GenSigTimeoutTime_AGSM" SG_ 2564682008 N_PDU 0;
BA_ "GenSigTimeoutTime_BCM" SG_ 2564682008 N_PDU 0;
BA_ "GenSigTimeoutTime_BSM" SG_ 2564682008 N_PDU 0;
BA_ "GenSigTimeoutTime_CADM" SG_ 2564682008 N_PDU 0;
BA_ "GenSigTimeoutTime_DMSM" SG_ 2564682008 N_PDU 0;
BA_ "GenSigTimeoutTime_DTCM" SG_ 2564682008 N_PDU 0;
BA_ "GenSigTimeoutTime_ECM" SG_ 2564682008 N_PDU 0;
BA_ "GenSigTimeoutTime_EVCU2" SG_ 2564682008 N_PDU 0;
BA_ "GenSigTimeoutTime_GNMM" SG_ 2564682008 N_PDU 0;
BA_ "GenSigTimeoutTime_HCP" SG_ 2564682008 N_PDU 0;
BA_ "GenSigTimeoutTime_IPC" SG_ 2564682008 N_PDU 0;
BA_ "GenSigTimeoutTime_RFHM" SG_ 2564682008 N_PDU 0;
BA_ "GenSigTimeoutTime_SGW" SG_ 2564682008 N_PDU 0;
BA_ "GenSigTimeoutTime_TCM" SG_ 2564682008 N_PDU 0;
BA_ "GenSigTimeoutTime_AGSM" SG_ 2564682099 N_PDU 0;
BA_ "GenSigTimeoutTime_BCM" SG_ 2564682099 N_PDU 0;
BA_ "GenSigTimeoutTime_BSM" SG_ 2564682099 N_PDU 0;
BA_ "GenSigTimeoutTime_CADM" SG_ 2564682099 N_PDU 0;
BA_ "GenSigTimeoutTime_DMSM" SG_ 2564682099 N_PDU 0;
BA_ "GenSigTimeoutTime_DTCM" SG_ 2564682099 N_PDU 0;
BA_ "GenSigTimeoutTime_ECM" SG_ 2564682099 N_PDU 0;
BA_ "GenSigTimeoutTime_EVCU2" SG_ 2564682099 N_PDU 0;
BA_ "GenSigTimeoutTime_GNMM" SG_ 2564682099 N_PDU 0;
BA_ "GenSigTimeoutTime_HCP" SG_ 2564682099 N_PDU 0;
BA_ "GenSigTimeoutTime_IPC" SG_ 2564682099 N_PDU 0;
BA_ "GenSigTimeoutTime_RFHM" SG_ 2564682099 N_PDU 0;
BA_ "GenSigTimeoutTime_SGW" SG_ 2564682099 N_PDU 0;
BA_ "GenSigTimeoutTime_TCM" SG_ 2564682099 N_PDU 0;
BA_ "GenSigStartValue" SG_ 517 AWDSysStat 7;
BA_ "GenSigTimeoutTime_AGSM" SG_ 517 AWDSysStat 0;
BA_ "GenSigTimeoutTime_CADM" SG_ 517 AWDSysStat 0;
BA_ "GenSigTimeoutTime_DMSM" SG_ 517 AWDSysStat 0;
BA_ "GenSigTimeoutTime_DTCM" SG_ 517 AWDSysStat 0;
BA_ "GenSigTimeoutTime_EVCU2" SG_ 517 AWDSysStat 0;
BA_ "GenSigTimeoutTime_AGSM" SG_ 517 CCMFailSts 0;
BA_ "GenSigTimeoutTime_CADM" SG_ 517 CCMFailSts 0;
BA_ "GenSigTimeoutTime_DMSM" SG_ 517 CCMFailSts 0;
BA_ "GenSigTimeoutTime_DTCM" SG_ 517 CCMFailSts 0;
BA_ "GenSigTimeoutTime_ECM" SG_ 517 CCMFailSts 0;
BA_ "GenSigTimeoutTime_EVCU2" SG_ 517 CCMFailSts 0;
BA_ "GenSigTimeoutTime_GNMM" SG_ 517 CCMFailSts 0;
BA_ "GenSigTimeoutTime_HCP" SG_ 517 CCMFailSts 0;
BA_ "GenSigTimeoutTime_RFHM" SG_ 517 CCMFailSts 0;
BA_ "GenSigTimeoutTime_TCM" SG_ 517 CCMFailSts 0;
BA_ "GenSigTimeoutTime_AGSM" SG_ 517 CRC_DRIVETRAIN1 0;
BA_ "GenSigTimeoutTime_CADM" SG_ 517 CRC_DRIVETRAIN1 0;
BA_ "GenSigTimeoutTime_DMSM" SG_ 517 CRC_DRIVETRAIN1 0;
BA_ "GenSigTimeoutTime_DTCM" SG_ 517 CRC_DRIVETRAIN1 0;
BA_ "GenSigTimeoutTime_EVCU2" SG_ 517 CRC_DRIVETRAIN1 0;
BA_ "GenSigTimeoutTime_IPC" SG_ 517 CRC_DRIVETRAIN1 0;
BA_ "GenSigTimeoutTime_RFHM" SG_ 517 CRC_DRIVETRAIN1 0;
BA_ "GenSigTimeoutTime_SGW" SG_ 517 CRC_DRIVETRAIN1 0;
BA_ "GenSigTimeoutTime_AGSM" SG_ 517 DrvLnMinTrqMd 0;
BA_ "GenSigTimeoutTime_BCM" SG_ 517 DrvLnMinTrqMd 0;
BA_ "GenSigTimeoutTime_BSM" SG_ 517 DrvLnMinTrqMd 0;
BA_ "GenSigTimeoutTime_CADM" SG_ 517 DrvLnMinTrqMd 0;
BA_ "GenSigTimeoutTime_DMSM" SG_ 517 DrvLnMinTrqMd 0;
BA_ "GenSigTimeoutTime_DTCM" SG_ 517 DrvLnMinTrqMd 0;
BA_ "GenSigTimeoutTime_EVCU2" SG_ 517 DrvLnMinTrqMd 0;
BA_ "GenSigTimeoutTime_GNMM" SG_ 517 DrvLnMinTrqMd 0;
BA_ "GenSigTimeoutTime_HCP" SG_ 517 DrvLnMinTrqMd 0;
BA_ "GenSigTimeoutTime_IPC" SG_ 517 DrvLnMinTrqMd 0;
BA_ "GenSigTimeoutTime_RFHM" SG_ 517 DrvLnMinTrqMd 0;
BA_ "GenSigTimeoutTime_SGW" SG_ 517 DrvLnMinTrqMd 0;
BA_ "GenSigTimeoutTime_TCM" SG_ 517 DrvLnMinTrqMd 0;
BA_ "GenSigStartValue" SG_ 517 DrvLnTrqRq 511;
BA_ "GenSigTimeoutTime_AGSM" SG_ 517 DrvLnTrqRq 0;
BA_ "GenSigTimeoutTime_BCM" SG_ 517 DrvLnTrqRq 0;
BA_ "GenSigTimeoutTime_BSM" SG_ 517 DrvLnTrqRq 0;
BA_ "GenSigTimeoutTime_CADM" SG_ 517 DrvLnTrqRq 0;
BA_ "GenSigTimeoutTime_DMSM" SG_ 517 DrvLnTrqRq 0;
BA_ "GenSigTimeoutTime_DTCM" SG_ 517 DrvLnTrqRq 0;
BA_ "GenSigTimeoutTime_EVCU2" SG_ 517 DrvLnTrqRq 0;
BA_ "GenSigTimeoutTime_GNMM" SG_ 517 DrvLnTrqRq 0;
BA_ "GenSigTimeoutTime_HCP" SG_ 517 DrvLnTrqRq 0;
BA_ "GenSigTimeoutTime_IPC" SG_ 517 DrvLnTrqRq 0;
BA_ "GenSigTimeoutTime_RFHM" SG_ 517 DrvLnTrqRq 0;
BA_ "GenSigTimeoutTime_SGW" SG_ 517 DrvLnTrqRq 0;
BA_ "GenSigTimeoutTime_TCM" SG_ 517 DrvLnTrqRq 0;
BA_ "GenSigStartValue" SG_ 517 Ft_RrCouplingTrq_Actual 255;
BA_ "GenSigTimeoutTime_AGSM" SG_ 517 Ft_RrCouplingTrq_Actual 0;
BA_ "GenSigTimeoutTime_CADM" SG_ 517 Ft_RrCouplingTrq_Actual 0;
BA_ "GenSigTimeoutTime_DMSM" SG_ 517 Ft_RrCouplingTrq_Actual 0;
BA_ "GenSigTimeoutTime_DTCM" SG_ 517 Ft_RrCouplingTrq_Actual 0;
BA_ "GenSigTimeoutTime_ECM" SG_ 517 Ft_RrCouplingTrq_Actual 0;
BA_ "GenSigTimeoutTime_EVCU2" SG_ 517 Ft_RrCouplingTrq_Actual 0;
BA_ "GenSigTimeoutTime_GNMM" SG_ 517 Ft_RrCouplingTrq_Actual 0;
BA_ "GenSigTimeoutTime_HCP" SG_ 517 Ft_RrCouplingTrq_Actual 0;
BA_ "GenSigTimeoutTime_IPC" SG_ 517 Ft_RrCouplingTrq_Actual 0;
BA_ "GenSigTimeoutTime_RFHM" SG_ 517 Ft_RrCouplingTrq_Actual 0;
BA_ "GenSigTimeoutTime_TCM" SG_ 517 Ft_RrCouplingTrq_Actual 0;
BA_ "GenSigStartValue" SG_ 517 Ft_RrCouplingTrq_Desired 255;
BA_ "GenSigTimeoutTime_AGSM" SG_ 517 Ft_RrCouplingTrq_Desired 0;
BA_ "GenSigTimeoutTime_BCM" SG_ 517 Ft_RrCouplingTrq_Desired 0;
BA_ "GenSigTimeoutTime_BSM" SG_ 517 Ft_RrCouplingTrq_Desired 0;
BA_ "GenSigTimeoutTime_CADM" SG_ 517 Ft_RrCouplingTrq_Desired 0;
BA_ "GenSigTimeoutTime_DMSM" SG_ 517 Ft_RrCouplingTrq_Desired 0;
BA_ "GenSigTimeoutTime_DTCM" SG_ 517 Ft_RrCouplingTrq_Desired 0;
BA_ "GenSigTimeoutTime_ECM" SG_ 517 Ft_RrCouplingTrq_Desired 0;
BA_ "GenSigTimeoutTime_EVCU2" SG_ 517 Ft_RrCouplingTrq_Desired 0;
BA_ "GenSigTimeoutTime_GNMM" SG_ 517 Ft_RrCouplingTrq_Desired 0;
BA_ "GenSigTimeoutTime_HCP" SG_ 517 Ft_RrCouplingTrq_Desired 0;
BA_ "GenSigTimeoutTime_IPC" SG_ 517 Ft_RrCouplingTrq_Desired 0;
BA_ "GenSigTimeoutTime_RFHM" SG_ 517 Ft_RrCouplingTrq_Desired 0;
BA_ "GenSigTimeoutTime_TCM" SG_ 517 Ft_RrCouplingTrq_Desired 0;
BA_ "GenSigTimeoutTime_AGSM" SG_ 517 MessageCounter_DRIVETRAIN1 0;
BA_ "GenSigTimeoutTime_CADM" SG_ 517 MessageCounter_DRIVETRAIN1 0;
BA_ "GenSigTimeoutTime_DMSM" SG_ 517 MessageCounter_DRIVETRAIN1 0;
BA_ "GenSigTimeoutTime_DTCM" SG_ 517 MessageCounter_DRIVETRAIN1 0;
BA_ "GenSigTimeoutTime_EVCU2" SG_ 517 MessageCounter_DRIVETRAIN1 0;
BA_ "GenSigTimeoutTime_IPC" SG_ 517 MessageCounter_DRIVETRAIN1 0;
BA_ "GenSigTimeoutTime_RFHM" SG_ 517 MessageCounter_DRIVETRAIN1 0;
BA_ "GenSigTimeoutTime_SGW" SG_ 517 MessageCounter_DRIVETRAIN1 0;
BA_ "GenSigSendType" SG_ 1447 CNT_DIFF_MOD 3;
BA_ "GenSigTimeoutTime_AGSM" SG_ 1447 CNT_DIFF_MOD 0;
BA_ "GenSigTimeoutTime_BCM" SG_ 1447 CNT_DIFF_MOD 0;
BA_ "GenSigTimeoutTime_BSM" SG_ 1447 CNT_DIFF_MOD 0;
BA_ "GenSigTimeoutTime_CADM" SG_ 1447 CNT_DIFF_MOD 0;
BA_ "GenSigTimeoutTime_DMSM" SG_ 1447 CNT_DIFF_MOD 0;
BA_ "GenSigTimeoutTime_DTCM" SG_ 1447 CNT_DIFF_MOD 0;
BA_ "GenSigTimeoutTime_ECM" SG_ 1447 CNT_DIFF_MOD 0;
BA_ "GenSigTimeoutTime_EVCU2" SG_ 1447 CNT_DIFF_MOD 0;
BA_ "GenSigTimeoutTime_GNMM" SG_ 1447 CNT_DIFF_MOD 0;
BA_ "GenSigTimeoutTime_HCP" SG_ 1447 CNT_DIFF_MOD 0;
BA_ "GenSigTimeoutTime_IPC" SG_ 1447 CNT_DIFF_MOD 0;
BA_ "GenSigTimeoutTime_RFHM" SG_ 1447 CNT_DIFF_MOD 0;
BA_ "GenSigTimeoutTime_SGW" SG_ 1447 CNT_DIFF_MOD 0;
BA_ "GenSigTimeoutTime_TCM" SG_ 1447 CNT_DIFF_MOD 0;
BA_ "GenSigSendType" SG_ 1447 DTCM_HMI_Rq 3;
BA_ "GenSigTimeoutTime_AGSM" SG_ 1447 DTCM_HMI_Rq 0;
BA_ "GenSigTimeoutTime_BCM" SG_ 1447 DTCM_HMI_Rq 0;
BA_ "GenSigTimeoutTime_BSM" SG_ 1447 DTCM_HMI_Rq 0;
BA_ "GenSigTimeoutTime_CADM" SG_ 1447 DTCM_HMI_Rq 0;
BA_ "GenSigTimeoutTime_DMSM" SG_ 1447 DTCM_HMI_Rq 0;
BA_ "GenSigTimeoutTime_DTCM" SG_ 1447 DTCM_HMI_Rq 0;
BA_ "GenSigTimeoutTime_ECM" SG_ 1447 DTCM_HMI_Rq 0;
BA_ "GenSigTimeoutTime_EVCU2" SG_ 1447 DTCM_HMI_Rq 0;
BA_ "GenSigTimeoutTime_GNMM" SG_ 1447 DTCM_HMI_Rq 0;
BA_ "GenSigTimeoutTime_HCP" SG_ 1447 DTCM_HMI_Rq 0;
BA_ "GenSigTimeoutTime_RFHM" SG_ 1447 DTCM_HMI_Rq 0;
BA_ "GenSigTimeoutTime_SGW" SG_ 1447 DTCM_HMI_Rq 0;
BA_ "GenSigTimeoutTime_TCM" SG_ 1447 DTCM_HMI_Rq 0;
BA_ "GenSigSendType" SG_ 1447 TerSt_SWITCH1 3;
BA_ "GenSigTimeoutTime_AGSM" SG_ 1447 TerSt_SWITCH1 0;
BA_ "GenSigTimeoutTime_BSM" SG_ 1447 TerSt_SWITCH1 0;
BA_ "GenSigTimeoutTime_CADM" SG_ 1447 TerSt_SWITCH1 0;
BA_ "GenSigTimeoutTime_DMSM" SG_ 1447 TerSt_SWITCH1 0;
BA_ "GenSigTimeoutTime_DTCM" SG_ 1447 TerSt_SWITCH1 0;
BA_ "GenSigTimeoutTime_ECM" SG_ 1447 TerSt_SWITCH1 0;
BA_ "GenSigTimeoutTime_EVCU2" SG_ 1447 TerSt_SWITCH1 0;
BA_ "GenSigTimeoutTime_GNMM" SG_ 1447 TerSt_SWITCH1 0;
BA_ "GenSigTimeoutTime_HCP" SG_ 1447 TerSt_SWITCH1 0;
BA_ "GenSigTimeoutTime_RFHM" SG_ 1447 TerSt_SWITCH1 0;
BA_ "GenSigTimeoutTime_TCM" SG_ 1447 TerSt_SWITCH1 0;
BA_ "GenSigSendType" SG_ 1447 TerSt_SWITCH2 3;
BA_ "GenSigTimeoutTime_AGSM" SG_ 1447 TerSt_SWITCH2 0;
BA_ "GenSigTimeoutTime_BSM" SG_ 1447 TerSt_SWITCH2 0;
BA_ "GenSigTimeoutTime_CADM" SG_ 1447 TerSt_SWITCH2 0;
BA_ "GenSigTimeoutTime_DMSM" SG_ 1447 TerSt_SWITCH2 0;
BA_ "GenSigTimeoutTime_DTCM" SG_ 1447 TerSt_SWITCH2 0;
BA_ "GenSigTimeoutTime_ECM" SG_ 1447 TerSt_SWITCH2 0;
BA_ "GenSigTimeoutTime_EVCU2" SG_ 1447 TerSt_SWITCH2 0;
BA_ "GenSigTimeoutTime_GNMM" SG_ 1447 TerSt_SWITCH2 0;
BA_ "GenSigTimeoutTime_HCP" SG_ 1447 TerSt_SWITCH2 0;
BA_ "GenSigTimeoutTime_RFHM" SG_ 1447 TerSt_SWITCH2 0;
BA_ "GenSigTimeoutTime_TCM" SG_ 1447 TerSt_SWITCH2 0;
BA_ "GenSigSendType" SG_ 1068 AxleLckr_SRV_RQ 3;
BA_ "GenSigTimeoutTime_AGSM" SG_ 1068 AxleLckr_SRV_RQ 0;
BA_ "GenSigTimeoutTime_BCM" SG_ 1068 AxleLckr_SRV_RQ 0;
BA_ "GenSigTimeoutTime_BSM" SG_ 1068 AxleLckr_SRV_RQ 0;
BA_ "GenSigTimeoutTime_CADM" SG_ 1068 AxleLckr_SRV_RQ 0;
BA_ "GenSigTimeoutTime_DMSM" SG_ 1068 AxleLckr_SRV_RQ 0;
BA_ "GenSigTimeoutTime_DTCM" SG_ 1068 AxleLckr_SRV_RQ 0;
BA_ "GenSigTimeoutTime_ECM" SG_ 1068 AxleLckr_SRV_RQ 0;
BA_ "GenSigTimeoutTime_EVCU2" SG_ 1068 AxleLckr_SRV_RQ 0;
BA_ "GenSigTimeoutTime_GNMM" SG_ 1068 AxleLckr_SRV_RQ 0;
BA_ "GenSigTimeoutTime_HCP" SG_ 1068 AxleLckr_SRV_RQ 0;
BA_ "GenSigTimeoutTime_RFHM" SG_ 1068 AxleLckr_SRV_RQ 0;
BA_ "GenSigTimeoutTime_SGW" SG_ 1068 AxleLckr_SRV_RQ 0;
BA_ "GenSigTimeoutTime_TCM" SG_ 1068 AxleLckr_SRV_RQ 0;
BA_ "GenSigSendType" SG_ 1068 AxleLckr_Stat 3;
BA_ "GenSigTimeoutTime_AGSM" SG_ 1068 AxleLckr_Stat 0;
BA_ "GenSigTimeoutTime_BCM" SG_ 1068 AxleLckr_Stat 0;
BA_ "GenSigTimeoutTime_CADM" SG_ 1068 AxleLckr_Stat 0;
BA_ "GenSigTimeoutTime_DMSM" SG_ 1068 AxleLckr_Stat 0;
BA_ "GenSigTimeoutTime_DTCM" SG_ 1068 AxleLckr_Stat 0;
BA_ "GenSigTimeoutTime_ECM" SG_ 1068 AxleLckr_Stat 0;
BA_ "GenSigTimeoutTime_EVCU2" SG_ 1068 AxleLckr_Stat 0;
BA_ "GenSigTimeoutTime_GNMM" SG_ 1068 AxleLckr_Stat 0;
BA_ "GenSigTimeoutTime_HCP" SG_ 1068 AxleLckr_Stat 0;
BA_ "GenSigTimeoutTime_RFHM" SG_ 1068 AxleLckr_Stat 0;
BA_ "GenSigTimeoutTime_TCM" SG_ 1068 AxleLckr_Stat 0;
BA_ "GenSigSendType" SG_ 1068 AxleLckrEvicDisp 3;
BA_ "GenSigTimeoutTime_AGSM" SG_ 1068 AxleLckrEvicDisp 0;
BA_ "GenSigTimeoutTime_BCM" SG_ 1068 AxleLckrEvicDisp 0;
BA_ "GenSigTimeoutTime_BSM" SG_ 1068 AxleLckrEvicDisp 0;
BA_ "GenSigTimeoutTime_CADM" SG_ 1068 AxleLckrEvicDisp 0;
BA_ "GenSigTimeoutTime_DMSM" SG_ 1068 AxleLckrEvicDisp 0;
BA_ "GenSigTimeoutTime_DTCM" SG_ 1068 AxleLckrEvicDisp 0;
BA_ "GenSigTimeoutTime_ECM" SG_ 1068 AxleLckrEvicDisp 0;
BA_ "GenSigTimeoutTime_EVCU2" SG_ 1068 AxleLckrEvicDisp 0;
BA_ "GenSigTimeoutTime_GNMM" SG_ 1068 AxleLckrEvicDisp 0;
BA_ "GenSigTimeoutTime_HCP" SG_ 1068 AxleLckrEvicDisp 0;
BA_ "GenSigTimeoutTime_RFHM" SG_ 1068 AxleLckrEvicDisp 0;
BA_ "GenSigTimeoutTime_SGW" SG_ 1068 AxleLckrEvicDisp 0;
BA_ "GenSigTimeoutTime_TCM" SG_ 1068 AxleLckrEvicDisp 0;
BA_ "GenSigTimeoutTime_AGSM" SG_ 1068 CRC__DRIVETRAIN3 0;
BA_ "GenSigTimeoutTime_DMSM" SG_ 1068 CRC__DRIVETRAIN3 0;
BA_ "GenSigTimeoutTime_DTCM" SG_ 1068 CRC__DRIVETRAIN3 0;
BA_ "GenSigTimeoutTime_EVCU2" SG_ 1068 CRC__DRIVETRAIN3 0;
BA_ "GenSigTimeoutTime_GNMM" SG_ 1068 CRC__DRIVETRAIN3 0;
BA_ "GenSigTimeoutTime_HCP" SG_ 1068 CRC__DRIVETRAIN3 0;
BA_ "GenSigTimeoutTime_IPC" SG_ 1068 CRC__DRIVETRAIN3 0;
BA_ "GenSigTimeoutTime_RFHM" SG_ 1068 CRC__DRIVETRAIN3 0;
BA_ "GenSigTimeoutTime_SGW" SG_ 1068 CRC__DRIVETRAIN3 0;
BA_ "GenSigSendType" SG_ 1068 DTCM_Vehicle_Hold_Rq 3;
BA_ "GenSigTimeoutTime_AGSM" SG_ 1068 DTCM_Vehicle_Hold_Rq 0;
BA_ "GenSigTimeoutTime_BCM" SG_ 1068 DTCM_Vehicle_Hold_Rq 0;
BA_ "GenSigTimeoutTime_CADM" SG_ 1068 DTCM_Vehicle_Hold_Rq 0;
BA_ "GenSigTimeoutTime_DMSM" SG_ 1068 DTCM_Vehicle_Hold_Rq 0;
BA_ "GenSigTimeoutTime_DTCM" SG_ 1068 DTCM_Vehicle_Hold_Rq 0;
BA_ "GenSigTimeoutTime_ECM" SG_ 1068 DTCM_Vehicle_Hold_Rq 0;
BA_ "GenSigTimeoutTime_EVCU2" SG_ 1068 DTCM_Vehicle_Hold_Rq 0;
BA_ "GenSigTimeoutTime_GNMM" SG_ 1068 DTCM_Vehicle_Hold_Rq 0;
BA_ "GenSigTimeoutTime_HCP" SG_ 1068 DTCM_Vehicle_Hold_Rq 0;
BA_ "GenSigTimeoutTime_IPC" SG_ 1068 DTCM_Vehicle_Hold_Rq 0;
BA_ "GenSigTimeoutTime_RFHM" SG_ 1068 DTCM_Vehicle_Hold_Rq 0;
BA_ "GenSigTimeoutTime_SGW" SG_ 1068 DTCM_Vehicle_Hold_Rq 0;
BA_ "GenSigTimeoutTime_TCM" SG_ 1068 DTCM_Vehicle_Hold_Rq 0;
BA_ "GenSigTimeoutTime_AGSM" SG_ 1068 MessageCounter_DRIVETRAIN3 0;
BA_ "GenSigTimeoutTime_DMSM" SG_ 1068 MessageCounter_DRIVETRAIN3 0;
BA_ "GenSigTimeoutTime_DTCM" SG_ 1068 MessageCounter_DRIVETRAIN3 0;
BA_ "GenSigTimeoutTime_EVCU2" SG_ 1068 MessageCounter_DRIVETRAIN3 0;
BA_ "GenSigTimeoutTime_GNMM" SG_ 1068 MessageCounter_DRIVETRAIN3 0;
BA_ "GenSigTimeoutTime_HCP" SG_ 1068 MessageCounter_DRIVETRAIN3 0;
BA_ "GenSigTimeoutTime_IPC" SG_ 1068 MessageCounter_DRIVETRAIN3 0;
BA_ "GenSigTimeoutTime_RFHM" SG_ 1068 MessageCounter_DRIVETRAIN3 0;
BA_ "GenSigTimeoutTime_SGW" SG_ 1068 MessageCounter_DRIVETRAIN3 0;
BA_ "GenSigSendType" SG_ 1068 RrAxleLockerIndRq 3;
BA_ "GenSigTimeoutTime_AGSM" SG_ 1068 RrAxleLockerIndRq 0;
BA_ "GenSigTimeoutTime_BSM" SG_ 1068 RrAxleLockerIndRq 0;
BA_ "GenSigTimeoutTime_CADM" SG_ 1068 RrAxleLockerIndRq 0;
BA_ "GenSigTimeoutTime_DMSM" SG_ 1068 RrAxleLockerIndRq 0;
BA_ "GenSigTimeoutTime_DTCM" SG_ 1068 RrAxleLockerIndRq 0;
BA_ "GenSigTimeoutTime_ECM" SG_ 1068 RrAxleLockerIndRq 0;
BA_ "GenSigTimeoutTime_EVCU2" SG_ 1068 RrAxleLockerIndRq 0;
BA_ "GenSigTimeoutTime_GNMM" SG_ 1068 RrAxleLockerIndRq 0;
BA_ "GenSigTimeoutTime_HCP" SG_ 1068 RrAxleLockerIndRq 0;
BA_ "GenSigTimeoutTime_RFHM" SG_ 1068 RrAxleLockerIndRq 0;
BA_ "GenSigTimeoutTime_SGW" SG_ 1068 RrAxleLockerIndRq 0;
BA_ "GenSigTimeoutTime_TCM" SG_ 1068 RrAxleLockerIndRq 0;
BA_ "GenSigSendType" SG_ 1068 Tcase2WD_Stat 3;
BA_ "GenSigTimeoutTime_AGSM" SG_ 1068 Tcase2WD_Stat 0;
BA_ "GenSigTimeoutTime_BSM" SG_ 1068 Tcase2WD_Stat 0;
BA_ "GenSigTimeoutTime_CADM" SG_ 1068 Tcase2WD_Stat 0;
BA_ "GenSigTimeoutTime_DMSM" SG_ 1068 Tcase2WD_Stat 0;
BA_ "GenSigTimeoutTime_DTCM" SG_ 1068 Tcase2WD_Stat 0;
BA_ "GenSigTimeoutTime_ECM" SG_ 1068 Tcase2WD_Stat 0;
BA_ "GenSigTimeoutTime_EVCU2" SG_ 1068 Tcase2WD_Stat 0;
BA_ "GenSigTimeoutTime_GNMM" SG_ 1068 Tcase2WD_Stat 0;
BA_ "GenSigTimeoutTime_HCP" SG_ 1068 Tcase2WD_Stat 0;
BA_ "GenSigTimeoutTime_RFHM" SG_ 1068 Tcase2WD_Stat 0;
BA_ "GenSigTimeoutTime_TCM" SG_ 1068 Tcase2WD_Stat 0;
BA_ "GenSigSendType" SG_ 1068 Tcase4Lock 3;
BA_ "GenSigTimeoutTime_AGSM" SG_ 1068 Tcase4Lock 0;
BA_ "GenSigTimeoutTime_BSM" SG_ 1068 Tcase4Lock 0;
BA_ "GenSigTimeoutTime_CADM" SG_ 1068 Tcase4Lock 0;
BA_ "GenSigTimeoutTime_DMSM" SG_ 1068 Tcase4Lock 0;
BA_ "GenSigTimeoutTime_DTCM" SG_ 1068 Tcase4Lock 0;
BA_ "GenSigTimeoutTime_ECM" SG_ 1068 Tcase4Lock 0;
BA_ "GenSigTimeoutTime_EVCU2" SG_ 1068 Tcase4Lock 0;
BA_ "GenSigTimeoutTime_GNMM" SG_ 1068 Tcase4Lock 0;
BA_ "GenSigTimeoutTime_HCP" SG_ 1068 Tcase4Lock 0;
BA_ "GenSigTimeoutTime_RFHM" SG_ 1068 Tcase4Lock 0;
BA_ "GenSigTimeoutTime_TCM" SG_ 1068 Tcase4Lock 0;
BA_ "GenSigSendType" SG_ 1068 Tcase4Low 3;
BA_ "GenSigTimeoutTime_AGSM" SG_ 1068 Tcase4Low 0;
BA_ "GenSigTimeoutTime_BSM" SG_ 1068 Tcase4Low 0;
BA_ "GenSigTimeoutTime_CADM" SG_ 1068 Tcase4Low 0;
BA_ "GenSigTimeoutTime_DMSM" SG_ 1068 Tcase4Low 0;
BA_ "GenSigTimeoutTime_DTCM" SG_ 1068 Tcase4Low 0;
BA_ "GenSigTimeoutTime_ECM" SG_ 1068 Tcase4Low 0;
BA_ "GenSigTimeoutTime_EVCU2" SG_ 1068 Tcase4Low 0;
BA_ "GenSigTimeoutTime_GNMM" SG_ 1068 Tcase4Low 0;
BA_ "GenSigTimeoutTime_HCP" SG_ 1068 Tcase4Low 0;
BA_ "GenSigTimeoutTime_IPC" SG_ 1068 Tcase4Low 0;
BA_ "GenSigTimeoutTime_RFHM" SG_ 1068 Tcase4Low 0;
BA_ "GenSigTimeoutTime_SGW" SG_ 1068 Tcase4Low 0;
BA_ "GenSigTimeoutTime_TCM" SG_ 1068 Tcase4Low 0;
BA_ "GenSigSendType" SG_ 1068 TcaseAWD 3;
BA_ "GenSigTimeoutTime_AGSM" SG_ 1068 TcaseAWD 0;
BA_ "GenSigTimeoutTime_BSM" SG_ 1068 TcaseAWD 0;
BA_ "GenSigTimeoutTime_CADM" SG_ 1068 TcaseAWD 0;
BA_ "GenSigTimeoutTime_DMSM" SG_ 1068 TcaseAWD 0;
BA_ "GenSigTimeoutTime_DTCM" SG_ 1068 TcaseAWD 0;
BA_ "GenSigTimeoutTime_ECM" SG_ 1068 TcaseAWD 0;
BA_ "GenSigTimeoutTime_EVCU2" SG_ 1068 TcaseAWD 0;
BA_ "GenSigTimeoutTime_GNMM" SG_ 1068 TcaseAWD 0;
BA_ "GenSigTimeoutTime_HCP" SG_ 1068 TcaseAWD 0;
BA_ "GenSigTimeoutTime_RFHM" SG_ 1068 TcaseAWD 0;
BA_ "GenSigTimeoutTime_TCM" SG_ 1068 TcaseAWD 0;
BA_ "GenSigSendType" SG_ 1068 TCASERANGESTATUS 3;
BA_ "GenSigTimeoutTime_AGSM" SG_ 1068 TCASERANGESTATUS 0;
BA_ "GenSigTimeoutTime_DMSM" SG_ 1068 TCASERANGESTATUS 0;
BA_ "GenSigTimeoutTime_DTCM" SG_ 1068 TCASERANGESTATUS 0;
BA_ "GenSigTimeoutTime_EVCU2" SG_ 1068 TCASERANGESTATUS 0;
BA_ "GenSigTimeoutTime_GNMM" SG_ 1068 TCASERANGESTATUS 0;
BA_ "GenSigTimeoutTime_HCP" SG_ 1068 TCASERANGESTATUS 0;
BA_ "GenSigTimeoutTime_RFHM" SG_ 1068 TCASERANGESTATUS 0;
BA_ "GenSigTimeoutTime_AGSM" SG_ 1438 CRC_DRV_MONITOR1 0;
BA_ "GenSigTimeoutTime_BCM" SG_ 1438 CRC_DRV_MONITOR1 0;
BA_ "GenSigTimeoutTime_BSM" SG_ 1438 CRC_DRV_MONITOR1 0;
BA_ "GenSigTimeoutTime_DMSM" SG_ 1438 CRC_DRV_MONITOR1 0;
BA_ "GenSigTimeoutTime_DTCM" SG_ 1438 CRC_DRV_MONITOR1 0;
BA_ "GenSigTimeoutTime_ECM" SG_ 1438 CRC_DRV_MONITOR1 0;
BA_ "GenSigTimeoutTime_EVCU2" SG_ 1438 CRC_DRV_MONITOR1 0;
BA_ "GenSigTimeoutTime_GNMM" SG_ 1438 CRC_DRV_MONITOR1 0;
BA_ "GenSigTimeoutTime_HCP" SG_ 1438 CRC_DRV_MONITOR1 0;
BA_ "GenSigTimeoutTime_IPC" SG_ 1438 CRC_DRV_MONITOR1 0;
BA_ "GenSigTimeoutTime_RFHM" SG_ 1438 CRC_DRV_MONITOR1 0;
BA_ "GenSigTimeoutTime_SGW" SG_ 1438 CRC_DRV_MONITOR1 0;
BA_ "GenSigTimeoutTime_TCM" SG_ 1438 CRC_DRV_MONITOR1 0;
BA_ "GenSigSendType" SG_ 1438 DM_Camera_Blind 3;
BA_ "GenSigTimeoutTime_AGSM" SG_ 1438 DM_Camera_Blind 0;
BA_ "GenSigTimeoutTime_BCM" SG_ 1438 DM_Camera_Blind 0;
BA_ "GenSigTimeoutTime_BSM" SG_ 1438 DM_Camera_Blind 0;
BA_ "GenSigTimeoutTime_DMSM" SG_ 1438 DM_Camera_Blind 0;
BA_ "GenSigTimeoutTime_DTCM" SG_ 1438 DM_Camera_Blind 0;
BA_ "GenSigTimeoutTime_ECM" SG_ 1438 DM_Camera_Blind 0;
BA_ "GenSigTimeoutTime_EVCU2" SG_ 1438 DM_Camera_Blind 0;
BA_ "GenSigTimeoutTime_GNMM" SG_ 1438 DM_Camera_Blind 0;
BA_ "GenSigTimeoutTime_HCP" SG_ 1438 DM_Camera_Blind 0;
BA_ "GenSigTimeoutTime_IPC" SG_ 1438 DM_Camera_Blind 0;
BA_ "GenSigTimeoutTime_RFHM" SG_ 1438 DM_Camera_Blind 0;
BA_ "GenSigTimeoutTime_SGW" SG_ 1438 DM_Camera_Blind 0;
BA_ "GenSigTimeoutTime_TCM" SG_ 1438 DM_Camera_Blind 0;
BA_ "GenSigSendType" SG_ 1438 DM_Distract_Conf 3;
BA_ "GenSigTimeoutTime_AGSM" SG_ 1438 DM_Distract_Conf 0;
BA_ "GenSigTimeoutTime_BCM" SG_ 1438 DM_Distract_Conf 0;
BA_ "GenSigTimeoutTime_BSM" SG_ 1438 DM_Distract_Conf 0;
BA_ "GenSigTimeoutTime_DMSM" SG_ 1438 DM_Distract_Conf 0;
BA_ "GenSigTimeoutTime_DTCM" SG_ 1438 DM_Distract_Conf 0;
BA_ "GenSigTimeoutTime_ECM" SG_ 1438 DM_Distract_Conf 0;
BA_ "GenSigTimeoutTime_EVCU2" SG_ 1438 DM_Distract_Conf 0;
BA_ "GenSigTimeoutTime_GNMM" SG_ 1438 DM_Distract_Conf 0;
BA_ "GenSigTimeoutTime_HCP" SG_ 1438 DM_Distract_Conf 0;
BA_ "GenSigTimeoutTime_IPC" SG_ 1438 DM_Distract_Conf 0;
BA_ "GenSigTimeoutTime_RFHM" SG_ 1438 DM_Distract_Conf 0;
BA_ "GenSigTimeoutTime_SGW" SG_ 1438 DM_Distract_Conf 0;
BA_ "GenSigTimeoutTime_TCM" SG_ 1438 DM_Distract_Conf 0;
BA_ "GenSigTimeoutTime_AGSM" SG_ 1438 DM_Distract_Instant 0;
BA_ "GenSigTimeoutTime_BCM" SG_ 1438 DM_Distract_Instant 0;
BA_ "GenSigTimeoutTime_BSM" SG_ 1438 DM_Distract_Instant 0;
BA_ "GenSigTimeoutTime_DMSM" SG_ 1438 DM_Distract_Instant 0;
BA_ "GenSigTimeoutTime_DTCM" SG_ 1438 DM_Distract_Instant 0;
BA_ "GenSigTimeoutTime_ECM" SG_ 1438 DM_Distract_Instant 0;
BA_ "GenSigTimeoutTime_EVCU2" SG_ 1438 DM_Distract_Instant 0;
BA_ "GenSigTimeoutTime_GNMM" SG_ 1438 DM_Distract_Instant 0;
BA_ "GenSigTimeoutTime_HCP" SG_ 1438 DM_Distract_Instant 0;
BA_ "GenSigTimeoutTime_IPC" SG_ 1438 DM_Distract_Instant 0;
BA_ "GenSigTimeoutTime_RFHM" SG_ 1438 DM_Distract_Instant 0;
BA_ "GenSigTimeoutTime_SGW" SG_ 1438 DM_Distract_Instant 0;
BA_ "GenSigTimeoutTime_TCM" SG_ 1438 DM_Distract_Instant 0;
BA_ "GenSigSendType" SG_ 1438 DM_Distract_State 3;
BA_ "GenSigTimeoutTime_AGSM" SG_ 1438 DM_Distract_State 0;
BA_ "GenSigTimeoutTime_BSM" SG_ 1438 DM_Distract_State 0;
BA_ "GenSigTimeoutTime_DMSM" SG_ 1438 DM_Distract_State 0;
BA_ "GenSigTimeoutTime_DTCM" SG_ 1438 DM_Distract_State 0;
BA_ "GenSigTimeoutTime_ECM" SG_ 1438 DM_Distract_State 0;
BA_ "GenSigTimeoutTime_EVCU2" SG_ 1438 DM_Distract_State 0;
BA_ "GenSigTimeoutTime_GNMM" SG_ 1438 DM_Distract_State 0;
BA_ "GenSigTimeoutTime_HCP" SG_ 1438 DM_Distract_State 0;
BA_ "GenSigTimeoutTime_IPC" SG_ 1438 DM_Distract_State 0;
BA_ "GenSigTimeoutTime_RFHM" SG_ 1438 DM_Distract_State 0;
BA_ "GenSigTimeoutTime_TCM" SG_ 1438 DM_Distract_State 0;
BA_ "GenSigSendType" SG_ 1438 DM_Drowsy_Conf 3;
BA_ "GenSigTimeoutTime_AGSM" SG_ 1438 DM_Drowsy_Conf 0;
BA_ "GenSigTimeoutTime_BCM" SG_ 1438 DM_Drowsy_Conf 0;
BA_ "GenSigTimeoutTime_BSM" SG_ 1438 DM_Drowsy_Conf 0;
BA_ "GenSigTimeoutTime_DMSM" SG_ 1438 DM_Drowsy_Conf 0;
BA_ "GenSigTimeoutTime_DTCM" SG_ 1438 DM_Drowsy_Conf 0;
BA_ "GenSigTimeoutTime_ECM" SG_ 1438 DM_Drowsy_Conf 0;
BA_ "GenSigTimeoutTime_EVCU2" SG_ 1438 DM_Drowsy_Conf 0;
BA_ "GenSigTimeoutTime_GNMM" SG_ 1438 DM_Drowsy_Conf 0;
BA_ "GenSigTimeoutTime_HCP" SG_ 1438 DM_Drowsy_Conf 0;
BA_ "GenSigTimeoutTime_IPC" SG_ 1438 DM_Drowsy_Conf 0;
BA_ "GenSigTimeoutTime_RFHM" SG_ 1438 DM_Drowsy_Conf 0;
BA_ "GenSigTimeoutTime_SGW" SG_ 1438 DM_Drowsy_Conf 0;
BA_ "GenSigTimeoutTime_TCM" SG_ 1438 DM_Drowsy_Conf 0;
BA_ "GenSigTimeoutTime_AGSM" SG_ 1438 DM_Drowsy_Instant 0;
BA_ "GenSigTimeoutTime_BCM" SG_ 1438 DM_Drowsy_Instant 0;
BA_ "GenSigTimeoutTime_BSM" SG_ 1438 DM_Drowsy_Instant 0;
BA_ "GenSigTimeoutTime_DMSM" SG_ 1438 DM_Drowsy_Instant 0;
BA_ "GenSigTimeoutTime_DTCM" SG_ 1438 DM_Drowsy_Instant 0;
BA_ "GenSigTimeoutTime_ECM" SG_ 1438 DM_Drowsy_Instant 0;
BA_ "GenSigTimeoutTime_EVCU2" SG_ 1438 DM_Drowsy_Instant 0;
BA_ "GenSigTimeoutTime_GNMM" SG_ 1438 DM_Drowsy_Instant 0;
BA_ "GenSigTimeoutTime_HCP" SG_ 1438 DM_Drowsy_Instant 0;
BA_ "GenSigTimeoutTime_IPC" SG_ 1438 DM_Drowsy_Instant 0;
BA_ "GenSigTimeoutTime_RFHM" SG_ 1438 DM_Drowsy_Instant 0;
BA_ "GenSigTimeoutTime_SGW" SG_ 1438 DM_Drowsy_Instant 0;
BA_ "GenSigTimeoutTime_TCM" SG_ 1438 DM_Drowsy_Instant 0;
BA_ "GenSigSendType" SG_ 1438 DM_Drowsy_Micro 3;
BA_ "GenSigTimeoutTime_AGSM" SG_ 1438 DM_Drowsy_Micro 0;
BA_ "GenSigTimeoutTime_BCM" SG_ 1438 DM_Drowsy_Micro 0;
BA_ "GenSigTimeoutTime_BSM" SG_ 1438 DM_Drowsy_Micro 0;
BA_ "GenSigTimeoutTime_DMSM" SG_ 1438 DM_Drowsy_Micro 0;
BA_ "GenSigTimeoutTime_DTCM" SG_ 1438 DM_Drowsy_Micro 0;
BA_ "GenSigTimeoutTime_ECM" SG_ 1438 DM_Drowsy_Micro 0;
BA_ "GenSigTimeoutTime_EVCU2" SG_ 1438 DM_Drowsy_Micro 0;
BA_ "GenSigTimeoutTime_GNMM" SG_ 1438 DM_Drowsy_Micro 0;
BA_ "GenSigTimeoutTime_HCP" SG_ 1438 DM_Drowsy_Micro 0;
BA_ "GenSigTimeoutTime_IPC" SG_ 1438 DM_Drowsy_Micro 0;
BA_ "GenSigTimeoutTime_RFHM" SG_ 1438 DM_Drowsy_Micro 0;
BA_ "GenSigTimeoutTime_SGW" SG_ 1438 DM_Drowsy_Micro 0;
BA_ "GenSigTimeoutTime_TCM" SG_ 1438 DM_Drowsy_Micro 0;
BA_ "GenSigSendType" SG_ 1438 DM_Drowsy_State 3;
BA_ "GenSigTimeoutTime_AGSM" SG_ 1438 DM_Drowsy_State 0;
BA_ "GenSigTimeoutTime_BSM" SG_ 1438 DM_Drowsy_State 0;
BA_ "GenSigTimeoutTime_DMSM" SG_ 1438 DM_Drowsy_State 0;
BA_ "GenSigTimeoutTime_DTCM" SG_ 1438 DM_Drowsy_State 0;
BA_ "GenSigTimeoutTime_ECM" SG_ 1438 DM_Drowsy_State 0;
BA_ "GenSigTimeoutTime_EVCU2" SG_ 1438 DM_Drowsy_State 0;
BA_ "GenSigTimeoutTime_GNMM" SG_ 1438 DM_Drowsy_State 0;
BA_ "GenSigTimeoutTime_HCP" SG_ 1438 DM_Drowsy_State 0;
BA_ "GenSigTimeoutTime_IPC" SG_ 1438 DM_Drowsy_State 0;
BA_ "GenSigTimeoutTime_RFHM" SG_ 1438 DM_Drowsy_State 0;
BA_ "GenSigTimeoutTime_TCM" SG_ 1438 DM_Drowsy_State 0;
BA_ "GenSigSendType" SG_ 1438 DM_Eyes_Tracked 3;
BA_ "GenSigTimeoutTime_AGSM" SG_ 1438 DM_Eyes_Tracked 0;
BA_ "GenSigTimeoutTime_BCM" SG_ 1438 DM_Eyes_Tracked 0;
BA_ "GenSigTimeoutTime_BSM" SG_ 1438 DM_Eyes_Tracked 0;
BA_ "GenSigTimeoutTime_DMSM" SG_ 1438 DM_Eyes_Tracked 0;
BA_ "GenSigTimeoutTime_DTCM" SG_ 1438 DM_Eyes_Tracked 0;
BA_ "GenSigTimeoutTime_ECM" SG_ 1438 DM_Eyes_Tracked 0;
BA_ "GenSigTimeoutTime_EVCU2" SG_ 1438 DM_Eyes_Tracked 0;
BA_ "GenSigTimeoutTime_GNMM" SG_ 1438 DM_Eyes_Tracked 0;
BA_ "GenSigTimeoutTime_HCP" SG_ 1438 DM_Eyes_Tracked 0;
BA_ "GenSigTimeoutTime_IPC" SG_ 1438 DM_Eyes_Tracked 0;
BA_ "GenSigTimeoutTime_RFHM" SG_ 1438 DM_Eyes_Tracked 0;
BA_ "GenSigTimeoutTime_SGW" SG_ 1438 DM_Eyes_Tracked 0;
BA_ "GenSigTimeoutTime_TCM" SG_ 1438 DM_Eyes_Tracked 0;
BA_ "GenSigSendType" SG_ 1438 DM_Steering_Angle_Blockage 3;
BA_ "GenSigTimeoutTime_AGSM" SG_ 1438 DM_Steering_Angle_Blockage 0;
BA_ "GenSigTimeoutTime_BCM" SG_ 1438 DM_Steering_Angle_Blockage 0;
BA_ "GenSigTimeoutTime_BSM" SG_ 1438 DM_Steering_Angle_Blockage 0;
BA_ "GenSigTimeoutTime_DMSM" SG_ 1438 DM_Steering_Angle_Blockage 0;
BA_ "GenSigTimeoutTime_DTCM" SG_ 1438 DM_Steering_Angle_Blockage 0;
BA_ "GenSigTimeoutTime_ECM" SG_ 1438 DM_Steering_Angle_Blockage 0;
BA_ "GenSigTimeoutTime_EVCU2" SG_ 1438 DM_Steering_Angle_Blockage 0;
BA_ "GenSigTimeoutTime_GNMM" SG_ 1438 DM_Steering_Angle_Blockage 0;
BA_ "GenSigTimeoutTime_HCP" SG_ 1438 DM_Steering_Angle_Blockage 0;
BA_ "GenSigTimeoutTime_IPC" SG_ 1438 DM_Steering_Angle_Blockage 0;
BA_ "GenSigTimeoutTime_RFHM" SG_ 1438 DM_Steering_Angle_Blockage 0;
BA_ "GenSigTimeoutTime_SGW" SG_ 1438 DM_Steering_Angle_Blockage 0;
BA_ "GenSigTimeoutTime_TCM" SG_ 1438 DM_Steering_Angle_Blockage 0;
BA_ "GenSigSendType" SG_ 1438 DM_Zone_Track 3;
BA_ "GenSigTimeoutTime_AGSM" SG_ 1438 DM_Zone_Track 0;
BA_ "GenSigTimeoutTime_BSM" SG_ 1438 DM_Zone_Track 0;
BA_ "GenSigTimeoutTime_DMSM" SG_ 1438 DM_Zone_Track 0;
BA_ "GenSigTimeoutTime_DTCM" SG_ 1438 DM_Zone_Track 0;
BA_ "GenSigTimeoutTime_ECM" SG_ 1438 DM_Zone_Track 0;
BA_ "GenSigTimeoutTime_EVCU2" SG_ 1438 DM_Zone_Track 0;
BA_ "GenSigTimeoutTime_GNMM" SG_ 1438 DM_Zone_Track 0;
BA_ "GenSigTimeoutTime_HCP" SG_ 1438 DM_Zone_Track 0;
BA_ "GenSigTimeoutTime_IPC" SG_ 1438 DM_Zone_Track 0;
BA_ "GenSigTimeoutTime_RFHM" SG_ 1438 DM_Zone_Track 0;
BA_ "GenSigTimeoutTime_SGW" SG_ 1438 DM_Zone_Track 0;
BA_ "GenSigTimeoutTime_TCM" SG_ 1438 DM_Zone_Track 0;
BA_ "GenSigSendType" SG_ 1438 DM_Zone_Track_Conf 3;
BA_ "GenSigTimeoutTime_AGSM" SG_ 1438 DM_Zone_Track_Conf 0;
BA_ "GenSigTimeoutTime_BCM" SG_ 1438 DM_Zone_Track_Conf 0;
BA_ "GenSigTimeoutTime_BSM" SG_ 1438 DM_Zone_Track_Conf 0;
BA_ "GenSigTimeoutTime_DMSM" SG_ 1438 DM_Zone_Track_Conf 0;
BA_ "GenSigTimeoutTime_DTCM" SG_ 1438 DM_Zone_Track_Conf 0;
BA_ "GenSigTimeoutTime_ECM" SG_ 1438 DM_Zone_Track_Conf 0;
BA_ "GenSigTimeoutTime_EVCU2" SG_ 1438 DM_Zone_Track_Conf 0;
BA_ "GenSigTimeoutTime_GNMM" SG_ 1438 DM_Zone_Track_Conf 0;
BA_ "GenSigTimeoutTime_HCP" SG_ 1438 DM_Zone_Track_Conf 0;
BA_ "GenSigTimeoutTime_IPC" SG_ 1438 DM_Zone_Track_Conf 0;
BA_ "GenSigTimeoutTime_RFHM" SG_ 1438 DM_Zone_Track_Conf 0;
BA_ "GenSigTimeoutTime_SGW" SG_ 1438 DM_Zone_Track_Conf 0;
BA_ "GenSigTimeoutTime_TCM" SG_ 1438 DM_Zone_Track_Conf 0;
BA_ "GenSigSendType" SG_ 1438 DMSM_System_Stat 3;
BA_ "GenSigTimeoutTime_AGSM" SG_ 1438 DMSM_System_Stat 0;
BA_ "GenSigTimeoutTime_BCM" SG_ 1438 DMSM_System_Stat 0;
BA_ "GenSigTimeoutTime_BSM" SG_ 1438 DMSM_System_Stat 0;
BA_ "GenSigTimeoutTime_DMSM" SG_ 1438 DMSM_System_Stat 0;
BA_ "GenSigTimeoutTime_DTCM" SG_ 1438 DMSM_System_Stat 0;
BA_ "GenSigTimeoutTime_ECM" SG_ 1438 DMSM_System_Stat 0;
BA_ "GenSigTimeoutTime_EVCU2" SG_ 1438 DMSM_System_Stat 0;
BA_ "GenSigTimeoutTime_GNMM" SG_ 1438 DMSM_System_Stat 0;
BA_ "GenSigTimeoutTime_HCP" SG_ 1438 DMSM_System_Stat 0;
BA_ "GenSigTimeoutTime_IPC" SG_ 1438 DMSM_System_Stat 0;
BA_ "GenSigTimeoutTime_RFHM" SG_ 1438 DMSM_System_Stat 0;
BA_ "GenSigTimeoutTime_SGW" SG_ 1438 DMSM_System_Stat 0;
BA_ "GenSigTimeoutTime_TCM" SG_ 1438 DMSM_System_Stat 0;
BA_ "GenSigSendType" SG_ 1438 Driver_Presence 3;
BA_ "GenSigTimeoutTime_AGSM" SG_ 1438 Driver_Presence 0;
BA_ "GenSigTimeoutTime_BCM" SG_ 1438 Driver_Presence 0;
BA_ "GenSigTimeoutTime_BSM" SG_ 1438 Driver_Presence 0;
BA_ "GenSigTimeoutTime_DMSM" SG_ 1438 Driver_Presence 0;
BA_ "GenSigTimeoutTime_DTCM" SG_ 1438 Driver_Presence 0;
BA_ "GenSigTimeoutTime_ECM" SG_ 1438 Driver_Presence 0;
BA_ "GenSigTimeoutTime_EVCU2" SG_ 1438 Driver_Presence 0;
BA_ "GenSigTimeoutTime_GNMM" SG_ 1438 Driver_Presence 0;
BA_ "GenSigTimeoutTime_HCP" SG_ 1438 Driver_Presence 0;
BA_ "GenSigTimeoutTime_IPC" SG_ 1438 Driver_Presence 0;
BA_ "GenSigTimeoutTime_RFHM" SG_ 1438 Driver_Presence 0;
BA_ "GenSigTimeoutTime_TCM" SG_ 1438 Driver_Presence 0;
BA_ "GenSigTimeoutTime_AGSM" SG_ 1438 MessageCounter_DRV_MONITOR1 0;
BA_ "GenSigTimeoutTime_BCM" SG_ 1438 MessageCounter_DRV_MONITOR1 0;
BA_ "GenSigTimeoutTime_BSM" SG_ 1438 MessageCounter_DRV_MONITOR1 0;
BA_ "GenSigTimeoutTime_DMSM" SG_ 1438 MessageCounter_DRV_MONITOR1 0;
BA_ "GenSigTimeoutTime_DTCM" SG_ 1438 MessageCounter_DRV_MONITOR1 0;
BA_ "GenSigTimeoutTime_ECM" SG_ 1438 MessageCounter_DRV_MONITOR1 0;
BA_ "GenSigTimeoutTime_EVCU2" SG_ 1438 MessageCounter_DRV_MONITOR1 0;
BA_ "GenSigTimeoutTime_GNMM" SG_ 1438 MessageCounter_DRV_MONITOR1 0;
BA_ "GenSigTimeoutTime_HCP" SG_ 1438 MessageCounter_DRV_MONITOR1 0;
BA_ "GenSigTimeoutTime_IPC" SG_ 1438 MessageCounter_DRV_MONITOR1 0;
BA_ "GenSigTimeoutTime_RFHM" SG_ 1438 MessageCounter_DRV_MONITOR1 0;
BA_ "GenSigTimeoutTime_SGW" SG_ 1438 MessageCounter_DRV_MONITOR1 0;
BA_ "GenSigTimeoutTime_TCM" SG_ 1438 MessageCounter_DRV_MONITOR1 0;
BA_ "GenSigTimeoutTime_AGSM" SG_ 2654814209 ECM_APPL1 0;
BA_ "GenSigTimeoutTime_BCM" SG_ 2654814209 ECM_APPL1 0;
BA_ "GenSigTimeoutTime_BSM" SG_ 2654814209 ECM_APPL1 0;
BA_ "GenSigTimeoutTime_CADM" SG_ 2654814209 ECM_APPL1 0;
BA_ "GenSigTimeoutTime_DMSM" SG_ 2654814209 ECM_APPL1 0;
BA_ "GenSigTimeoutTime_DTCM" SG_ 2654814209 ECM_APPL1 0;
BA_ "GenSigTimeoutTime_ECM" SG_ 2654814209 ECM_APPL1 0;
BA_ "GenSigTimeoutTime_EVCU2" SG_ 2654814209 ECM_APPL1 0;
BA_ "GenSigTimeoutTime_GNMM" SG_ 2654814209 ECM_APPL1 0;
BA_ "GenSigTimeoutTime_HCP" SG_ 2654814209 ECM_APPL1 0;
BA_ "GenSigTimeoutTime_IPC" SG_ 2654814209 ECM_APPL1 0;
BA_ "GenSigTimeoutTime_RFHM" SG_ 2654814209 ECM_APPL1 0;
BA_ "GenSigTimeoutTime_TCM" SG_ 2654814209 ECM_APPL1 0;
BA_ "GenSigTimeoutTime_AGSM" SG_ 2654817823 ECU_APPL_FD_AGSM 0;
BA_ "GenSigTimeoutTime_BCM" SG_ 2654817823 ECU_APPL_FD_AGSM 0;
BA_ "GenSigTimeoutTime_BSM" SG_ 2654817823 ECU_APPL_FD_AGSM 0;
BA_ "GenSigTimeoutTime_CADM" SG_ 2654817823 ECU_APPL_FD_AGSM 0;
BA_ "GenSigTimeoutTime_DMSM" SG_ 2654817823 ECU_APPL_FD_AGSM 0;
BA_ "GenSigTimeoutTime_DTCM" SG_ 2654817823 ECU_APPL_FD_AGSM 0;
BA_ "GenSigTimeoutTime_ECM" SG_ 2654817823 ECU_APPL_FD_AGSM 0;
BA_ "GenSigTimeoutTime_EVCU2" SG_ 2654817823 ECU_APPL_FD_AGSM 0;
BA_ "GenSigTimeoutTime_GNMM" SG_ 2654817823 ECU_APPL_FD_AGSM 0;
BA_ "GenSigTimeoutTime_HCP" SG_ 2654817823 ECU_APPL_FD_AGSM 0;
BA_ "GenSigTimeoutTime_IPC" SG_ 2654817823 ECU_APPL_FD_AGSM 0;
BA_ "GenSigTimeoutTime_RFHM" SG_ 2654817823 ECU_APPL_FD_AGSM 0;
BA_ "GenSigTimeoutTime_TCM" SG_ 2654817823 ECU_APPL_FD_AGSM 0;
BA_ "GenSigTimeoutTime_AGSM" SG_ 2654817818 ECU_APPL_FD_DTCM 0;
BA_ "GenSigTimeoutTime_BCM" SG_ 2654817818 ECU_APPL_FD_DTCM 0;
BA_ "GenSigTimeoutTime_BSM" SG_ 2654817818 ECU_APPL_FD_DTCM 0;
BA_ "GenSigTimeoutTime_CADM" SG_ 2654817818 ECU_APPL_FD_DTCM 0;
BA_ "GenSigTimeoutTime_DMSM" SG_ 2654817818 ECU_APPL_FD_DTCM 0;
BA_ "GenSigTimeoutTime_DTCM" SG_ 2654817818 ECU_APPL_FD_DTCM 0;
BA_ "GenSigTimeoutTime_ECM" SG_ 2654817818 ECU_APPL_FD_DTCM 0;
BA_ "GenSigTimeoutTime_EVCU2" SG_ 2654817818 ECU_APPL_FD_DTCM 0;
BA_ "GenSigTimeoutTime_GNMM" SG_ 2654817818 ECU_APPL_FD_DTCM 0;
BA_ "GenSigTimeoutTime_HCP" SG_ 2654817818 ECU_APPL_FD_DTCM 0;
BA_ "GenSigTimeoutTime_IPC" SG_ 2654817818 ECU_APPL_FD_DTCM 0;
BA_ "GenSigTimeoutTime_RFHM" SG_ 2654817818 ECU_APPL_FD_DTCM 0;
BA_ "GenSigTimeoutTime_TCM" SG_ 2654817818 ECU_APPL_FD_DTCM 0;
BA_ "GenSigTimeoutTime_AGSM" SG_ 2654817808 ECU_APPL_FD_ECM 0;
BA_ "GenSigTimeoutTime_BCM" SG_ 2654817808 ECU_APPL_FD_ECM 0;
BA_ "GenSigTimeoutTime_BSM" SG_ 2654817808 ECU_APPL_FD_ECM 0;
BA_ "GenSigTimeoutTime_CADM" SG_ 2654817808 ECU_APPL_FD_ECM 0;
BA_ "GenSigTimeoutTime_DMSM" SG_ 2654817808 ECU_APPL_FD_ECM 0;
BA_ "GenSigTimeoutTime_DTCM" SG_ 2654817808 ECU_APPL_FD_ECM 0;
BA_ "GenSigTimeoutTime_ECM" SG_ 2654817808 ECU_APPL_FD_ECM 0;
BA_ "GenSigTimeoutTime_EVCU2" SG_ 2654817808 ECU_APPL_FD_ECM 0;
BA_ "GenSigTimeoutTime_GNMM" SG_ 2654817808 ECU_APPL_FD_ECM 0;
BA_ "GenSigTimeoutTime_HCP" SG_ 2654817808 ECU_APPL_FD_ECM 0;
BA_ "GenSigTimeoutTime_IPC" SG_ 2654817808 ECU_APPL_FD_ECM 0;
BA_ "GenSigTimeoutTime_RFHM" SG_ 2654817808 ECU_APPL_FD_ECM 0;
BA_ "GenSigTimeoutTime_TCM" SG_ 2654817808 ECU_APPL_FD_ECM 0;
BA_ "GenSigTimeoutTime_AGSM" SG_ 2654817991 ECU_APPL_FD_RFHM 0;
BA_ "GenSigTimeoutTime_BCM" SG_ 2654817991 ECU_APPL_FD_RFHM 0;
BA_ "GenSigTimeoutTime_BSM" SG_ 2654817991 ECU_APPL_FD_RFHM 0;
BA_ "GenSigTimeoutTime_CADM" SG_ 2654817991 ECU_APPL_FD_RFHM 0;
BA_ "GenSigTimeoutTime_DMSM" SG_ 2654817991 ECU_APPL_FD_RFHM 0;
BA_ "GenSigTimeoutTime_DTCM" SG_ 2654817991 ECU_APPL_FD_RFHM 0;
BA_ "GenSigTimeoutTime_ECM" SG_ 2654817991 ECU_APPL_FD_RFHM 0;
BA_ "GenSigTimeoutTime_EVCU2" SG_ 2654817991 ECU_APPL_FD_RFHM 0;
BA_ "GenSigTimeoutTime_GNMM" SG_ 2654817991 ECU_APPL_FD_RFHM 0;
BA_ "GenSigTimeoutTime_HCP" SG_ 2654817991 ECU_APPL_FD_RFHM 0;
BA_ "GenSigTimeoutTime_IPC" SG_ 2654817991 ECU_APPL_FD_RFHM 0;
BA_ "GenSigTimeoutTime_RFHM" SG_ 2654817991 ECU_APPL_FD_RFHM 0;
BA_ "GenSigTimeoutTime_SGW" SG_ 2654817991 ECU_APPL_FD_RFHM 0;
BA_ "GenSigTimeoutTime_TCM" SG_ 2654817991 ECU_APPL_FD_RFHM 0;
BA_ "GenSigTimeoutTime_AGSM" SG_ 2654817816 ECU_APPL_FD_TCM 0;
BA_ "GenSigTimeoutTime_BCM" SG_ 2654817816 ECU_APPL_FD_TCM 0;
BA_ "GenSigTimeoutTime_BSM" SG_ 2654817816 ECU_APPL_FD_TCM 0;
BA_ "GenSigTimeoutTime_CADM" SG_ 2654817816 ECU_APPL_FD_TCM 0;
BA_ "GenSigTimeoutTime_DMSM" SG_ 2654817816 ECU_APPL_FD_TCM 0;
BA_ "GenSigTimeoutTime_DTCM" SG_ 2654817816 ECU_APPL_FD_TCM 0;
BA_ "GenSigTimeoutTime_ECM" SG_ 2654817816 ECU_APPL_FD_TCM 0;
BA_ "GenSigTimeoutTime_EVCU2" SG_ 2654817816 ECU_APPL_FD_TCM 0;
BA_ "GenSigTimeoutTime_GNMM" SG_ 2654817816 ECU_APPL_FD_TCM 0;
BA_ "GenSigTimeoutTime_HCP" SG_ 2654817816 ECU_APPL_FD_TCM 0;
BA_ "GenSigTimeoutTime_IPC" SG_ 2654817816 ECU_APPL_FD_TCM 0;
BA_ "GenSigTimeoutTime_RFHM" SG_ 2654817816 ECU_APPL_FD_TCM 0;
BA_ "GenSigTimeoutTime_SGW" SG_ 2654817816 ECU_APPL_FD_TCM 0;
BA_ "GenSigTimeoutTime_TCM" SG_ 2654817816 ECU_APPL_FD_TCM 0;
BA_ "GenSigStartValue" SG_ 1054 ACPressure 511;
BA_ "GenSigTimeoutTime_AGSM" SG_ 1054 ACPressure 0;
BA_ "GenSigTimeoutTime_BSM" SG_ 1054 ACPressure 0;
BA_ "GenSigTimeoutTime_CADM" SG_ 1054 ACPressure 0;
BA_ "GenSigTimeoutTime_DMSM" SG_ 1054 ACPressure 0;
BA_ "GenSigTimeoutTime_DTCM" SG_ 1054 ACPressure 0;
BA_ "GenSigTimeoutTime_ECM" SG_ 1054 ACPressure 0;
BA_ "GenSigTimeoutTime_EVCU2" SG_ 1054 ACPressure 0;
BA_ "GenSigTimeoutTime_GNMM" SG_ 1054 ACPressure 0;
BA_ "GenSigTimeoutTime_HCP" SG_ 1054 ACPressure 0;
BA_ "GenSigTimeoutTime_IPC" SG_ 1054 ACPressure 0;
BA_ "GenSigTimeoutTime_RFHM" SG_ 1054 ACPressure 0;
BA_ "GenSigTimeoutTime_SGW" SG_ 1054 ACPressure 0;
BA_ "GenSigTimeoutTime_TCM" SG_ 1054 ACPressure 0;
BA_ "GenSigTimeoutTime_AGSM" SG_ 1054 ACPressureFailSts 0;
BA_ "GenSigTimeoutTime_BCM" SG_ 1054 ACPressureFailSts 0;
BA_ "GenSigTimeoutTime_BSM" SG_ 1054 ACPressureFailSts 0;
BA_ "GenSigTimeoutTime_CADM" SG_ 1054 ACPressureFailSts 0;
BA_ "GenSigTimeoutTime_DMSM" SG_ 1054 ACPressureFailSts 0;
BA_ "GenSigTimeoutTime_DTCM" SG_ 1054 ACPressureFailSts 0;
BA_ "GenSigTimeoutTime_ECM" SG_ 1054 ACPressureFailSts 0;
BA_ "GenSigTimeoutTime_EVCU2" SG_ 1054 ACPressureFailSts 0;
BA_ "GenSigTimeoutTime_GNMM" SG_ 1054 ACPressureFailSts 0;
BA_ "GenSigTimeoutTime_HCP" SG_ 1054 ACPressureFailSts 0;
BA_ "GenSigTimeoutTime_IPC" SG_ 1054 ACPressureFailSts 0;
BA_ "GenSigTimeoutTime_RFHM" SG_ 1054 ACPressureFailSts 0;
BA_ "GenSigTimeoutTime_SGW" SG_ 1054 ACPressureFailSts 0;
BA_ "GenSigTimeoutTime_TCM" SG_ 1054 ACPressureFailSts 0;
BA_ "GenSigSendType" SG_ 1054 AGS2Posn 3;
BA_ "GenSigTimeoutTime_AGSM" SG_ 1054 AGS2Posn 0;
BA_ "GenSigTimeoutTime_BCM" SG_ 1054 AGS2Posn 0;
BA_ "GenSigTimeoutTime_BSM" SG_ 1054 AGS2Posn 0;
BA_ "GenSigTimeoutTime_CADM" SG_ 1054 AGS2Posn 0;
BA_ "GenSigTimeoutTime_DMSM" SG_ 1054 AGS2Posn 0;
BA_ "GenSigTimeoutTime_DTCM" SG_ 1054 AGS2Posn 0;
BA_ "GenSigTimeoutTime_ECM" SG_ 1054 AGS2Posn 0;
BA_ "GenSigTimeoutTime_EVCU2" SG_ 1054 AGS2Posn 0;
BA_ "GenSigTimeoutTime_GNMM" SG_ 1054 AGS2Posn 0;
BA_ "GenSigTimeoutTime_HCP" SG_ 1054 AGS2Posn 0;
BA_ "GenSigTimeoutTime_IPC" SG_ 1054 AGS2Posn 0;
BA_ "GenSigTimeoutTime_RFHM" SG_ 1054 AGS2Posn 0;
BA_ "GenSigTimeoutTime_SGW" SG_ 1054 AGS2Posn 0;
BA_ "GenSigTimeoutTime_TCM" SG_ 1054 AGS2Posn 0;
BA_ "GenSigStartValue" SG_ 1054 AtmosphericPressure_W 255;
BA_ "GenSigTimeoutTime_AGSM" SG_ 1054 AtmosphericPressure_W 0;
BA_ "GenSigTimeoutTime_CADM" SG_ 1054 AtmosphericPressure_W 0;
BA_ "GenSigTimeoutTime_DMSM" SG_ 1054 AtmosphericPressure_W 0;
BA_ "GenSigTimeoutTime_DTCM" SG_ 1054 AtmosphericPressure_W 0;
BA_ "GenSigTimeoutTime_ECM" SG_ 1054 AtmosphericPressure_W 0;
BA_ "GenSigTimeoutTime_EVCU2" SG_ 1054 AtmosphericPressure_W 0;
BA_ "GenSigTimeoutTime_GNMM" SG_ 1054 AtmosphericPressure_W 0;
BA_ "GenSigTimeoutTime_HCP" SG_ 1054 AtmosphericPressure_W 0;
BA_ "GenSigTimeoutTime_IPC" SG_ 1054 AtmosphericPressure_W 0;
BA_ "GenSigTimeoutTime_AGSM" SG_ 1054 AtmosphericPressureFailSts_W 0;
BA_ "GenSigTimeoutTime_BCM" SG_ 1054 AtmosphericPressureFailSts_W 0;
BA_ "GenSigTimeoutTime_BSM" SG_ 1054 AtmosphericPressureFailSts_W 0;
BA_ "GenSigTimeoutTime_CADM" SG_ 1054 AtmosphericPressureFailSts_W 0;
BA_ "GenSigTimeoutTime_DMSM" SG_ 1054 AtmosphericPressureFailSts_W 0;
BA_ "GenSigTimeoutTime_DTCM" SG_ 1054 AtmosphericPressureFailSts_W 0;
BA_ "GenSigTimeoutTime_ECM" SG_ 1054 AtmosphericPressureFailSts_W 0;
BA_ "GenSigTimeoutTime_EVCU2" SG_ 1054 AtmosphericPressureFailSts_W 0;
BA_ "GenSigTimeoutTime_GNMM" SG_ 1054 AtmosphericPressureFailSts_W 0;
BA_ "GenSigTimeoutTime_HCP" SG_ 1054 AtmosphericPressureFailSts_W 0;
BA_ "GenSigTimeoutTime_IPC" SG_ 1054 AtmosphericPressureFailSts_W 0;
BA_ "GenSigTimeoutTime_RFHM" SG_ 1054 AtmosphericPressureFailSts_W 0;
BA_ "GenSigStartValue" SG_ 1054 BoostVacGauge 100;
BA_ "GenSigSendType" SG_ 1054 BoostVacGauge 4;
BA_ "GenSigTimeoutTime_AGSM" SG_ 1054 BoostVacGauge 0;
BA_ "GenSigTimeoutTime_BCM" SG_ 1054 BoostVacGauge 0;
BA_ "GenSigTimeoutTime_BSM" SG_ 1054 BoostVacGauge 0;
BA_ "GenSigTimeoutTime_CADM" SG_ 1054 BoostVacGauge 0;
BA_ "GenSigTimeoutTime_DMSM" SG_ 1054 BoostVacGauge 0;
BA_ "GenSigTimeoutTime_DTCM" SG_ 1054 BoostVacGauge 0;
BA_ "GenSigTimeoutTime_ECM" SG_ 1054 BoostVacGauge 0;
BA_ "GenSigTimeoutTime_EVCU2" SG_ 1054 BoostVacGauge 0;
BA_ "GenSigTimeoutTime_GNMM" SG_ 1054 BoostVacGauge 0;
BA_ "GenSigTimeoutTime_HCP" SG_ 1054 BoostVacGauge 0;
BA_ "GenSigTimeoutTime_RFHM" SG_ 1054 BoostVacGauge 0;
BA_ "GenSigTimeoutTime_TCM" SG_ 1054 BoostVacGauge 0;
BA_ "GenSigTimeoutTime_AGSM" SG_ 1054 BrkSw1Stat 0;
BA_ "GenSigTimeoutTime_BSM" SG_ 1054 BrkSw1Stat 0;
BA_ "GenSigTimeoutTime_CADM" SG_ 1054 BrkSw1Stat 0;
BA_ "GenSigTimeoutTime_DMSM" SG_ 1054 BrkSw1Stat 0;
BA_ "GenSigTimeoutTime_DTCM" SG_ 1054 BrkSw1Stat 0;
BA_ "GenSigTimeoutTime_ECM" SG_ 1054 BrkSw1Stat 0;
BA_ "GenSigTimeoutTime_EVCU2" SG_ 1054 BrkSw1Stat 0;
BA_ "GenSigTimeoutTime_GNMM" SG_ 1054 BrkSw1Stat 0;
BA_ "GenSigTimeoutTime_HCP" SG_ 1054 BrkSw1Stat 0;
BA_ "GenSigTimeoutTime_IPC" SG_ 1054 BrkSw1Stat 0;
BA_ "GenSigTimeoutTime_RFHM" SG_ 1054 BrkSw1Stat 0;
BA_ "GenSigTimeoutTime_TCM" SG_ 1054 BrkSw1Stat 0;
BA_ "GenSigTimeoutTime_AGSM" SG_ 1054 BrkSw2Stat 0;
BA_ "GenSigTimeoutTime_BSM" SG_ 1054 BrkSw2Stat 0;
BA_ "GenSigTimeoutTime_CADM" SG_ 1054 BrkSw2Stat 0;
BA_ "GenSigTimeoutTime_DMSM" SG_ 1054 BrkSw2Stat 0;
BA_ "GenSigTimeoutTime_DTCM" SG_ 1054 BrkSw2Stat 0;
BA_ "GenSigTimeoutTime_ECM" SG_ 1054 BrkSw2Stat 0;
BA_ "GenSigTimeoutTime_EVCU2" SG_ 1054 BrkSw2Stat 0;
BA_ "GenSigTimeoutTime_GNMM" SG_ 1054 BrkSw2Stat 0;
BA_ "GenSigTimeoutTime_HCP" SG_ 1054 BrkSw2Stat 0;
BA_ "GenSigTimeoutTime_IPC" SG_ 1054 BrkSw2Stat 0;
BA_ "GenSigTimeoutTime_RFHM" SG_ 1054 BrkSw2Stat 0;
BA_ "GenSigTimeoutTime_TCM" SG_ 1054 BrkSw2Stat 0;
BA_ "GenSigTimeoutTime_AGSM" SG_ 1054 CRC_ENGINE1 0;
BA_ "GenSigTimeoutTime_BSM" SG_ 1054 CRC_ENGINE1 0;
BA_ "GenSigTimeoutTime_CADM" SG_ 1054 CRC_ENGINE1 0;
BA_ "GenSigTimeoutTime_DMSM" SG_ 1054 CRC_ENGINE1 0;
BA_ "GenSigTimeoutTime_DTCM" SG_ 1054 CRC_ENGINE1 0;
BA_ "GenSigTimeoutTime_ECM" SG_ 1054 CRC_ENGINE1 0;
BA_ "GenSigTimeoutTime_GNMM" SG_ 1054 CRC_ENGINE1 0;
BA_ "GenSigTimeoutTime_IPC" SG_ 1054 CRC_ENGINE1 0;
BA_ "GenSigTimeoutTime_SGW" SG_ 1054 CRC_ENGINE1 0;
BA_ "GenSigStartValue" SG_ 1054 EngMaxRPM_W 255;
BA_ "GenSigTimeoutTime_AGSM" SG_ 1054 EngMaxRPM_W 0;
BA_ "GenSigTimeoutTime_BCM" SG_ 1054 EngMaxRPM_W 0;
BA_ "GenSigTimeoutTime_BSM" SG_ 1054 EngMaxRPM_W 0;
BA_ "GenSigTimeoutTime_CADM" SG_ 1054 EngMaxRPM_W 0;
BA_ "GenSigTimeoutTime_DMSM" SG_ 1054 EngMaxRPM_W 0;
BA_ "GenSigTimeoutTime_DTCM" SG_ 1054 EngMaxRPM_W 0;
BA_ "GenSigTimeoutTime_ECM" SG_ 1054 EngMaxRPM_W 0;
BA_ "GenSigTimeoutTime_GNMM" SG_ 1054 EngMaxRPM_W 0;
BA_ "GenSigTimeoutTime_HCP" SG_ 1054 EngMaxRPM_W 0;
BA_ "GenSigTimeoutTime_IPC" SG_ 1054 EngMaxRPM_W 0;
BA_ "GenSigTimeoutTime_RFHM" SG_ 1054 EngMaxRPM_W 0;
BA_ "GenSigTimeoutTime_SGW" SG_ 1054 EngMaxRPM_W 0;
BA_ "GenSigTimeoutTime_AGSM" SG_ 1054 ESP_TrqRqEnabl 0;
BA_ "GenSigTimeoutTime_BSM" SG_ 1054 ESP_TrqRqEnabl 0;
BA_ "GenSigTimeoutTime_CADM" SG_ 1054 ESP_TrqRqEnabl 0;
BA_ "GenSigTimeoutTime_DMSM" SG_ 1054 ESP_TrqRqEnabl 0;
BA_ "GenSigTimeoutTime_DTCM" SG_ 1054 ESP_TrqRqEnabl 0;
BA_ "GenSigTimeoutTime_ECM" SG_ 1054 ESP_TrqRqEnabl 0;
BA_ "GenSigTimeoutTime_EVCU2" SG_ 1054 ESP_TrqRqEnabl 0;
BA_ "GenSigTimeoutTime_GNMM" SG_ 1054 ESP_TrqRqEnabl 0;
BA_ "GenSigTimeoutTime_HCP" SG_ 1054 ESP_TrqRqEnabl 0;
BA_ "GenSigTimeoutTime_IPC" SG_ 1054 ESP_TrqRqEnabl 0;
BA_ "GenSigTimeoutTime_RFHM" SG_ 1054 ESP_TrqRqEnabl 0;
BA_ "GenSigTimeoutTime_TCM" SG_ 1054 ESP_TrqRqEnabl 0;
BA_ "GenSigTimeoutTime_AGSM" SG_ 1054 HighPressureFuelSystemFailure 0;
BA_ "GenSigTimeoutTime_BCM" SG_ 1054 HighPressureFuelSystemFailure 0;
BA_ "GenSigTimeoutTime_BSM" SG_ 1054 HighPressureFuelSystemFailure 0;
BA_ "GenSigTimeoutTime_CADM" SG_ 1054 HighPressureFuelSystemFailure 0;
BA_ "GenSigTimeoutTime_DMSM" SG_ 1054 HighPressureFuelSystemFailure 0;
BA_ "GenSigTimeoutTime_DTCM" SG_ 1054 HighPressureFuelSystemFailure 0;
BA_ "GenSigTimeoutTime_ECM" SG_ 1054 HighPressureFuelSystemFailure 0;
BA_ "GenSigTimeoutTime_EVCU2" SG_ 1054 HighPressureFuelSystemFailure 0;
BA_ "GenSigTimeoutTime_GNMM" SG_ 1054 HighPressureFuelSystemFailure 0;
BA_ "GenSigTimeoutTime_HCP" SG_ 1054 HighPressureFuelSystemFailure 0;
BA_ "GenSigTimeoutTime_RFHM" SG_ 1054 HighPressureFuelSystemFailure 0;
BA_ "GenSigTimeoutTime_SGW" SG_ 1054 HighPressureFuelSystemFailure 0;
BA_ "GenSigTimeoutTime_TCM" SG_ 1054 HighPressureFuelSystemFailure 0;
BA_ "GenSigTimeoutTime_AGSM" SG_ 1054 Lv1CrsCtrlOff 0;
BA_ "GenSigTimeoutTime_BSM" SG_ 1054 Lv1CrsCtrlOff 0;
BA_ "GenSigTimeoutTime_CADM" SG_ 1054 Lv1CrsCtrlOff 0;
BA_ "GenSigTimeoutTime_DMSM" SG_ 1054 Lv1CrsCtrlOff 0;
BA_ "GenSigTimeoutTime_DTCM" SG_ 1054 Lv1CrsCtrlOff 0;
BA_ "GenSigTimeoutTime_ECM" SG_ 1054 Lv1CrsCtrlOff 0;
BA_ "GenSigTimeoutTime_EVCU2" SG_ 1054 Lv1CrsCtrlOff 0;
BA_ "GenSigTimeoutTime_GNMM" SG_ 1054 Lv1CrsCtrlOff 0;
BA_ "GenSigTimeoutTime_HCP" SG_ 1054 Lv1CrsCtrlOff 0;
BA_ "GenSigTimeoutTime_IPC" SG_ 1054 Lv1CrsCtrlOff 0;
BA_ "GenSigTimeoutTime_RFHM" SG_ 1054 Lv1CrsCtrlOff 0;
BA_ "GenSigTimeoutTime_TCM" SG_ 1054 Lv1CrsCtrlOff 0;
BA_ "GenSigTimeoutTime_AGSM" SG_ 1054 MessageCounter_ENGINE1 0;
BA_ "GenSigTimeoutTime_BSM" SG_ 1054 MessageCounter_ENGINE1 0;
BA_ "GenSigTimeoutTime_CADM" SG_ 1054 MessageCounter_ENGINE1 0;
BA_ "GenSigTimeoutTime_DMSM" SG_ 1054 MessageCounter_ENGINE1 0;
BA_ "GenSigTimeoutTime_DTCM" SG_ 1054 MessageCounter_ENGINE1 0;
BA_ "GenSigTimeoutTime_ECM" SG_ 1054 MessageCounter_ENGINE1 0;
BA_ "GenSigTimeoutTime_GNMM" SG_ 1054 MessageCounter_ENGINE1 0;
BA_ "GenSigTimeoutTime_IPC" SG_ 1054 MessageCounter_ENGINE1 0;
BA_ "GenSigTimeoutTime_SGW" SG_ 1054 MessageCounter_ENGINE1 0;
BA_ "GenSigStartValue" SG_ 1054 RawPVS1 255;
BA_ "GenSigTimeoutTime_AGSM" SG_ 1054 RawPVS1 0;
BA_ "GenSigTimeoutTime_BSM" SG_ 1054 RawPVS1 0;
BA_ "GenSigTimeoutTime_CADM" SG_ 1054 RawPVS1 0;
BA_ "GenSigTimeoutTime_DMSM" SG_ 1054 RawPVS1 0;
BA_ "GenSigTimeoutTime_DTCM" SG_ 1054 RawPVS1 0;
BA_ "GenSigTimeoutTime_ECM" SG_ 1054 RawPVS1 0;
BA_ "GenSigTimeoutTime_EVCU2" SG_ 1054 RawPVS1 0;
BA_ "GenSigTimeoutTime_GNMM" SG_ 1054 RawPVS1 0;
BA_ "GenSigTimeoutTime_HCP" SG_ 1054 RawPVS1 0;
BA_ "GenSigTimeoutTime_IPC" SG_ 1054 RawPVS1 0;
BA_ "GenSigTimeoutTime_RFHM" SG_ 1054 RawPVS1 0;
BA_ "GenSigTimeoutTime_TCM" SG_ 1054 RawPVS1 0;
BA_ "GenSigStartValue" SG_ 1054 RawPVS2 255;
BA_ "GenSigTimeoutTime_AGSM" SG_ 1054 RawPVS2 0;
BA_ "GenSigTimeoutTime_BSM" SG_ 1054 RawPVS2 0;
BA_ "GenSigTimeoutTime_CADM" SG_ 1054 RawPVS2 0;
BA_ "GenSigTimeoutTime_DMSM" SG_ 1054 RawPVS2 0;
BA_ "GenSigTimeoutTime_DTCM" SG_ 1054 RawPVS2 0;
BA_ "GenSigTimeoutTime_ECM" SG_ 1054 RawPVS2 0;
BA_ "GenSigTimeoutTime_EVCU2" SG_ 1054 RawPVS2 0;
BA_ "GenSigTimeoutTime_GNMM" SG_ 1054 RawPVS2 0;
BA_ "GenSigTimeoutTime_HCP" SG_ 1054 RawPVS2 0;
BA_ "GenSigTimeoutTime_IPC" SG_ 1054 RawPVS2 0;
BA_ "GenSigTimeoutTime_RFHM" SG_ 1054 RawPVS2 0;
BA_ "GenSigTimeoutTime_TCM" SG_ 1054 RawPVS2 0;
BA_ "GenSigStartValue" SG_ 1054 RawTPS1 255;
BA_ "GenSigTimeoutTime_AGSM" SG_ 1054 RawTPS1 0;
BA_ "GenSigTimeoutTime_BSM" SG_ 1054 RawTPS1 0;
BA_ "GenSigTimeoutTime_CADM" SG_ 1054 RawTPS1 0;
BA_ "GenSigTimeoutTime_DMSM" SG_ 1054 RawTPS1 0;
BA_ "GenSigTimeoutTime_DTCM" SG_ 1054 RawTPS1 0;
BA_ "GenSigTimeoutTime_ECM" SG_ 1054 RawTPS1 0;
BA_ "GenSigTimeoutTime_EVCU2" SG_ 1054 RawTPS1 0;
BA_ "GenSigTimeoutTime_GNMM" SG_ 1054 RawTPS1 0;
BA_ "GenSigTimeoutTime_HCP" SG_ 1054 RawTPS1 0;
BA_ "GenSigTimeoutTime_IPC" SG_ 1054 RawTPS1 0;
BA_ "GenSigTimeoutTime_RFHM" SG_ 1054 RawTPS1 0;
BA_ "GenSigTimeoutTime_TCM" SG_ 1054 RawTPS1 0;
BA_ "GenSigStartValue" SG_ 1054 RawTPS2 255;
BA_ "GenSigTimeoutTime_AGSM" SG_ 1054 RawTPS2 0;
BA_ "GenSigTimeoutTime_BSM" SG_ 1054 RawTPS2 0;
BA_ "GenSigTimeoutTime_CADM" SG_ 1054 RawTPS2 0;
BA_ "GenSigTimeoutTime_DMSM" SG_ 1054 RawTPS2 0;
BA_ "GenSigTimeoutTime_DTCM" SG_ 1054 RawTPS2 0;
BA_ "GenSigTimeoutTime_ECM" SG_ 1054 RawTPS2 0;
BA_ "GenSigTimeoutTime_EVCU2" SG_ 1054 RawTPS2 0;
BA_ "GenSigTimeoutTime_GNMM" SG_ 1054 RawTPS2 0;
BA_ "GenSigTimeoutTime_HCP" SG_ 1054 RawTPS2 0;
BA_ "GenSigTimeoutTime_IPC" SG_ 1054 RawTPS2 0;
BA_ "GenSigTimeoutTime_RFHM" SG_ 1054 RawTPS2 0;
BA_ "GenSigTimeoutTime_TCM" SG_ 1054 RawTPS2 0;
BA_ "GenSigTimeoutTime_AGSM" SG_ 1054 ThermalManagementActive_W 0;
BA_ "GenSigTimeoutTime_BCM" SG_ 1054 ThermalManagementActive_W 0;
BA_ "GenSigTimeoutTime_BSM" SG_ 1054 ThermalManagementActive_W 0;
BA_ "GenSigTimeoutTime_CADM" SG_ 1054 ThermalManagementActive_W 0;
BA_ "GenSigTimeoutTime_DMSM" SG_ 1054 ThermalManagementActive_W 0;
BA_ "GenSigTimeoutTime_DTCM" SG_ 1054 ThermalManagementActive_W 0;
BA_ "GenSigTimeoutTime_ECM" SG_ 1054 ThermalManagementActive_W 0;
BA_ "GenSigTimeoutTime_EVCU2" SG_ 1054 ThermalManagementActive_W 0;
BA_ "GenSigTimeoutTime_GNMM" SG_ 1054 ThermalManagementActive_W 0;
BA_ "GenSigTimeoutTime_HCP" SG_ 1054 ThermalManagementActive_W 0;
BA_ "GenSigTimeoutTime_IPC" SG_ 1054 ThermalManagementActive_W 0;
BA_ "GenSigTimeoutTime_RFHM" SG_ 1054 ThermalManagementActive_W 0;
BA_ "GenSigTimeoutTime_SGW" SG_ 1054 ThermalManagementActive_W 0;
BA_ "GenSigTimeoutTime_AGSM" SG_ 1054 ThrottlePosition 0;
BA_ "GenSigTimeoutTime_BSM" SG_ 1054 ThrottlePosition 0;
BA_ "GenSigTimeoutTime_CADM" SG_ 1054 ThrottlePosition 0;
BA_ "GenSigTimeoutTime_DMSM" SG_ 1054 ThrottlePosition 0;
BA_ "GenSigTimeoutTime_DTCM" SG_ 1054 ThrottlePosition 0;
BA_ "GenSigTimeoutTime_ECM" SG_ 1054 ThrottlePosition 0;
BA_ "GenSigTimeoutTime_EVCU2" SG_ 1054 ThrottlePosition 0;
BA_ "GenSigTimeoutTime_GNMM" SG_ 1054 ThrottlePosition 0;
BA_ "GenSigTimeoutTime_HCP" SG_ 1054 ThrottlePosition 0;
BA_ "GenSigTimeoutTime_IPC" SG_ 1054 ThrottlePosition 0;
BA_ "GenSigTimeoutTime_RFHM" SG_ 1054 ThrottlePosition 0;
BA_ "GenSigTimeoutTime_TCM" SG_ 1054 ThrottlePosition 0;
BA_ "GenSigTimeoutTime_AGSM" SG_ 1054 TransWarmUpMin_RPM 0;
BA_ "GenSigTimeoutTime_BCM" SG_ 1054 TransWarmUpMin_RPM 0;
BA_ "GenSigTimeoutTime_BSM" SG_ 1054 TransWarmUpMin_RPM 0;
BA_ "GenSigTimeoutTime_CADM" SG_ 1054 TransWarmUpMin_RPM 0;
BA_ "GenSigTimeoutTime_DMSM" SG_ 1054 TransWarmUpMin_RPM 0;
BA_ "GenSigTimeoutTime_DTCM" SG_ 1054 TransWarmUpMin_RPM 0;
BA_ "GenSigTimeoutTime_ECM" SG_ 1054 TransWarmUpMin_RPM 0;
BA_ "GenSigTimeoutTime_EVCU2" SG_ 1054 TransWarmUpMin_RPM 0;
BA_ "GenSigTimeoutTime_GNMM" SG_ 1054 TransWarmUpMin_RPM 0;
BA_ "GenSigTimeoutTime_HCP" SG_ 1054 TransWarmUpMin_RPM 0;
BA_ "GenSigTimeoutTime_IPC" SG_ 1054 TransWarmUpMin_RPM 0;
BA_ "GenSigTimeoutTime_RFHM" SG_ 1054 TransWarmUpMin_RPM 0;
BA_ "GenSigTimeoutTime_SGW" SG_ 1054 TransWarmUpMin_RPM 0;
BA_ "GenSigTimeoutTime_AGSM" SG_ 1054 TransWarmUpReq 0;
BA_ "GenSigTimeoutTime_BCM" SG_ 1054 TransWarmUpReq 0;
BA_ "GenSigTimeoutTime_BSM" SG_ 1054 TransWarmUpReq 0;
BA_ "GenSigTimeoutTime_CADM" SG_ 1054 TransWarmUpReq 0;
BA_ "GenSigTimeoutTime_DMSM" SG_ 1054 TransWarmUpReq 0;
BA_ "GenSigTimeoutTime_DTCM" SG_ 1054 TransWarmUpReq 0;
BA_ "GenSigTimeoutTime_ECM" SG_ 1054 TransWarmUpReq 0;
BA_ "GenSigTimeoutTime_EVCU2" SG_ 1054 TransWarmUpReq 0;
BA_ "GenSigTimeoutTime_GNMM" SG_ 1054 TransWarmUpReq 0;
BA_ "GenSigTimeoutTime_HCP" SG_ 1054 TransWarmUpReq 0;
BA_ "GenSigTimeoutTime_IPC" SG_ 1054 TransWarmUpReq 0;
BA_ "GenSigTimeoutTime_RFHM" SG_ 1054 TransWarmUpReq 0;
BA_ "GenSigTimeoutTime_SGW" SG_ 1054 TransWarmUpReq 0;
BA_ "GenSigStartValue" SG_ 262 AlternatorFail_W 1;
BA_ "GenSigTimeoutTime_AGSM" SG_ 262 AlternatorFail_W 0;
BA_ "GenSigTimeoutTime_BCM" SG_ 262 AlternatorFail_W 0;
BA_ "GenSigTimeoutTime_BSM" SG_ 262 AlternatorFail_W 0;
BA_ "GenSigTimeoutTime_CADM" SG_ 262 AlternatorFail_W 0;
BA_ "GenSigTimeoutTime_DMSM" SG_ 262 AlternatorFail_W 0;
BA_ "GenSigTimeoutTime_DTCM" SG_ 262 AlternatorFail_W 0;
BA_ "GenSigTimeoutTime_ECM" SG_ 262 AlternatorFail_W 0;
BA_ "GenSigTimeoutTime_EVCU2" SG_ 262 AlternatorFail_W 0;
BA_ "GenSigTimeoutTime_GNMM" SG_ 262 AlternatorFail_W 0;
BA_ "GenSigTimeoutTime_HCP" SG_ 262 AlternatorFail_W 0;
BA_ "GenSigTimeoutTime_RFHM" SG_ 262 AlternatorFail_W 0;
BA_ "GenSigTimeoutTime_TCM" SG_ 262 AlternatorFail_W 0;
BA_ "GenSigTimeoutTime_AGSM" SG_ 262 CrankHold_W 0;
BA_ "GenSigTimeoutTime_BSM" SG_ 262 CrankHold_W 0;
BA_ "GenSigTimeoutTime_CADM" SG_ 262 CrankHold_W 0;
BA_ "GenSigTimeoutTime_DMSM" SG_ 262 CrankHold_W 0;
BA_ "GenSigTimeoutTime_DTCM" SG_ 262 CrankHold_W 0;
BA_ "GenSigTimeoutTime_ECM" SG_ 262 CrankHold_W 0;
BA_ "GenSigTimeoutTime_EVCU2" SG_ 262 CrankHold_W 0;
BA_ "GenSigTimeoutTime_GNMM" SG_ 262 CrankHold_W 0;
BA_ "GenSigTimeoutTime_HCP" SG_ 262 CrankHold_W 0;
BA_ "GenSigTimeoutTime_IPC" SG_ 262 CrankHold_W 0;
BA_ "GenSigTimeoutTime_RFHM" SG_ 262 CrankHold_W 0;
BA_ "GenSigTimeoutTime_TCM" SG_ 262 CrankHold_W 0;
BA_ "GenSigTimeoutTime_AGSM" SG_ 262 CRC_ENGINE2 0;
BA_ "GenSigTimeoutTime_ECM" SG_ 262 CRC_ENGINE2 0;
BA_ "GenSigTimeoutTime_GNMM" SG_ 262 CRC_ENGINE2 0;
BA_ "GenSigTimeoutTime_RFHM" SG_ 262 CRC_ENGINE2 0;
BA_ "GenSigTimeoutTime_SGW" SG_ 262 CRC_ENGINE2 0;
BA_ "GenSigTimeoutTime_AGSM" SG_ 262 ECM_Ack_DriveMode 0;
BA_ "GenSigTimeoutTime_BCM" SG_ 262 ECM_Ack_DriveMode 0;
BA_ "GenSigTimeoutTime_BSM" SG_ 262 ECM_Ack_DriveMode 0;
BA_ "GenSigTimeoutTime_CADM" SG_ 262 ECM_Ack_DriveMode 0;
BA_ "GenSigTimeoutTime_DMSM" SG_ 262 ECM_Ack_DriveMode 0;
BA_ "GenSigTimeoutTime_DTCM" SG_ 262 ECM_Ack_DriveMode 0;
BA_ "GenSigTimeoutTime_ECM" SG_ 262 ECM_Ack_DriveMode 0;
BA_ "GenSigTimeoutTime_EVCU2" SG_ 262 ECM_Ack_DriveMode 0;
BA_ "GenSigTimeoutTime_GNMM" SG_ 262 ECM_Ack_DriveMode 0;
BA_ "GenSigTimeoutTime_HCP" SG_ 262 ECM_Ack_DriveMode 0;
BA_ "GenSigTimeoutTime_IPC" SG_ 262 ECM_Ack_DriveMode 0;
BA_ "GenSigTimeoutTime_RFHM" SG_ 262 ECM_Ack_DriveMode 0;
BA_ "GenSigTimeoutTime_SGW" SG_ 262 ECM_Ack_DriveMode 0;
BA_ "GenSigTimeoutTime_TCM" SG_ 262 ECM_Ack_DriveMode 0;
BA_ "GenSigTimeoutTime_AGSM" SG_ 262 ECM_LHOM_Trans_W 0;
BA_ "GenSigTimeoutTime_BCM" SG_ 262 ECM_LHOM_Trans_W 0;
BA_ "GenSigTimeoutTime_BSM" SG_ 262 ECM_LHOM_Trans_W 0;
BA_ "GenSigTimeoutTime_CADM" SG_ 262 ECM_LHOM_Trans_W 0;
BA_ "GenSigTimeoutTime_DMSM" SG_ 262 ECM_LHOM_Trans_W 0;
BA_ "GenSigTimeoutTime_DTCM" SG_ 262 ECM_LHOM_Trans_W 0;
BA_ "GenSigTimeoutTime_ECM" SG_ 262 ECM_LHOM_Trans_W 0;
BA_ "GenSigTimeoutTime_EVCU2" SG_ 262 ECM_LHOM_Trans_W 0;
BA_ "GenSigTimeoutTime_GNMM" SG_ 262 ECM_LHOM_Trans_W 0;
BA_ "GenSigTimeoutTime_HCP" SG_ 262 ECM_LHOM_Trans_W 0;
BA_ "GenSigTimeoutTime_IPC" SG_ 262 ECM_LHOM_Trans_W 0;
BA_ "GenSigTimeoutTime_RFHM" SG_ 262 ECM_LHOM_Trans_W 0;
BA_ "GenSigTimeoutTime_SGW" SG_ 262 ECM_LHOM_Trans_W 0;
BA_ "GenSigTimeoutTime_AGSM" SG_ 262 ECM_LHOM_W 0;
BA_ "GenSigTimeoutTime_BCM" SG_ 262 ECM_LHOM_W 0;
BA_ "GenSigTimeoutTime_BSM" SG_ 262 ECM_LHOM_W 0;
BA_ "GenSigTimeoutTime_CADM" SG_ 262 ECM_LHOM_W 0;
BA_ "GenSigTimeoutTime_DMSM" SG_ 262 ECM_LHOM_W 0;
BA_ "GenSigTimeoutTime_DTCM" SG_ 262 ECM_LHOM_W 0;
BA_ "GenSigTimeoutTime_ECM" SG_ 262 ECM_LHOM_W 0;
BA_ "GenSigTimeoutTime_EVCU2" SG_ 262 ECM_LHOM_W 0;
BA_ "GenSigTimeoutTime_GNMM" SG_ 262 ECM_LHOM_W 0;
BA_ "GenSigTimeoutTime_HCP" SG_ 262 ECM_LHOM_W 0;
BA_ "GenSigTimeoutTime_IPC" SG_ 262 ECM_LHOM_W 0;
BA_ "GenSigTimeoutTime_RFHM" SG_ 262 ECM_LHOM_W 0;
BA_ "GenSigTimeoutTime_SGW" SG_ 262 ECM_LHOM_W 0;
BA_ "GenSigTimeoutTime_AGSM" SG_ 262 EngineFrictionTorque_W 0;
BA_ "GenSigTimeoutTime_BSM" SG_ 262 EngineFrictionTorque_W 0;
BA_ "GenSigTimeoutTime_CADM" SG_ 262 EngineFrictionTorque_W 0;
BA_ "GenSigTimeoutTime_DMSM" SG_ 262 EngineFrictionTorque_W 0;
BA_ "GenSigTimeoutTime_DTCM" SG_ 262 EngineFrictionTorque_W 0;
BA_ "GenSigTimeoutTime_ECM" SG_ 262 EngineFrictionTorque_W 0;
BA_ "GenSigTimeoutTime_EVCU2" SG_ 262 EngineFrictionTorque_W 0;
BA_ "GenSigTimeoutTime_GNMM" SG_ 262 EngineFrictionTorque_W 0;
BA_ "GenSigTimeoutTime_HCP" SG_ 262 EngineFrictionTorque_W 0;
BA_ "GenSigTimeoutTime_IPC" SG_ 262 EngineFrictionTorque_W 0;
BA_ "GenSigTimeoutTime_RFHM" SG_ 262 EngineFrictionTorque_W 0;
BA_ "GenSigTimeoutTime_TCM" SG_ 262 EngineFrictionTorque_W 0;
BA_ "GenSigTimeoutTime_AGSM" SG_ 262 EngineIdleRefSpeed 0;
BA_ "GenSigTimeoutTime_BCM" SG_ 262 EngineIdleRefSpeed 0;
BA_ "GenSigTimeoutTime_CADM" SG_ 262 EngineIdleRefSpeed 0;
BA_ "GenSigTimeoutTime_DMSM" SG_ 262 EngineIdleRefSpeed 0;
BA_ "GenSigTimeoutTime_DTCM" SG_ 262 EngineIdleRefSpeed 0;
BA_ "GenSigTimeoutTime_ECM" SG_ 262 EngineIdleRefSpeed 0;
BA_ "GenSigTimeoutTime_EVCU2" SG_ 262 EngineIdleRefSpeed 0;
BA_ "GenSigTimeoutTime_GNMM" SG_ 262 EngineIdleRefSpeed 0;
BA_ "GenSigTimeoutTime_HCP" SG_ 262 EngineIdleRefSpeed 0;
BA_ "GenSigTimeoutTime_IPC" SG_ 262 EngineIdleRefSpeed 0;
BA_ "GenSigTimeoutTime_RFHM" SG_ 262 EngineIdleRefSpeed 0;
BA_ "GenSigTimeoutTime_SGW" SG_ 262 EngineIdleRefSpeed 0;
BA_ "GenSigTimeoutTime_AGSM" SG_ 262 EngineSailingRq 0;
BA_ "GenSigTimeoutTime_BCM" SG_ 262 EngineSailingRq 0;
BA_ "GenSigTimeoutTime_BSM" SG_ 262 EngineSailingRq 0;
BA_ "GenSigTimeoutTime_CADM" SG_ 262 EngineSailingRq 0;
BA_ "GenSigTimeoutTime_DMSM" SG_ 262 EngineSailingRq 0;
BA_ "GenSigTimeoutTime_DTCM" SG_ 262 EngineSailingRq 0;
BA_ "GenSigTimeoutTime_ECM" SG_ 262 EngineSailingRq 0;
BA_ "GenSigTimeoutTime_EVCU2" SG_ 262 EngineSailingRq 0;
BA_ "GenSigTimeoutTime_GNMM" SG_ 262 EngineSailingRq 0;
BA_ "GenSigTimeoutTime_HCP" SG_ 262 EngineSailingRq 0;
BA_ "GenSigTimeoutTime_IPC" SG_ 262 EngineSailingRq 0;
BA_ "GenSigTimeoutTime_RFHM" SG_ 262 EngineSailingRq 0;
BA_ "GenSigTimeoutTime_SGW" SG_ 262 EngineSailingRq 0;
BA_ "GenSigTimeoutTime_AGSM" SG_ 262 EngineSpeedFailSts_W 0;
BA_ "GenSigTimeoutTime_BSM" SG_ 262 EngineSpeedFailSts_W 0;
BA_ "GenSigTimeoutTime_CADM" SG_ 262 EngineSpeedFailSts_W 0;
BA_ "GenSigTimeoutTime_DMSM" SG_ 262 EngineSpeedFailSts_W 0;
BA_ "GenSigTimeoutTime_ECM" SG_ 262 EngineSpeedFailSts_W 0;
BA_ "GenSigTimeoutTime_GNMM" SG_ 262 EngineSpeedFailSts_W 0;
BA_ "GenSigTimeoutTime_HCP" SG_ 262 EngineSpeedFailSts_W 0;
BA_ "GenSigTimeoutTime_RFHM" SG_ 262 EngineSpeedFailSts_W 0;
BA_ "GenSigTimeoutTime_TCM" SG_ 262 EngineSpeedFailSts_W 0;
BA_ "GenSigStartValue" SG_ 262 EngineSts_W 3;
BA_ "GenSigTimeoutTime_AGSM" SG_ 262 EngineSts_W 0;
BA_ "GenSigTimeoutTime_CADM" SG_ 262 EngineSts_W 0;
BA_ "GenSigTimeoutTime_DMSM" SG_ 262 EngineSts_W 0;
BA_ "GenSigTimeoutTime_DTCM" SG_ 262 EngineSts_W 0;
BA_ "GenSigTimeoutTime_GNMM" SG_ 262 EngineSts_W 0;
BA_ "GenSigTimeoutTime_HCP" SG_ 262 EngineSts_W 0;
BA_ "GenSigTimeoutTime_RFHM" SG_ 262 EngineSts_W 0;
BA_ "GenSigStartValue" SG_ 262 EngRPM_Tach 65535;
BA_ "GenSigTimeoutTime_AGSM" SG_ 262 EngRPM_Tach 0;
BA_ "GenSigTimeoutTime_BCM" SG_ 262 EngRPM_Tach 0;
BA_ "GenSigTimeoutTime_BSM" SG_ 262 EngRPM_Tach 0;
BA_ "GenSigTimeoutTime_CADM" SG_ 262 EngRPM_Tach 0;
BA_ "GenSigTimeoutTime_DMSM" SG_ 262 EngRPM_Tach 0;
BA_ "GenSigTimeoutTime_DTCM" SG_ 262 EngRPM_Tach 0;
BA_ "GenSigTimeoutTime_ECM" SG_ 262 EngRPM_Tach 0;
BA_ "GenSigTimeoutTime_EVCU2" SG_ 262 EngRPM_Tach 0;
BA_ "GenSigTimeoutTime_GNMM" SG_ 262 EngRPM_Tach 0;
BA_ "GenSigTimeoutTime_HCP" SG_ 262 EngRPM_Tach 0;
BA_ "GenSigTimeoutTime_RFHM" SG_ 262 EngRPM_Tach 0;
BA_ "GenSigTimeoutTime_SGW" SG_ 262 EngRPM_Tach 0;
BA_ "GenSigTimeoutTime_TCM" SG_ 262 EngRPM_Tach 0;
BA_ "GenSigTimeoutTime_AGSM" SG_ 262 EngTrq_Enbl_Rq_TCM_W 0;
BA_ "GenSigTimeoutTime_BSM" SG_ 262 EngTrq_Enbl_Rq_TCM_W 0;
BA_ "GenSigTimeoutTime_CADM" SG_ 262 EngTrq_Enbl_Rq_TCM_W 0;
BA_ "GenSigTimeoutTime_DMSM" SG_ 262 EngTrq_Enbl_Rq_TCM_W 0;
BA_ "GenSigTimeoutTime_DTCM" SG_ 262 EngTrq_Enbl_Rq_TCM_W 0;
BA_ "GenSigTimeoutTime_ECM" SG_ 262 EngTrq_Enbl_Rq_TCM_W 0;
BA_ "GenSigTimeoutTime_EVCU2" SG_ 262 EngTrq_Enbl_Rq_TCM_W 0;
BA_ "GenSigTimeoutTime_GNMM" SG_ 262 EngTrq_Enbl_Rq_TCM_W 0;
BA_ "GenSigTimeoutTime_HCP" SG_ 262 EngTrq_Enbl_Rq_TCM_W 0;
BA_ "GenSigTimeoutTime_IPC" SG_ 262 EngTrq_Enbl_Rq_TCM_W 0;
BA_ "GenSigTimeoutTime_RFHM" SG_ 262 EngTrq_Enbl_Rq_TCM_W 0;
BA_ "GenSigTimeoutTime_SGW" SG_ 262 EngTrq_Enbl_Rq_TCM_W 0;
BA_ "GenSigTimeoutTime_AGSM" SG_ 262 ESS_EBOOST_BRKHLD_STATUS 0;
BA_ "GenSigTimeoutTime_BCM" SG_ 262 ESS_EBOOST_BRKHLD_STATUS 0;
BA_ "GenSigTimeoutTime_CADM" SG_ 262 ESS_EBOOST_BRKHLD_STATUS 0;
BA_ "GenSigTimeoutTime_DMSM" SG_ 262 ESS_EBOOST_BRKHLD_STATUS 0;
BA_ "GenSigTimeoutTime_DTCM" SG_ 262 ESS_EBOOST_BRKHLD_STATUS 0;
BA_ "GenSigTimeoutTime_ECM" SG_ 262 ESS_EBOOST_BRKHLD_STATUS 0;
BA_ "GenSigTimeoutTime_EVCU2" SG_ 262 ESS_EBOOST_BRKHLD_STATUS 0;
BA_ "GenSigTimeoutTime_GNMM" SG_ 262 ESS_EBOOST_BRKHLD_STATUS 0;
BA_ "GenSigTimeoutTime_HCP" SG_ 262 ESS_EBOOST_BRKHLD_STATUS 0;
BA_ "GenSigTimeoutTime_IPC" SG_ 262 ESS_EBOOST_BRKHLD_STATUS 0;
BA_ "GenSigTimeoutTime_RFHM" SG_ 262 ESS_EBOOST_BRKHLD_STATUS 0;
BA_ "GenSigTimeoutTime_SGW" SG_ 262 ESS_EBOOST_BRKHLD_STATUS 0;
BA_ "GenSigTimeoutTime_TCM" SG_ 262 ESS_EBOOST_BRKHLD_STATUS 0;
BA_ "GenSigStartValue" SG_ 262 ESS_ENG_ST_W 15;
BA_ "GenSigSendType" SG_ 262 ESS_ENG_ST_W 3;
BA_ "GenSigTimeoutTime_AGSM" SG_ 262 ESS_ENG_ST_W 0;
BA_ "GenSigTimeoutTime_CADM" SG_ 262 ESS_ENG_ST_W 0;
BA_ "GenSigTimeoutTime_ECM" SG_ 262 ESS_ENG_ST_W 0;
BA_ "GenSigTimeoutTime_EVCU2" SG_ 262 ESS_ENG_ST_W 0;
BA_ "GenSigTimeoutTime_GNMM" SG_ 262 ESS_ENG_ST_W 0;
BA_ "GenSigTimeoutTime_HCP" SG_ 262 ESS_ENG_ST_W 0;
BA_ "GenSigTimeoutTime_RFHM" SG_ 262 ESS_ENG_ST_W 0;
BA_ "GenSigTimeoutTime_AGSM" SG_ 262 ESS_RqShftPark_W 0;
BA_ "GenSigTimeoutTime_CADM" SG_ 262 ESS_RqShftPark_W 0;
BA_ "GenSigTimeoutTime_DMSM" SG_ 262 ESS_RqShftPark_W 0;
BA_ "GenSigTimeoutTime_DTCM" SG_ 262 ESS_RqShftPark_W 0;
BA_ "GenSigTimeoutTime_ECM" SG_ 262 ESS_RqShftPark_W 0;
BA_ "GenSigTimeoutTime_EVCU2" SG_ 262 ESS_RqShftPark_W 0;
BA_ "GenSigTimeoutTime_GNMM" SG_ 262 ESS_RqShftPark_W 0;
BA_ "GenSigTimeoutTime_HCP" SG_ 262 ESS_RqShftPark_W 0;
BA_ "GenSigTimeoutTime_IPC" SG_ 262 ESS_RqShftPark_W 0;
BA_ "GenSigTimeoutTime_RFHM" SG_ 262 ESS_RqShftPark_W 0;
BA_ "GenSigTimeoutTime_SGW" SG_ 262 ESS_RqShftPark_W 0;
BA_ "GenSigTimeoutTime_AGSM" SG_ 262 EVRDesiredSetpoint 0;
BA_ "GenSigTimeoutTime_BCM" SG_ 262 EVRDesiredSetpoint 0;
BA_ "GenSigTimeoutTime_BSM" SG_ 262 EVRDesiredSetpoint 0;
BA_ "GenSigTimeoutTime_CADM" SG_ 262 EVRDesiredSetpoint 0;
BA_ "GenSigTimeoutTime_DMSM" SG_ 262 EVRDesiredSetpoint 0;
BA_ "GenSigTimeoutTime_DTCM" SG_ 262 EVRDesiredSetpoint 0;
BA_ "GenSigTimeoutTime_ECM" SG_ 262 EVRDesiredSetpoint 0;
BA_ "GenSigTimeoutTime_GNMM" SG_ 262 EVRDesiredSetpoint 0;
BA_ "GenSigTimeoutTime_IPC" SG_ 262 EVRDesiredSetpoint 0;
BA_ "GenSigTimeoutTime_RFHM" SG_ 262 EVRDesiredSetpoint 0;
BA_ "GenSigTimeoutTime_SGW" SG_ 262 EVRDesiredSetpoint 0;
BA_ "GenSigTimeoutTime_TCM" SG_ 262 EVRDesiredSetpoint 0;
BA_ "GenSigTimeoutTime_AGSM" SG_ 262 FuelConsumption_GAG_3 0;
BA_ "GenSigTimeoutTime_BCM" SG_ 262 FuelConsumption_GAG_3 0;
BA_ "GenSigTimeoutTime_BSM" SG_ 262 FuelConsumption_GAG_3 0;
BA_ "GenSigTimeoutTime_CADM" SG_ 262 FuelConsumption_GAG_3 0;
BA_ "GenSigTimeoutTime_DMSM" SG_ 262 FuelConsumption_GAG_3 0;
BA_ "GenSigTimeoutTime_DTCM" SG_ 262 FuelConsumption_GAG_3 0;
BA_ "GenSigTimeoutTime_ECM" SG_ 262 FuelConsumption_GAG_3 0;
BA_ "GenSigTimeoutTime_GNMM" SG_ 262 FuelConsumption_GAG_3 0;
BA_ "GenSigTimeoutTime_HCP" SG_ 262 FuelConsumption_GAG_3 0;
BA_ "GenSigTimeoutTime_RFHM" SG_ 262 FuelConsumption_GAG_3 0;
BA_ "GenSigTimeoutTime_TCM" SG_ 262 FuelConsumption_GAG_3 0;
BA_ "GenSigTimeoutTime_AGSM" SG_ 262 FullOFC_Actv 0;
BA_ "GenSigTimeoutTime_BCM" SG_ 262 FullOFC_Actv 0;
BA_ "GenSigTimeoutTime_BSM" SG_ 262 FullOFC_Actv 0;
BA_ "GenSigTimeoutTime_CADM" SG_ 262 FullOFC_Actv 0;
BA_ "GenSigTimeoutTime_DMSM" SG_ 262 FullOFC_Actv 0;
BA_ "GenSigTimeoutTime_DTCM" SG_ 262 FullOFC_Actv 0;
BA_ "GenSigTimeoutTime_ECM" SG_ 262 FullOFC_Actv 0;
BA_ "GenSigTimeoutTime_EVCU2" SG_ 262 FullOFC_Actv 0;
BA_ "GenSigTimeoutTime_GNMM" SG_ 262 FullOFC_Actv 0;
BA_ "GenSigTimeoutTime_HCP" SG_ 262 FullOFC_Actv 0;
BA_ "GenSigTimeoutTime_IPC" SG_ 262 FullOFC_Actv 0;
BA_ "GenSigTimeoutTime_RFHM" SG_ 262 FullOFC_Actv 0;
BA_ "GenSigTimeoutTime_SGW" SG_ 262 FullOFC_Actv 0;
BA_ "GenSigTimeoutTime_TCM" SG_ 262 FullOFC_Actv 0;
BA_ "GenSigTimeoutTime_AGSM" SG_ 262 GasPedalGradient_W 0;
BA_ "GenSigTimeoutTime_BSM" SG_ 262 GasPedalGradient_W 0;
BA_ "GenSigTimeoutTime_CADM" SG_ 262 GasPedalGradient_W 0;
BA_ "GenSigTimeoutTime_DMSM" SG_ 262 GasPedalGradient_W 0;
BA_ "GenSigTimeoutTime_DTCM" SG_ 262 GasPedalGradient_W 0;
BA_ "GenSigTimeoutTime_ECM" SG_ 262 GasPedalGradient_W 0;
BA_ "GenSigTimeoutTime_EVCU2" SG_ 262 GasPedalGradient_W 0;
BA_ "GenSigTimeoutTime_GNMM" SG_ 262 GasPedalGradient_W 0;
BA_ "GenSigTimeoutTime_HCP" SG_ 262 GasPedalGradient_W 0;
BA_ "GenSigTimeoutTime_IPC" SG_ 262 GasPedalGradient_W 0;
BA_ "GenSigTimeoutTime_RFHM" SG_ 262 GasPedalGradient_W 0;
BA_ "GenSigTimeoutTime_SGW" SG_ 262 GasPedalGradient_W 0;
BA_ "GenSigTimeoutTime_TCM" SG_ 262 GasPedalGradient_W 0;
BA_ "GenSigTimeoutTime_AGSM" SG_ 262 GasPedalPosition_W 0;
BA_ "GenSigTimeoutTime_CADM" SG_ 262 GasPedalPosition_W 0;
BA_ "GenSigTimeoutTime_DMSM" SG_ 262 GasPedalPosition_W 0;
BA_ "GenSigTimeoutTime_EVCU2" SG_ 262 GasPedalPosition_W 0;
BA_ "GenSigTimeoutTime_GNMM" SG_ 262 GasPedalPosition_W 0;
BA_ "GenSigTimeoutTime_IPC" SG_ 262 GasPedalPosition_W 0;
BA_ "GenSigTimeoutTime_RFHM" SG_ 262 GasPedalPosition_W 0;
BA_ "GenSigTimeoutTime_AGSM" SG_ 262 GasPedalPositionFailSts_W 0;
BA_ "GenSigTimeoutTime_CADM" SG_ 262 GasPedalPositionFailSts_W 0;
BA_ "GenSigTimeoutTime_DMSM" SG_ 262 GasPedalPositionFailSts_W 0;
BA_ "GenSigTimeoutTime_ECM" SG_ 262 GasPedalPositionFailSts_W 0;
BA_ "GenSigTimeoutTime_EVCU2" SG_ 262 GasPedalPositionFailSts_W 0;
BA_ "GenSigTimeoutTime_GNMM" SG_ 262 GasPedalPositionFailSts_W 0;
BA_ "GenSigTimeoutTime_HCP" SG_ 262 GasPedalPositionFailSts_W 0;
BA_ "GenSigTimeoutTime_IPC" SG_ 262 GasPedalPositionFailSts_W 0;
BA_ "GenSigTimeoutTime_RFHM" SG_ 262 GasPedalPositionFailSts_W 0;
BA_ "GenSigStartValue" SG_ 262 IntakeAirTemperature_W 65;
BA_ "GenSigTimeoutTime_AGSM" SG_ 262 IntakeAirTemperature_W 0;
BA_ "GenSigTimeoutTime_BCM" SG_ 262 IntakeAirTemperature_W 0;
BA_ "GenSigTimeoutTime_BSM" SG_ 262 IntakeAirTemperature_W 0;
BA_ "GenSigTimeoutTime_CADM" SG_ 262 IntakeAirTemperature_W 0;
BA_ "GenSigTimeoutTime_DMSM" SG_ 262 IntakeAirTemperature_W 0;
BA_ "GenSigTimeoutTime_DTCM" SG_ 262 IntakeAirTemperature_W 0;
BA_ "GenSigTimeoutTime_ECM" SG_ 262 IntakeAirTemperature_W 0;
BA_ "GenSigTimeoutTime_EVCU2" SG_ 262 IntakeAirTemperature_W 0;
BA_ "GenSigTimeoutTime_GNMM" SG_ 262 IntakeAirTemperature_W 0;
BA_ "GenSigTimeoutTime_HCP" SG_ 262 IntakeAirTemperature_W 0;
BA_ "GenSigTimeoutTime_RFHM" SG_ 262 IntakeAirTemperature_W 0;
BA_ "GenSigTimeoutTime_AGSM" SG_ 262 KickDownRequest_W 0;
BA_ "GenSigTimeoutTime_BCM" SG_ 262 KickDownRequest_W 0;
BA_ "GenSigTimeoutTime_BSM" SG_ 262 KickDownRequest_W 0;
BA_ "GenSigTimeoutTime_CADM" SG_ 262 KickDownRequest_W 0;
BA_ "GenSigTimeoutTime_DMSM" SG_ 262 KickDownRequest_W 0;
BA_ "GenSigTimeoutTime_DTCM" SG_ 262 KickDownRequest_W 0;
BA_ "GenSigTimeoutTime_ECM" SG_ 262 KickDownRequest_W 0;
BA_ "GenSigTimeoutTime_EVCU2" SG_ 262 KickDownRequest_W 0;
BA_ "GenSigTimeoutTime_GNMM" SG_ 262 KickDownRequest_W 0;
BA_ "GenSigTimeoutTime_HCP" SG_ 262 KickDownRequest_W 0;
BA_ "GenSigTimeoutTime_IPC" SG_ 262 KickDownRequest_W 0;
BA_ "GenSigTimeoutTime_RFHM" SG_ 262 KickDownRequest_W 0;
BA_ "GenSigTimeoutTime_SGW" SG_ 262 KickDownRequest_W 0;
BA_ "GenSigTimeoutTime_AGSM" SG_ 262 LV12PwrFreeRq_W 0;
BA_ "GenSigTimeoutTime_BCM" SG_ 262 LV12PwrFreeRq_W 0;
BA_ "GenSigTimeoutTime_BSM" SG_ 262 LV12PwrFreeRq_W 0;
BA_ "GenSigTimeoutTime_CADM" SG_ 262 LV12PwrFreeRq_W 0;
BA_ "GenSigTimeoutTime_DMSM" SG_ 262 LV12PwrFreeRq_W 0;
BA_ "GenSigTimeoutTime_DTCM" SG_ 262 LV12PwrFreeRq_W 0;
BA_ "GenSigTimeoutTime_ECM" SG_ 262 LV12PwrFreeRq_W 0;
BA_ "GenSigTimeoutTime_GNMM" SG_ 262 LV12PwrFreeRq_W 0;
BA_ "GenSigTimeoutTime_HCP" SG_ 262 LV12PwrFreeRq_W 0;
BA_ "GenSigTimeoutTime_IPC" SG_ 262 LV12PwrFreeRq_W 0;
BA_ "GenSigTimeoutTime_RFHM" SG_ 262 LV12PwrFreeRq_W 0;
BA_ "GenSigTimeoutTime_SGW" SG_ 262 LV12PwrFreeRq_W 0;
BA_ "GenSigTimeoutTime_AGSM" SG_ 262 MessageCounter_ENGINE2 0;
BA_ "GenSigTimeoutTime_ECM" SG_ 262 MessageCounter_ENGINE2 0;
BA_ "GenSigTimeoutTime_GNMM" SG_ 262 MessageCounter_ENGINE2 0;
BA_ "GenSigTimeoutTime_RFHM" SG_ 262 MessageCounter_ENGINE2 0;
BA_ "GenSigTimeoutTime_SGW" SG_ 262 MessageCounter_ENGINE2 0;
BA_ "GenSigTimeoutTime_AGSM" SG_ 262 PowertrainPrplsnActv 0;
BA_ "GenSigTimeoutTime_DMSM" SG_ 262 PowertrainPrplsnActv 0;
BA_ "GenSigTimeoutTime_DTCM" SG_ 262 PowertrainPrplsnActv 0;
BA_ "GenSigTimeoutTime_ECM" SG_ 262 PowertrainPrplsnActv 0;
BA_ "GenSigTimeoutTime_EVCU2" SG_ 262 PowertrainPrplsnActv 0;
BA_ "GenSigTimeoutTime_GNMM" SG_ 262 PowertrainPrplsnActv 0;
BA_ "GenSigTimeoutTime_HCP" SG_ 262 PowertrainPrplsnActv 0;
BA_ "GenSigTimeoutTime_AGSM" SG_ 262 StartRelayBCMCmd_W 0;
BA_ "GenSigTimeoutTime_BSM" SG_ 262 StartRelayBCMCmd_W 0;
BA_ "GenSigTimeoutTime_CADM" SG_ 262 StartRelayBCMCmd_W 0;
BA_ "GenSigTimeoutTime_DMSM" SG_ 262 StartRelayBCMCmd_W 0;
BA_ "GenSigTimeoutTime_DTCM" SG_ 262 StartRelayBCMCmd_W 0;
BA_ "GenSigTimeoutTime_ECM" SG_ 262 StartRelayBCMCmd_W 0;
BA_ "GenSigTimeoutTime_EVCU2" SG_ 262 StartRelayBCMCmd_W 0;
BA_ "GenSigTimeoutTime_GNMM" SG_ 262 StartRelayBCMCmd_W 0;
BA_ "GenSigTimeoutTime_HCP" SG_ 262 StartRelayBCMCmd_W 0;
BA_ "GenSigTimeoutTime_IPC" SG_ 262 StartRelayBCMCmd_W 0;
BA_ "GenSigTimeoutTime_RFHM" SG_ 262 StartRelayBCMCmd_W 0;
BA_ "GenSigTimeoutTime_SGW" SG_ 262 StartRelayBCMCmd_W 0;
BA_ "GenSigTimeoutTime_TCM" SG_ 262 StartRelayBCMCmd_W 0;
BA_ "GenSigTimeoutTime_AGSM" SG_ 262 TRANS_CLU_SLIP_MODE_W 0;
BA_ "GenSigTimeoutTime_BCM" SG_ 262 TRANS_CLU_SLIP_MODE_W 0;
BA_ "GenSigTimeoutTime_BSM" SG_ 262 TRANS_CLU_SLIP_MODE_W 0;
BA_ "GenSigTimeoutTime_CADM" SG_ 262 TRANS_CLU_SLIP_MODE_W 0;
BA_ "GenSigTimeoutTime_DMSM" SG_ 262 TRANS_CLU_SLIP_MODE_W 0;
BA_ "GenSigTimeoutTime_DTCM" SG_ 262 TRANS_CLU_SLIP_MODE_W 0;
BA_ "GenSigTimeoutTime_ECM" SG_ 262 TRANS_CLU_SLIP_MODE_W 0;
BA_ "GenSigTimeoutTime_EVCU2" SG_ 262 TRANS_CLU_SLIP_MODE_W 0;
BA_ "GenSigTimeoutTime_GNMM" SG_ 262 TRANS_CLU_SLIP_MODE_W 0;
BA_ "GenSigTimeoutTime_HCP" SG_ 262 TRANS_CLU_SLIP_MODE_W 0;
BA_ "GenSigTimeoutTime_IPC" SG_ 262 TRANS_CLU_SLIP_MODE_W 0;
BA_ "GenSigTimeoutTime_RFHM" SG_ 262 TRANS_CLU_SLIP_MODE_W 0;
BA_ "GenSigTimeoutTime_SGW" SG_ 262 TRANS_CLU_SLIP_MODE_W 0;
BA_ "GenSigTimeoutTime_AGSM" SG_ 262 TxAC_EMCC_rq_W 0;
BA_ "GenSigTimeoutTime_BCM" SG_ 262 TxAC_EMCC_rq_W 0;
BA_ "GenSigTimeoutTime_BSM" SG_ 262 TxAC_EMCC_rq_W 0;
BA_ "GenSigTimeoutTime_CADM" SG_ 262 TxAC_EMCC_rq_W 0;
BA_ "GenSigTimeoutTime_DMSM" SG_ 262 TxAC_EMCC_rq_W 0;
BA_ "GenSigTimeoutTime_DTCM" SG_ 262 TxAC_EMCC_rq_W 0;
BA_ "GenSigTimeoutTime_ECM" SG_ 262 TxAC_EMCC_rq_W 0;
BA_ "GenSigTimeoutTime_EVCU2" SG_ 262 TxAC_EMCC_rq_W 0;
BA_ "GenSigTimeoutTime_GNMM" SG_ 262 TxAC_EMCC_rq_W 0;
BA_ "GenSigTimeoutTime_HCP" SG_ 262 TxAC_EMCC_rq_W 0;
BA_ "GenSigTimeoutTime_IPC" SG_ 262 TxAC_EMCC_rq_W 0;
BA_ "GenSigTimeoutTime_RFHM" SG_ 262 TxAC_EMCC_rq_W 0;
BA_ "GenSigTimeoutTime_SGW" SG_ 262 TxAC_EMCC_rq_W 0;
BA_ "GenSigSendType" SG_ 1036 AfterRunCoolantPumpFailSts 3;
BA_ "GenSigTimeoutTime_AGSM" SG_ 1036 AfterRunCoolantPumpFailSts 0;
BA_ "GenSigTimeoutTime_BCM" SG_ 1036 AfterRunCoolantPumpFailSts 0;
BA_ "GenSigTimeoutTime_BSM" SG_ 1036 AfterRunCoolantPumpFailSts 0;
BA_ "GenSigTimeoutTime_CADM" SG_ 1036 AfterRunCoolantPumpFailSts 0;
BA_ "GenSigTimeoutTime_DMSM" SG_ 1036 AfterRunCoolantPumpFailSts 0;
BA_ "GenSigTimeoutTime_DTCM" SG_ 1036 AfterRunCoolantPumpFailSts 0;
BA_ "GenSigTimeoutTime_ECM" SG_ 1036 AfterRunCoolantPumpFailSts 0;
BA_ "GenSigTimeoutTime_EVCU2" SG_ 1036 AfterRunCoolantPumpFailSts 0;
BA_ "GenSigTimeoutTime_GNMM" SG_ 1036 AfterRunCoolantPumpFailSts 0;
BA_ "GenSigTimeoutTime_HCP" SG_ 1036 AfterRunCoolantPumpFailSts 0;
BA_ "GenSigTimeoutTime_RFHM" SG_ 1036 AfterRunCoolantPumpFailSts 0;
BA_ "GenSigTimeoutTime_SGW" SG_ 1036 AfterRunCoolantPumpFailSts 0;
BA_ "GenSigTimeoutTime_TCM" SG_ 1036 AfterRunCoolantPumpFailSts 0;
BA_ "GenSigSendType" SG_ 1036 AxleInAir_Stat 3;
BA_ "GenSigTimeoutTime_AGSM" SG_ 1036 AxleInAir_Stat 0;
BA_ "GenSigTimeoutTime_CADM" SG_ 1036 AxleInAir_Stat 0;
BA_ "GenSigTimeoutTime_DMSM" SG_ 1036 AxleInAir_Stat 0;
BA_ "GenSigTimeoutTime_ECM" SG_ 1036 AxleInAir_Stat 0;
BA_ "GenSigTimeoutTime_EVCU2" SG_ 1036 AxleInAir_Stat 0;
BA_ "GenSigTimeoutTime_GNMM" SG_ 1036 AxleInAir_Stat 0;
BA_ "GenSigTimeoutTime_HCP" SG_ 1036 AxleInAir_Stat 0;
BA_ "GenSigTimeoutTime_IPC" SG_ 1036 AxleInAir_Stat 0;
BA_ "GenSigTimeoutTime_RFHM" SG_ 1036 AxleInAir_Stat 0;
BA_ "GenSigTimeoutTime_SGW" SG_ 1036 AxleInAir_Stat 0;
BA_ "GenSigSendType" SG_ 1036 CODE_1CHAR 3;
BA_ "GenSigTimeoutTime_AGSM" SG_ 1036 CODE_1CHAR 0;
BA_ "GenSigTimeoutTime_BCM" SG_ 1036 CODE_1CHAR 0;
BA_ "GenSigTimeoutTime_BSM" SG_ 1036 CODE_1CHAR 0;
BA_ "GenSigTimeoutTime_CADM" SG_ 1036 CODE_1CHAR 0;
BA_ "GenSigTimeoutTime_DMSM" SG_ 1036 CODE_1CHAR 0;
BA_ "GenSigTimeoutTime_DTCM" SG_ 1036 CODE_1CHAR 0;
BA_ "GenSigTimeoutTime_ECM" SG_ 1036 CODE_1CHAR 0;
BA_ "GenSigTimeoutTime_EVCU2" SG_ 1036 CODE_1CHAR 0;
BA_ "GenSigTimeoutTime_GNMM" SG_ 1036 CODE_1CHAR 0;
BA_ "GenSigTimeoutTime_HCP" SG_ 1036 CODE_1CHAR 0;
BA_ "GenSigTimeoutTime_RFHM" SG_ 1036 CODE_1CHAR 0;
BA_ "GenSigTimeoutTime_SGW" SG_ 1036 CODE_1CHAR 0;
BA_ "GenSigTimeoutTime_TCM" SG_ 1036 CODE_1CHAR 0;
BA_ "GenSigSendType" SG_ 1036 CODE_2CHAR 3;
BA_ "GenSigTimeoutTime_AGSM" SG_ 1036 CODE_2CHAR 0;
BA_ "GenSigTimeoutTime_BCM" SG_ 1036 CODE_2CHAR 0;
BA_ "GenSigTimeoutTime_BSM" SG_ 1036 CODE_2CHAR 0;
BA_ "GenSigTimeoutTime_CADM" SG_ 1036 CODE_2CHAR 0;
BA_ "GenSigTimeoutTime_DMSM" SG_ 1036 CODE_2CHAR 0;
BA_ "GenSigTimeoutTime_DTCM" SG_ 1036 CODE_2CHAR 0;
BA_ "GenSigTimeoutTime_ECM" SG_ 1036 CODE_2CHAR 0;
BA_ "GenSigTimeoutTime_EVCU2" SG_ 1036 CODE_2CHAR 0;
BA_ "GenSigTimeoutTime_GNMM" SG_ 1036 CODE_2CHAR 0;
BA_ "GenSigTimeoutTime_HCP" SG_ 1036 CODE_2CHAR 0;
BA_ "GenSigTimeoutTime_RFHM" SG_ 1036 CODE_2CHAR 0;
BA_ "GenSigTimeoutTime_SGW" SG_ 1036 CODE_2CHAR 0;
BA_ "GenSigTimeoutTime_TCM" SG_ 1036 CODE_2CHAR 0;
BA_ "GenSigSendType" SG_ 1036 CODE_3CHAR 3;
BA_ "GenSigTimeoutTime_AGSM" SG_ 1036 CODE_3CHAR 0;
BA_ "GenSigTimeoutTime_BCM" SG_ 1036 CODE_3CHAR 0;
BA_ "GenSigTimeoutTime_BSM" SG_ 1036 CODE_3CHAR 0;
BA_ "GenSigTimeoutTime_CADM" SG_ 1036 CODE_3CHAR 0;
BA_ "GenSigTimeoutTime_DMSM" SG_ 1036 CODE_3CHAR 0;
BA_ "GenSigTimeoutTime_DTCM" SG_ 1036 CODE_3CHAR 0;
BA_ "GenSigTimeoutTime_ECM" SG_ 1036 CODE_3CHAR 0;
BA_ "GenSigTimeoutTime_EVCU2" SG_ 1036 CODE_3CHAR 0;
BA_ "GenSigTimeoutTime_GNMM" SG_ 1036 CODE_3CHAR 0;
BA_ "GenSigTimeoutTime_HCP" SG_ 1036 CODE_3CHAR 0;
BA_ "GenSigTimeoutTime_RFHM" SG_ 1036 CODE_3CHAR 0;
BA_ "GenSigTimeoutTime_SGW" SG_ 1036 CODE_3CHAR 0;
BA_ "GenSigTimeoutTime_TCM" SG_ 1036 CODE_3CHAR 0;
BA_ "GenSigSendType" SG_ 1036 CODE_4CHAR 3;
BA_ "GenSigTimeoutTime_AGSM" SG_ 1036 CODE_4CHAR 0;
BA_ "GenSigTimeoutTime_BCM" SG_ 1036 CODE_4CHAR 0;
BA_ "GenSigTimeoutTime_BSM" SG_ 1036 CODE_4CHAR 0;
BA_ "GenSigTimeoutTime_CADM" SG_ 1036 CODE_4CHAR 0;
BA_ "GenSigTimeoutTime_DMSM" SG_ 1036 CODE_4CHAR 0;
BA_ "GenSigTimeoutTime_DTCM" SG_ 1036 CODE_4CHAR 0;
BA_ "GenSigTimeoutTime_ECM" SG_ 1036 CODE_4CHAR 0;
BA_ "GenSigTimeoutTime_EVCU2" SG_ 1036 CODE_4CHAR 0;
BA_ "GenSigTimeoutTime_GNMM" SG_ 1036 CODE_4CHAR 0;
BA_ "GenSigTimeoutTime_HCP" SG_ 1036 CODE_4CHAR 0;
BA_ "GenSigTimeoutTime_RFHM" SG_ 1036 CODE_4CHAR 0;
BA_ "GenSigTimeoutTime_SGW" SG_ 1036 CODE_4CHAR 0;
BA_ "GenSigTimeoutTime_TCM" SG_ 1036 CODE_4CHAR 0;
BA_ "GenSigSendType" SG_ 1036 CODE_CTGY 3;
BA_ "GenSigTimeoutTime_AGSM" SG_ 1036 CODE_CTGY 0;
BA_ "GenSigTimeoutTime_BCM" SG_ 1036 CODE_CTGY 0;
BA_ "GenSigTimeoutTime_BSM" SG_ 1036 CODE_CTGY 0;
BA_ "GenSigTimeoutTime_CADM" SG_ 1036 CODE_CTGY 0;
BA_ "GenSigTimeoutTime_DMSM" SG_ 1036 CODE_CTGY 0;
BA_ "GenSigTimeoutTime_DTCM" SG_ 1036 CODE_CTGY 0;
BA_ "GenSigTimeoutTime_ECM" SG_ 1036 CODE_CTGY 0;
BA_ "GenSigTimeoutTime_EVCU2" SG_ 1036 CODE_CTGY 0;
BA_ "GenSigTimeoutTime_GNMM" SG_ 1036 CODE_CTGY 0;
BA_ "GenSigTimeoutTime_HCP" SG_ 1036 CODE_CTGY 0;
BA_ "GenSigTimeoutTime_RFHM" SG_ 1036 CODE_CTGY 0;
BA_ "GenSigTimeoutTime_SGW" SG_ 1036 CODE_CTGY 0;
BA_ "GenSigTimeoutTime_TCM" SG_ 1036 CODE_CTGY 0;
BA_ "GenSigStartValue" SG_ 1036 CoolVlvPos 255;
BA_ "GenSigTimeoutTime_AGSM" SG_ 1036 CoolVlvPos 0;
BA_ "GenSigTimeoutTime_BSM" SG_ 1036 CoolVlvPos 0;
BA_ "GenSigTimeoutTime_CADM" SG_ 1036 CoolVlvPos 0;
BA_ "GenSigTimeoutTime_DMSM" SG_ 1036 CoolVlvPos 0;
BA_ "GenSigTimeoutTime_DTCM" SG_ 1036 CoolVlvPos 0;
BA_ "GenSigTimeoutTime_ECM" SG_ 1036 CoolVlvPos 0;
BA_ "GenSigTimeoutTime_EVCU2" SG_ 1036 CoolVlvPos 0;
BA_ "GenSigTimeoutTime_GNMM" SG_ 1036 CoolVlvPos 0;
BA_ "GenSigTimeoutTime_HCP" SG_ 1036 CoolVlvPos 0;
BA_ "GenSigTimeoutTime_IPC" SG_ 1036 CoolVlvPos 0;
BA_ "GenSigTimeoutTime_RFHM" SG_ 1036 CoolVlvPos 0;
BA_ "GenSigTimeoutTime_SGW" SG_ 1036 CoolVlvPos 0;
BA_ "GenSigTimeoutTime_TCM" SG_ 1036 CoolVlvPos 0;
BA_ "GenSigTimeoutTime_AGSM" SG_ 1036 CRC_ENGINE3 0;
BA_ "GenSigTimeoutTime_BCM" SG_ 1036 CRC_ENGINE3 0;
BA_ "GenSigTimeoutTime_CADM" SG_ 1036 CRC_ENGINE3 0;
BA_ "GenSigTimeoutTime_DMSM" SG_ 1036 CRC_ENGINE3 0;
BA_ "GenSigTimeoutTime_DTCM" SG_ 1036 CRC_ENGINE3 0;
BA_ "GenSigTimeoutTime_ECM" SG_ 1036 CRC_ENGINE3 0;
BA_ "GenSigTimeoutTime_EVCU2" SG_ 1036 CRC_ENGINE3 0;
BA_ "GenSigTimeoutTime_GNMM" SG_ 1036 CRC_ENGINE3 0;
BA_ "GenSigTimeoutTime_HCP" SG_ 1036 CRC_ENGINE3 0;
BA_ "GenSigTimeoutTime_IPC" SG_ 1036 CRC_ENGINE3 0;
BA_ "GenSigTimeoutTime_RFHM" SG_ 1036 CRC_ENGINE3 0;
BA_ "GenSigTimeoutTime_SGW" SG_ 1036 CRC_ENGINE3 0;
BA_ "GenSigStartValue" SG_ 1036 DefFuelEcon 255;
BA_ "GenSigTimeoutTime_AGSM" SG_ 1036 DefFuelEcon 0;
BA_ "GenSigTimeoutTime_BCM" SG_ 1036 DefFuelEcon 0;
BA_ "GenSigTimeoutTime_BSM" SG_ 1036 DefFuelEcon 0;
BA_ "GenSigTimeoutTime_CADM" SG_ 1036 DefFuelEcon 0;
BA_ "GenSigTimeoutTime_DMSM" SG_ 1036 DefFuelEcon 0;
BA_ "GenSigTimeoutTime_DTCM" SG_ 1036 DefFuelEcon 0;
BA_ "GenSigTimeoutTime_ECM" SG_ 1036 DefFuelEcon 0;
BA_ "GenSigTimeoutTime_EVCU2" SG_ 1036 DefFuelEcon 0;
BA_ "GenSigTimeoutTime_GNMM" SG_ 1036 DefFuelEcon 0;
BA_ "GenSigTimeoutTime_HCP" SG_ 1036 DefFuelEcon 0;
BA_ "GenSigTimeoutTime_RFHM" SG_ 1036 DefFuelEcon 0;
BA_ "GenSigTimeoutTime_TCM" SG_ 1036 DefFuelEcon 0;
BA_ "GenSigStartValue" SG_ 1036 DistOilLifeRst 65535;
BA_ "GenSigSendType" SG_ 1036 DistOilLifeRst 3;
BA_ "GenSigTimeoutTime_AGSM" SG_ 1036 DistOilLifeRst 0;
BA_ "GenSigTimeoutTime_BSM" SG_ 1036 DistOilLifeRst 0;
BA_ "GenSigTimeoutTime_CADM" SG_ 1036 DistOilLifeRst 0;
BA_ "GenSigTimeoutTime_DMSM" SG_ 1036 DistOilLifeRst 0;
BA_ "GenSigTimeoutTime_DTCM" SG_ 1036 DistOilLifeRst 0;
BA_ "GenSigTimeoutTime_ECM" SG_ 1036 DistOilLifeRst 0;
BA_ "GenSigTimeoutTime_EVCU2" SG_ 1036 DistOilLifeRst 0;
BA_ "GenSigTimeoutTime_GNMM" SG_ 1036 DistOilLifeRst 0;
BA_ "GenSigTimeoutTime_HCP" SG_ 1036 DistOilLifeRst 0;
BA_ "GenSigTimeoutTime_RFHM" SG_ 1036 DistOilLifeRst 0;
BA_ "GenSigTimeoutTime_SGW" SG_ 1036 DistOilLifeRst 0;
BA_ "GenSigTimeoutTime_TCM" SG_ 1036 DistOilLifeRst 0;
BA_ "GenSigSendType" SG_ 1036 ECM_Thermal_AAD_Request 3;
BA_ "GenSigTimeoutTime_AGSM" SG_ 1036 ECM_Thermal_AAD_Request 0;
BA_ "GenSigTimeoutTime_BCM" SG_ 1036 ECM_Thermal_AAD_Request 0;
BA_ "GenSigTimeoutTime_BSM" SG_ 1036 ECM_Thermal_AAD_Request 0;
BA_ "GenSigTimeoutTime_CADM" SG_ 1036 ECM_Thermal_AAD_Request 0;
BA_ "GenSigTimeoutTime_DMSM" SG_ 1036 ECM_Thermal_AAD_Request 0;
BA_ "GenSigTimeoutTime_DTCM" SG_ 1036 ECM_Thermal_AAD_Request 0;
BA_ "GenSigTimeoutTime_ECM" SG_ 1036 ECM_Thermal_AAD_Request 0;
BA_ "GenSigTimeoutTime_GNMM" SG_ 1036 ECM_Thermal_AAD_Request 0;
BA_ "GenSigTimeoutTime_HCP" SG_ 1036 ECM_Thermal_AAD_Request 0;
BA_ "GenSigTimeoutTime_IPC" SG_ 1036 ECM_Thermal_AAD_Request 0;
BA_ "GenSigTimeoutTime_RFHM" SG_ 1036 ECM_Thermal_AAD_Request 0;
BA_ "GenSigTimeoutTime_SGW" SG_ 1036 ECM_Thermal_AAD_Request 0;
BA_ "GenSigTimeoutTime_TCM" SG_ 1036 ECM_Thermal_AAD_Request 0;
BA_ "GenSigSendType" SG_ 1036 EngineOilCritical 3;
BA_ "GenSigTimeoutTime_AGSM" SG_ 1036 EngineOilCritical 0;
BA_ "GenSigTimeoutTime_BCM" SG_ 1036 EngineOilCritical 0;
BA_ "GenSigTimeoutTime_BSM" SG_ 1036 EngineOilCritical 0;
BA_ "GenSigTimeoutTime_CADM" SG_ 1036 EngineOilCritical 0;
BA_ "GenSigTimeoutTime_DMSM" SG_ 1036 EngineOilCritical 0;
BA_ "GenSigTimeoutTime_DTCM" SG_ 1036 EngineOilCritical 0;
BA_ "GenSigTimeoutTime_ECM" SG_ 1036 EngineOilCritical 0;
BA_ "GenSigTimeoutTime_EVCU2" SG_ 1036 EngineOilCritical 0;
BA_ "GenSigTimeoutTime_GNMM" SG_ 1036 EngineOilCritical 0;
BA_ "GenSigTimeoutTime_HCP" SG_ 1036 EngineOilCritical 0;
BA_ "GenSigTimeoutTime_RFHM" SG_ 1036 EngineOilCritical 0;
BA_ "GenSigTimeoutTime_SGW" SG_ 1036 EngineOilCritical 0;
BA_ "GenSigTimeoutTime_TCM" SG_ 1036 EngineOilCritical 0;
BA_ "GenSigTimeoutTime_AGSM" SG_ 1036 EngineOilLevel 0;
BA_ "GenSigTimeoutTime_BCM" SG_ 1036 EngineOilLevel 0;
BA_ "GenSigTimeoutTime_BSM" SG_ 1036 EngineOilLevel 0;
BA_ "GenSigTimeoutTime_CADM" SG_ 1036 EngineOilLevel 0;
BA_ "GenSigTimeoutTime_DMSM" SG_ 1036 EngineOilLevel 0;
BA_ "GenSigTimeoutTime_DTCM" SG_ 1036 EngineOilLevel 0;
BA_ "GenSigTimeoutTime_ECM" SG_ 1036 EngineOilLevel 0;
BA_ "GenSigTimeoutTime_EVCU2" SG_ 1036 EngineOilLevel 0;
BA_ "GenSigTimeoutTime_GNMM" SG_ 1036 EngineOilLevel 0;
BA_ "GenSigTimeoutTime_HCP" SG_ 1036 EngineOilLevel 0;
BA_ "GenSigTimeoutTime_RFHM" SG_ 1036 EngineOilLevel 0;
BA_ "GenSigTimeoutTime_SGW" SG_ 1036 EngineOilLevel 0;
BA_ "GenSigTimeoutTime_TCM" SG_ 1036 EngineOilLevel 0;
BA_ "GenSigSendType" SG_ 1036 EngineOilMin 3;
BA_ "GenSigTimeoutTime_AGSM" SG_ 1036 EngineOilMin 0;
BA_ "GenSigTimeoutTime_BCM" SG_ 1036 EngineOilMin 0;
BA_ "GenSigTimeoutTime_BSM" SG_ 1036 EngineOilMin 0;
BA_ "GenSigTimeoutTime_CADM" SG_ 1036 EngineOilMin 0;
BA_ "GenSigTimeoutTime_DMSM" SG_ 1036 EngineOilMin 0;
BA_ "GenSigTimeoutTime_DTCM" SG_ 1036 EngineOilMin 0;
BA_ "GenSigTimeoutTime_ECM" SG_ 1036 EngineOilMin 0;
BA_ "GenSigTimeoutTime_EVCU2" SG_ 1036 EngineOilMin 0;
BA_ "GenSigTimeoutTime_GNMM" SG_ 1036 EngineOilMin 0;
BA_ "GenSigTimeoutTime_HCP" SG_ 1036 EngineOilMin 0;
BA_ "GenSigTimeoutTime_RFHM" SG_ 1036 EngineOilMin 0;
BA_ "GenSigTimeoutTime_SGW" SG_ 1036 EngineOilMin 0;
BA_ "GenSigTimeoutTime_TCM" SG_ 1036 EngineOilMin 0;
BA_ "GenSigSendType" SG_ 1036 EngineOilOverfill 3;
BA_ "GenSigTimeoutTime_AGSM" SG_ 1036 EngineOilOverfill 0;
BA_ "GenSigTimeoutTime_BCM" SG_ 1036 EngineOilOverfill 0;
BA_ "GenSigTimeoutTime_BSM" SG_ 1036 EngineOilOverfill 0;
BA_ "GenSigTimeoutTime_CADM" SG_ 1036 EngineOilOverfill 0;
BA_ "GenSigTimeoutTime_DMSM" SG_ 1036 EngineOilOverfill 0;
BA_ "GenSigTimeoutTime_DTCM" SG_ 1036 EngineOilOverfill 0;
BA_ "GenSigTimeoutTime_ECM" SG_ 1036 EngineOilOverfill 0;
BA_ "GenSigTimeoutTime_EVCU2" SG_ 1036 EngineOilOverfill 0;
BA_ "GenSigTimeoutTime_GNMM" SG_ 1036 EngineOilOverfill 0;
BA_ "GenSigTimeoutTime_HCP" SG_ 1036 EngineOilOverfill 0;
BA_ "GenSigTimeoutTime_RFHM" SG_ 1036 EngineOilOverfill 0;
BA_ "GenSigTimeoutTime_SGW" SG_ 1036 EngineOilOverfill 0;
BA_ "GenSigTimeoutTime_TCM" SG_ 1036 EngineOilOverfill 0;
BA_ "GenSigStartValue" SG_ 1036 EngineOilTemperature 255;
BA_ "GenSigTimeoutTime_AGSM" SG_ 1036 EngineOilTemperature 0;
BA_ "GenSigTimeoutTime_BCM" SG_ 1036 EngineOilTemperature 0;
BA_ "GenSigTimeoutTime_BSM" SG_ 1036 EngineOilTemperature 0;
BA_ "GenSigTimeoutTime_CADM" SG_ 1036 EngineOilTemperature 0;
BA_ "GenSigTimeoutTime_DMSM" SG_ 1036 EngineOilTemperature 0;
BA_ "GenSigTimeoutTime_DTCM" SG_ 1036 EngineOilTemperature 0;
BA_ "GenSigTimeoutTime_ECM" SG_ 1036 EngineOilTemperature 0;
BA_ "GenSigTimeoutTime_GNMM" SG_ 1036 EngineOilTemperature 0;
BA_ "GenSigTimeoutTime_HCP" SG_ 1036 EngineOilTemperature 0;
BA_ "GenSigTimeoutTime_RFHM" SG_ 1036 EngineOilTemperature 0;
BA_ "GenSigTimeoutTime_AGSM" SG_ 1036 FANStatus 0;
BA_ "GenSigTimeoutTime_BCM" SG_ 1036 FANStatus 0;
BA_ "GenSigTimeoutTime_BSM" SG_ 1036 FANStatus 0;
BA_ "GenSigTimeoutTime_CADM" SG_ 1036 FANStatus 0;
BA_ "GenSigTimeoutTime_DMSM" SG_ 1036 FANStatus 0;
BA_ "GenSigTimeoutTime_DTCM" SG_ 1036 FANStatus 0;
BA_ "GenSigTimeoutTime_ECM" SG_ 1036 FANStatus 0;
BA_ "GenSigTimeoutTime_EVCU2" SG_ 1036 FANStatus 0;
BA_ "GenSigTimeoutTime_GNMM" SG_ 1036 FANStatus 0;
BA_ "GenSigTimeoutTime_HCP" SG_ 1036 FANStatus 0;
BA_ "GenSigTimeoutTime_IPC" SG_ 1036 FANStatus 0;
BA_ "GenSigTimeoutTime_RFHM" SG_ 1036 FANStatus 0;
BA_ "GenSigTimeoutTime_SGW" SG_ 1036 FANStatus 0;
BA_ "GenSigTimeoutTime_TCM" SG_ 1036 FANStatus 0;
BA_ "GenSigTimeoutTime_AGSM" SG_ 1036 MessageCounter_ENGINE3 0;
BA_ "GenSigTimeoutTime_BCM" SG_ 1036 MessageCounter_ENGINE3 0;
BA_ "GenSigTimeoutTime_CADM" SG_ 1036 MessageCounter_ENGINE3 0;
BA_ "GenSigTimeoutTime_DMSM" SG_ 1036 MessageCounter_ENGINE3 0;
BA_ "GenSigTimeoutTime_DTCM" SG_ 1036 MessageCounter_ENGINE3 0;
BA_ "GenSigTimeoutTime_ECM" SG_ 1036 MessageCounter_ENGINE3 0;
BA_ "GenSigTimeoutTime_EVCU2" SG_ 1036 MessageCounter_ENGINE3 0;
BA_ "GenSigTimeoutTime_GNMM" SG_ 1036 MessageCounter_ENGINE3 0;
BA_ "GenSigTimeoutTime_HCP" SG_ 1036 MessageCounter_ENGINE3 0;
BA_ "GenSigTimeoutTime_IPC" SG_ 1036 MessageCounter_ENGINE3 0;
BA_ "GenSigTimeoutTime_RFHM" SG_ 1036 MessageCounter_ENGINE3 0;
BA_ "GenSigTimeoutTime_SGW" SG_ 1036 MessageCounter_ENGINE3 0;
BA_ "GenSigSendType" SG_ 1036 OIL_IND_LMP_FLSH 3;
BA_ "GenSigTimeoutTime_AGSM" SG_ 1036 OIL_IND_LMP_FLSH 0;
BA_ "GenSigTimeoutTime_BCM" SG_ 1036 OIL_IND_LMP_FLSH 0;
BA_ "GenSigTimeoutTime_BSM" SG_ 1036 OIL_IND_LMP_FLSH 0;
BA_ "GenSigTimeoutTime_CADM" SG_ 1036 OIL_IND_LMP_FLSH 0;
BA_ "GenSigTimeoutTime_DMSM" SG_ 1036 OIL_IND_LMP_FLSH 0;
BA_ "GenSigTimeoutTime_DTCM" SG_ 1036 OIL_IND_LMP_FLSH 0;
BA_ "GenSigTimeoutTime_ECM" SG_ 1036 OIL_IND_LMP_FLSH 0;
BA_ "GenSigTimeoutTime_EVCU2" SG_ 1036 OIL_IND_LMP_FLSH 0;
BA_ "GenSigTimeoutTime_GNMM" SG_ 1036 OIL_IND_LMP_FLSH 0;
BA_ "GenSigTimeoutTime_HCP" SG_ 1036 OIL_IND_LMP_FLSH 0;
BA_ "GenSigTimeoutTime_RFHM" SG_ 1036 OIL_IND_LMP_FLSH 0;
BA_ "GenSigTimeoutTime_TCM" SG_ 1036 OIL_IND_LMP_FLSH 0;
BA_ "GenSigSendType" SG_ 1036 OIL_TEMP_CHM_RQ 3;
BA_ "GenSigTimeoutTime_AGSM" SG_ 1036 OIL_TEMP_CHM_RQ 0;
BA_ "GenSigTimeoutTime_BCM" SG_ 1036 OIL_TEMP_CHM_RQ 0;
BA_ "GenSigTimeoutTime_BSM" SG_ 1036 OIL_TEMP_CHM_RQ 0;
BA_ "GenSigTimeoutTime_CADM" SG_ 1036 OIL_TEMP_CHM_RQ 0;
BA_ "GenSigTimeoutTime_DMSM" SG_ 1036 OIL_TEMP_CHM_RQ 0;
BA_ "GenSigTimeoutTime_DTCM" SG_ 1036 OIL_TEMP_CHM_RQ 0;
BA_ "GenSigTimeoutTime_ECM" SG_ 1036 OIL_TEMP_CHM_RQ 0;
BA_ "GenSigTimeoutTime_EVCU2" SG_ 1036 OIL_TEMP_CHM_RQ 0;
BA_ "GenSigTimeoutTime_GNMM" SG_ 1036 OIL_TEMP_CHM_RQ 0;
BA_ "GenSigTimeoutTime_HCP" SG_ 1036 OIL_TEMP_CHM_RQ 0;
BA_ "GenSigTimeoutTime_IPC" SG_ 1036 OIL_TEMP_CHM_RQ 0;
BA_ "GenSigTimeoutTime_RFHM" SG_ 1036 OIL_TEMP_CHM_RQ 0;
BA_ "GenSigTimeoutTime_TCM" SG_ 1036 OIL_TEMP_CHM_RQ 0;
BA_ "GenSigSendType" SG_ 1036 OIL_TEMP_IND_RQ 3;
BA_ "GenSigTimeoutTime_AGSM" SG_ 1036 OIL_TEMP_IND_RQ 0;
BA_ "GenSigTimeoutTime_BCM" SG_ 1036 OIL_TEMP_IND_RQ 0;
BA_ "GenSigTimeoutTime_BSM" SG_ 1036 OIL_TEMP_IND_RQ 0;
BA_ "GenSigTimeoutTime_CADM" SG_ 1036 OIL_TEMP_IND_RQ 0;
BA_ "GenSigTimeoutTime_DMSM" SG_ 1036 OIL_TEMP_IND_RQ 0;
BA_ "GenSigTimeoutTime_DTCM" SG_ 1036 OIL_TEMP_IND_RQ 0;
BA_ "GenSigTimeoutTime_ECM" SG_ 1036 OIL_TEMP_IND_RQ 0;
BA_ "GenSigTimeoutTime_EVCU2" SG_ 1036 OIL_TEMP_IND_RQ 0;
BA_ "GenSigTimeoutTime_GNMM" SG_ 1036 OIL_TEMP_IND_RQ 0;
BA_ "GenSigTimeoutTime_HCP" SG_ 1036 OIL_TEMP_IND_RQ 0;
BA_ "GenSigTimeoutTime_RFHM" SG_ 1036 OIL_TEMP_IND_RQ 0;
BA_ "GenSigTimeoutTime_TCM" SG_ 1036 OIL_TEMP_IND_RQ 0;
BA_ "GenSigStartValue" SG_ 1036 OilLifeLeft 255;
BA_ "GenSigSendType" SG_ 1036 OilLifeLeft 3;
BA_ "GenSigTimeoutTime_AGSM" SG_ 1036 OilLifeLeft 0;
BA_ "GenSigTimeoutTime_BCM" SG_ 1036 OilLifeLeft 0;
BA_ "GenSigTimeoutTime_BSM" SG_ 1036 OilLifeLeft 0;
BA_ "GenSigTimeoutTime_CADM" SG_ 1036 OilLifeLeft 0;
BA_ "GenSigTimeoutTime_DMSM" SG_ 1036 OilLifeLeft 0;
BA_ "GenSigTimeoutTime_DTCM" SG_ 1036 OilLifeLeft 0;
BA_ "GenSigTimeoutTime_ECM" SG_ 1036 OilLifeLeft 0;
BA_ "GenSigTimeoutTime_EVCU2" SG_ 1036 OilLifeLeft 0;
BA_ "GenSigTimeoutTime_GNMM" SG_ 1036 OilLifeLeft 0;
BA_ "GenSigTimeoutTime_HCP" SG_ 1036 OilLifeLeft 0;
BA_ "GenSigTimeoutTime_RFHM" SG_ 1036 OilLifeLeft 0;
BA_ "GenSigTimeoutTime_TCM" SG_ 1036 OilLifeLeft 0;
BA_ "GenSigSendType" SG_ 1036 OilLifeLeftRst 3;
BA_ "GenSigTimeoutTime_AGSM" SG_ 1036 OilLifeLeftRst 0;
BA_ "GenSigTimeoutTime_BCM" SG_ 1036 OilLifeLeftRst 0;
BA_ "GenSigTimeoutTime_BSM" SG_ 1036 OilLifeLeftRst 0;
BA_ "GenSigTimeoutTime_CADM" SG_ 1036 OilLifeLeftRst 0;
BA_ "GenSigTimeoutTime_DMSM" SG_ 1036 OilLifeLeftRst 0;
BA_ "GenSigTimeoutTime_DTCM" SG_ 1036 OilLifeLeftRst 0;
BA_ "GenSigTimeoutTime_ECM" SG_ 1036 OilLifeLeftRst 0;
BA_ "GenSigTimeoutTime_EVCU2" SG_ 1036 OilLifeLeftRst 0;
BA_ "GenSigTimeoutTime_GNMM" SG_ 1036 OilLifeLeftRst 0;
BA_ "GenSigTimeoutTime_HCP" SG_ 1036 OilLifeLeftRst 0;
BA_ "GenSigTimeoutTime_RFHM" SG_ 1036 OilLifeLeftRst 0;
BA_ "GenSigTimeoutTime_SGW" SG_ 1036 OilLifeLeftRst 0;
BA_ "GenSigTimeoutTime_TCM" SG_ 1036 OilLifeLeftRst 0;
BA_ "GenSigTimeoutTime_AGSM" SG_ 1036 PT_WorkSite_Invtr_Capacity_ECM 0;
BA_ "GenSigTimeoutTime_BSM" SG_ 1036 PT_WorkSite_Invtr_Capacity_ECM 0;
BA_ "GenSigTimeoutTime_CADM" SG_ 1036 PT_WorkSite_Invtr_Capacity_ECM 0;
BA_ "GenSigTimeoutTime_DMSM" SG_ 1036 PT_WorkSite_Invtr_Capacity_ECM 0;
BA_ "GenSigTimeoutTime_DTCM" SG_ 1036 PT_WorkSite_Invtr_Capacity_ECM 0;
BA_ "GenSigTimeoutTime_ECM" SG_ 1036 PT_WorkSite_Invtr_Capacity_ECM 0;
BA_ "GenSigTimeoutTime_EVCU2" SG_ 1036 PT_WorkSite_Invtr_Capacity_ECM 0;
BA_ "GenSigTimeoutTime_GNMM" SG_ 1036 PT_WorkSite_Invtr_Capacity_ECM 0;
BA_ "GenSigTimeoutTime_HCP" SG_ 1036 PT_WorkSite_Invtr_Capacity_ECM 0;
BA_ "GenSigTimeoutTime_IPC" SG_ 1036 PT_WorkSite_Invtr_Capacity_ECM 0;
BA_ "GenSigTimeoutTime_RFHM" SG_ 1036 PT_WorkSite_Invtr_Capacity_ECM 0;
BA_ "GenSigTimeoutTime_SGW" SG_ 1036 PT_WorkSite_Invtr_Capacity_ECM 0;
BA_ "GenSigTimeoutTime_TCM" SG_ 1036 PT_WorkSite_Invtr_Capacity_ECM 0;
BA_ "GenSigTimeoutTime_AGSM" SG_ 1036 PT_WorkSite_Invtr_Sts_ECM 0;
BA_ "GenSigTimeoutTime_BSM" SG_ 1036 PT_WorkSite_Invtr_Sts_ECM 0;
BA_ "GenSigTimeoutTime_CADM" SG_ 1036 PT_WorkSite_Invtr_Sts_ECM 0;
BA_ "GenSigTimeoutTime_DMSM" SG_ 1036 PT_WorkSite_Invtr_Sts_ECM 0;
BA_ "GenSigTimeoutTime_DTCM" SG_ 1036 PT_WorkSite_Invtr_Sts_ECM 0;
BA_ "GenSigTimeoutTime_ECM" SG_ 1036 PT_WorkSite_Invtr_Sts_ECM 0;
BA_ "GenSigTimeoutTime_EVCU2" SG_ 1036 PT_WorkSite_Invtr_Sts_ECM 0;
BA_ "GenSigTimeoutTime_GNMM" SG_ 1036 PT_WorkSite_Invtr_Sts_ECM 0;
BA_ "GenSigTimeoutTime_HCP" SG_ 1036 PT_WorkSite_Invtr_Sts_ECM 0;
BA_ "GenSigTimeoutTime_IPC" SG_ 1036 PT_WorkSite_Invtr_Sts_ECM 0;
BA_ "GenSigTimeoutTime_RFHM" SG_ 1036 PT_WorkSite_Invtr_Sts_ECM 0;
BA_ "GenSigTimeoutTime_SGW" SG_ 1036 PT_WorkSite_Invtr_Sts_ECM 0;
BA_ "GenSigTimeoutTime_TCM" SG_ 1036 PT_WorkSite_Invtr_Sts_ECM 0;
VAL_ 517 AWDSysStat 0 "SH_IPG" 1 "4LO" 2 "4HI" 3 "2WD" 4 "NEUTRAL" 5 "SYNC_IPG" 6 "4WDLock" 7 "SNA";
VAL_ 517 CCMFailSts 0 "FailNotPresent" 1 "FailPresent";
VAL_ 517 DrvLnMinTrqMd 0 "False" 1 "True";
VAL_ 517 DrvLnTrqRq 511 "SNA";
VAL_ 517 Ft_RrCouplingTrq_Actual 255 "SNA";
VAL_ 517 Ft_RrCouplingTrq_Desired 255 "SNA";
VAL_ 1447 CNT_DIFF_MOD 0 "FREE" 1 " ESP_OPEN" 2 " ESP_HOLD" 3 " CMD_FLT" 4 " Currently Not used" 5 " Currently Not used" 6 " Currently Not used" 7 " SNA";
VAL_ 1447 DTCM_HMI_Rq 0 "No_request" 1 "SCREEN_1" 2 "SCREEN_2" 3 "SCREEN_3" 4 "SCREEN_4" 5 "SCREEN_5" 6 "SCREEN_6" 7 "SCREEN_7" 8 "SCREEN_8" 9 "SCREEN_9" 10 "SCREEN_10" 11 "SCREEN_11" 12 "SCREEN_12" 13 "SCREEN_13" 14 "SCREEN_14" 15 "SCREEN_15" 16 "SCREEN_16" 17 "SCREEN_17" 18 "SCREEN_18" 19 "SCREEN_19" 20 "SCREEN_20" 21 "SCREEN_21" 22 "SCREEN_22" 23 "SCREEN_23" 24 "SCREEN_24" 25 "SCREEN_25" 26 "SCREEN_26" 27 "SCREEN_27" 28 "SCREEN_28" 29 "SCREEN_29" 30 "SCREEN_30" 31 "SNA";
VAL_ 1447 TerSt_SWITCH1 0 "Off" 1 "Continuous" 2 "Blink" 3 "SNA";
VAL_ 1447 TerSt_SWITCH2 0 "Off" 1 "Continuous" 2 "Blink" 3 "SNA";
VAL_ 1068 AxleLckr_SRV_RQ 0 "OFF" 1 "ON" 2 "BLINK" 3 "SNA";
VAL_ 1068 AxleLckr_Stat 0 "Unlocked" 1 "Rear_Locked" 2 "Front_Rear_Locked" 3 "SNA";
VAL_ 1068 AxleLckrEvicDisp 0 "None" 1 "SCREEN_1" 2 "SCREEN_2" 3 "SCREEN_3" 4 "SCREEN_4" 5 "SCREEN_5" 6 "SCREEN_6" 7 "SCREEN_7" 8 "SCREEN_8" 9 "SCREEN_9" 10 "SCREEN_10" 11 "SCREEN_11" 12 "SCREEN_12" 13 "SCREEN_13" 14 "SCREEN_14" 15 "SCREEN_15" 16 "SCREEN_16" 17 "SCREEN_17" 18 "SCREEN_18" 19 "SCREEN_19" 20 "SCREEN_20" 21 "SCREEN_21" 22 "SCREEN_22" 23 "SCREEN_23" 24 "SCREEN_24" 25 "SCREEN_25" 26 "SCREEN_26" 27 "SCREEN_27" 28 "SCREEN_28" 29 "SCREEN_29" 30 "SCREEN_30" 31 "SNA";
VAL_ 1068 DTCM_Vehicle_Hold_Rq 0 "NotActive" 1 "Active";
VAL_ 1068 RrAxleLockerIndRq 0 "OFF" 1 "ON" 2 "BLINK" 3 "SNA";
VAL_ 1068 Tcase2WD_Stat 0 "OFF" 1 "ON" 2 "BLINK" 3 "SNA";
VAL_ 1068 Tcase4Lock 0 "OFF" 1 "ON" 2 "BLINK" 3 "SNA";
VAL_ 1068 Tcase4Low 0 "OFF" 1 "ON" 2 "BLINK" 3 "SNA";
VAL_ 1068 TcaseAWD 0 "OFF" 1 "ON" 2 "BLINK" 3 "SNA";
VAL_ 1068 TCASERANGESTATUS 0 "HIGH" 1 "NTRL" 2 "LOW" 3 "SNA";
VAL_ 1438 DM_Camera_Blind 0 "Unknown" 1 "Not_Occluded" 2 "Partial_Occluded" 3 "Feature_Not_Aval";
VAL_ 1438 DM_Distract_State 0 "Unknown" 1 "Not_Distracted" 2 "Partially_Distracted" 3 "Fully_Distracted";
VAL_ 1438 DM_Drowsy_Micro 0 "False" 1 "True";
VAL_ 1438 DM_Drowsy_State 0 "Unknown" 1 "Not_Drowsy" 2 "Partially_Drowsy" 3 "Fully_Drowsy";
VAL_ 1438 DM_Eyes_Tracked 0 "False" 1 "True";
VAL_ 1438 DM_Steering_Angle_Blockage 0 "False" 1 "True";
VAL_ 1438 DM_Zone_Track 0 "Unknown" 1 "On_Road" 2 "Cluster" 3 "Left_Mirror" 4 "Right_Mirror" 5 "Radio" 6 "Rear_View_Mirror" 7 "Off_Road";
VAL_ 1438 DMSM_System_Stat 0 "Standby" 1 "Temp_NA" 2 "Internal_Error" 3 "Functional";
VAL_ 1438 Driver_Presence 0 "Not_Present" 1 "Present";
VAL_ 1054 ACPressure 511 "SNA";
VAL_ 1054 ACPressureFailSts 0 "Fail_Not_Present" 1 "Fail_Present";
VAL_ 1054 AGS2Posn 127 "SNA";
VAL_ 1054 AtmosphericPressure_W 255 "SNA";
VAL_ 1054 AtmosphericPressureFailSts_W 0 "Fail_Not_Present" 1 "Fail_Present";
VAL_ 1054 BoostVacGauge 255 "SNA";
VAL_ 1054 EngMaxRPM_W 255 "SNA";
VAL_ 1054 HighPressureFuelSystemFailure 0 "No_Fault" 1 "Fault";
VAL_ 1054 ThermalManagementActive_W 0 "Not_active" 1 "Active";
VAL_ 1054 TransWarmUpMin_RPM 255 "SNA";
VAL_ 1054 TransWarmUpReq 0 "WarmUp_Not_Enabled" 1 "WarmUp_Enabled";
VAL_ 262 AlternatorFail_W 0 "Alternator_Fail" 1 "Alternator_Not_In_Fail";
VAL_ 262 CrankHold_W 0 "Not_Active" 1 "Active";
VAL_ 262 ECM_Ack_DriveMode 0 "No_programs_available_selected" 1 "Eco" 2 "Sport" 3 "Valet" 4 "Ice_Winter" 5 "Tow_Haul" 6 "Track" 7 "4LowMode" 8 "HDC_SSC" 9 "Rock" 10 "Sand" 11 "Mud" 12 "Normal" 13 "Mud_Sand";
VAL_ 262 ECM_LHOM_Trans_W 0 "Limp Home not Active" 1 "No Redundant Torque Req" 2 "Precise Torque +/-15%" 3 "Imprecise Torque";
VAL_ 262 ECM_LHOM_W 0 "Not_In_Limp_Home" 1 "In_Limp_Home";
VAL_ 262 EngineFrictionTorque_W 511 "SNA";
VAL_ 262 EngineIdleRefSpeed 4095 "SNA";
VAL_ 262 EngineSailingRq 0 "Not_Request" 1 "Request";
VAL_ 262 EngineSpeed_W 16383 "SNA";
VAL_ 262 EngineSpeedFailSts_W 0 "Fail_not_present" 1 "Fail_present";
VAL_ 262 EngineSts_W 0 "Engine_Off" 1 "Engine_Cranking" 2 "Engine_On" 3 "SNA";
VAL_ 262 EngRPM_Tach 65535 "SNA";
VAL_ 262 EngTrq_Enbl_Rq_TCM_W 0 "Not_Active" 1 "Active";
VAL_ 262 ESS_EBOOST_BRKHLD_STATUS 0 "Default_Hold_BSM" 1 "ImmediateRelease" 2 "PositiveGradeTorqueBlending" 3 "NegativeGradeTorqueBlending" 7 "SNA";
VAL_ 262 ESS_ENG_ST_W 1 "ENS Stopped / ENS_STOPPED" 2 "ENS Request Start / ENS_RQ_ST" 3 "ENS Running / ENS_RUN" 4 "ENS Stop Pending / ENS_STOP_PEND" 5 "ENS Start protection / ENS_ST_PRTCT" 6 "ENS Start inhibit / ENS_ST_INH" 7 "ENS disabled / ENS_DSBL" 8 "ENS_IHB_LATCH" 9 "ENS Starting / ENS_Starting" 15 "SNA";
VAL_ 262 EVRDesiredSetpoint 255 "SNA";
VAL_ 262 FullOFC_Actv 0 "Not_Active" 1 "Active";
VAL_ 262 GasPedalGradient_W 255 "SNA";
VAL_ 262 GasPedalPosition_W 255 "SNA";
VAL_ 262 GasPedalPositionFailSts_W 0 "Fail_not_present" 1 "Fail_present";
VAL_ 262 IntakeAirTemperature_W 255 "SNA";
VAL_ 262 KickDownRequest_W 0 "No_kd_request" 1 "Kd_request";
VAL_ 262 LV12PwrFreeRq_W 0 "Level 1 or 2 Power free Mode NOT active" 1 "Level 1 or 2 Power free Mode Active";
VAL_ 262 PowertrainPrplsnActv 0 "Off" 1 "Active";
VAL_ 262 StartRelayBCMCmd_W 0 "Not_Action" 1 "Action";
VAL_ 262 TRANS_CLU_SLIP_MODE_W 0 "NORMAL" 1 "MDS_RQ" 2 "IDFSO_RQ" 3 "AC_EN_DIS_RQ" 4 "IDFSO_ACTIVE" 5 "MDS_IDFSO_ACT" 7 "SNA";
VAL_ 262 TxAC_EMCC_rq_W 0 "False" 1 "True";
VAL_ 1036 AfterRunCoolantPumpFailSts 0 "Fault_Not_Present" 1 "Fault_Present";
VAL_ 1036 AxleInAir_Stat 0 "None" 1 "Rough_terrain" 2 "Front_in_air" 3 "Rear_in_air" 4 "Both_in_air" 7 "SNA";
VAL_ 1036 CODE_CTGY 0 "FLS_P" 1 "FLS_C" 2 "FLS_B" 3 "FLS_U";
VAL_ 1036 CoolVlvPos 255 "SNA";
VAL_ 1036 DefFuelEcon 255 "SNA";
VAL_ 1036 DistOilLifeRst 65535 "SNA";
VAL_ 1036 ECM_Thermal_AAD_Request 0 "Normal_Level" 1 "Low_Level";
VAL_ 1036 EngineOilCritical 0 "False" 1 "True";
VAL_ 1036 EngineOilLevel 0 "Level1" 1 "Level2" 2 "Level3" 3 "Level4" 4 "Level5" 5 "Level6" 6 "Level7" 7 "Level8" 8 "Level9" 9 "Level10" 10 "Level11" 11 "Level12" 12 "Level13" 13 "Level14" 31 "SNA";
VAL_ 1036 EngineOilMin 0 "False" 1 "True";
VAL_ 1036 EngineOilOverfill 0 "False" 1 "True";
VAL_ 1036 EngineOilTemperature 255 "SNA";
VAL_ 1036 FANStatus 127 "SNA";
VAL_ 1036 OIL_IND_LMP_FLSH 0 "Not_active" 1 "Active";
VAL_ 1036 OIL_TEMP_CHM_RQ 0 "NONE" 1 "SINGLE" 2 "SLOW" 3 "FAST";
VAL_ 1036 OIL_TEMP_IND_RQ 0 "OFF" 1 "ON" 2 "FLASH" 3 "SNA";
VAL_ 1036 OilLifeLeft 255 "SNA";
VAL_ 1036 OilLifeLeftRst 0 "Not_Active" 1 "Active";
VAL_ 1036 PT_WorkSite_Invtr_Sts_ECM 0 "NOT_ACTIVE" 1 "ACTIVE" 3 "SNA";
