VERSION ""

NS_ :

BS_:

BU_: AGSM BCM BSM CADM DMSM DTCM ECM EVCU2 GNMM HCP IPC RFHM SGW TCM
BO_ 1956 HYBRID_RM_MOTORS: 32 EVCU2
 SG_ MotorA_DC_Current : 38|15@0+ (0.1,-1638.4) [-1638.4|1638.3] "A" Vector__XXX
 SG_ MotorA_DC_Voltage : 97|10@0+ (1,0) [0|1023] "V" Vector__XXX
 SG_ MotorA_InverterState : 101|4@0+ (1,0) [0|15] "" Vector__XXX
 SG_ MotorA_InverterTemp : 143|8@0+ (1,-40) [-40|215] "oC" Vector__XXX
 SG_ MotorA_RPM : 7|16@0+ (1,-32768) [-32768|32767] "RPM" Vector__XXX
 SG_ MotorA_Temperature : 135|8@0+ (1,-40) [-40|215] "oC" IPC
 SG_ MotorA_TorqueAchieved : 68|13@0+ (0.125,-512) [-512|511.875] "Nm" Vector__XXX
 SG_ MotorB_DC_Current : 54|15@0+ (0.1,-1638.4) [-1638.4|1638.3] "A" Vector__XXX
 SG_ MotorB_DC_Voltage : 113|10@0+ (1,0) [0|1023] "V" Vector__XXX
 SG_ MotorB_InverterState : 117|4@0+ (1,0) [0|15] "" Vector__XXX
 SG_ MotorB_InverterTemp : 159|8@0+ (1,-40) [-40|215] "oC" Vector__XXX
 SG_ MotorB_RPM : 23|16@0+ (1,-32768) [-32768|32767] "RPM" Vector__XXX
 SG_ MotorB_Temperature : 151|8@0+ (1,-40) [-40|215] "oC" IPC
 SG_ MotorB_TorqueAchieved : 84|13@0+ (0.125,-512) [-512|511.875] "Nm" Vector__XXX
 SG_ Warning_DCDCPerformance_DPT : 85|1@0+ (1,0) [0|1] "" Vector__XXX
 SG_ Warning_DCDCTemp_DPT : 71|1@0+ (1,0) [0|1] "" Vector__XXX
 SG_ Warning_InverterA_Overtemp : 69|1@0+ (1,0) [0|1] "" Vector__XXX
 SG_ Warning_InverterB_Overtemp : 70|1@0+ (1,0) [0|1] "" Vector__XXX
 SG_ Warning_MotorA_Overtemp : 39|1@0+ (1,0) [0|1] "" Vector__XXX
 SG_ Warning_MotorB_Overtemp : 55|1@0+ (1,0) [0|1] "" Vector__XXX

BO_ 1853 HYBRID_RM_MOTORS_2: 32 EVCU2
 SG_ APM_CtrlSts_Fbk : 145|4@0+ (1,0) [0|15] "" Vector__XXX
 SG_ APM_FailureReason : 151|6@0+ (1,0) [0|63] "" SGW
 SG_ APM_OutputPower : 119|10@0+ (3,0) [0|3069] "W" SGW

BO_ 1032 HYBRID_THERMAL_COMMAND: 32 EVCU2
 SG_ AirflowRequest : 62|7@0+ (1,0) [0|100] "%" ECM
 SG_ LTR_PumpFlowRequest : 70|7@0+ (1,0) [0|100] "%" ECM
 SG_ RadiatorFanSts : 78|7@0+ (1,0) [0|100] "%" ECM

BO_ 752 IBS3_DATA_1: 32 BCM
 SG_ CRC_IBS3DATA1 : 191|8@0+ (1,0) [0|255] "0" ECM,EVCU2
 SG_ CurrBattFailStatus : 103|1@0+ (1,0) [0|1] "" ECM,EVCU2
 SG_ IBS3_Error_Internal : 101|1@0+ (1,0) [0|1] "" ECM,EVCU2
 SG_ IBS3_Ibatt : 87|16@0+ (0.02,-1000) [-1000|310.68] "A" ECM,EVCU2,SGW
 SG_ IBS3_SOF_V_Accuracy : 99|1@0+ (1,0) [0|1] "" ECM,EVCU2
 SG_ IBS3_SOF_VC : 118|7@0+ (0.05,5) [5|11.3] "V" ECM,EVCU2
 SG_ IBS3_Vbatt : 96|9@0+ (0.025,5) [5|17.75] "V" ECM,EVCU2,HCP,RFHM,SGW
 SG_ MessageCounter_IBS3DATA1 : 179|4@0+ (1,0) [0|15] "0" ECM,EVCU2
 SG_ RsErrIBS3 : 100|1@0+ (1,0) [0|1] "" ECM,EVCU2
 SG_ VoltBattFailStatus : 102|1@0+ (1,0) [0|1] "" ECM,EVCU2,HCP

BO_ 754 IBS3_DATA_1_2: 32 BCM
 SG_ CurrBattFailStatus_2 : 103|1@0+ (1,0) [0|1] "" Vector__XXX
 SG_ IBS3_Error_Internal_2 : 101|1@0+ (1,0) [0|1] "" Vector__XXX
 SG_ RsErrIBS3_2 : 100|1@0+ (1,0) [0|1] "" Vector__XXX
 SG_ VoltBattFailStatus_2 : 102|1@0+ (1,0) [0|1] "" Vector__XXX

BO_ 1955 IBS3_DATA_2: 32 BCM
 SG_ CRC_IBS3DATA2 : 191|8@0+ (1,0) [0|255] "0" EVCU2
 SG_ IBS3_CRC_IBS_1 : 15|8@0+ (1,0) [0|254] "" CADM
 SG_ IBS3_CRC_IBS_2 : 71|8@0+ (1,0) [0|254] "" CADM
 SG_ IBS3_FLAG_DISCONNECT : 117|1@0+ (1,0) [0|1] "" ECM,EVCU2
 SG_ IBS3_FLAG_DISCONNECT_ADAS : 1|2@0+ (1,0) [0|2] "" CADM
 SG_ IBS3_FLAG_DISCONNECT_ADAS_2 : 17|2@0+ (1,0) [0|2] "" CADM
 SG_ IBS3_IBS_ADAS_OK : 3|2@0+ (1,0) [0|2] "" CADM
 SG_ IBS3_IBS_ADAS_OK_2 : 19|2@0+ (1,0) [0|2] "" CADM
 SG_ IBS3_MC_IBS_1 : 7|4@0+ (1,0) [0|15] "" CADM
 SG_ IBS3_MC_IBS_2 : 23|4@0+ (1,0) [0|15] "" CADM
 SG_ IBS3_Q_received : 159|16@0+ (0.125,0) [0|8191.75] "Ah" EVCU2
 SG_ IBS3_Q_released : 31|16@0+ (0.125,0) [0|8191.75] "Ah" EVCU2
 SG_ IBS3_R_Batt : 63|8@0+ (0.1,0) [0|25.4] "mOhm" EVCU2
 SG_ IBS3_R_Batt_25 : 79|8@0+ (0.1,0) [0|25.4] "mOhm" EVCU2
 SG_ IBS3_SOC : 86|7@0+ (1,0) [0|100] "%" CADM,ECM,EVCU2,HCP,RFHM,SGW
 SG_ IBS3_SOC_Accuracy : 87|1@0+ (1,0) [0|1] "" ECM,EVCU2,HCP,RFHM,SGW
 SG_ IBS3_SOF_Q : 103|8@0+ (1,0) [0|254] "Ah" EVCU2
 SG_ IBS3_SOF_Q_Accuracy : 118|1@0+ (1,0) [0|1] "" EVCU2
 SG_ IBS3_SOH_COR : 46|7@0+ (1,0) [0|100] "%" EVCU2
 SG_ IBS3_SOH_COR_Accuracy : 47|1@0+ (1,0) [0|1] "" EVCU2
 SG_ IBS3_SOH_Q : 110|7@0+ (2,0) [0|252] "Ah" ECM,EVCU2
 SG_ IBS3_SOH_Q_Accuracy : 119|1@0+ (1,0) [0|1] "" ECM,EVCU2
 SG_ IBS3_SOH_SUL : 54|7@0+ (1,0) [0|100] "%" EVCU2
 SG_ IBS3_SOH_SUL_Accuracy : 55|1@0+ (1,0) [0|1] "" EVCU2
 SG_ IBS3_T_BATT : 95|8@0+ (1,-40) [-40|105] "°C" ECM,EVCU2,HCP,SGW
 SG_ IBS3_TempFailStatus : 111|1@0+ (1,0) [0|1] "" ECM,EVCU2,HCP,SGW
 SG_ IBS3_Tm_Lst_Reset_Days : 139|12@0+ (1,0) [0|4094] "Days" EVCU2
 SG_ IBS3_Tm_Lst_Reset_Sec : 127|16@0+ (2,0) [0|86398] "sec" EVCU2
 SG_ MessageCounter_IBS3DATA2 : 179|4@0+ (1,0) [0|15] "0" EVCU2

BO_ 100 IMMO_CODE_REQUEST: 32 ECM
 SG_ ControlEncodingReq : 87|8@0+ (1,0) [0|255] "-" BCM
 SG_ f1_1 : 95|8@0+ (1,0) [0|255] "-" BCM
 SG_ f1_2 : 103|8@0+ (1,0) [0|255] "-" BCM
 SG_ rnd_1 : 111|8@0+ (1,0) [0|255] "-" BCM
 SG_ rnd_2 : 119|8@0+ (1,0) [0|255] "-" BCM
 SG_ rnd_3 : 127|8@0+ (1,0) [0|255] "-" BCM
 SG_ rnd_4 : 135|8@0+ (1,0) [0|255] "-" BCM

BO_ 104 IMMO_CODE_RESPONSE: 32 BCM
 SG_ ControlEncodingRsp : 87|8@0+ (1,0) [0|255] "-" ECM,EVCU2
 SG_ ImmoParkReq : 7|1@0+ (1,0) [0|1] "-" EVCU2
 SG_ MKKey_3 : 111|8@0+ (1,0) [0|255] "-" ECM,EVCU2
 SG_ MKKey_4 : 119|8@0+ (1,0) [0|255] "-" ECM,EVCU2
 SG_ MKKey_5 : 127|8@0+ (1,0) [0|255] "-" ECM,EVCU2
 SG_ MKKey_6 : 135|8@0+ (1,0) [0|255] "-" ECM,EVCU2
 SG_ MKKey1org21 : 95|8@0+ (1,0) [0|255] "-" ECM,EVCU2
 SG_ MKKey2org22 : 103|8@0+ (1,0) [0|255] "-" ECM,EVCU2

BO_ 1626 IMPACT_INFO: 32 BCM
 SG_ CRC_IMPACTINFO : 191|8@0+ (1,0) [0|255] "-" DMSM,EVCU2,HCP
 SG_ IMPACTCommand : 80|1@0+ (1,0) [0|1] "-" DMSM,ECM,EVCU2
 SG_ IMPACTConfirm : 81|1@0+ (1,0) [0|1] "-" DMSM,ECM,EVCU2
 SG_ IMPACTThreshold : 103|1@0+ (1,0) [0|1] "-" ECM
 SG_ MessageCounter_IMPACTINFO : 179|4@0+ (1,0) [0|15] "-" DMSM,EVCU2,HCP

BO_ 1829 IPC_FD_1: 32 IPC
 SG_ CRC_IPC1 : 191|8@0+ (1,0) [0|255] "-" BCM,BSM,CADM,DMSM,ECM
 SG_ InstantaneousFuelConsumption1 : 134|4@0+ (1,0) [0|15] "-" SGW
 SG_ InstantaneousFuelConsumption2 : 150|4@0+ (1,0) [0|15] "-" SGW
 SG_ InstantaneousFuelConsumption3 : 166|4@0+ (1,0) [0|15] "-" SGW
 SG_ MessageCounter_IPC1 : 179|4@0+ (1,0) [0|15] "-" BCM,BSM,CADM,DMSM,ECM
 SG_ PCODE_CTRL : 55|2@0+ (1,0) [0|3] "" ECM
 SG_ TotalOdometer : 75|20@0+ (1,0) [0|1048575] "km" AGSM,BCM,BSM,CADM,DMSM,DTCM,ECM,EVCU2,GNMM,HCP,RFHM,SGW,TCM
 SG_ Trailer_Trp_Rst : 151|1@0+ (1,0) [0|1] "" BCM

BO_ 1441 IPC_FD_10: 32 IPC
 SG_ DTE_Ave_Fuel_Econ : 161|10@0+ (0.05,0) [0|50] "kmpl" Vector__XXX

BO_ 1455 IPC_FD_11: 32 IPC
 SG_ A_EV_Kilometers : 55|24@0+ (0.1,0) [0|16093.3] "km" SGW
 SG_ A_EV_Miles : 31|24@0+ (0.1,0) [0|9999.9] "Mile" SGW
 SG_ A_Hybrid_Kilometers : 103|24@0+ (0.1,0) [0|16093.3] "km" SGW
 SG_ A_Hybrid_Miles : 79|24@0+ (0.1,0) [0|9999.9] "Mile" SGW
 SG_ AudioMenuPopup : 0|1@0+ (1,0) [0|1] "-" SGW
 SG_ Avg_Fuel_Econ : 9|10@0+ (0.05,0) [0|50] "kmpl" SGW
 SG_ Cluster_In_Audio_Md : 10|1@0+ (1,0) [0|1] "-" SGW
 SG_ IC_ETM_HUDCustom_Req : 2|2@0+ (1,0) [0|3] "-" SGW
 SG_ IPC_NavigationMap_Req : 5|2@0+ (1,0) [0|2] "-" SGW
 SG_ NavigationMapPopUP : 6|1@0+ (1,0) [0|1] "-" SGW
 SG_ NextNavInstructionPanelTheme : 183|4@0+ (1,0) [0|14] "" SGW

BO_ 1844 IPC_FD_12: 32 IPC
 SG_ B_EV_Kilometers : 63|24@0+ (0.1,0) [0|16093.3] "km" SGW
 SG_ B_EV_Miles : 39|24@0+ (0.1,0) [0|9999.9] "Mile" SGW
 SG_ B_Hybrid_Kilometers : 111|24@0+ (0.1,0) [0|16093.3] "km" SGW
 SG_ B_Hybrid_Miles : 87|24@0+ (0.1,0) [0|9999.9] "Mile" SGW

BO_ 1842 IPC_FD_13: 32 IPC
 SG_ FuelLvlIndicator : 71|8@0+ (1,0) [0|255] "%" SGW
 SG_ Gas_Range : 49|10@0+ (1,0) [0|1022] "km" BCM,SGW
 SG_ Total_Range : 34|11@0+ (1,0) [0|2046] "km" SGW

BO_ 1831 IPC_FD_3: 32 IPC
 SG_ ABS_IND_STAT : 83|2@0+ (1,0) [0|3] "" SGW
 SG_ ACC_WARN_STAT : 9|2@0+ (1,0) [0|3] "" SGW
 SG_ AIR_BAG_STAT : 11|2@0+ (1,0) [0|3] "" SGW
 SG_ AWD_IND_STAT : 141|2@0+ (1,0) [0|3] "" SGW
 SG_ AWD_SERVICE_STAT : 133|2@0+ (1,0) [0|3] "" SGW
 SG_ BATTERY_CHARGE_STAT : 73|2@0+ (1,0) [0|3] "" SGW
 SG_ BRAKE_PAD_STAT : 123|2@0+ (1,0) [0|3] "" SGW
 SG_ BRK_IND_STAT : 85|2@0+ (1,0) [0|3] "" SGW
 SG_ CARGO_LT_STAT : 137|2@0+ (1,0) [0|3] "" SGW
 SG_ CATALYST_TEMP_STAT : 99|2@0+ (1,0) [0|3] "" SGW
 SG_ COOLENT_LEVEL_STAT : 115|2@0+ (1,0) [0|3] "" SGW
 SG_ CRUISE_SET_STAT : 139|2@0+ (1,0) [0|3] "" SGW
 SG_ DAMPING_SYSTEM_STAT : 125|2@0+ (1,0) [0|3] "" SGW
 SG_ DEF_STAT : 119|2@0+ (1,0) [0|3] "" SGW
 SG_ DOORS_STAT : 151|2@0+ (1,0) [0|3] "" SGW
 SG_ ECO_MODE_STAT : 13|2@0+ (1,0) [0|3] "" SGW
 SG_ ELEC_STAB_STAT : 91|2@0+ (1,0) [0|3] "" SGW
 SG_ ELECTRIC_WRENCH_STAT : 129|2@0+ (1,0) [0|3] "" SGW
 SG_ ENGINE_MIL_STAT : 81|2@0+ (1,0) [0|3] "" SGW
 SG_ ENGINE_TEMP_STAT : 75|2@0+ (1,0) [0|3] "" SGW
 SG_ EPB_WARN_STAT : 131|2@0+ (1,0) [0|3] "" SGW
 SG_ EPS_STAT : 101|2@0+ (1,0) [0|3] "" SGW
 SG_ ESC_OFF_STAT : 147|2@0+ (1,0) [0|3] "" SGW
 SG_ ETC_CONTROL_STAT : 93|2@0+ (1,0) [0|3] "" SGW
 SG_ EXH_BRK_STAT : 171|2@0+ (1,0) [0|3] "" SGW
 SG_ FCW_SYSTEM_STAT : 111|2@0+ (1,0) [0|3] "" SGW
 SG_ FOUR_WD_SERVICE_STAT : 121|2@0+ (1,0) [0|3] "" SGW
 SG_ FT_FOG_STAT : 145|2@0+ (1,0) [0|3] "" SGW
 SG_ FUEL_CAP_STAT : 97|2@0+ (1,0) [0|3] "" SGW
 SG_ FUEL_CUT_OFF_STAT : 159|2@0+ (1,0) [0|3] "" SGW
 SG_ HDLT_LVL_STAT : 157|2@0+ (1,0) [0|3] "" SGW
 SG_ HI_BEAM_STAT : 153|2@0+ (1,0) [0|3] "" SGW
 SG_ HILL_DESCENT_STAT : 167|2@0+ (1,0) [0|3] "" SGW
 SG_ HVY_EXH_STAT : 155|2@0+ (1,0) [0|3] "" SGW
 SG_ LANE_DEPART_FAIL_STAT : 163|2@0+ (1,0) [0|3] "" SGW
 SG_ LANE_DEPART_STAT : 165|2@0+ (1,0) [0|3] "" SGW
 SG_ LANE_SENSE_STAT : 135|2@0+ (1,0) [0|3] "" SGW
 SG_ LIFT_GATE_STAT : 161|2@0+ (1,0) [0|3] "" SGW
 SG_ LT_EXH_STAT : 175|2@0+ (1,0) [0|3] "" SGW
 SG_ NAT_GAS_STAT : 173|2@0+ (1,0) [0|3] "" SGW
 SG_ OIL_LEVEL_STAT : 127|2@0+ (1,0) [0|3] "" SGW
 SG_ OIL_PRESSURE_STAT : 87|2@0+ (1,0) [0|3] "" SGW
 SG_ OIL_TEMP_STAT : 117|2@0+ (1,0) [0|3] "" SGW
 SG_ OVER_TEMP_STAT : 89|2@0+ (1,0) [0|3] "" SGW
 SG_ PARK_BRAKE_STAT : 149|2@0+ (1,0) [0|3] "" SGW
 SG_ POS_LIGHT_STAT : 169|2@0+ (1,0) [0|3] "" SGW
 SG_ SEAT_BELT_STAT : 183|2@0+ (1,0) [0|3] "" SGW
 SG_ SERVICE_ACC_STAT : 107|2@0+ (1,0) [0|3] "" SGW
 SG_ SERVICE_STAT : 113|2@0+ (1,0) [0|3] "" SGW
 SG_ SPEED_CTRL_STAT : 181|2@0+ (1,0) [0|3] "" SGW
 SG_ SPEED_LMT_STAT : 7|2@0+ (1,0) [0|3] "" SGW
 SG_ STOP_START_STAT : 103|2@0+ (1,0) [0|3] "" SGW
 SG_ STR_DIR_LT_STAT : 5|2@0+ (1,0) [0|3] "" SGW
 SG_ THEFT_ALARM_STAT : 15|2@0+ (1,0) [0|3] "" SGW
 SG_ TIRE_PRESSURE_STAT : 95|2@0+ (1,0) [0|3] "" SGW
 SG_ TORQUE_STAT : 143|2@0+ (1,0) [0|3] "" SGW
 SG_ TOW_HAUL_STAT : 3|2@0+ (1,0) [0|3] "" SGW
 SG_ TRK_OPN_STAT : 1|2@0+ (1,0) [0|3] "" SGW
 SG_ WATER_IN_FUEL_STAT : 105|2@0+ (1,0) [0|3] "" SGW
 SG_ WINDSHIELD_FLUID_STAT : 109|2@0+ (1,0) [0|3] "" SGW

BO_ 600 IPC_FD_4: 32 IPC
 SG_ AirBagLamp_FailSts : 143|2@0+ (1,0) [0|3] "-" BCM,SGW
 SG_ DisplayedSpeedLimSts : 119|8@0+ (1,0) [0|255] "" EVCU2,SGW
 SG_ OilChgRst : 162|1@0+ (1,0) [0|1] "" ECM

BO_ 1154 IPC_FD_5: 32 IPC
 SG_ Est_Range_Disp : 7|8@0+ (1,0) [0|254] "-" SGW
 SG_ Est_Range_Disp_Long : 119|11@0+ (1,0) [0|2047] "km,mi" SGW
 SG_ VehSpd_MPH : 93|1@0+ (1,0) [0|1] "" SGW
 SG_ VehSpdDisp : 103|16@0+ (1,0) [0|65534] "-" SGW

BO_TX_BU_ 1032 : EVCU2,HCP;
BO_TX_BU_ 100 : ECM,EVCU2;
CM_ SG_ 1956 MotorA_DC_Current "Motor A DC Current";
CM_ SG_ 1956 MotorA_DC_Voltage "Motor A DC Voltage";
CM_ SG_ 1956 MotorA_InverterState "Inverter State of Operation";
CM_ SG_ 1956 MotorA_InverterTemp "Inverter A Temperature";
CM_ SG_ 1956 MotorA_RPM "Motor A Speed Raw";
CM_ SG_ 1956 MotorA_Temperature "Motor A temperature";
CM_ SG_ 1956 MotorA_TorqueAchieved "Motor A Torque Achieved";
CM_ SG_ 1956 MotorB_DC_Current "Motor B DC Current";
CM_ SG_ 1956 MotorB_DC_Voltage "Motor B DC Voltage";
CM_ SG_ 1956 MotorB_InverterState "Inverter State of Operation";
CM_ SG_ 1956 MotorB_InverterTemp "Inverter B Temperature";
CM_ SG_ 1956 MotorB_RPM "Motor B Speed Raw";
CM_ SG_ 1956 MotorB_Temperature "Motor B temperature";
CM_ SG_ 1956 MotorB_TorqueAchieved "Motor B Torque Achieved";
CM_ SG_ 1956 Warning_DCDCPerformance_DPT "APM performance warning";
CM_ SG_ 1956 Warning_DCDCTemp_DPT "APM temperature warning";
CM_ SG_ 1956 Warning_InverterA_Overtemp "Motor A inverter over-temperature warning";
CM_ SG_ 1956 Warning_InverterB_Overtemp "Motor B inverter over-temperature warning";
CM_ SG_ 1956 Warning_MotorA_Overtemp "Motor A over-temperature warning";
CM_ SG_ 1956 Warning_MotorB_Overtemp "Motor B over-temperature warning";
CM_ SG_ 1853 APM_CtrlSts_Fbk "This signal indicates the DC-DC feedback mode.";
CM_ SG_ 1853 APM_FailureReason "FailureReason";
CM_ SG_ 1853 APM_OutputPower "APM Output Power";
CM_ SG_ 1032 AirflowRequest "Air Flow Request";
CM_ SG_ 1032 LTR_PumpFlowRequest "Low Temperature Radiator Pump flow rate request from HCP";
CM_ SG_ 1032 RadiatorFanSts "Radiator Fan state";
CM_ SG_ 752 CRC_IBS3DATA1 "CRC according to SAE J1850 standard at each frame transmission.";
CM_ SG_ 752 CurrBattFailStatus "Failure Status of Current meas. (internal defect)";
CM_ SG_ 752 IBS3_Error_Internal "Error in IBS calibration data; No Error = [0], Error = [1]";
CM_ SG_ 752 IBS3_Ibatt "Battery current";
CM_ SG_ 752 IBS3_SOF_V_Accuracy "SOF_V accuracy; Data reliable = [0], unreliable = [1]";
CM_ SG_ 752 IBS3_SOF_VC "Predicted initial battery voltage dip during cranking (old CG spec)";
CM_ SG_ 752 IBS3_Vbatt "Battery voltage measured at the terminals";
CM_ SG_ 752 MessageCounter_IBS3DATA1 "This signal is a counter used for safety checks strategies. This counter is incremented of 1 (one) unit at each frame transmission.";
CM_ SG_ 752 RsErrIBS3 "Response Error IBS; Error=[1]";
CM_ SG_ 752 VoltBattFailStatus "Failure Status of Voltage meas. (internal defect)";
CM_ SG_ 754 CurrBattFailStatus_2 "Failure Status of Current meas. (internal defect)";
CM_ SG_ 754 IBS3_Error_Internal_2 "Error in IBS calibration data; No Error = [0], Error = [1]";
CM_ SG_ 754 RsErrIBS3_2 "Response Error IBS; Error=[1]";
CM_ SG_ 754 VoltBattFailStatus_2 "Failure Status of Voltage meas. (internal defect)";
CM_ SG_ 1955 CRC_IBS3DATA2 "CRC according to SAE J1850 standard at each frame transmission.";
CM_ SG_ 1955 IBS3_CRC_IBS_1 "CRC";
CM_ SG_ 1955 IBS3_CRC_IBS_2 "CRC";
CM_ SG_ 1955 IBS3_FLAG_DISCONNECT "Battery disconnection flag";
CM_ SG_ 1955 IBS3_FLAG_DISCONNECT_ADAS "IBS indicates that the reason for unknown values is a recent battery disconnection";
CM_ SG_ 1955 IBS3_FLAG_DISCONNECT_ADAS_2 "IBS indicates that the reason for unknown values is a recent battery disconnection";
CM_ SG_ 1955 IBS3_IBS_ADAS_OK "IBS indicates that battery is able to support ADAS operation";
CM_ SG_ 1955 IBS3_IBS_ADAS_OK_2 "IBS indicates that battery is able to support ADAS operation";
CM_ SG_ 1955 IBS3_MC_IBS_1 "Message Counter";
CM_ SG_ 1955 IBS3_MC_IBS_2 "Message Counter";
CM_ SG_ 1955 IBS3_Q_received "LifeTime charge received";
CM_ SG_ 1955 IBS3_Q_released "Lifetime charge released";
CM_ SG_ 1955 IBS3_R_Batt "Calculated battery resistance";
CM_ SG_ 1955 IBS3_R_Batt_25 "Batt resistance at 100% SOC and 25 degC";
CM_ SG_ 1955 IBS3_SOC "State of charge";
CM_ SG_ 1955 IBS3_SOC_Accuracy "SOC accuracy status";
CM_ SG_ 1955 IBS3_SOF_Q "Residual battery charge in Ah";
CM_ SG_ 1955 IBS3_SOF_Q_Accuracy "SOF_Q accuracy status";
CM_ SG_ 1955 IBS3_SOH_COR "Ageing related to voltage drop predicted for -18°C cold crank due to corrosion";
CM_ SG_ 1955 IBS3_SOH_COR_Accuracy "SOH_COR accuracy status ( Inaccurate = 0 / Accurate = 1)";
CM_ SG_ 1955 IBS3_SOH_Q "State of health related to capacity (energy)";
CM_ SG_ 1955 IBS3_SOH_Q_Accuracy "SOH_Q accuracy status";
CM_ SG_ 1955 IBS3_SOH_SUL "Maximum SOC available due to the fact that the battery could be sulphated";
CM_ SG_ 1955 IBS3_SOH_SUL_Accuracy "SOH_SUL accuracy status ( Inaccurate = 0 / Accurate = 1)";
CM_ SG_ 1955 IBS3_T_BATT "Battery temperature";
CM_ SG_ 1955 IBS3_TempFailStatus "Failure of ASIC Temperature meas. (internal defect)";
CM_ SG_ 1955 IBS3_Tm_Lst_Reset_Days "Accumulated time since last reset in days";
CM_ SG_ 1955 IBS3_Tm_Lst_Reset_Sec "Accumulated time since last reset in seconds";
CM_ SG_ 1955 MessageCounter_IBS3DATA2 "This signal is a counter used for safety checks strategies. This counter is incremented of 1 (one) unit at each frame transmission.";
CM_ SG_ 100 ControlEncodingReq "This signal is used for IMMO communication";
CM_ SG_ 100 f1_1 "This signal is used for IMMO communication";
CM_ SG_ 100 f1_2 "This signal is used for IMMO communication";
CM_ SG_ 100 rnd_1 "This signal is used for IMMO communication";
CM_ SG_ 100 rnd_2 "This signal is used for IMMO communication";
CM_ SG_ 100 rnd_3 "This signal is used for IMMO communication";
CM_ SG_ 100 rnd_4 "This signal is used for IMMO communication";
CM_ SG_ 104 ControlEncodingRsp "This signal is used for IMMO communication";
CM_ SG_ 104 ImmoParkReq "Parl lock request for immo code";
CM_ SG_ 104 MKKey_3 "This signal is used for IMMO communication";
CM_ SG_ 104 MKKey_4 "This signal is used for IMMO communication";
CM_ SG_ 104 MKKey_5 "This signal is used for IMMO communication";
CM_ SG_ 104 MKKey_6 "This signal is used for IMMO communication";
CM_ SG_ 104 MKKey1org21 "This signal is used for IMMO communication";
CM_ SG_ 104 MKKey2org22 "This signal is used for IMMO communication";
CM_ SG_ 1626 CRC_IMPACTINFO "CRC according to SAE J1850 standard at each frame transmission.";
CM_ SG_ 1626 IMPACTCommand "This signal is used to indicate that a crash happened";
CM_ SG_ 1626 IMPACTConfirm "This signal is used to confirm that a crash happened";
CM_ SG_ 1626 IMPACTThreshold "Upon a crash, the ORC Calibration Threshold was either \"Met\" or \"Not_Met\".";
CM_ SG_ 1626 MessageCounter_IMPACTINFO "This signal is a counter used for safety checks strategies. This counter is incremented of 1 (one) unit at each frame transmission.";
CM_ SG_ 1829 CRC_IPC1 "CRC according to SAE J1850 standard at each frame transmission.";
CM_ SG_ 1829 InstantaneousFuelConsumption1 "Used to give information about the tens of the instantaneous fuel consumption value.";
CM_ SG_ 1829 InstantaneousFuelConsumption2 "Used to give information about the units of the instantaneous fuel consumption value.";
CM_ SG_ 1829 InstantaneousFuelConsumption3 "Used to give information about the tenths of the instantaneous fuel consumption value.";
CM_ SG_ 1829 MessageCounter_IPC1 "This signal is a counter used for safety checks strategies. This counter is incremented of 1 (one) unit at each frame transmission.";
CM_ SG_ 1829 PCODE_CTRL "P-Code control signal from CCN";
CM_ SG_ 1829 TotalOdometer "Used to give information about the total odometer value in km.";
CM_ SG_ 1829 Trailer_Trp_Rst "Trailer Trip Reset Request";
CM_ SG_ 1441 DTE_Ave_Fuel_Econ "Signal for giving average fuel economy used for calculating the distance to empty";
CM_ SG_ 1455 A_EV_Kilometers "Trip A EV distance in kilometers";
CM_ SG_ 1455 A_EV_Miles "Trip A EV distance in US miles";
CM_ SG_ 1455 A_Hybrid_Kilometers "Trip A hybrid distance in kilometers";
CM_ SG_ 1455 A_Hybrid_Miles "Trip A hybrid distance in US miles";
CM_ SG_ 1455 AudioMenuPopup "Pop-up present on the Audio Menu";
CM_ SG_ 1455 Avg_Fuel_Econ "Average fuel economy";
CM_ SG_ 1455 Cluster_In_Audio_Md "Cluster display screen for Audio mode";
CM_ SG_ 1455 IC_ETM_HUDCustom_Req "IC to ETM HUD Customization Request";
CM_ SG_ 1455 IPC_NavigationMap_Req "IPC Navigation Map Req";
CM_ SG_ 1455 NavigationMapPopUP "Navigation Map PopUP";
CM_ SG_ 1455 NextNavInstructionPanelTheme "Next Nav Instruction Panel Theme";
CM_ SG_ 1844 B_EV_Kilometers "Trip B EV distance in kilometers";
CM_ SG_ 1844 B_EV_Miles "Trip B EV distance in US miles";
CM_ SG_ 1844 B_Hybrid_Kilometers "Trip B hybrid distance in kilometers";
CM_ SG_ 1844 B_Hybrid_Miles "Trip B hybrid distance in US miles";
CM_ SG_ 1842 FuelLvlIndicator "Fuel Level gauge display";
CM_ SG_ 1842 Gas_Range "Gas range or DTE";
CM_ SG_ 1842 Total_Range "Total range or DTE";
CM_ SG_ 1831 ABS_IND_STAT "Anti-lock Brake System";
CM_ SG_ 1831 ACC_WARN_STAT "ACC Ready";
CM_ SG_ 1831 AIR_BAG_STAT "Air Bag";
CM_ SG_ 1831 AWD_IND_STAT "4WD Low Indicator";
CM_ SG_ 1831 AWD_SERVICE_STAT "Service AWD";
CM_ SG_ 1831 BATTERY_CHARGE_STAT "Battery Charge";
CM_ SG_ 1831 BRAKE_PAD_STAT "Brake Pad Failure";
CM_ SG_ 1831 BRK_IND_STAT "Parking Brake and Low Brake Fluid";
CM_ SG_ 1831 CARGO_LT_STAT "Cargo Light";
CM_ SG_ 1831 CATALYST_TEMP_STAT "Catalyst Overtemp";
CM_ SG_ 1831 COOLENT_LEVEL_STAT "Low Coolent Level";
CM_ SG_ 1831 CRUISE_SET_STAT "Cruise Set";
CM_ SG_ 1831 DAMPING_SYSTEM_STAT "Damping System Failure";
CM_ SG_ 1831 DEF_STAT "LowDieselExhaustFuel";
CM_ SG_ 1831 DOORS_STAT "Door(s) Open";
CM_ SG_ 1831 ECO_MODE_STAT "Eco Mode";
CM_ SG_ 1831 ELEC_STAB_STAT "Electronic Stability Control";
CM_ SG_ 1831 ELECTRIC_WRENCH_STAT "Electric Wrench";
CM_ SG_ 1831 ENGINE_MIL_STAT "Check Engine / MIL";
CM_ SG_ 1831 ENGINE_TEMP_STAT "Engine Temperature";
CM_ SG_ 1831 EPB_WARN_STAT "EPB Warning";
CM_ SG_ 1831 EPS_STAT "EPS Fail";
CM_ SG_ 1831 ESC_OFF_STAT "Electronic Stability Control off";
CM_ SG_ 1831 ETC_CONTROL_STAT "ETC(Electronic Throttle Control)";
CM_ SG_ 1831 EXH_BRK_STAT "Medium Exhaust Brake Mode";
CM_ SG_ 1831 FCW_SYSTEM_STAT "Service FCW System";
CM_ SG_ 1831 FOUR_WD_SERVICE_STAT "Service 4WD";
CM_ SG_ 1831 FT_FOG_STAT "Front Fog Lamps";
CM_ SG_ 1831 FUEL_CAP_STAT "Fuel Cap Unfastened";
CM_ SG_ 1831 FUEL_CUT_OFF_STAT "Fuel  Cut Off";
CM_ SG_ 1831 HDLT_LVL_STAT "Headlight Levelling";
CM_ SG_ 1831 HI_BEAM_STAT "High Beam";
CM_ SG_ 1831 HILL_DESCENT_STAT "Hill Descent Control";
CM_ SG_ 1831 HVY_EXH_STAT "Heavy Exhaust Brake mode";
CM_ SG_ 1831 LANE_DEPART_FAIL_STAT "Lane Departure Failure";
CM_ SG_ 1831 LANE_DEPART_STAT "Lane Departure";
CM_ SG_ 1831 LANE_SENSE_STAT "Lane Sense Failure";
CM_ SG_ 1831 LIFT_GATE_STAT "Lift Gate Open";
CM_ SG_ 1831 LT_EXH_STAT "Light Exhaust Brake Mode";
CM_ SG_ 1831 NAT_GAS_STAT "Low Compressed Natural Gas";
CM_ SG_ 1831 OIL_LEVEL_STAT "Oil Level";
CM_ SG_ 1831 OIL_PRESSURE_STAT "Oil Pressure";
CM_ SG_ 1831 OIL_TEMP_STAT "OilTemperature";
CM_ SG_ 1831 OVER_TEMP_STAT "Transmission Over Temperature";
CM_ SG_ 1831 PARK_BRAKE_STAT "Electronic Park Brake";
CM_ SG_ 1831 POS_LIGHT_STAT "Position Lights";
CM_ SG_ 1831 SEAT_BELT_STAT "Seat Belt";
CM_ SG_ 1831 SERVICE_ACC_STAT "Service ACC System";
CM_ SG_ 1831 SERVICE_STAT "Service";
CM_ SG_ 1831 SPEED_CTRL_STAT "SelectSpeedControlLamp";
CM_ SG_ 1831 SPEED_LMT_STAT "Speed Limiter Indicator";
CM_ SG_ 1831 STOP_START_STAT "Stop/Start Service";
CM_ SG_ 1831 STR_DIR_LT_STAT "Steering Directed Head Lights";
CM_ SG_ 1831 THEFT_ALARM_STAT "Vehicle Theft Alarm";
CM_ SG_ 1831 TIRE_PRESSURE_STAT "Tire pressure Monitoring";
CM_ SG_ 1831 TORQUE_STAT "Torque Limited";
CM_ SG_ 1831 TOW_HAUL_STAT "Tow/Haul";
CM_ SG_ 1831 TRK_OPN_STAT "Trunk Open";
CM_ SG_ 1831 WATER_IN_FUEL_STAT "Water In Fuel";
CM_ SG_ 1831 WINDSHIELD_FLUID_STAT "Windshield Water Fluid";
CM_ SG_ 600 AirBagLamp_FailSts "This signal is used to inform about the airbag warning light status";
CM_ SG_ 600 DisplayedSpeedLimSts "This signal indicates the road sign of vehicle speed limit displayed by IPC";
CM_ SG_ 600 OilChgRst "This signal sends the reset command via the EVIC.";
CM_ SG_ 1154 Est_Range_Disp "Estimated electric range for display";
CM_ SG_ 1154 Est_Range_Disp_Long "Estimate vehicle range";
CM_ SG_ 1154 VehSpd_MPH "Vehicle speed signal is in miles per hour format";
CM_ SG_ 1154 VehSpdDisp "Vehicle speed - displayed";

BA_DEF_ SG_ "GenSigStartValue" INT 0 2147483647;
BA_DEF_ SG_ "GenSigInactiveValue" INT 0 2147483647;
BA_DEF_ SG_ "GenSigSendType" ENUM "NotUsed","OnWrite","OnWriteWithRepetition","OnChange","OnChangeWithRepetition","IfActive","IfActiveWithRepetition","NoSigSendType";
BA_DEF_ SG_ "SystemSignalLongSymbol" STRING ;
BA_DEF_ SG_ "GenSigTimeoutTime_AGSM" INT 0 65535;
BA_DEF_ SG_ "GenSigTimeoutTime_BCM" INT 0 65535;
BA_DEF_ SG_ "GenSigTimeoutTime_BSM" INT 0 65535;
BA_DEF_ SG_ "GenSigTimeoutTime_CADM" INT 0 65535;
BA_DEF_ SG_ "GenSigTimeoutTime_DMSM" INT 0 65535;
BA_DEF_ SG_ "GenSigTimeoutTime_DTCM" INT 0 65535;
BA_DEF_ SG_ "GenSigTimeoutTime_ECM" INT 0 65535;
BA_DEF_ SG_ "GenSigTimeoutTime_EVCU2" INT 0 65535;
BA_DEF_ SG_ "GenSigTimeoutTime_GNMM" INT 0 65535;
BA_DEF_ SG_ "GenSigTimeoutTime_HCP" INT 0 65535;
BA_DEF_ SG_ "GenSigTimeoutTime_IPC" INT 0 65535;
BA_DEF_ SG_ "GenSigTimeoutTime_RFHM" INT 0 65535;
BA_DEF_ SG_ "GenSigTimeoutTime_SGW" INT 0 65535;
BA_DEF_ SG_ "GenSigTimeoutTime_TCM" INT 0 65535;
BA_DEF_ BO_ "DiagRequest" ENUM "No","Yes";
BA_DEF_ BO_ "Type" ENUM "P","C","PE","COC","PE_Cntrl","E","E_Cntrl","OC","S","BAF","DC","EM","MM","ISO-TP","-";
BA_DEF_ BO_ "DiagResponse" ENUM "No","Yes";
BA_DEF_ BO_ "NmMessage" ENUM "No","Yes";
BA_DEF_ BO_ "GenMsgSendType" ENUM "Cyclic","NotUsed","NotUsed","NotUsed","NotUsed","NotUsed","NotUsed","NotUsed","NoMsgSendType";
BA_DEF_ BO_ "GenMsgNrOfRepetition" INT 0 255;
BA_DEF_ BO_ "GenMsgILSupport" ENUM "No","Yes";
BA_DEF_ BO_ "GenMsgStartDelayTime" INT 0 65535;
BA_DEF_ BO_ "GenMsgCycleTimeFast" INT 0 65535;
BA_DEF_ BO_ "GenMsgCycleTime" INT 0 65535;
BA_DEF_ BO_ "GenMsgDelayTime" INT 0 65535;
BA_DEF_ BO_ "NmAsrMessage" ENUM "No","Yes";
BA_DEF_ BO_ "DiagState" ENUM "No","Yes";
BA_DEF_ BO_ "DiagConnection" HEX 0 65535;
BA_DEF_ BO_ "VFrameFormat" ENUM "StandardCAN","ExtendedCAN","reserved","reserved","reserved","reserved","reserved","reserved","reserved","reserved","reserved","reserved","reserved","reserved","StandardCAN_FD","ExtendedCAN_FD";
BA_DEF_ BO_ "CANFD_BRS" ENUM "0","1";
BA_DEF_DEF_ "DiagRequest" "No";
BA_DEF_DEF_ "Type" "-";
BA_DEF_DEF_ "DiagResponse" "No";
BA_DEF_DEF_ "NmMessage" "No";
BA_DEF_DEF_ "GenMsgSendType" "NoMsgSendType";
BA_DEF_DEF_ "GenMsgNrOfRepetition" 0;
BA_DEF_DEF_ "GenMsgILSupport" "No";
BA_DEF_DEF_ "GenMsgStartDelayTime" 0;
BA_DEF_DEF_ "GenMsgCycleTimeFast" 0;
BA_DEF_DEF_ "GenMsgCycleTime" 0;
BA_DEF_DEF_ "GenMsgDelayTime" 0;
BA_DEF_DEF_ "NmAsrMessage" "No";
BA_DEF_DEF_ "DiagState" "No";
BA_DEF_DEF_ "DiagConnection" 0;
BA_DEF_DEF_ "VFrameFormat" "StandardCAN_FD";
BA_DEF_DEF_ "CANFD_BRS" "0";
BA_DEF_DEF_ "GenSigStartValue" 0;
BA_DEF_DEF_ "GenSigInactiveValue" 0;
BA_DEF_DEF_ "GenSigSendType" "NoSigSendType";
BA_DEF_DEF_ "SystemSignalLongSymbol" "";
BA_DEF_DEF_ "GenSigTimeoutTime_AGSM" 2500;
BA_DEF_DEF_ "GenSigTimeoutTime_BCM" 2500;
BA_DEF_DEF_ "GenSigTimeoutTime_BSM" 2500;
BA_DEF_DEF_ "GenSigTimeoutTime_CADM" 2500;
BA_DEF_DEF_ "GenSigTimeoutTime_DMSM" 2500;
BA_DEF_DEF_ "GenSigTimeoutTime_DTCM" 2500;
BA_DEF_DEF_ "GenSigTimeoutTime_ECM" 2500;
BA_DEF_DEF_ "GenSigTimeoutTime_EVCU2" 2500;
BA_DEF_DEF_ "GenSigTimeoutTime_GNMM" 2500;
BA_DEF_DEF_ "GenSigTimeoutTime_HCP" 2500;
BA_DEF_DEF_ "GenSigTimeoutTime_IPC" 2500;
BA_DEF_DEF_ "GenSigTimeoutTime_RFHM" 2500;
BA_DEF_DEF_ "GenSigTimeoutTime_SGW" 2500;
BA_DEF_DEF_ "GenSigTimeoutTime_TCM" 2500;
BA_ "Type" BO_ 1956 1;
BA_ "GenMsgSendType" BO_ 1956 0;
BA_ "GenMsgILSupport" BO_ 1956 1;
BA_ "GenMsgCycleTime" BO_ 1956 1000;
BA_ "CANFD_BRS" BO_ 1956 1;
BA_ "Type" BO_ 1853 1;
BA_ "GenMsgSendType" BO_ 1853 0;
BA_ "GenMsgILSupport" BO_ 1853 1;
BA_ "GenMsgCycleTime" BO_ 1853 1000;
BA_ "CANFD_BRS" BO_ 1853 1;
BA_ "Type" BO_ 1032 1;
BA_ "GenMsgSendType" BO_ 1032 0;
BA_ "GenMsgILSupport" BO_ 1032 1;
BA_ "GenMsgCycleTime" BO_ 1032 100;
BA_ "CANFD_BRS" BO_ 1032 1;
BA_ "Type" BO_ 752 1;
BA_ "GenMsgSendType" BO_ 752 0;
BA_ "GenMsgILSupport" BO_ 752 1;
BA_ "GenMsgStartDelayTime" BO_ 752 40;
BA_ "GenMsgCycleTime" BO_ 752 50;
BA_ "CANFD_BRS" BO_ 752 1;
BA_ "Type" BO_ 754 1;
BA_ "GenMsgSendType" BO_ 754 0;
BA_ "GenMsgILSupport" BO_ 754 1;
BA_ "GenMsgStartDelayTime" BO_ 754 45;
BA_ "GenMsgCycleTime" BO_ 754 50;
BA_ "CANFD_BRS" BO_ 754 1;
BA_ "Type" BO_ 1955 1;
BA_ "GenMsgSendType" BO_ 1955 0;
BA_ "GenMsgILSupport" BO_ 1955 1;
BA_ "GenMsgStartDelayTime" BO_ 1955 420;
BA_ "GenMsgCycleTime" BO_ 1955 1000;
BA_ "CANFD_BRS" BO_ 1955 1;
BA_ "Type" BO_ 100 8;
BA_ "GenMsgNrOfRepetition" BO_ 100 2;
BA_ "GenMsgILSupport" BO_ 100 1;
BA_ "GenMsgCycleTimeFast" BO_ 100 20;
BA_ "GenMsgDelayTime" BO_ 100 20;
BA_ "CANFD_BRS" BO_ 100 1;
BA_ "Type" BO_ 104 11;
BA_ "GenMsgILSupport" BO_ 104 1;
BA_ "CANFD_BRS" BO_ 104 1;
BA_ "Type" BO_ 1626 10;
BA_ "GenMsgSendType" BO_ 1626 0;
BA_ "GenMsgILSupport" BO_ 1626 1;
BA_ "GenMsgStartDelayTime" BO_ 1626 55;
BA_ "GenMsgCycleTimeFast" BO_ 1626 10;
BA_ "GenMsgCycleTime" BO_ 1626 500;
BA_ "CANFD_BRS" BO_ 1626 1;
BA_ "Type" BO_ 1829 1;
BA_ "GenMsgSendType" BO_ 1829 0;
BA_ "GenMsgILSupport" BO_ 1829 1;
BA_ "GenMsgCycleTime" BO_ 1829 1000;
BA_ "CANFD_BRS" BO_ 1829 1;
BA_ "Type" BO_ 1441 3;
BA_ "GenMsgSendType" BO_ 1441 0;
BA_ "GenMsgNrOfRepetition" BO_ 1441 2;
BA_ "GenMsgILSupport" BO_ 1441 1;
BA_ "GenMsgCycleTimeFast" BO_ 1441 20;
BA_ "GenMsgCycleTime" BO_ 1441 1000;
BA_ "GenMsgDelayTime" BO_ 1441 20;
BA_ "CANFD_BRS" BO_ 1441 1;
BA_ "Type" BO_ 1455 3;
BA_ "GenMsgSendType" BO_ 1455 0;
BA_ "GenMsgNrOfRepetition" BO_ 1455 2;
BA_ "GenMsgILSupport" BO_ 1455 1;
BA_ "GenMsgCycleTimeFast" BO_ 1455 20;
BA_ "GenMsgCycleTime" BO_ 1455 1000;
BA_ "GenMsgDelayTime" BO_ 1455 20;
BA_ "CANFD_BRS" BO_ 1455 1;
BA_ "Type" BO_ 1844 1;
BA_ "GenMsgSendType" BO_ 1844 0;
BA_ "GenMsgNrOfRepetition" BO_ 1844 2;
BA_ "GenMsgILSupport" BO_ 1844 1;
BA_ "GenMsgCycleTimeFast" BO_ 1844 20;
BA_ "GenMsgCycleTime" BO_ 1844 1000;
BA_ "GenMsgDelayTime" BO_ 1844 20;
BA_ "CANFD_BRS" BO_ 1844 1;
BA_ "Type" BO_ 1842 1;
BA_ "GenMsgSendType" BO_ 1842 0;
BA_ "GenMsgILSupport" BO_ 1842 1;
BA_ "GenMsgCycleTime" BO_ 1842 1000;
BA_ "CANFD_BRS" BO_ 1842 1;
BA_ "Type" BO_ 1831 1;
BA_ "GenMsgSendType" BO_ 1831 0;
BA_ "GenMsgILSupport" BO_ 1831 1;
BA_ "GenMsgCycleTime" BO_ 1831 1000;
BA_ "CANFD_BRS" BO_ 1831 1;
BA_ "Type" BO_ 600 3;
BA_ "GenMsgSendType" BO_ 600 0;
BA_ "GenMsgNrOfRepetition" BO_ 600 2;
BA_ "GenMsgILSupport" BO_ 600 1;
BA_ "GenMsgCycleTimeFast" BO_ 600 20;
BA_ "GenMsgCycleTime" BO_ 600 100;
BA_ "GenMsgDelayTime" BO_ 600 20;
BA_ "CANFD_BRS" BO_ 600 1;
BA_ "Type" BO_ 1154 3;
BA_ "GenMsgSendType" BO_ 1154 0;
BA_ "GenMsgNrOfRepetition" BO_ 1154 2;
BA_ "GenMsgILSupport" BO_ 1154 1;
BA_ "GenMsgCycleTime" BO_ 1154 500;
BA_ "GenMsgDelayTime" BO_ 1154 20;
BA_ "CANFD_BRS" BO_ 1154 1;
BA_ "GenSigStartValue" SG_ 1956 MotorA_DC_Current 16384;
BA_ "GenSigTimeoutTime_AGSM" SG_ 1956 MotorA_DC_Current 0;
BA_ "GenSigTimeoutTime_BCM" SG_ 1956 MotorA_DC_Current 0;
BA_ "GenSigTimeoutTime_BSM" SG_ 1956 MotorA_DC_Current 0;
BA_ "GenSigTimeoutTime_CADM" SG_ 1956 MotorA_DC_Current 0;
BA_ "GenSigTimeoutTime_DMSM" SG_ 1956 MotorA_DC_Current 0;
BA_ "GenSigTimeoutTime_DTCM" SG_ 1956 MotorA_DC_Current 0;
BA_ "GenSigTimeoutTime_ECM" SG_ 1956 MotorA_DC_Current 0;
BA_ "GenSigTimeoutTime_EVCU2" SG_ 1956 MotorA_DC_Current 0;
BA_ "GenSigTimeoutTime_GNMM" SG_ 1956 MotorA_DC_Current 0;
BA_ "GenSigTimeoutTime_HCP" SG_ 1956 MotorA_DC_Current 0;
BA_ "GenSigTimeoutTime_IPC" SG_ 1956 MotorA_DC_Current 0;
BA_ "GenSigTimeoutTime_RFHM" SG_ 1956 MotorA_DC_Current 0;
BA_ "GenSigTimeoutTime_SGW" SG_ 1956 MotorA_DC_Current 0;
BA_ "GenSigTimeoutTime_TCM" SG_ 1956 MotorA_DC_Current 0;
BA_ "GenSigTimeoutTime_AGSM" SG_ 1956 MotorA_DC_Voltage 0;
BA_ "GenSigTimeoutTime_BCM" SG_ 1956 MotorA_DC_Voltage 0;
BA_ "GenSigTimeoutTime_BSM" SG_ 1956 MotorA_DC_Voltage 0;
BA_ "GenSigTimeoutTime_CADM" SG_ 1956 MotorA_DC_Voltage 0;
BA_ "GenSigTimeoutTime_DMSM" SG_ 1956 MotorA_DC_Voltage 0;
BA_ "GenSigTimeoutTime_DTCM" SG_ 1956 MotorA_DC_Voltage 0;
BA_ "GenSigTimeoutTime_ECM" SG_ 1956 MotorA_DC_Voltage 0;
BA_ "GenSigTimeoutTime_EVCU2" SG_ 1956 MotorA_DC_Voltage 0;
BA_ "GenSigTimeoutTime_GNMM" SG_ 1956 MotorA_DC_Voltage 0;
BA_ "GenSigTimeoutTime_HCP" SG_ 1956 MotorA_DC_Voltage 0;
BA_ "GenSigTimeoutTime_IPC" SG_ 1956 MotorA_DC_Voltage 0;
BA_ "GenSigTimeoutTime_RFHM" SG_ 1956 MotorA_DC_Voltage 0;
BA_ "GenSigTimeoutTime_SGW" SG_ 1956 MotorA_DC_Voltage 0;
BA_ "GenSigTimeoutTime_TCM" SG_ 1956 MotorA_DC_Voltage 0;
BA_ "GenSigTimeoutTime_AGSM" SG_ 1956 MotorA_InverterState 0;
BA_ "GenSigTimeoutTime_BCM" SG_ 1956 MotorA_InverterState 0;
BA_ "GenSigTimeoutTime_BSM" SG_ 1956 MotorA_InverterState 0;
BA_ "GenSigTimeoutTime_CADM" SG_ 1956 MotorA_InverterState 0;
BA_ "GenSigTimeoutTime_DMSM" SG_ 1956 MotorA_InverterState 0;
BA_ "GenSigTimeoutTime_DTCM" SG_ 1956 MotorA_InverterState 0;
BA_ "GenSigTimeoutTime_ECM" SG_ 1956 MotorA_InverterState 0;
BA_ "GenSigTimeoutTime_EVCU2" SG_ 1956 MotorA_InverterState 0;
BA_ "GenSigTimeoutTime_GNMM" SG_ 1956 MotorA_InverterState 0;
BA_ "GenSigTimeoutTime_HCP" SG_ 1956 MotorA_InverterState 0;
BA_ "GenSigTimeoutTime_IPC" SG_ 1956 MotorA_InverterState 0;
BA_ "GenSigTimeoutTime_RFHM" SG_ 1956 MotorA_InverterState 0;
BA_ "GenSigTimeoutTime_SGW" SG_ 1956 MotorA_InverterState 0;
BA_ "GenSigTimeoutTime_TCM" SG_ 1956 MotorA_InverterState 0;
BA_ "GenSigStartValue" SG_ 1956 MotorA_InverterTemp 40;
BA_ "GenSigTimeoutTime_AGSM" SG_ 1956 MotorA_InverterTemp 0;
BA_ "GenSigTimeoutTime_BCM" SG_ 1956 MotorA_InverterTemp 0;
BA_ "GenSigTimeoutTime_BSM" SG_ 1956 MotorA_InverterTemp 0;
BA_ "GenSigTimeoutTime_CADM" SG_ 1956 MotorA_InverterTemp 0;
BA_ "GenSigTimeoutTime_DMSM" SG_ 1956 MotorA_InverterTemp 0;
BA_ "GenSigTimeoutTime_DTCM" SG_ 1956 MotorA_InverterTemp 0;
BA_ "GenSigTimeoutTime_ECM" SG_ 1956 MotorA_InverterTemp 0;
BA_ "GenSigTimeoutTime_EVCU2" SG_ 1956 MotorA_InverterTemp 0;
BA_ "GenSigTimeoutTime_GNMM" SG_ 1956 MotorA_InverterTemp 0;
BA_ "GenSigTimeoutTime_HCP" SG_ 1956 MotorA_InverterTemp 0;
BA_ "GenSigTimeoutTime_IPC" SG_ 1956 MotorA_InverterTemp 0;
BA_ "GenSigTimeoutTime_RFHM" SG_ 1956 MotorA_InverterTemp 0;
BA_ "GenSigTimeoutTime_SGW" SG_ 1956 MotorA_InverterTemp 0;
BA_ "GenSigTimeoutTime_TCM" SG_ 1956 MotorA_InverterTemp 0;
BA_ "GenSigStartValue" SG_ 1956 MotorA_RPM 32768;
BA_ "GenSigTimeoutTime_AGSM" SG_ 1956 MotorA_RPM 0;
BA_ "GenSigTimeoutTime_BCM" SG_ 1956 MotorA_RPM 0;
BA_ "GenSigTimeoutTime_BSM" SG_ 1956 MotorA_RPM 0;
BA_ "GenSigTimeoutTime_CADM" SG_ 1956 MotorA_RPM 0;
BA_ "GenSigTimeoutTime_DMSM" SG_ 1956 MotorA_RPM 0;
BA_ "GenSigTimeoutTime_DTCM" SG_ 1956 MotorA_RPM 0;
BA_ "GenSigTimeoutTime_ECM" SG_ 1956 MotorA_RPM 0;
BA_ "GenSigTimeoutTime_EVCU2" SG_ 1956 MotorA_RPM 0;
BA_ "GenSigTimeoutTime_GNMM" SG_ 1956 MotorA_RPM 0;
BA_ "GenSigTimeoutTime_HCP" SG_ 1956 MotorA_RPM 0;
BA_ "GenSigTimeoutTime_IPC" SG_ 1956 MotorA_RPM 0;
BA_ "GenSigTimeoutTime_RFHM" SG_ 1956 MotorA_RPM 0;
BA_ "GenSigTimeoutTime_SGW" SG_ 1956 MotorA_RPM 0;
BA_ "GenSigTimeoutTime_TCM" SG_ 1956 MotorA_RPM 0;
BA_ "GenSigStartValue" SG_ 1956 MotorA_Temperature 40;
BA_ "GenSigTimeoutTime_AGSM" SG_ 1956 MotorA_Temperature 0;
BA_ "GenSigTimeoutTime_BCM" SG_ 1956 MotorA_Temperature 0;
BA_ "GenSigTimeoutTime_BSM" SG_ 1956 MotorA_Temperature 0;
BA_ "GenSigTimeoutTime_CADM" SG_ 1956 MotorA_Temperature 0;
BA_ "GenSigTimeoutTime_DMSM" SG_ 1956 MotorA_Temperature 0;
BA_ "GenSigTimeoutTime_DTCM" SG_ 1956 MotorA_Temperature 0;
BA_ "GenSigTimeoutTime_ECM" SG_ 1956 MotorA_Temperature 0;
BA_ "GenSigTimeoutTime_EVCU2" SG_ 1956 MotorA_Temperature 0;
BA_ "GenSigTimeoutTime_GNMM" SG_ 1956 MotorA_Temperature 0;
BA_ "GenSigTimeoutTime_HCP" SG_ 1956 MotorA_Temperature 0;
BA_ "GenSigTimeoutTime_RFHM" SG_ 1956 MotorA_Temperature 0;
BA_ "GenSigTimeoutTime_SGW" SG_ 1956 MotorA_Temperature 0;
BA_ "GenSigTimeoutTime_TCM" SG_ 1956 MotorA_Temperature 0;
BA_ "GenSigStartValue" SG_ 1956 MotorA_TorqueAchieved 4096;
BA_ "GenSigTimeoutTime_AGSM" SG_ 1956 MotorA_TorqueAchieved 0;
BA_ "GenSigTimeoutTime_BCM" SG_ 1956 MotorA_TorqueAchieved 0;
BA_ "GenSigTimeoutTime_BSM" SG_ 1956 MotorA_TorqueAchieved 0;
BA_ "GenSigTimeoutTime_CADM" SG_ 1956 MotorA_TorqueAchieved 0;
BA_ "GenSigTimeoutTime_DMSM" SG_ 1956 MotorA_TorqueAchieved 0;
BA_ "GenSigTimeoutTime_DTCM" SG_ 1956 MotorA_TorqueAchieved 0;
BA_ "GenSigTimeoutTime_ECM" SG_ 1956 MotorA_TorqueAchieved 0;
BA_ "GenSigTimeoutTime_EVCU2" SG_ 1956 MotorA_TorqueAchieved 0;
BA_ "GenSigTimeoutTime_GNMM" SG_ 1956 MotorA_TorqueAchieved 0;
BA_ "GenSigTimeoutTime_HCP" SG_ 1956 MotorA_TorqueAchieved 0;
BA_ "GenSigTimeoutTime_IPC" SG_ 1956 MotorA_TorqueAchieved 0;
BA_ "GenSigTimeoutTime_RFHM" SG_ 1956 MotorA_TorqueAchieved 0;
BA_ "GenSigTimeoutTime_SGW" SG_ 1956 MotorA_TorqueAchieved 0;
BA_ "GenSigTimeoutTime_TCM" SG_ 1956 MotorA_TorqueAchieved 0;
BA_ "GenSigStartValue" SG_ 1956 MotorB_DC_Current 16384;
BA_ "GenSigTimeoutTime_AGSM" SG_ 1956 MotorB_DC_Current 0;
BA_ "GenSigTimeoutTime_BCM" SG_ 1956 MotorB_DC_Current 0;
BA_ "GenSigTimeoutTime_BSM" SG_ 1956 MotorB_DC_Current 0;
BA_ "GenSigTimeoutTime_CADM" SG_ 1956 MotorB_DC_Current 0;
BA_ "GenSigTimeoutTime_DMSM" SG_ 1956 MotorB_DC_Current 0;
BA_ "GenSigTimeoutTime_DTCM" SG_ 1956 MotorB_DC_Current 0;
BA_ "GenSigTimeoutTime_ECM" SG_ 1956 MotorB_DC_Current 0;
BA_ "GenSigTimeoutTime_EVCU2" SG_ 1956 MotorB_DC_Current 0;
BA_ "GenSigTimeoutTime_GNMM" SG_ 1956 MotorB_DC_Current 0;
BA_ "GenSigTimeoutTime_HCP" SG_ 1956 MotorB_DC_Current 0;
BA_ "GenSigTimeoutTime_IPC" SG_ 1956 MotorB_DC_Current 0;
BA_ "GenSigTimeoutTime_RFHM" SG_ 1956 MotorB_DC_Current 0;
BA_ "GenSigTimeoutTime_SGW" SG_ 1956 MotorB_DC_Current 0;
BA_ "GenSigTimeoutTime_TCM" SG_ 1956 MotorB_DC_Current 0;
BA_ "GenSigTimeoutTime_AGSM" SG_ 1956 MotorB_DC_Voltage 0;
BA_ "GenSigTimeoutTime_BCM" SG_ 1956 MotorB_DC_Voltage 0;
BA_ "GenSigTimeoutTime_BSM" SG_ 1956 MotorB_DC_Voltage 0;
BA_ "GenSigTimeoutTime_CADM" SG_ 1956 MotorB_DC_Voltage 0;
BA_ "GenSigTimeoutTime_DMSM" SG_ 1956 MotorB_DC_Voltage 0;
BA_ "GenSigTimeoutTime_DTCM" SG_ 1956 MotorB_DC_Voltage 0;
BA_ "GenSigTimeoutTime_ECM" SG_ 1956 MotorB_DC_Voltage 0;
BA_ "GenSigTimeoutTime_EVCU2" SG_ 1956 MotorB_DC_Voltage 0;
BA_ "GenSigTimeoutTime_GNMM" SG_ 1956 MotorB_DC_Voltage 0;
BA_ "GenSigTimeoutTime_HCP" SG_ 1956 MotorB_DC_Voltage 0;
BA_ "GenSigTimeoutTime_IPC" SG_ 1956 MotorB_DC_Voltage 0;
BA_ "GenSigTimeoutTime_RFHM" SG_ 1956 MotorB_DC_Voltage 0;
BA_ "GenSigTimeoutTime_SGW" SG_ 1956 MotorB_DC_Voltage 0;
BA_ "GenSigTimeoutTime_TCM" SG_ 1956 MotorB_DC_Voltage 0;
BA_ "GenSigTimeoutTime_AGSM" SG_ 1956 MotorB_InverterState 0;
BA_ "GenSigTimeoutTime_BCM" SG_ 1956 MotorB_InverterState 0;
BA_ "GenSigTimeoutTime_BSM" SG_ 1956 MotorB_InverterState 0;
BA_ "GenSigTimeoutTime_CADM" SG_ 1956 MotorB_InverterState 0;
BA_ "GenSigTimeoutTime_DMSM" SG_ 1956 MotorB_InverterState 0;
BA_ "GenSigTimeoutTime_DTCM" SG_ 1956 MotorB_InverterState 0;
BA_ "GenSigTimeoutTime_ECM" SG_ 1956 MotorB_InverterState 0;
BA_ "GenSigTimeoutTime_EVCU2" SG_ 1956 MotorB_InverterState 0;
BA_ "GenSigTimeoutTime_GNMM" SG_ 1956 MotorB_InverterState 0;
BA_ "GenSigTimeoutTime_HCP" SG_ 1956 MotorB_InverterState 0;
BA_ "GenSigTimeoutTime_IPC" SG_ 1956 MotorB_InverterState 0;
BA_ "GenSigTimeoutTime_RFHM" SG_ 1956 MotorB_InverterState 0;
BA_ "GenSigTimeoutTime_SGW" SG_ 1956 MotorB_InverterState 0;
BA_ "GenSigTimeoutTime_TCM" SG_ 1956 MotorB_InverterState 0;
BA_ "GenSigStartValue" SG_ 1956 MotorB_InverterTemp 40;
BA_ "GenSigTimeoutTime_AGSM" SG_ 1956 MotorB_InverterTemp 0;
BA_ "GenSigTimeoutTime_BCM" SG_ 1956 MotorB_InverterTemp 0;
BA_ "GenSigTimeoutTime_BSM" SG_ 1956 MotorB_InverterTemp 0;
BA_ "GenSigTimeoutTime_CADM" SG_ 1956 MotorB_InverterTemp 0;
BA_ "GenSigTimeoutTime_DMSM" SG_ 1956 MotorB_InverterTemp 0;
BA_ "GenSigTimeoutTime_DTCM" SG_ 1956 MotorB_InverterTemp 0;
BA_ "GenSigTimeoutTime_ECM" SG_ 1956 MotorB_InverterTemp 0;
BA_ "GenSigTimeoutTime_EVCU2" SG_ 1956 MotorB_InverterTemp 0;
BA_ "GenSigTimeoutTime_GNMM" SG_ 1956 MotorB_InverterTemp 0;
BA_ "GenSigTimeoutTime_HCP" SG_ 1956 MotorB_InverterTemp 0;
BA_ "GenSigTimeoutTime_IPC" SG_ 1956 MotorB_InverterTemp 0;
BA_ "GenSigTimeoutTime_RFHM" SG_ 1956 MotorB_InverterTemp 0;
BA_ "GenSigTimeoutTime_SGW" SG_ 1956 MotorB_InverterTemp 0;
BA_ "GenSigTimeoutTime_TCM" SG_ 1956 MotorB_InverterTemp 0;
BA_ "GenSigStartValue" SG_ 1956 MotorB_RPM 32768;
BA_ "GenSigTimeoutTime_AGSM" SG_ 1956 MotorB_RPM 0;
BA_ "GenSigTimeoutTime_BCM" SG_ 1956 MotorB_RPM 0;
BA_ "GenSigTimeoutTime_BSM" SG_ 1956 MotorB_RPM 0;
BA_ "GenSigTimeoutTime_CADM" SG_ 1956 MotorB_RPM 0;
BA_ "GenSigTimeoutTime_DMSM" SG_ 1956 MotorB_RPM 0;
BA_ "GenSigTimeoutTime_DTCM" SG_ 1956 MotorB_RPM 0;
BA_ "GenSigTimeoutTime_ECM" SG_ 1956 MotorB_RPM 0;
BA_ "GenSigTimeoutTime_EVCU2" SG_ 1956 MotorB_RPM 0;
BA_ "GenSigTimeoutTime_GNMM" SG_ 1956 MotorB_RPM 0;
BA_ "GenSigTimeoutTime_HCP" SG_ 1956 MotorB_RPM 0;
BA_ "GenSigTimeoutTime_IPC" SG_ 1956 MotorB_RPM 0;
BA_ "GenSigTimeoutTime_RFHM" SG_ 1956 MotorB_RPM 0;
BA_ "GenSigTimeoutTime_SGW" SG_ 1956 MotorB_RPM 0;
BA_ "GenSigTimeoutTime_TCM" SG_ 1956 MotorB_RPM 0;
BA_ "GenSigStartValue" SG_ 1956 MotorB_Temperature 40;
BA_ "GenSigTimeoutTime_AGSM" SG_ 1956 MotorB_Temperature 0;
BA_ "GenSigTimeoutTime_BCM" SG_ 1956 MotorB_Temperature 0;
BA_ "GenSigTimeoutTime_BSM" SG_ 1956 MotorB_Temperature 0;
BA_ "GenSigTimeoutTime_CADM" SG_ 1956 MotorB_Temperature 0;
BA_ "GenSigTimeoutTime_DMSM" SG_ 1956 MotorB_Temperature 0;
BA_ "GenSigTimeoutTime_DTCM" SG_ 1956 MotorB_Temperature 0;
BA_ "GenSigTimeoutTime_ECM" SG_ 1956 MotorB_Temperature 0;
BA_ "GenSigTimeoutTime_EVCU2" SG_ 1956 MotorB_Temperature 0;
BA_ "GenSigTimeoutTime_GNMM" SG_ 1956 MotorB_Temperature 0;
BA_ "GenSigTimeoutTime_HCP" SG_ 1956 MotorB_Temperature 0;
BA_ "GenSigTimeoutTime_RFHM" SG_ 1956 MotorB_Temperature 0;
BA_ "GenSigTimeoutTime_SGW" SG_ 1956 MotorB_Temperature 0;
BA_ "GenSigTimeoutTime_TCM" SG_ 1956 MotorB_Temperature 0;
BA_ "GenSigStartValue" SG_ 1956 MotorB_TorqueAchieved 4096;
BA_ "GenSigTimeoutTime_AGSM" SG_ 1956 MotorB_TorqueAchieved 0;
BA_ "GenSigTimeoutTime_BCM" SG_ 1956 MotorB_TorqueAchieved 0;
BA_ "GenSigTimeoutTime_BSM" SG_ 1956 MotorB_TorqueAchieved 0;
BA_ "GenSigTimeoutTime_CADM" SG_ 1956 MotorB_TorqueAchieved 0;
BA_ "GenSigTimeoutTime_DMSM" SG_ 1956 MotorB_TorqueAchieved 0;
BA_ "GenSigTimeoutTime_DTCM" SG_ 1956 MotorB_TorqueAchieved 0;
BA_ "GenSigTimeoutTime_ECM" SG_ 1956 MotorB_TorqueAchieved 0;
BA_ "GenSigTimeoutTime_EVCU2" SG_ 1956 MotorB_TorqueAchieved 0;
BA_ "GenSigTimeoutTime_GNMM" SG_ 1956 MotorB_TorqueAchieved 0;
BA_ "GenSigTimeoutTime_HCP" SG_ 1956 MotorB_TorqueAchieved 0;
BA_ "GenSigTimeoutTime_IPC" SG_ 1956 MotorB_TorqueAchieved 0;
BA_ "GenSigTimeoutTime_RFHM" SG_ 1956 MotorB_TorqueAchieved 0;
BA_ "GenSigTimeoutTime_SGW" SG_ 1956 MotorB_TorqueAchieved 0;
BA_ "GenSigTimeoutTime_TCM" SG_ 1956 MotorB_TorqueAchieved 0;
BA_ "GenSigTimeoutTime_AGSM" SG_ 1956 Warning_DCDCPerformance_DPT 0;
BA_ "GenSigTimeoutTime_BCM" SG_ 1956 Warning_DCDCPerformance_DPT 0;
BA_ "GenSigTimeoutTime_BSM" SG_ 1956 Warning_DCDCPerformance_DPT 0;
BA_ "GenSigTimeoutTime_CADM" SG_ 1956 Warning_DCDCPerformance_DPT 0;
BA_ "GenSigTimeoutTime_DMSM" SG_ 1956 Warning_DCDCPerformance_DPT 0;
BA_ "GenSigTimeoutTime_DTCM" SG_ 1956 Warning_DCDCPerformance_DPT 0;
BA_ "GenSigTimeoutTime_ECM" SG_ 1956 Warning_DCDCPerformance_DPT 0;
BA_ "GenSigTimeoutTime_EVCU2" SG_ 1956 Warning_DCDCPerformance_DPT 0;
BA_ "GenSigTimeoutTime_GNMM" SG_ 1956 Warning_DCDCPerformance_DPT 0;
BA_ "GenSigTimeoutTime_HCP" SG_ 1956 Warning_DCDCPerformance_DPT 0;
BA_ "GenSigTimeoutTime_IPC" SG_ 1956 Warning_DCDCPerformance_DPT 0;
BA_ "GenSigTimeoutTime_RFHM" SG_ 1956 Warning_DCDCPerformance_DPT 0;
BA_ "GenSigTimeoutTime_SGW" SG_ 1956 Warning_DCDCPerformance_DPT 0;
BA_ "GenSigTimeoutTime_TCM" SG_ 1956 Warning_DCDCPerformance_DPT 0;
BA_ "GenSigTimeoutTime_AGSM" SG_ 1956 Warning_DCDCTemp_DPT 0;
BA_ "GenSigTimeoutTime_BCM" SG_ 1956 Warning_DCDCTemp_DPT 0;
BA_ "GenSigTimeoutTime_BSM" SG_ 1956 Warning_DCDCTemp_DPT 0;
BA_ "GenSigTimeoutTime_CADM" SG_ 1956 Warning_DCDCTemp_DPT 0;
BA_ "GenSigTimeoutTime_DMSM" SG_ 1956 Warning_DCDCTemp_DPT 0;
BA_ "GenSigTimeoutTime_DTCM" SG_ 1956 Warning_DCDCTemp_DPT 0;
BA_ "GenSigTimeoutTime_ECM" SG_ 1956 Warning_DCDCTemp_DPT 0;
BA_ "GenSigTimeoutTime_EVCU2" SG_ 1956 Warning_DCDCTemp_DPT 0;
BA_ "GenSigTimeoutTime_GNMM" SG_ 1956 Warning_DCDCTemp_DPT 0;
BA_ "GenSigTimeoutTime_HCP" SG_ 1956 Warning_DCDCTemp_DPT 0;
BA_ "GenSigTimeoutTime_IPC" SG_ 1956 Warning_DCDCTemp_DPT 0;
BA_ "GenSigTimeoutTime_RFHM" SG_ 1956 Warning_DCDCTemp_DPT 0;
BA_ "GenSigTimeoutTime_SGW" SG_ 1956 Warning_DCDCTemp_DPT 0;
BA_ "GenSigTimeoutTime_TCM" SG_ 1956 Warning_DCDCTemp_DPT 0;
BA_ "GenSigTimeoutTime_AGSM" SG_ 1956 Warning_InverterA_Overtemp 0;
BA_ "GenSigTimeoutTime_BCM" SG_ 1956 Warning_InverterA_Overtemp 0;
BA_ "GenSigTimeoutTime_BSM" SG_ 1956 Warning_InverterA_Overtemp 0;
BA_ "GenSigTimeoutTime_CADM" SG_ 1956 Warning_InverterA_Overtemp 0;
BA_ "GenSigTimeoutTime_DMSM" SG_ 1956 Warning_InverterA_Overtemp 0;
BA_ "GenSigTimeoutTime_DTCM" SG_ 1956 Warning_InverterA_Overtemp 0;
BA_ "GenSigTimeoutTime_ECM" SG_ 1956 Warning_InverterA_Overtemp 0;
BA_ "GenSigTimeoutTime_EVCU2" SG_ 1956 Warning_InverterA_Overtemp 0;
BA_ "GenSigTimeoutTime_GNMM" SG_ 1956 Warning_InverterA_Overtemp 0;
BA_ "GenSigTimeoutTime_HCP" SG_ 1956 Warning_InverterA_Overtemp 0;
BA_ "GenSigTimeoutTime_IPC" SG_ 1956 Warning_InverterA_Overtemp 0;
BA_ "GenSigTimeoutTime_RFHM" SG_ 1956 Warning_InverterA_Overtemp 0;
BA_ "GenSigTimeoutTime_SGW" SG_ 1956 Warning_InverterA_Overtemp 0;
BA_ "GenSigTimeoutTime_TCM" SG_ 1956 Warning_InverterA_Overtemp 0;
BA_ "GenSigTimeoutTime_AGSM" SG_ 1956 Warning_InverterB_Overtemp 0;
BA_ "GenSigTimeoutTime_BCM" SG_ 1956 Warning_InverterB_Overtemp 0;
BA_ "GenSigTimeoutTime_BSM" SG_ 1956 Warning_InverterB_Overtemp 0;
BA_ "GenSigTimeoutTime_CADM" SG_ 1956 Warning_InverterB_Overtemp 0;
BA_ "GenSigTimeoutTime_DMSM" SG_ 1956 Warning_InverterB_Overtemp 0;
BA_ "GenSigTimeoutTime_DTCM" SG_ 1956 Warning_InverterB_Overtemp 0;
BA_ "GenSigTimeoutTime_ECM" SG_ 1956 Warning_InverterB_Overtemp 0;
BA_ "GenSigTimeoutTime_EVCU2" SG_ 1956 Warning_InverterB_Overtemp 0;
BA_ "GenSigTimeoutTime_GNMM" SG_ 1956 Warning_InverterB_Overtemp 0;
BA_ "GenSigTimeoutTime_HCP" SG_ 1956 Warning_InverterB_Overtemp 0;
BA_ "GenSigTimeoutTime_IPC" SG_ 1956 Warning_InverterB_Overtemp 0;
BA_ "GenSigTimeoutTime_RFHM" SG_ 1956 Warning_InverterB_Overtemp 0;
BA_ "GenSigTimeoutTime_SGW" SG_ 1956 Warning_InverterB_Overtemp 0;
BA_ "GenSigTimeoutTime_TCM" SG_ 1956 Warning_InverterB_Overtemp 0;
BA_ "GenSigTimeoutTime_AGSM" SG_ 1956 Warning_MotorA_Overtemp 0;
BA_ "GenSigTimeoutTime_BCM" SG_ 1956 Warning_MotorA_Overtemp 0;
BA_ "GenSigTimeoutTime_BSM" SG_ 1956 Warning_MotorA_Overtemp 0;
BA_ "GenSigTimeoutTime_CADM" SG_ 1956 Warning_MotorA_Overtemp 0;
BA_ "GenSigTimeoutTime_DMSM" SG_ 1956 Warning_MotorA_Overtemp 0;
BA_ "GenSigTimeoutTime_DTCM" SG_ 1956 Warning_MotorA_Overtemp 0;
BA_ "GenSigTimeoutTime_ECM" SG_ 1956 Warning_MotorA_Overtemp 0;
BA_ "GenSigTimeoutTime_EVCU2" SG_ 1956 Warning_MotorA_Overtemp 0;
BA_ "GenSigTimeoutTime_GNMM" SG_ 1956 Warning_MotorA_Overtemp 0;
BA_ "GenSigTimeoutTime_HCP" SG_ 1956 Warning_MotorA_Overtemp 0;
BA_ "GenSigTimeoutTime_IPC" SG_ 1956 Warning_MotorA_Overtemp 0;
BA_ "GenSigTimeoutTime_RFHM" SG_ 1956 Warning_MotorA_Overtemp 0;
BA_ "GenSigTimeoutTime_SGW" SG_ 1956 Warning_MotorA_Overtemp 0;
BA_ "GenSigTimeoutTime_TCM" SG_ 1956 Warning_MotorA_Overtemp 0;
BA_ "GenSigTimeoutTime_AGSM" SG_ 1956 Warning_MotorB_Overtemp 0;
BA_ "GenSigTimeoutTime_BCM" SG_ 1956 Warning_MotorB_Overtemp 0;
BA_ "GenSigTimeoutTime_BSM" SG_ 1956 Warning_MotorB_Overtemp 0;
BA_ "GenSigTimeoutTime_CADM" SG_ 1956 Warning_MotorB_Overtemp 0;
BA_ "GenSigTimeoutTime_DMSM" SG_ 1956 Warning_MotorB_Overtemp 0;
BA_ "GenSigTimeoutTime_DTCM" SG_ 1956 Warning_MotorB_Overtemp 0;
BA_ "GenSigTimeoutTime_ECM" SG_ 1956 Warning_MotorB_Overtemp 0;
BA_ "GenSigTimeoutTime_EVCU2" SG_ 1956 Warning_MotorB_Overtemp 0;
BA_ "GenSigTimeoutTime_GNMM" SG_ 1956 Warning_MotorB_Overtemp 0;
BA_ "GenSigTimeoutTime_HCP" SG_ 1956 Warning_MotorB_Overtemp 0;
BA_ "GenSigTimeoutTime_IPC" SG_ 1956 Warning_MotorB_Overtemp 0;
BA_ "GenSigTimeoutTime_RFHM" SG_ 1956 Warning_MotorB_Overtemp 0;
BA_ "GenSigTimeoutTime_SGW" SG_ 1956 Warning_MotorB_Overtemp 0;
BA_ "GenSigTimeoutTime_TCM" SG_ 1956 Warning_MotorB_Overtemp 0;
BA_ "GenSigTimeoutTime_AGSM" SG_ 1853 APM_CtrlSts_Fbk 0;
BA_ "GenSigTimeoutTime_BCM" SG_ 1853 APM_CtrlSts_Fbk 0;
BA_ "GenSigTimeoutTime_BSM" SG_ 1853 APM_CtrlSts_Fbk 0;
BA_ "GenSigTimeoutTime_CADM" SG_ 1853 APM_CtrlSts_Fbk 0;
BA_ "GenSigTimeoutTime_DMSM" SG_ 1853 APM_CtrlSts_Fbk 0;
BA_ "GenSigTimeoutTime_DTCM" SG_ 1853 APM_CtrlSts_Fbk 0;
BA_ "GenSigTimeoutTime_ECM" SG_ 1853 APM_CtrlSts_Fbk 0;
BA_ "GenSigTimeoutTime_EVCU2" SG_ 1853 APM_CtrlSts_Fbk 0;
BA_ "GenSigTimeoutTime_GNMM" SG_ 1853 APM_CtrlSts_Fbk 0;
BA_ "GenSigTimeoutTime_HCP" SG_ 1853 APM_CtrlSts_Fbk 0;
BA_ "GenSigTimeoutTime_IPC" SG_ 1853 APM_CtrlSts_Fbk 0;
BA_ "GenSigTimeoutTime_RFHM" SG_ 1853 APM_CtrlSts_Fbk 0;
BA_ "GenSigTimeoutTime_SGW" SG_ 1853 APM_CtrlSts_Fbk 0;
BA_ "GenSigTimeoutTime_TCM" SG_ 1853 APM_CtrlSts_Fbk 0;
BA_ "GenSigTimeoutTime_AGSM" SG_ 1853 APM_FailureReason 0;
BA_ "GenSigTimeoutTime_BCM" SG_ 1853 APM_FailureReason 0;
BA_ "GenSigTimeoutTime_BSM" SG_ 1853 APM_FailureReason 0;
BA_ "GenSigTimeoutTime_CADM" SG_ 1853 APM_FailureReason 0;
BA_ "GenSigTimeoutTime_DMSM" SG_ 1853 APM_FailureReason 0;
BA_ "GenSigTimeoutTime_DTCM" SG_ 1853 APM_FailureReason 0;
BA_ "GenSigTimeoutTime_ECM" SG_ 1853 APM_FailureReason 0;
BA_ "GenSigTimeoutTime_EVCU2" SG_ 1853 APM_FailureReason 0;
BA_ "GenSigTimeoutTime_GNMM" SG_ 1853 APM_FailureReason 0;
BA_ "GenSigTimeoutTime_HCP" SG_ 1853 APM_FailureReason 0;
BA_ "GenSigTimeoutTime_IPC" SG_ 1853 APM_FailureReason 0;
BA_ "GenSigTimeoutTime_RFHM" SG_ 1853 APM_FailureReason 0;
BA_ "GenSigTimeoutTime_TCM" SG_ 1853 APM_FailureReason 0;
BA_ "GenSigTimeoutTime_AGSM" SG_ 1853 APM_OutputPower 0;
BA_ "GenSigTimeoutTime_BCM" SG_ 1853 APM_OutputPower 0;
BA_ "GenSigTimeoutTime_BSM" SG_ 1853 APM_OutputPower 0;
BA_ "GenSigTimeoutTime_CADM" SG_ 1853 APM_OutputPower 0;
BA_ "GenSigTimeoutTime_DMSM" SG_ 1853 APM_OutputPower 0;
BA_ "GenSigTimeoutTime_DTCM" SG_ 1853 APM_OutputPower 0;
BA_ "GenSigTimeoutTime_ECM" SG_ 1853 APM_OutputPower 0;
BA_ "GenSigTimeoutTime_EVCU2" SG_ 1853 APM_OutputPower 0;
BA_ "GenSigTimeoutTime_GNMM" SG_ 1853 APM_OutputPower 0;
BA_ "GenSigTimeoutTime_HCP" SG_ 1853 APM_OutputPower 0;
BA_ "GenSigTimeoutTime_IPC" SG_ 1853 APM_OutputPower 0;
BA_ "GenSigTimeoutTime_RFHM" SG_ 1853 APM_OutputPower 0;
BA_ "GenSigTimeoutTime_TCM" SG_ 1853 APM_OutputPower 0;
BA_ "GenSigTimeoutTime_AGSM" SG_ 1032 AirflowRequest 0;
BA_ "GenSigTimeoutTime_BCM" SG_ 1032 AirflowRequest 0;
BA_ "GenSigTimeoutTime_BSM" SG_ 1032 AirflowRequest 0;
BA_ "GenSigTimeoutTime_CADM" SG_ 1032 AirflowRequest 0;
BA_ "GenSigTimeoutTime_DMSM" SG_ 1032 AirflowRequest 0;
BA_ "GenSigTimeoutTime_DTCM" SG_ 1032 AirflowRequest 0;
BA_ "GenSigTimeoutTime_EVCU2" SG_ 1032 AirflowRequest 0;
BA_ "GenSigTimeoutTime_GNMM" SG_ 1032 AirflowRequest 0;
BA_ "GenSigTimeoutTime_HCP" SG_ 1032 AirflowRequest 0;
BA_ "GenSigTimeoutTime_IPC" SG_ 1032 AirflowRequest 0;
BA_ "GenSigTimeoutTime_RFHM" SG_ 1032 AirflowRequest 0;
BA_ "GenSigTimeoutTime_SGW" SG_ 1032 AirflowRequest 0;
BA_ "GenSigTimeoutTime_TCM" SG_ 1032 AirflowRequest 0;
BA_ "GenSigTimeoutTime_AGSM" SG_ 1032 LTR_PumpFlowRequest 0;
BA_ "GenSigTimeoutTime_BCM" SG_ 1032 LTR_PumpFlowRequest 0;
BA_ "GenSigTimeoutTime_BSM" SG_ 1032 LTR_PumpFlowRequest 0;
BA_ "GenSigTimeoutTime_CADM" SG_ 1032 LTR_PumpFlowRequest 0;
BA_ "GenSigTimeoutTime_DMSM" SG_ 1032 LTR_PumpFlowRequest 0;
BA_ "GenSigTimeoutTime_DTCM" SG_ 1032 LTR_PumpFlowRequest 0;
BA_ "GenSigTimeoutTime_EVCU2" SG_ 1032 LTR_PumpFlowRequest 0;
BA_ "GenSigTimeoutTime_GNMM" SG_ 1032 LTR_PumpFlowRequest 0;
BA_ "GenSigTimeoutTime_HCP" SG_ 1032 LTR_PumpFlowRequest 0;
BA_ "GenSigTimeoutTime_IPC" SG_ 1032 LTR_PumpFlowRequest 0;
BA_ "GenSigTimeoutTime_RFHM" SG_ 1032 LTR_PumpFlowRequest 0;
BA_ "GenSigTimeoutTime_SGW" SG_ 1032 LTR_PumpFlowRequest 0;
BA_ "GenSigTimeoutTime_TCM" SG_ 1032 LTR_PumpFlowRequest 0;
BA_ "GenSigTimeoutTime_AGSM" SG_ 1032 RadiatorFanSts 0;
BA_ "GenSigTimeoutTime_BCM" SG_ 1032 RadiatorFanSts 0;
BA_ "GenSigTimeoutTime_BSM" SG_ 1032 RadiatorFanSts 0;
BA_ "GenSigTimeoutTime_CADM" SG_ 1032 RadiatorFanSts 0;
BA_ "GenSigTimeoutTime_DMSM" SG_ 1032 RadiatorFanSts 0;
BA_ "GenSigTimeoutTime_DTCM" SG_ 1032 RadiatorFanSts 0;
BA_ "GenSigTimeoutTime_EVCU2" SG_ 1032 RadiatorFanSts 0;
BA_ "GenSigTimeoutTime_GNMM" SG_ 1032 RadiatorFanSts 0;
BA_ "GenSigTimeoutTime_HCP" SG_ 1032 RadiatorFanSts 0;
BA_ "GenSigTimeoutTime_IPC" SG_ 1032 RadiatorFanSts 0;
BA_ "GenSigTimeoutTime_RFHM" SG_ 1032 RadiatorFanSts 0;
BA_ "GenSigTimeoutTime_SGW" SG_ 1032 RadiatorFanSts 0;
BA_ "GenSigTimeoutTime_TCM" SG_ 1032 RadiatorFanSts 0;
BA_ "GenSigTimeoutTime_AGSM" SG_ 752 CRC_IBS3DATA1 0;
BA_ "GenSigTimeoutTime_BCM" SG_ 752 CRC_IBS3DATA1 0;
BA_ "GenSigTimeoutTime_BSM" SG_ 752 CRC_IBS3DATA1 0;
BA_ "GenSigTimeoutTime_CADM" SG_ 752 CRC_IBS3DATA1 0;
BA_ "GenSigTimeoutTime_DMSM" SG_ 752 CRC_IBS3DATA1 0;
BA_ "GenSigTimeoutTime_DTCM" SG_ 752 CRC_IBS3DATA1 0;
BA_ "GenSigTimeoutTime_GNMM" SG_ 752 CRC_IBS3DATA1 0;
BA_ "GenSigTimeoutTime_HCP" SG_ 752 CRC_IBS3DATA1 0;
BA_ "GenSigTimeoutTime_IPC" SG_ 752 CRC_IBS3DATA1 0;
BA_ "GenSigTimeoutTime_RFHM" SG_ 752 CRC_IBS3DATA1 0;
BA_ "GenSigTimeoutTime_SGW" SG_ 752 CRC_IBS3DATA1 0;
BA_ "GenSigTimeoutTime_TCM" SG_ 752 CRC_IBS3DATA1 0;
BA_ "GenSigTimeoutTime_AGSM" SG_ 752 CurrBattFailStatus 0;
BA_ "GenSigTimeoutTime_BCM" SG_ 752 CurrBattFailStatus 0;
BA_ "GenSigTimeoutTime_BSM" SG_ 752 CurrBattFailStatus 0;
BA_ "GenSigTimeoutTime_CADM" SG_ 752 CurrBattFailStatus 0;
BA_ "GenSigTimeoutTime_DMSM" SG_ 752 CurrBattFailStatus 0;
BA_ "GenSigTimeoutTime_DTCM" SG_ 752 CurrBattFailStatus 0;
BA_ "GenSigTimeoutTime_GNMM" SG_ 752 CurrBattFailStatus 0;
BA_ "GenSigTimeoutTime_HCP" SG_ 752 CurrBattFailStatus 0;
BA_ "GenSigTimeoutTime_IPC" SG_ 752 CurrBattFailStatus 0;
BA_ "GenSigTimeoutTime_RFHM" SG_ 752 CurrBattFailStatus 0;
BA_ "GenSigTimeoutTime_SGW" SG_ 752 CurrBattFailStatus 0;
BA_ "GenSigTimeoutTime_TCM" SG_ 752 CurrBattFailStatus 0;
BA_ "GenSigTimeoutTime_AGSM" SG_ 752 IBS3_Error_Internal 0;
BA_ "GenSigTimeoutTime_BCM" SG_ 752 IBS3_Error_Internal 0;
BA_ "GenSigTimeoutTime_BSM" SG_ 752 IBS3_Error_Internal 0;
BA_ "GenSigTimeoutTime_CADM" SG_ 752 IBS3_Error_Internal 0;
BA_ "GenSigTimeoutTime_DMSM" SG_ 752 IBS3_Error_Internal 0;
BA_ "GenSigTimeoutTime_DTCM" SG_ 752 IBS3_Error_Internal 0;
BA_ "GenSigTimeoutTime_GNMM" SG_ 752 IBS3_Error_Internal 0;
BA_ "GenSigTimeoutTime_HCP" SG_ 752 IBS3_Error_Internal 0;
BA_ "GenSigTimeoutTime_IPC" SG_ 752 IBS3_Error_Internal 0;
BA_ "GenSigTimeoutTime_RFHM" SG_ 752 IBS3_Error_Internal 0;
BA_ "GenSigTimeoutTime_SGW" SG_ 752 IBS3_Error_Internal 0;
BA_ "GenSigTimeoutTime_TCM" SG_ 752 IBS3_Error_Internal 0;
BA_ "GenSigStartValue" SG_ 752 IBS3_Ibatt 65535;
BA_ "GenSigTimeoutTime_AGSM" SG_ 752 IBS3_Ibatt 0;
BA_ "GenSigTimeoutTime_BCM" SG_ 752 IBS3_Ibatt 0;
BA_ "GenSigTimeoutTime_BSM" SG_ 752 IBS3_Ibatt 0;
BA_ "GenSigTimeoutTime_CADM" SG_ 752 IBS3_Ibatt 0;
BA_ "GenSigTimeoutTime_DMSM" SG_ 752 IBS3_Ibatt 0;
BA_ "GenSigTimeoutTime_DTCM" SG_ 752 IBS3_Ibatt 0;
BA_ "GenSigTimeoutTime_GNMM" SG_ 752 IBS3_Ibatt 0;
BA_ "GenSigTimeoutTime_HCP" SG_ 752 IBS3_Ibatt 0;
BA_ "GenSigTimeoutTime_IPC" SG_ 752 IBS3_Ibatt 0;
BA_ "GenSigTimeoutTime_RFHM" SG_ 752 IBS3_Ibatt 0;
BA_ "GenSigTimeoutTime_TCM" SG_ 752 IBS3_Ibatt 0;
BA_ "GenSigStartValue" SG_ 752 IBS3_SOF_V_Accuracy 1;
BA_ "GenSigTimeoutTime_AGSM" SG_ 752 IBS3_SOF_V_Accuracy 0;
BA_ "GenSigTimeoutTime_BCM" SG_ 752 IBS3_SOF_V_Accuracy 0;
BA_ "GenSigTimeoutTime_BSM" SG_ 752 IBS3_SOF_V_Accuracy 0;
BA_ "GenSigTimeoutTime_CADM" SG_ 752 IBS3_SOF_V_Accuracy 0;
BA_ "GenSigTimeoutTime_DMSM" SG_ 752 IBS3_SOF_V_Accuracy 0;
BA_ "GenSigTimeoutTime_DTCM" SG_ 752 IBS3_SOF_V_Accuracy 0;
BA_ "GenSigTimeoutTime_GNMM" SG_ 752 IBS3_SOF_V_Accuracy 0;
BA_ "GenSigTimeoutTime_HCP" SG_ 752 IBS3_SOF_V_Accuracy 0;
BA_ "GenSigTimeoutTime_IPC" SG_ 752 IBS3_SOF_V_Accuracy 0;
BA_ "GenSigTimeoutTime_RFHM" SG_ 752 IBS3_SOF_V_Accuracy 0;
BA_ "GenSigTimeoutTime_SGW" SG_ 752 IBS3_SOF_V_Accuracy 0;
BA_ "GenSigTimeoutTime_TCM" SG_ 752 IBS3_SOF_V_Accuracy 0;
BA_ "GenSigTimeoutTime_AGSM" SG_ 752 IBS3_SOF_VC 0;
BA_ "GenSigTimeoutTime_BCM" SG_ 752 IBS3_SOF_VC 0;
BA_ "GenSigTimeoutTime_BSM" SG_ 752 IBS3_SOF_VC 0;
BA_ "GenSigTimeoutTime_CADM" SG_ 752 IBS3_SOF_VC 0;
BA_ "GenSigTimeoutTime_DMSM" SG_ 752 IBS3_SOF_VC 0;
BA_ "GenSigTimeoutTime_DTCM" SG_ 752 IBS3_SOF_VC 0;
BA_ "GenSigTimeoutTime_GNMM" SG_ 752 IBS3_SOF_VC 0;
BA_ "GenSigTimeoutTime_HCP" SG_ 752 IBS3_SOF_VC 0;
BA_ "GenSigTimeoutTime_IPC" SG_ 752 IBS3_SOF_VC 0;
BA_ "GenSigTimeoutTime_RFHM" SG_ 752 IBS3_SOF_VC 0;
BA_ "GenSigTimeoutTime_SGW" SG_ 752 IBS3_SOF_VC 0;
BA_ "GenSigTimeoutTime_TCM" SG_ 752 IBS3_SOF_VC 0;
BA_ "GenSigStartValue" SG_ 752 IBS3_Vbatt 511;
BA_ "GenSigTimeoutTime_AGSM" SG_ 752 IBS3_Vbatt 0;
BA_ "GenSigTimeoutTime_BCM" SG_ 752 IBS3_Vbatt 0;
BA_ "GenSigTimeoutTime_BSM" SG_ 752 IBS3_Vbatt 0;
BA_ "GenSigTimeoutTime_CADM" SG_ 752 IBS3_Vbatt 0;
BA_ "GenSigTimeoutTime_DMSM" SG_ 752 IBS3_Vbatt 0;
BA_ "GenSigTimeoutTime_DTCM" SG_ 752 IBS3_Vbatt 0;
BA_ "GenSigTimeoutTime_GNMM" SG_ 752 IBS3_Vbatt 0;
BA_ "GenSigTimeoutTime_IPC" SG_ 752 IBS3_Vbatt 0;
BA_ "GenSigTimeoutTime_TCM" SG_ 752 IBS3_Vbatt 0;
BA_ "GenSigTimeoutTime_AGSM" SG_ 752 MessageCounter_IBS3DATA1 0;
BA_ "GenSigTimeoutTime_BCM" SG_ 752 MessageCounter_IBS3DATA1 0;
BA_ "GenSigTimeoutTime_BSM" SG_ 752 MessageCounter_IBS3DATA1 0;
BA_ "GenSigTimeoutTime_CADM" SG_ 752 MessageCounter_IBS3DATA1 0;
BA_ "GenSigTimeoutTime_DMSM" SG_ 752 MessageCounter_IBS3DATA1 0;
BA_ "GenSigTimeoutTime_DTCM" SG_ 752 MessageCounter_IBS3DATA1 0;
BA_ "GenSigTimeoutTime_GNMM" SG_ 752 MessageCounter_IBS3DATA1 0;
BA_ "GenSigTimeoutTime_HCP" SG_ 752 MessageCounter_IBS3DATA1 0;
BA_ "GenSigTimeoutTime_IPC" SG_ 752 MessageCounter_IBS3DATA1 0;
BA_ "GenSigTimeoutTime_RFHM" SG_ 752 MessageCounter_IBS3DATA1 0;
BA_ "GenSigTimeoutTime_SGW" SG_ 752 MessageCounter_IBS3DATA1 0;
BA_ "GenSigTimeoutTime_TCM" SG_ 752 MessageCounter_IBS3DATA1 0;
BA_ "GenSigTimeoutTime_AGSM" SG_ 752 RsErrIBS3 0;
BA_ "GenSigTimeoutTime_BCM" SG_ 752 RsErrIBS3 0;
BA_ "GenSigTimeoutTime_BSM" SG_ 752 RsErrIBS3 0;
BA_ "GenSigTimeoutTime_CADM" SG_ 752 RsErrIBS3 0;
BA_ "GenSigTimeoutTime_DMSM" SG_ 752 RsErrIBS3 0;
BA_ "GenSigTimeoutTime_DTCM" SG_ 752 RsErrIBS3 0;
BA_ "GenSigTimeoutTime_GNMM" SG_ 752 RsErrIBS3 0;
BA_ "GenSigTimeoutTime_HCP" SG_ 752 RsErrIBS3 0;
BA_ "GenSigTimeoutTime_IPC" SG_ 752 RsErrIBS3 0;
BA_ "GenSigTimeoutTime_RFHM" SG_ 752 RsErrIBS3 0;
BA_ "GenSigTimeoutTime_SGW" SG_ 752 RsErrIBS3 0;
BA_ "GenSigTimeoutTime_TCM" SG_ 752 RsErrIBS3 0;
BA_ "GenSigTimeoutTime_AGSM" SG_ 752 VoltBattFailStatus 0;
BA_ "GenSigTimeoutTime_BCM" SG_ 752 VoltBattFailStatus 0;
BA_ "GenSigTimeoutTime_BSM" SG_ 752 VoltBattFailStatus 0;
BA_ "GenSigTimeoutTime_CADM" SG_ 752 VoltBattFailStatus 0;
BA_ "GenSigTimeoutTime_DMSM" SG_ 752 VoltBattFailStatus 0;
BA_ "GenSigTimeoutTime_DTCM" SG_ 752 VoltBattFailStatus 0;
BA_ "GenSigTimeoutTime_GNMM" SG_ 752 VoltBattFailStatus 0;
BA_ "GenSigTimeoutTime_IPC" SG_ 752 VoltBattFailStatus 0;
BA_ "GenSigTimeoutTime_RFHM" SG_ 752 VoltBattFailStatus 0;
BA_ "GenSigTimeoutTime_SGW" SG_ 752 VoltBattFailStatus 0;
BA_ "GenSigTimeoutTime_TCM" SG_ 752 VoltBattFailStatus 0;
BA_ "GenSigTimeoutTime_AGSM" SG_ 754 CurrBattFailStatus_2 0;
BA_ "GenSigTimeoutTime_BCM" SG_ 754 CurrBattFailStatus_2 0;
BA_ "GenSigTimeoutTime_BSM" SG_ 754 CurrBattFailStatus_2 0;
BA_ "GenSigTimeoutTime_CADM" SG_ 754 CurrBattFailStatus_2 0;
BA_ "GenSigTimeoutTime_DMSM" SG_ 754 CurrBattFailStatus_2 0;
BA_ "GenSigTimeoutTime_DTCM" SG_ 754 CurrBattFailStatus_2 0;
BA_ "GenSigTimeoutTime_ECM" SG_ 754 CurrBattFailStatus_2 0;
BA_ "GenSigTimeoutTime_EVCU2" SG_ 754 CurrBattFailStatus_2 0;
BA_ "GenSigTimeoutTime_GNMM" SG_ 754 CurrBattFailStatus_2 0;
BA_ "GenSigTimeoutTime_HCP" SG_ 754 CurrBattFailStatus_2 0;
BA_ "GenSigTimeoutTime_IPC" SG_ 754 CurrBattFailStatus_2 0;
BA_ "GenSigTimeoutTime_RFHM" SG_ 754 CurrBattFailStatus_2 0;
BA_ "GenSigTimeoutTime_SGW" SG_ 754 CurrBattFailStatus_2 0;
BA_ "GenSigTimeoutTime_TCM" SG_ 754 CurrBattFailStatus_2 0;
BA_ "GenSigTimeoutTime_AGSM" SG_ 754 IBS3_Error_Internal_2 0;
BA_ "GenSigTimeoutTime_BCM" SG_ 754 IBS3_Error_Internal_2 0;
BA_ "GenSigTimeoutTime_BSM" SG_ 754 IBS3_Error_Internal_2 0;
BA_ "GenSigTimeoutTime_CADM" SG_ 754 IBS3_Error_Internal_2 0;
BA_ "GenSigTimeoutTime_DMSM" SG_ 754 IBS3_Error_Internal_2 0;
BA_ "GenSigTimeoutTime_DTCM" SG_ 754 IBS3_Error_Internal_2 0;
BA_ "GenSigTimeoutTime_ECM" SG_ 754 IBS3_Error_Internal_2 0;
BA_ "GenSigTimeoutTime_EVCU2" SG_ 754 IBS3_Error_Internal_2 0;
BA_ "GenSigTimeoutTime_GNMM" SG_ 754 IBS3_Error_Internal_2 0;
BA_ "GenSigTimeoutTime_HCP" SG_ 754 IBS3_Error_Internal_2 0;
BA_ "GenSigTimeoutTime_IPC" SG_ 754 IBS3_Error_Internal_2 0;
BA_ "GenSigTimeoutTime_RFHM" SG_ 754 IBS3_Error_Internal_2 0;
BA_ "GenSigTimeoutTime_SGW" SG_ 754 IBS3_Error_Internal_2 0;
BA_ "GenSigTimeoutTime_TCM" SG_ 754 IBS3_Error_Internal_2 0;
BA_ "GenSigTimeoutTime_AGSM" SG_ 754 RsErrIBS3_2 0;
BA_ "GenSigTimeoutTime_BCM" SG_ 754 RsErrIBS3_2 0;
BA_ "GenSigTimeoutTime_BSM" SG_ 754 RsErrIBS3_2 0;
BA_ "GenSigTimeoutTime_CADM" SG_ 754 RsErrIBS3_2 0;
BA_ "GenSigTimeoutTime_DMSM" SG_ 754 RsErrIBS3_2 0;
BA_ "GenSigTimeoutTime_DTCM" SG_ 754 RsErrIBS3_2 0;
BA_ "GenSigTimeoutTime_ECM" SG_ 754 RsErrIBS3_2 0;
BA_ "GenSigTimeoutTime_EVCU2" SG_ 754 RsErrIBS3_2 0;
BA_ "GenSigTimeoutTime_GNMM" SG_ 754 RsErrIBS3_2 0;
BA_ "GenSigTimeoutTime_HCP" SG_ 754 RsErrIBS3_2 0;
BA_ "GenSigTimeoutTime_IPC" SG_ 754 RsErrIBS3_2 0;
BA_ "GenSigTimeoutTime_RFHM" SG_ 754 RsErrIBS3_2 0;
BA_ "GenSigTimeoutTime_SGW" SG_ 754 RsErrIBS3_2 0;
BA_ "GenSigTimeoutTime_TCM" SG_ 754 RsErrIBS3_2 0;
BA_ "GenSigTimeoutTime_AGSM" SG_ 754 VoltBattFailStatus_2 0;
BA_ "GenSigTimeoutTime_BCM" SG_ 754 VoltBattFailStatus_2 0;
BA_ "GenSigTimeoutTime_BSM" SG_ 754 VoltBattFailStatus_2 0;
BA_ "GenSigTimeoutTime_CADM" SG_ 754 VoltBattFailStatus_2 0;
BA_ "GenSigTimeoutTime_DMSM" SG_ 754 VoltBattFailStatus_2 0;
BA_ "GenSigTimeoutTime_DTCM" SG_ 754 VoltBattFailStatus_2 0;
BA_ "GenSigTimeoutTime_ECM" SG_ 754 VoltBattFailStatus_2 0;
BA_ "GenSigTimeoutTime_EVCU2" SG_ 754 VoltBattFailStatus_2 0;
BA_ "GenSigTimeoutTime_GNMM" SG_ 754 VoltBattFailStatus_2 0;
BA_ "GenSigTimeoutTime_HCP" SG_ 754 VoltBattFailStatus_2 0;
BA_ "GenSigTimeoutTime_IPC" SG_ 754 VoltBattFailStatus_2 0;
BA_ "GenSigTimeoutTime_RFHM" SG_ 754 VoltBattFailStatus_2 0;
BA_ "GenSigTimeoutTime_SGW" SG_ 754 VoltBattFailStatus_2 0;
BA_ "GenSigTimeoutTime_TCM" SG_ 754 VoltBattFailStatus_2 0;
BA_ "GenSigTimeoutTime_AGSM" SG_ 1955 CRC_IBS3DATA2 0;
BA_ "GenSigTimeoutTime_BCM" SG_ 1955 CRC_IBS3DATA2 0;
BA_ "GenSigTimeoutTime_BSM" SG_ 1955 CRC_IBS3DATA2 0;
BA_ "GenSigTimeoutTime_CADM" SG_ 1955 CRC_IBS3DATA2 0;
BA_ "GenSigTimeoutTime_DMSM" SG_ 1955 CRC_IBS3DATA2 0;
BA_ "GenSigTimeoutTime_DTCM" SG_ 1955 CRC_IBS3DATA2 0;
BA_ "GenSigTimeoutTime_ECM" SG_ 1955 CRC_IBS3DATA2 0;
BA_ "GenSigTimeoutTime_GNMM" SG_ 1955 CRC_IBS3DATA2 0;
BA_ "GenSigTimeoutTime_HCP" SG_ 1955 CRC_IBS3DATA2 0;
BA_ "GenSigTimeoutTime_IPC" SG_ 1955 CRC_IBS3DATA2 0;
BA_ "GenSigTimeoutTime_RFHM" SG_ 1955 CRC_IBS3DATA2 0;
BA_ "GenSigTimeoutTime_SGW" SG_ 1955 CRC_IBS3DATA2 0;
BA_ "GenSigTimeoutTime_TCM" SG_ 1955 CRC_IBS3DATA2 0;
BA_ "GenSigTimeoutTime_AGSM" SG_ 1955 IBS3_CRC_IBS_1 0;
BA_ "GenSigTimeoutTime_BCM" SG_ 1955 IBS3_CRC_IBS_1 0;
BA_ "GenSigTimeoutTime_BSM" SG_ 1955 IBS3_CRC_IBS_1 0;
BA_ "GenSigTimeoutTime_DMSM" SG_ 1955 IBS3_CRC_IBS_1 0;
BA_ "GenSigTimeoutTime_DTCM" SG_ 1955 IBS3_CRC_IBS_1 0;
BA_ "GenSigTimeoutTime_ECM" SG_ 1955 IBS3_CRC_IBS_1 0;
BA_ "GenSigTimeoutTime_EVCU2" SG_ 1955 IBS3_CRC_IBS_1 0;
BA_ "GenSigTimeoutTime_GNMM" SG_ 1955 IBS3_CRC_IBS_1 0;
BA_ "GenSigTimeoutTime_HCP" SG_ 1955 IBS3_CRC_IBS_1 0;
BA_ "GenSigTimeoutTime_IPC" SG_ 1955 IBS3_CRC_IBS_1 0;
BA_ "GenSigTimeoutTime_RFHM" SG_ 1955 IBS3_CRC_IBS_1 0;
BA_ "GenSigTimeoutTime_SGW" SG_ 1955 IBS3_CRC_IBS_1 0;
BA_ "GenSigTimeoutTime_TCM" SG_ 1955 IBS3_CRC_IBS_1 0;
BA_ "GenSigTimeoutTime_AGSM" SG_ 1955 IBS3_CRC_IBS_2 0;
BA_ "GenSigTimeoutTime_BCM" SG_ 1955 IBS3_CRC_IBS_2 0;
BA_ "GenSigTimeoutTime_BSM" SG_ 1955 IBS3_CRC_IBS_2 0;
BA_ "GenSigTimeoutTime_DMSM" SG_ 1955 IBS3_CRC_IBS_2 0;
BA_ "GenSigTimeoutTime_DTCM" SG_ 1955 IBS3_CRC_IBS_2 0;
BA_ "GenSigTimeoutTime_ECM" SG_ 1955 IBS3_CRC_IBS_2 0;
BA_ "GenSigTimeoutTime_EVCU2" SG_ 1955 IBS3_CRC_IBS_2 0;
BA_ "GenSigTimeoutTime_GNMM" SG_ 1955 IBS3_CRC_IBS_2 0;
BA_ "GenSigTimeoutTime_HCP" SG_ 1955 IBS3_CRC_IBS_2 0;
BA_ "GenSigTimeoutTime_IPC" SG_ 1955 IBS3_CRC_IBS_2 0;
BA_ "GenSigTimeoutTime_RFHM" SG_ 1955 IBS3_CRC_IBS_2 0;
BA_ "GenSigTimeoutTime_SGW" SG_ 1955 IBS3_CRC_IBS_2 0;
BA_ "GenSigTimeoutTime_TCM" SG_ 1955 IBS3_CRC_IBS_2 0;
BA_ "GenSigTimeoutTime_AGSM" SG_ 1955 IBS3_FLAG_DISCONNECT 0;
BA_ "GenSigTimeoutTime_BCM" SG_ 1955 IBS3_FLAG_DISCONNECT 0;
BA_ "GenSigTimeoutTime_BSM" SG_ 1955 IBS3_FLAG_DISCONNECT 0;
BA_ "GenSigTimeoutTime_CADM" SG_ 1955 IBS3_FLAG_DISCONNECT 0;
BA_ "GenSigTimeoutTime_DMSM" SG_ 1955 IBS3_FLAG_DISCONNECT 0;
BA_ "GenSigTimeoutTime_DTCM" SG_ 1955 IBS3_FLAG_DISCONNECT 0;
BA_ "GenSigTimeoutTime_GNMM" SG_ 1955 IBS3_FLAG_DISCONNECT 0;
BA_ "GenSigTimeoutTime_HCP" SG_ 1955 IBS3_FLAG_DISCONNECT 0;
BA_ "GenSigTimeoutTime_IPC" SG_ 1955 IBS3_FLAG_DISCONNECT 0;
BA_ "GenSigTimeoutTime_RFHM" SG_ 1955 IBS3_FLAG_DISCONNECT 0;
BA_ "GenSigTimeoutTime_SGW" SG_ 1955 IBS3_FLAG_DISCONNECT 0;
BA_ "GenSigTimeoutTime_TCM" SG_ 1955 IBS3_FLAG_DISCONNECT 0;
BA_ "GenSigTimeoutTime_AGSM" SG_ 1955 IBS3_FLAG_DISCONNECT_ADAS 0;
BA_ "GenSigTimeoutTime_BCM" SG_ 1955 IBS3_FLAG_DISCONNECT_ADAS 0;
BA_ "GenSigTimeoutTime_BSM" SG_ 1955 IBS3_FLAG_DISCONNECT_ADAS 0;
BA_ "GenSigTimeoutTime_DMSM" SG_ 1955 IBS3_FLAG_DISCONNECT_ADAS 0;
BA_ "GenSigTimeoutTime_DTCM" SG_ 1955 IBS3_FLAG_DISCONNECT_ADAS 0;
BA_ "GenSigTimeoutTime_ECM" SG_ 1955 IBS3_FLAG_DISCONNECT_ADAS 0;
BA_ "GenSigTimeoutTime_EVCU2" SG_ 1955 IBS3_FLAG_DISCONNECT_ADAS 0;
BA_ "GenSigTimeoutTime_GNMM" SG_ 1955 IBS3_FLAG_DISCONNECT_ADAS 0;
BA_ "GenSigTimeoutTime_HCP" SG_ 1955 IBS3_FLAG_DISCONNECT_ADAS 0;
BA_ "GenSigTimeoutTime_IPC" SG_ 1955 IBS3_FLAG_DISCONNECT_ADAS 0;
BA_ "GenSigTimeoutTime_RFHM" SG_ 1955 IBS3_FLAG_DISCONNECT_ADAS 0;
BA_ "GenSigTimeoutTime_SGW" SG_ 1955 IBS3_FLAG_DISCONNECT_ADAS 0;
BA_ "GenSigTimeoutTime_TCM" SG_ 1955 IBS3_FLAG_DISCONNECT_ADAS 0;
BA_ "GenSigTimeoutTime_AGSM" SG_ 1955 IBS3_FLAG_DISCONNECT_ADAS_2 0;
BA_ "GenSigTimeoutTime_BCM" SG_ 1955 IBS3_FLAG_DISCONNECT_ADAS_2 0;
BA_ "GenSigTimeoutTime_BSM" SG_ 1955 IBS3_FLAG_DISCONNECT_ADAS_2 0;
BA_ "GenSigTimeoutTime_DMSM" SG_ 1955 IBS3_FLAG_DISCONNECT_ADAS_2 0;
BA_ "GenSigTimeoutTime_DTCM" SG_ 1955 IBS3_FLAG_DISCONNECT_ADAS_2 0;
BA_ "GenSigTimeoutTime_ECM" SG_ 1955 IBS3_FLAG_DISCONNECT_ADAS_2 0;
BA_ "GenSigTimeoutTime_EVCU2" SG_ 1955 IBS3_FLAG_DISCONNECT_ADAS_2 0;
BA_ "GenSigTimeoutTime_GNMM" SG_ 1955 IBS3_FLAG_DISCONNECT_ADAS_2 0;
BA_ "GenSigTimeoutTime_HCP" SG_ 1955 IBS3_FLAG_DISCONNECT_ADAS_2 0;
BA_ "GenSigTimeoutTime_IPC" SG_ 1955 IBS3_FLAG_DISCONNECT_ADAS_2 0;
BA_ "GenSigTimeoutTime_RFHM" SG_ 1955 IBS3_FLAG_DISCONNECT_ADAS_2 0;
BA_ "GenSigTimeoutTime_SGW" SG_ 1955 IBS3_FLAG_DISCONNECT_ADAS_2 0;
BA_ "GenSigTimeoutTime_TCM" SG_ 1955 IBS3_FLAG_DISCONNECT_ADAS_2 0;
BA_ "GenSigTimeoutTime_AGSM" SG_ 1955 IBS3_IBS_ADAS_OK 0;
BA_ "GenSigTimeoutTime_BCM" SG_ 1955 IBS3_IBS_ADAS_OK 0;
BA_ "GenSigTimeoutTime_BSM" SG_ 1955 IBS3_IBS_ADAS_OK 0;
BA_ "GenSigTimeoutTime_DMSM" SG_ 1955 IBS3_IBS_ADAS_OK 0;
BA_ "GenSigTimeoutTime_DTCM" SG_ 1955 IBS3_IBS_ADAS_OK 0;
BA_ "GenSigTimeoutTime_ECM" SG_ 1955 IBS3_IBS_ADAS_OK 0;
BA_ "GenSigTimeoutTime_EVCU2" SG_ 1955 IBS3_IBS_ADAS_OK 0;
BA_ "GenSigTimeoutTime_GNMM" SG_ 1955 IBS3_IBS_ADAS_OK 0;
BA_ "GenSigTimeoutTime_HCP" SG_ 1955 IBS3_IBS_ADAS_OK 0;
BA_ "GenSigTimeoutTime_IPC" SG_ 1955 IBS3_IBS_ADAS_OK 0;
BA_ "GenSigTimeoutTime_RFHM" SG_ 1955 IBS3_IBS_ADAS_OK 0;
BA_ "GenSigTimeoutTime_SGW" SG_ 1955 IBS3_IBS_ADAS_OK 0;
BA_ "GenSigTimeoutTime_TCM" SG_ 1955 IBS3_IBS_ADAS_OK 0;
BA_ "GenSigTimeoutTime_AGSM" SG_ 1955 IBS3_IBS_ADAS_OK_2 0;
BA_ "GenSigTimeoutTime_BCM" SG_ 1955 IBS3_IBS_ADAS_OK_2 0;
BA_ "GenSigTimeoutTime_BSM" SG_ 1955 IBS3_IBS_ADAS_OK_2 0;
BA_ "GenSigTimeoutTime_DMSM" SG_ 1955 IBS3_IBS_ADAS_OK_2 0;
BA_ "GenSigTimeoutTime_DTCM" SG_ 1955 IBS3_IBS_ADAS_OK_2 0;
BA_ "GenSigTimeoutTime_ECM" SG_ 1955 IBS3_IBS_ADAS_OK_2 0;
BA_ "GenSigTimeoutTime_EVCU2" SG_ 1955 IBS3_IBS_ADAS_OK_2 0;
BA_ "GenSigTimeoutTime_GNMM" SG_ 1955 IBS3_IBS_ADAS_OK_2 0;
BA_ "GenSigTimeoutTime_HCP" SG_ 1955 IBS3_IBS_ADAS_OK_2 0;
BA_ "GenSigTimeoutTime_IPC" SG_ 1955 IBS3_IBS_ADAS_OK_2 0;
BA_ "GenSigTimeoutTime_RFHM" SG_ 1955 IBS3_IBS_ADAS_OK_2 0;
BA_ "GenSigTimeoutTime_SGW" SG_ 1955 IBS3_IBS_ADAS_OK_2 0;
BA_ "GenSigTimeoutTime_TCM" SG_ 1955 IBS3_IBS_ADAS_OK_2 0;
BA_ "GenSigTimeoutTime_AGSM" SG_ 1955 IBS3_MC_IBS_1 0;
BA_ "GenSigTimeoutTime_BCM" SG_ 1955 IBS3_MC_IBS_1 0;
BA_ "GenSigTimeoutTime_BSM" SG_ 1955 IBS3_MC_IBS_1 0;
BA_ "GenSigTimeoutTime_DMSM" SG_ 1955 IBS3_MC_IBS_1 0;
BA_ "GenSigTimeoutTime_DTCM" SG_ 1955 IBS3_MC_IBS_1 0;
BA_ "GenSigTimeoutTime_ECM" SG_ 1955 IBS3_MC_IBS_1 0;
BA_ "GenSigTimeoutTime_EVCU2" SG_ 1955 IBS3_MC_IBS_1 0;
BA_ "GenSigTimeoutTime_GNMM" SG_ 1955 IBS3_MC_IBS_1 0;
BA_ "GenSigTimeoutTime_HCP" SG_ 1955 IBS3_MC_IBS_1 0;
BA_ "GenSigTimeoutTime_IPC" SG_ 1955 IBS3_MC_IBS_1 0;
BA_ "GenSigTimeoutTime_RFHM" SG_ 1955 IBS3_MC_IBS_1 0;
BA_ "GenSigTimeoutTime_SGW" SG_ 1955 IBS3_MC_IBS_1 0;
BA_ "GenSigTimeoutTime_TCM" SG_ 1955 IBS3_MC_IBS_1 0;
BA_ "GenSigTimeoutTime_AGSM" SG_ 1955 IBS3_MC_IBS_2 0;
BA_ "GenSigTimeoutTime_BCM" SG_ 1955 IBS3_MC_IBS_2 0;
BA_ "GenSigTimeoutTime_BSM" SG_ 1955 IBS3_MC_IBS_2 0;
BA_ "GenSigTimeoutTime_DMSM" SG_ 1955 IBS3_MC_IBS_2 0;
BA_ "GenSigTimeoutTime_DTCM" SG_ 1955 IBS3_MC_IBS_2 0;
BA_ "GenSigTimeoutTime_ECM" SG_ 1955 IBS3_MC_IBS_2 0;
BA_ "GenSigTimeoutTime_EVCU2" SG_ 1955 IBS3_MC_IBS_2 0;
BA_ "GenSigTimeoutTime_GNMM" SG_ 1955 IBS3_MC_IBS_2 0;
BA_ "GenSigTimeoutTime_HCP" SG_ 1955 IBS3_MC_IBS_2 0;
BA_ "GenSigTimeoutTime_IPC" SG_ 1955 IBS3_MC_IBS_2 0;
BA_ "GenSigTimeoutTime_RFHM" SG_ 1955 IBS3_MC_IBS_2 0;
BA_ "GenSigTimeoutTime_SGW" SG_ 1955 IBS3_MC_IBS_2 0;
BA_ "GenSigTimeoutTime_TCM" SG_ 1955 IBS3_MC_IBS_2 0;
BA_ "GenSigStartValue" SG_ 1955 IBS3_Q_received 65535;
BA_ "GenSigTimeoutTime_AGSM" SG_ 1955 IBS3_Q_received 0;
BA_ "GenSigTimeoutTime_BCM" SG_ 1955 IBS3_Q_received 0;
BA_ "GenSigTimeoutTime_BSM" SG_ 1955 IBS3_Q_received 0;
BA_ "GenSigTimeoutTime_CADM" SG_ 1955 IBS3_Q_received 0;
BA_ "GenSigTimeoutTime_DMSM" SG_ 1955 IBS3_Q_received 0;
BA_ "GenSigTimeoutTime_DTCM" SG_ 1955 IBS3_Q_received 0;
BA_ "GenSigTimeoutTime_ECM" SG_ 1955 IBS3_Q_received 0;
BA_ "GenSigTimeoutTime_GNMM" SG_ 1955 IBS3_Q_received 0;
BA_ "GenSigTimeoutTime_HCP" SG_ 1955 IBS3_Q_received 0;
BA_ "GenSigTimeoutTime_IPC" SG_ 1955 IBS3_Q_received 0;
BA_ "GenSigTimeoutTime_RFHM" SG_ 1955 IBS3_Q_received 0;
BA_ "GenSigTimeoutTime_SGW" SG_ 1955 IBS3_Q_received 0;
BA_ "GenSigTimeoutTime_TCM" SG_ 1955 IBS3_Q_received 0;
BA_ "GenSigStartValue" SG_ 1955 IBS3_Q_released 65535;
BA_ "GenSigTimeoutTime_AGSM" SG_ 1955 IBS3_Q_released 0;
BA_ "GenSigTimeoutTime_BCM" SG_ 1955 IBS3_Q_released 0;
BA_ "GenSigTimeoutTime_BSM" SG_ 1955 IBS3_Q_released 0;
BA_ "GenSigTimeoutTime_CADM" SG_ 1955 IBS3_Q_released 0;
BA_ "GenSigTimeoutTime_DMSM" SG_ 1955 IBS3_Q_released 0;
BA_ "GenSigTimeoutTime_DTCM" SG_ 1955 IBS3_Q_released 0;
BA_ "GenSigTimeoutTime_ECM" SG_ 1955 IBS3_Q_released 0;
BA_ "GenSigTimeoutTime_GNMM" SG_ 1955 IBS3_Q_released 0;
BA_ "GenSigTimeoutTime_HCP" SG_ 1955 IBS3_Q_released 0;
BA_ "GenSigTimeoutTime_IPC" SG_ 1955 IBS3_Q_released 0;
BA_ "GenSigTimeoutTime_RFHM" SG_ 1955 IBS3_Q_released 0;
BA_ "GenSigTimeoutTime_SGW" SG_ 1955 IBS3_Q_released 0;
BA_ "GenSigTimeoutTime_TCM" SG_ 1955 IBS3_Q_released 0;
BA_ "GenSigStartValue" SG_ 1955 IBS3_R_Batt 255;
BA_ "GenSigTimeoutTime_AGSM" SG_ 1955 IBS3_R_Batt 0;
BA_ "GenSigTimeoutTime_BCM" SG_ 1955 IBS3_R_Batt 0;
BA_ "GenSigTimeoutTime_BSM" SG_ 1955 IBS3_R_Batt 0;
BA_ "GenSigTimeoutTime_CADM" SG_ 1955 IBS3_R_Batt 0;
BA_ "GenSigTimeoutTime_DMSM" SG_ 1955 IBS3_R_Batt 0;
BA_ "GenSigTimeoutTime_DTCM" SG_ 1955 IBS3_R_Batt 0;
BA_ "GenSigTimeoutTime_ECM" SG_ 1955 IBS3_R_Batt 0;
BA_ "GenSigTimeoutTime_GNMM" SG_ 1955 IBS3_R_Batt 0;
BA_ "GenSigTimeoutTime_HCP" SG_ 1955 IBS3_R_Batt 0;
BA_ "GenSigTimeoutTime_IPC" SG_ 1955 IBS3_R_Batt 0;
BA_ "GenSigTimeoutTime_RFHM" SG_ 1955 IBS3_R_Batt 0;
BA_ "GenSigTimeoutTime_SGW" SG_ 1955 IBS3_R_Batt 0;
BA_ "GenSigTimeoutTime_TCM" SG_ 1955 IBS3_R_Batt 0;
BA_ "GenSigStartValue" SG_ 1955 IBS3_R_Batt_25 255;
BA_ "GenSigTimeoutTime_AGSM" SG_ 1955 IBS3_R_Batt_25 0;
BA_ "GenSigTimeoutTime_BCM" SG_ 1955 IBS3_R_Batt_25 0;
BA_ "GenSigTimeoutTime_BSM" SG_ 1955 IBS3_R_Batt_25 0;
BA_ "GenSigTimeoutTime_CADM" SG_ 1955 IBS3_R_Batt_25 0;
BA_ "GenSigTimeoutTime_DMSM" SG_ 1955 IBS3_R_Batt_25 0;
BA_ "GenSigTimeoutTime_DTCM" SG_ 1955 IBS3_R_Batt_25 0;
BA_ "GenSigTimeoutTime_ECM" SG_ 1955 IBS3_R_Batt_25 0;
BA_ "GenSigTimeoutTime_GNMM" SG_ 1955 IBS3_R_Batt_25 0;
BA_ "GenSigTimeoutTime_HCP" SG_ 1955 IBS3_R_Batt_25 0;
BA_ "GenSigTimeoutTime_IPC" SG_ 1955 IBS3_R_Batt_25 0;
BA_ "GenSigTimeoutTime_RFHM" SG_ 1955 IBS3_R_Batt_25 0;
BA_ "GenSigTimeoutTime_SGW" SG_ 1955 IBS3_R_Batt_25 0;
BA_ "GenSigTimeoutTime_TCM" SG_ 1955 IBS3_R_Batt_25 0;
BA_ "GenSigStartValue" SG_ 1955 IBS3_SOC 127;
BA_ "GenSigTimeoutTime_AGSM" SG_ 1955 IBS3_SOC 0;
BA_ "GenSigTimeoutTime_BCM" SG_ 1955 IBS3_SOC 0;
BA_ "GenSigTimeoutTime_BSM" SG_ 1955 IBS3_SOC 0;
BA_ "GenSigTimeoutTime_DMSM" SG_ 1955 IBS3_SOC 0;
BA_ "GenSigTimeoutTime_DTCM" SG_ 1955 IBS3_SOC 0;
BA_ "GenSigTimeoutTime_GNMM" SG_ 1955 IBS3_SOC 0;
BA_ "GenSigTimeoutTime_IPC" SG_ 1955 IBS3_SOC 0;
BA_ "GenSigTimeoutTime_TCM" SG_ 1955 IBS3_SOC 0;
BA_ "GenSigTimeoutTime_AGSM" SG_ 1955 IBS3_SOC_Accuracy 0;
BA_ "GenSigTimeoutTime_BCM" SG_ 1955 IBS3_SOC_Accuracy 0;
BA_ "GenSigTimeoutTime_BSM" SG_ 1955 IBS3_SOC_Accuracy 0;
BA_ "GenSigTimeoutTime_CADM" SG_ 1955 IBS3_SOC_Accuracy 0;
BA_ "GenSigTimeoutTime_DMSM" SG_ 1955 IBS3_SOC_Accuracy 0;
BA_ "GenSigTimeoutTime_DTCM" SG_ 1955 IBS3_SOC_Accuracy 0;
BA_ "GenSigTimeoutTime_GNMM" SG_ 1955 IBS3_SOC_Accuracy 0;
BA_ "GenSigTimeoutTime_IPC" SG_ 1955 IBS3_SOC_Accuracy 0;
BA_ "GenSigTimeoutTime_TCM" SG_ 1955 IBS3_SOC_Accuracy 0;
BA_ "GenSigStartValue" SG_ 1955 IBS3_SOF_Q 255;
BA_ "GenSigTimeoutTime_AGSM" SG_ 1955 IBS3_SOF_Q 0;
BA_ "GenSigTimeoutTime_BCM" SG_ 1955 IBS3_SOF_Q 0;
BA_ "GenSigTimeoutTime_BSM" SG_ 1955 IBS3_SOF_Q 0;
BA_ "GenSigTimeoutTime_CADM" SG_ 1955 IBS3_SOF_Q 0;
BA_ "GenSigTimeoutTime_DMSM" SG_ 1955 IBS3_SOF_Q 0;
BA_ "GenSigTimeoutTime_DTCM" SG_ 1955 IBS3_SOF_Q 0;
BA_ "GenSigTimeoutTime_ECM" SG_ 1955 IBS3_SOF_Q 0;
BA_ "GenSigTimeoutTime_GNMM" SG_ 1955 IBS3_SOF_Q 0;
BA_ "GenSigTimeoutTime_HCP" SG_ 1955 IBS3_SOF_Q 0;
BA_ "GenSigTimeoutTime_IPC" SG_ 1955 IBS3_SOF_Q 0;
BA_ "GenSigTimeoutTime_RFHM" SG_ 1955 IBS3_SOF_Q 0;
BA_ "GenSigTimeoutTime_SGW" SG_ 1955 IBS3_SOF_Q 0;
BA_ "GenSigTimeoutTime_TCM" SG_ 1955 IBS3_SOF_Q 0;
BA_ "GenSigTimeoutTime_AGSM" SG_ 1955 IBS3_SOF_Q_Accuracy 0;
BA_ "GenSigTimeoutTime_BCM" SG_ 1955 IBS3_SOF_Q_Accuracy 0;
BA_ "GenSigTimeoutTime_BSM" SG_ 1955 IBS3_SOF_Q_Accuracy 0;
BA_ "GenSigTimeoutTime_CADM" SG_ 1955 IBS3_SOF_Q_Accuracy 0;
BA_ "GenSigTimeoutTime_DMSM" SG_ 1955 IBS3_SOF_Q_Accuracy 0;
BA_ "GenSigTimeoutTime_DTCM" SG_ 1955 IBS3_SOF_Q_Accuracy 0;
BA_ "GenSigTimeoutTime_ECM" SG_ 1955 IBS3_SOF_Q_Accuracy 0;
BA_ "GenSigTimeoutTime_GNMM" SG_ 1955 IBS3_SOF_Q_Accuracy 0;
BA_ "GenSigTimeoutTime_HCP" SG_ 1955 IBS3_SOF_Q_Accuracy 0;
BA_ "GenSigTimeoutTime_IPC" SG_ 1955 IBS3_SOF_Q_Accuracy 0;
BA_ "GenSigTimeoutTime_RFHM" SG_ 1955 IBS3_SOF_Q_Accuracy 0;
BA_ "GenSigTimeoutTime_SGW" SG_ 1955 IBS3_SOF_Q_Accuracy 0;
BA_ "GenSigTimeoutTime_TCM" SG_ 1955 IBS3_SOF_Q_Accuracy 0;
BA_ "GenSigStartValue" SG_ 1955 IBS3_SOH_COR 127;
BA_ "GenSigTimeoutTime_AGSM" SG_ 1955 IBS3_SOH_COR 0;
BA_ "GenSigTimeoutTime_BCM" SG_ 1955 IBS3_SOH_COR 0;
BA_ "GenSigTimeoutTime_BSM" SG_ 1955 IBS3_SOH_COR 0;
BA_ "GenSigTimeoutTime_CADM" SG_ 1955 IBS3_SOH_COR 0;
BA_ "GenSigTimeoutTime_DMSM" SG_ 1955 IBS3_SOH_COR 0;
BA_ "GenSigTimeoutTime_DTCM" SG_ 1955 IBS3_SOH_COR 0;
BA_ "GenSigTimeoutTime_ECM" SG_ 1955 IBS3_SOH_COR 0;
BA_ "GenSigTimeoutTime_GNMM" SG_ 1955 IBS3_SOH_COR 0;
BA_ "GenSigTimeoutTime_HCP" SG_ 1955 IBS3_SOH_COR 0;
BA_ "GenSigTimeoutTime_IPC" SG_ 1955 IBS3_SOH_COR 0;
BA_ "GenSigTimeoutTime_RFHM" SG_ 1955 IBS3_SOH_COR 0;
BA_ "GenSigTimeoutTime_SGW" SG_ 1955 IBS3_SOH_COR 0;
BA_ "GenSigTimeoutTime_TCM" SG_ 1955 IBS3_SOH_COR 0;
BA_ "GenSigTimeoutTime_AGSM" SG_ 1955 IBS3_SOH_COR_Accuracy 0;
BA_ "GenSigTimeoutTime_BCM" SG_ 1955 IBS3_SOH_COR_Accuracy 0;
BA_ "GenSigTimeoutTime_BSM" SG_ 1955 IBS3_SOH_COR_Accuracy 0;
BA_ "GenSigTimeoutTime_CADM" SG_ 1955 IBS3_SOH_COR_Accuracy 0;
BA_ "GenSigTimeoutTime_DMSM" SG_ 1955 IBS3_SOH_COR_Accuracy 0;
BA_ "GenSigTimeoutTime_DTCM" SG_ 1955 IBS3_SOH_COR_Accuracy 0;
BA_ "GenSigTimeoutTime_ECM" SG_ 1955 IBS3_SOH_COR_Accuracy 0;
BA_ "GenSigTimeoutTime_GNMM" SG_ 1955 IBS3_SOH_COR_Accuracy 0;
BA_ "GenSigTimeoutTime_HCP" SG_ 1955 IBS3_SOH_COR_Accuracy 0;
BA_ "GenSigTimeoutTime_IPC" SG_ 1955 IBS3_SOH_COR_Accuracy 0;
BA_ "GenSigTimeoutTime_RFHM" SG_ 1955 IBS3_SOH_COR_Accuracy 0;
BA_ "GenSigTimeoutTime_SGW" SG_ 1955 IBS3_SOH_COR_Accuracy 0;
BA_ "GenSigTimeoutTime_TCM" SG_ 1955 IBS3_SOH_COR_Accuracy 0;
BA_ "GenSigStartValue" SG_ 1955 IBS3_SOH_Q 127;
BA_ "GenSigTimeoutTime_AGSM" SG_ 1955 IBS3_SOH_Q 0;
BA_ "GenSigTimeoutTime_BCM" SG_ 1955 IBS3_SOH_Q 0;
BA_ "GenSigTimeoutTime_BSM" SG_ 1955 IBS3_SOH_Q 0;
BA_ "GenSigTimeoutTime_CADM" SG_ 1955 IBS3_SOH_Q 0;
BA_ "GenSigTimeoutTime_DMSM" SG_ 1955 IBS3_SOH_Q 0;
BA_ "GenSigTimeoutTime_DTCM" SG_ 1955 IBS3_SOH_Q 0;
BA_ "GenSigTimeoutTime_GNMM" SG_ 1955 IBS3_SOH_Q 0;
BA_ "GenSigTimeoutTime_HCP" SG_ 1955 IBS3_SOH_Q 0;
BA_ "GenSigTimeoutTime_IPC" SG_ 1955 IBS3_SOH_Q 0;
BA_ "GenSigTimeoutTime_RFHM" SG_ 1955 IBS3_SOH_Q 0;
BA_ "GenSigTimeoutTime_SGW" SG_ 1955 IBS3_SOH_Q 0;
BA_ "GenSigTimeoutTime_TCM" SG_ 1955 IBS3_SOH_Q 0;
BA_ "GenSigTimeoutTime_AGSM" SG_ 1955 IBS3_SOH_Q_Accuracy 0;
BA_ "GenSigTimeoutTime_BCM" SG_ 1955 IBS3_SOH_Q_Accuracy 0;
BA_ "GenSigTimeoutTime_BSM" SG_ 1955 IBS3_SOH_Q_Accuracy 0;
BA_ "GenSigTimeoutTime_CADM" SG_ 1955 IBS3_SOH_Q_Accuracy 0;
BA_ "GenSigTimeoutTime_DMSM" SG_ 1955 IBS3_SOH_Q_Accuracy 0;
BA_ "GenSigTimeoutTime_DTCM" SG_ 1955 IBS3_SOH_Q_Accuracy 0;
BA_ "GenSigTimeoutTime_GNMM" SG_ 1955 IBS3_SOH_Q_Accuracy 0;
BA_ "GenSigTimeoutTime_HCP" SG_ 1955 IBS3_SOH_Q_Accuracy 0;
BA_ "GenSigTimeoutTime_IPC" SG_ 1955 IBS3_SOH_Q_Accuracy 0;
BA_ "GenSigTimeoutTime_RFHM" SG_ 1955 IBS3_SOH_Q_Accuracy 0;
BA_ "GenSigTimeoutTime_SGW" SG_ 1955 IBS3_SOH_Q_Accuracy 0;
BA_ "GenSigTimeoutTime_TCM" SG_ 1955 IBS3_SOH_Q_Accuracy 0;
BA_ "GenSigStartValue" SG_ 1955 IBS3_SOH_SUL 127;
BA_ "GenSigTimeoutTime_AGSM" SG_ 1955 IBS3_SOH_SUL 0;
BA_ "GenSigTimeoutTime_BCM" SG_ 1955 IBS3_SOH_SUL 0;
BA_ "GenSigTimeoutTime_BSM" SG_ 1955 IBS3_SOH_SUL 0;
BA_ "GenSigTimeoutTime_CADM" SG_ 1955 IBS3_SOH_SUL 0;
BA_ "GenSigTimeoutTime_DMSM" SG_ 1955 IBS3_SOH_SUL 0;
BA_ "GenSigTimeoutTime_DTCM" SG_ 1955 IBS3_SOH_SUL 0;
BA_ "GenSigTimeoutTime_ECM" SG_ 1955 IBS3_SOH_SUL 0;
BA_ "GenSigTimeoutTime_GNMM" SG_ 1955 IBS3_SOH_SUL 0;
BA_ "GenSigTimeoutTime_HCP" SG_ 1955 IBS3_SOH_SUL 0;
BA_ "GenSigTimeoutTime_IPC" SG_ 1955 IBS3_SOH_SUL 0;
BA_ "GenSigTimeoutTime_RFHM" SG_ 1955 IBS3_SOH_SUL 0;
BA_ "GenSigTimeoutTime_SGW" SG_ 1955 IBS3_SOH_SUL 0;
BA_ "GenSigTimeoutTime_TCM" SG_ 1955 IBS3_SOH_SUL 0;
BA_ "GenSigTimeoutTime_AGSM" SG_ 1955 IBS3_SOH_SUL_Accuracy 0;
BA_ "GenSigTimeoutTime_BCM" SG_ 1955 IBS3_SOH_SUL_Accuracy 0;
BA_ "GenSigTimeoutTime_BSM" SG_ 1955 IBS3_SOH_SUL_Accuracy 0;
BA_ "GenSigTimeoutTime_CADM" SG_ 1955 IBS3_SOH_SUL_Accuracy 0;
BA_ "GenSigTimeoutTime_DMSM" SG_ 1955 IBS3_SOH_SUL_Accuracy 0;
BA_ "GenSigTimeoutTime_DTCM" SG_ 1955 IBS3_SOH_SUL_Accuracy 0;
BA_ "GenSigTimeoutTime_ECM" SG_ 1955 IBS3_SOH_SUL_Accuracy 0;
BA_ "GenSigTimeoutTime_GNMM" SG_ 1955 IBS3_SOH_SUL_Accuracy 0;
BA_ "GenSigTimeoutTime_HCP" SG_ 1955 IBS3_SOH_SUL_Accuracy 0;
BA_ "GenSigTimeoutTime_IPC" SG_ 1955 IBS3_SOH_SUL_Accuracy 0;
BA_ "GenSigTimeoutTime_RFHM" SG_ 1955 IBS3_SOH_SUL_Accuracy 0;
BA_ "GenSigTimeoutTime_SGW" SG_ 1955 IBS3_SOH_SUL_Accuracy 0;
BA_ "GenSigTimeoutTime_TCM" SG_ 1955 IBS3_SOH_SUL_Accuracy 0;
BA_ "GenSigStartValue" SG_ 1955 IBS3_T_BATT 255;
BA_ "GenSigTimeoutTime_AGSM" SG_ 1955 IBS3_T_BATT 0;
BA_ "GenSigTimeoutTime_BCM" SG_ 1955 IBS3_T_BATT 0;
BA_ "GenSigTimeoutTime_BSM" SG_ 1955 IBS3_T_BATT 0;
BA_ "GenSigTimeoutTime_CADM" SG_ 1955 IBS3_T_BATT 0;
BA_ "GenSigTimeoutTime_DMSM" SG_ 1955 IBS3_T_BATT 0;
BA_ "GenSigTimeoutTime_DTCM" SG_ 1955 IBS3_T_BATT 0;
BA_ "GenSigTimeoutTime_GNMM" SG_ 1955 IBS3_T_BATT 0;
BA_ "GenSigTimeoutTime_IPC" SG_ 1955 IBS3_T_BATT 0;
BA_ "GenSigTimeoutTime_RFHM" SG_ 1955 IBS3_T_BATT 0;
BA_ "GenSigTimeoutTime_TCM" SG_ 1955 IBS3_T_BATT 0;
BA_ "GenSigTimeoutTime_AGSM" SG_ 1955 IBS3_TempFailStatus 0;
BA_ "GenSigTimeoutTime_BCM" SG_ 1955 IBS3_TempFailStatus 0;
BA_ "GenSigTimeoutTime_BSM" SG_ 1955 IBS3_TempFailStatus 0;
BA_ "GenSigTimeoutTime_CADM" SG_ 1955 IBS3_TempFailStatus 0;
BA_ "GenSigTimeoutTime_DMSM" SG_ 1955 IBS3_TempFailStatus 0;
BA_ "GenSigTimeoutTime_DTCM" SG_ 1955 IBS3_TempFailStatus 0;
BA_ "GenSigTimeoutTime_GNMM" SG_ 1955 IBS3_TempFailStatus 0;
BA_ "GenSigTimeoutTime_IPC" SG_ 1955 IBS3_TempFailStatus 0;
BA_ "GenSigTimeoutTime_RFHM" SG_ 1955 IBS3_TempFailStatus 0;
BA_ "GenSigTimeoutTime_TCM" SG_ 1955 IBS3_TempFailStatus 0;
BA_ "GenSigTimeoutTime_AGSM" SG_ 1955 IBS3_Tm_Lst_Reset_Days 0;
BA_ "GenSigTimeoutTime_BCM" SG_ 1955 IBS3_Tm_Lst_Reset_Days 0;
BA_ "GenSigTimeoutTime_BSM" SG_ 1955 IBS3_Tm_Lst_Reset_Days 0;
BA_ "GenSigTimeoutTime_CADM" SG_ 1955 IBS3_Tm_Lst_Reset_Days 0;
BA_ "GenSigTimeoutTime_DMSM" SG_ 1955 IBS3_Tm_Lst_Reset_Days 0;
BA_ "GenSigTimeoutTime_DTCM" SG_ 1955 IBS3_Tm_Lst_Reset_Days 0;
BA_ "GenSigTimeoutTime_ECM" SG_ 1955 IBS3_Tm_Lst_Reset_Days 0;
BA_ "GenSigTimeoutTime_GNMM" SG_ 1955 IBS3_Tm_Lst_Reset_Days 0;
BA_ "GenSigTimeoutTime_HCP" SG_ 1955 IBS3_Tm_Lst_Reset_Days 0;
BA_ "GenSigTimeoutTime_IPC" SG_ 1955 IBS3_Tm_Lst_Reset_Days 0;
BA_ "GenSigTimeoutTime_RFHM" SG_ 1955 IBS3_Tm_Lst_Reset_Days 0;
BA_ "GenSigTimeoutTime_SGW" SG_ 1955 IBS3_Tm_Lst_Reset_Days 0;
BA_ "GenSigTimeoutTime_TCM" SG_ 1955 IBS3_Tm_Lst_Reset_Days 0;
BA_ "GenSigTimeoutTime_AGSM" SG_ 1955 IBS3_Tm_Lst_Reset_Sec 0;
BA_ "GenSigTimeoutTime_BCM" SG_ 1955 IBS3_Tm_Lst_Reset_Sec 0;
BA_ "GenSigTimeoutTime_BSM" SG_ 1955 IBS3_Tm_Lst_Reset_Sec 0;
BA_ "GenSigTimeoutTime_CADM" SG_ 1955 IBS3_Tm_Lst_Reset_Sec 0;
BA_ "GenSigTimeoutTime_DMSM" SG_ 1955 IBS3_Tm_Lst_Reset_Sec 0;
BA_ "GenSigTimeoutTime_DTCM" SG_ 1955 IBS3_Tm_Lst_Reset_Sec 0;
BA_ "GenSigTimeoutTime_ECM" SG_ 1955 IBS3_Tm_Lst_Reset_Sec 0;
BA_ "GenSigTimeoutTime_GNMM" SG_ 1955 IBS3_Tm_Lst_Reset_Sec 0;
BA_ "GenSigTimeoutTime_HCP" SG_ 1955 IBS3_Tm_Lst_Reset_Sec 0;
BA_ "GenSigTimeoutTime_IPC" SG_ 1955 IBS3_Tm_Lst_Reset_Sec 0;
BA_ "GenSigTimeoutTime_RFHM" SG_ 1955 IBS3_Tm_Lst_Reset_Sec 0;
BA_ "GenSigTimeoutTime_SGW" SG_ 1955 IBS3_Tm_Lst_Reset_Sec 0;
BA_ "GenSigTimeoutTime_TCM" SG_ 1955 IBS3_Tm_Lst_Reset_Sec 0;
BA_ "GenSigTimeoutTime_AGSM" SG_ 1955 MessageCounter_IBS3DATA2 0;
BA_ "GenSigTimeoutTime_BCM" SG_ 1955 MessageCounter_IBS3DATA2 0;
BA_ "GenSigTimeoutTime_BSM" SG_ 1955 MessageCounter_IBS3DATA2 0;
BA_ "GenSigTimeoutTime_CADM" SG_ 1955 MessageCounter_IBS3DATA2 0;
BA_ "GenSigTimeoutTime_DMSM" SG_ 1955 MessageCounter_IBS3DATA2 0;
BA_ "GenSigTimeoutTime_DTCM" SG_ 1955 MessageCounter_IBS3DATA2 0;
BA_ "GenSigTimeoutTime_ECM" SG_ 1955 MessageCounter_IBS3DATA2 0;
BA_ "GenSigTimeoutTime_GNMM" SG_ 1955 MessageCounter_IBS3DATA2 0;
BA_ "GenSigTimeoutTime_HCP" SG_ 1955 MessageCounter_IBS3DATA2 0;
BA_ "GenSigTimeoutTime_IPC" SG_ 1955 MessageCounter_IBS3DATA2 0;
BA_ "GenSigTimeoutTime_RFHM" SG_ 1955 MessageCounter_IBS3DATA2 0;
BA_ "GenSigTimeoutTime_SGW" SG_ 1955 MessageCounter_IBS3DATA2 0;
BA_ "GenSigTimeoutTime_TCM" SG_ 1955 MessageCounter_IBS3DATA2 0;
BA_ "GenSigSendType" SG_ 100 ControlEncodingReq 1;
BA_ "GenSigTimeoutTime_AGSM" SG_ 100 ControlEncodingReq 0;
BA_ "GenSigTimeoutTime_BSM" SG_ 100 ControlEncodingReq 0;
BA_ "GenSigTimeoutTime_CADM" SG_ 100 ControlEncodingReq 0;
BA_ "GenSigTimeoutTime_DMSM" SG_ 100 ControlEncodingReq 0;
BA_ "GenSigTimeoutTime_DTCM" SG_ 100 ControlEncodingReq 0;
BA_ "GenSigTimeoutTime_ECM" SG_ 100 ControlEncodingReq 0;
BA_ "GenSigTimeoutTime_EVCU2" SG_ 100 ControlEncodingReq 0;
BA_ "GenSigTimeoutTime_GNMM" SG_ 100 ControlEncodingReq 0;
BA_ "GenSigTimeoutTime_HCP" SG_ 100 ControlEncodingReq 0;
BA_ "GenSigTimeoutTime_IPC" SG_ 100 ControlEncodingReq 0;
BA_ "GenSigTimeoutTime_RFHM" SG_ 100 ControlEncodingReq 0;
BA_ "GenSigTimeoutTime_SGW" SG_ 100 ControlEncodingReq 0;
BA_ "GenSigTimeoutTime_TCM" SG_ 100 ControlEncodingReq 0;
BA_ "GenSigTimeoutTime_AGSM" SG_ 100 f1_1 0;
BA_ "GenSigTimeoutTime_BSM" SG_ 100 f1_1 0;
BA_ "GenSigTimeoutTime_CADM" SG_ 100 f1_1 0;
BA_ "GenSigTimeoutTime_DMSM" SG_ 100 f1_1 0;
BA_ "GenSigTimeoutTime_DTCM" SG_ 100 f1_1 0;
BA_ "GenSigTimeoutTime_ECM" SG_ 100 f1_1 0;
BA_ "GenSigTimeoutTime_EVCU2" SG_ 100 f1_1 0;
BA_ "GenSigTimeoutTime_GNMM" SG_ 100 f1_1 0;
BA_ "GenSigTimeoutTime_HCP" SG_ 100 f1_1 0;
BA_ "GenSigTimeoutTime_IPC" SG_ 100 f1_1 0;
BA_ "GenSigTimeoutTime_RFHM" SG_ 100 f1_1 0;
BA_ "GenSigTimeoutTime_SGW" SG_ 100 f1_1 0;
BA_ "GenSigTimeoutTime_TCM" SG_ 100 f1_1 0;
BA_ "GenSigTimeoutTime_AGSM" SG_ 100 f1_2 0;
BA_ "GenSigTimeoutTime_BSM" SG_ 100 f1_2 0;
BA_ "GenSigTimeoutTime_CADM" SG_ 100 f1_2 0;
BA_ "GenSigTimeoutTime_DMSM" SG_ 100 f1_2 0;
BA_ "GenSigTimeoutTime_DTCM" SG_ 100 f1_2 0;
BA_ "GenSigTimeoutTime_ECM" SG_ 100 f1_2 0;
BA_ "GenSigTimeoutTime_EVCU2" SG_ 100 f1_2 0;
BA_ "GenSigTimeoutTime_GNMM" SG_ 100 f1_2 0;
BA_ "GenSigTimeoutTime_HCP" SG_ 100 f1_2 0;
BA_ "GenSigTimeoutTime_IPC" SG_ 100 f1_2 0;
BA_ "GenSigTimeoutTime_RFHM" SG_ 100 f1_2 0;
BA_ "GenSigTimeoutTime_SGW" SG_ 100 f1_2 0;
BA_ "GenSigTimeoutTime_TCM" SG_ 100 f1_2 0;
BA_ "GenSigTimeoutTime_AGSM" SG_ 100 rnd_1 0;
BA_ "GenSigTimeoutTime_BSM" SG_ 100 rnd_1 0;
BA_ "GenSigTimeoutTime_CADM" SG_ 100 rnd_1 0;
BA_ "GenSigTimeoutTime_DMSM" SG_ 100 rnd_1 0;
BA_ "GenSigTimeoutTime_DTCM" SG_ 100 rnd_1 0;
BA_ "GenSigTimeoutTime_ECM" SG_ 100 rnd_1 0;
BA_ "GenSigTimeoutTime_EVCU2" SG_ 100 rnd_1 0;
BA_ "GenSigTimeoutTime_GNMM" SG_ 100 rnd_1 0;
BA_ "GenSigTimeoutTime_HCP" SG_ 100 rnd_1 0;
BA_ "GenSigTimeoutTime_IPC" SG_ 100 rnd_1 0;
BA_ "GenSigTimeoutTime_RFHM" SG_ 100 rnd_1 0;
BA_ "GenSigTimeoutTime_SGW" SG_ 100 rnd_1 0;
BA_ "GenSigTimeoutTime_TCM" SG_ 100 rnd_1 0;
BA_ "GenSigTimeoutTime_AGSM" SG_ 100 rnd_2 0;
BA_ "GenSigTimeoutTime_BSM" SG_ 100 rnd_2 0;
BA_ "GenSigTimeoutTime_CADM" SG_ 100 rnd_2 0;
BA_ "GenSigTimeoutTime_DMSM" SG_ 100 rnd_2 0;
BA_ "GenSigTimeoutTime_DTCM" SG_ 100 rnd_2 0;
BA_ "GenSigTimeoutTime_ECM" SG_ 100 rnd_2 0;
BA_ "GenSigTimeoutTime_EVCU2" SG_ 100 rnd_2 0;
BA_ "GenSigTimeoutTime_GNMM" SG_ 100 rnd_2 0;
BA_ "GenSigTimeoutTime_HCP" SG_ 100 rnd_2 0;
BA_ "GenSigTimeoutTime_IPC" SG_ 100 rnd_2 0;
BA_ "GenSigTimeoutTime_RFHM" SG_ 100 rnd_2 0;
BA_ "GenSigTimeoutTime_SGW" SG_ 100 rnd_2 0;
BA_ "GenSigTimeoutTime_TCM" SG_ 100 rnd_2 0;
BA_ "GenSigTimeoutTime_AGSM" SG_ 100 rnd_3 0;
BA_ "GenSigTimeoutTime_BSM" SG_ 100 rnd_3 0;
BA_ "GenSigTimeoutTime_CADM" SG_ 100 rnd_3 0;
BA_ "GenSigTimeoutTime_DMSM" SG_ 100 rnd_3 0;
BA_ "GenSigTimeoutTime_DTCM" SG_ 100 rnd_3 0;
BA_ "GenSigTimeoutTime_ECM" SG_ 100 rnd_3 0;
BA_ "GenSigTimeoutTime_EVCU2" SG_ 100 rnd_3 0;
BA_ "GenSigTimeoutTime_GNMM" SG_ 100 rnd_3 0;
BA_ "GenSigTimeoutTime_HCP" SG_ 100 rnd_3 0;
BA_ "GenSigTimeoutTime_IPC" SG_ 100 rnd_3 0;
BA_ "GenSigTimeoutTime_RFHM" SG_ 100 rnd_3 0;
BA_ "GenSigTimeoutTime_SGW" SG_ 100 rnd_3 0;
BA_ "GenSigTimeoutTime_TCM" SG_ 100 rnd_3 0;
BA_ "GenSigTimeoutTime_AGSM" SG_ 100 rnd_4 0;
BA_ "GenSigTimeoutTime_BSM" SG_ 100 rnd_4 0;
BA_ "GenSigTimeoutTime_CADM" SG_ 100 rnd_4 0;
BA_ "GenSigTimeoutTime_DMSM" SG_ 100 rnd_4 0;
BA_ "GenSigTimeoutTime_DTCM" SG_ 100 rnd_4 0;
BA_ "GenSigTimeoutTime_ECM" SG_ 100 rnd_4 0;
BA_ "GenSigTimeoutTime_EVCU2" SG_ 100 rnd_4 0;
BA_ "GenSigTimeoutTime_GNMM" SG_ 100 rnd_4 0;
BA_ "GenSigTimeoutTime_HCP" SG_ 100 rnd_4 0;
BA_ "GenSigTimeoutTime_IPC" SG_ 100 rnd_4 0;
BA_ "GenSigTimeoutTime_RFHM" SG_ 100 rnd_4 0;
BA_ "GenSigTimeoutTime_SGW" SG_ 100 rnd_4 0;
BA_ "GenSigTimeoutTime_TCM" SG_ 100 rnd_4 0;
BA_ "GenSigSendType" SG_ 104 ControlEncodingRsp 1;
BA_ "GenSigTimeoutTime_AGSM" SG_ 104 ControlEncodingRsp 0;
BA_ "GenSigTimeoutTime_BCM" SG_ 104 ControlEncodingRsp 0;
BA_ "GenSigTimeoutTime_BSM" SG_ 104 ControlEncodingRsp 0;
BA_ "GenSigTimeoutTime_CADM" SG_ 104 ControlEncodingRsp 0;
BA_ "GenSigTimeoutTime_DMSM" SG_ 104 ControlEncodingRsp 0;
BA_ "GenSigTimeoutTime_DTCM" SG_ 104 ControlEncodingRsp 0;
BA_ "GenSigTimeoutTime_GNMM" SG_ 104 ControlEncodingRsp 0;
BA_ "GenSigTimeoutTime_HCP" SG_ 104 ControlEncodingRsp 0;
BA_ "GenSigTimeoutTime_IPC" SG_ 104 ControlEncodingRsp 0;
BA_ "GenSigTimeoutTime_RFHM" SG_ 104 ControlEncodingRsp 0;
BA_ "GenSigTimeoutTime_SGW" SG_ 104 ControlEncodingRsp 0;
BA_ "GenSigTimeoutTime_TCM" SG_ 104 ControlEncodingRsp 0;
BA_ "GenSigTimeoutTime_AGSM" SG_ 104 ImmoParkReq 0;
BA_ "GenSigTimeoutTime_BCM" SG_ 104 ImmoParkReq 0;
BA_ "GenSigTimeoutTime_BSM" SG_ 104 ImmoParkReq 0;
BA_ "GenSigTimeoutTime_CADM" SG_ 104 ImmoParkReq 0;
BA_ "GenSigTimeoutTime_DMSM" SG_ 104 ImmoParkReq 0;
BA_ "GenSigTimeoutTime_DTCM" SG_ 104 ImmoParkReq 0;
BA_ "GenSigTimeoutTime_ECM" SG_ 104 ImmoParkReq 0;
BA_ "GenSigTimeoutTime_GNMM" SG_ 104 ImmoParkReq 0;
BA_ "GenSigTimeoutTime_HCP" SG_ 104 ImmoParkReq 0;
BA_ "GenSigTimeoutTime_IPC" SG_ 104 ImmoParkReq 0;
BA_ "GenSigTimeoutTime_RFHM" SG_ 104 ImmoParkReq 0;
BA_ "GenSigTimeoutTime_SGW" SG_ 104 ImmoParkReq 0;
BA_ "GenSigTimeoutTime_TCM" SG_ 104 ImmoParkReq 0;
BA_ "GenSigTimeoutTime_AGSM" SG_ 104 MKKey_3 0;
BA_ "GenSigTimeoutTime_BCM" SG_ 104 MKKey_3 0;
BA_ "GenSigTimeoutTime_BSM" SG_ 104 MKKey_3 0;
BA_ "GenSigTimeoutTime_CADM" SG_ 104 MKKey_3 0;
BA_ "GenSigTimeoutTime_DMSM" SG_ 104 MKKey_3 0;
BA_ "GenSigTimeoutTime_DTCM" SG_ 104 MKKey_3 0;
BA_ "GenSigTimeoutTime_GNMM" SG_ 104 MKKey_3 0;
BA_ "GenSigTimeoutTime_HCP" SG_ 104 MKKey_3 0;
BA_ "GenSigTimeoutTime_IPC" SG_ 104 MKKey_3 0;
BA_ "GenSigTimeoutTime_RFHM" SG_ 104 MKKey_3 0;
BA_ "GenSigTimeoutTime_SGW" SG_ 104 MKKey_3 0;
BA_ "GenSigTimeoutTime_TCM" SG_ 104 MKKey_3 0;
BA_ "GenSigTimeoutTime_AGSM" SG_ 104 MKKey_4 0;
BA_ "GenSigTimeoutTime_BCM" SG_ 104 MKKey_4 0;
BA_ "GenSigTimeoutTime_BSM" SG_ 104 MKKey_4 0;
BA_ "GenSigTimeoutTime_CADM" SG_ 104 MKKey_4 0;
BA_ "GenSigTimeoutTime_DMSM" SG_ 104 MKKey_4 0;
BA_ "GenSigTimeoutTime_DTCM" SG_ 104 MKKey_4 0;
BA_ "GenSigTimeoutTime_GNMM" SG_ 104 MKKey_4 0;
BA_ "GenSigTimeoutTime_HCP" SG_ 104 MKKey_4 0;
BA_ "GenSigTimeoutTime_IPC" SG_ 104 MKKey_4 0;
BA_ "GenSigTimeoutTime_RFHM" SG_ 104 MKKey_4 0;
BA_ "GenSigTimeoutTime_SGW" SG_ 104 MKKey_4 0;
BA_ "GenSigTimeoutTime_TCM" SG_ 104 MKKey_4 0;
BA_ "GenSigTimeoutTime_AGSM" SG_ 104 MKKey_5 0;
BA_ "GenSigTimeoutTime_BCM" SG_ 104 MKKey_5 0;
BA_ "GenSigTimeoutTime_BSM" SG_ 104 MKKey_5 0;
BA_ "GenSigTimeoutTime_CADM" SG_ 104 MKKey_5 0;
BA_ "GenSigTimeoutTime_DMSM" SG_ 104 MKKey_5 0;
BA_ "GenSigTimeoutTime_DTCM" SG_ 104 MKKey_5 0;
BA_ "GenSigTimeoutTime_GNMM" SG_ 104 MKKey_5 0;
BA_ "GenSigTimeoutTime_HCP" SG_ 104 MKKey_5 0;
BA_ "GenSigTimeoutTime_IPC" SG_ 104 MKKey_5 0;
BA_ "GenSigTimeoutTime_RFHM" SG_ 104 MKKey_5 0;
BA_ "GenSigTimeoutTime_SGW" SG_ 104 MKKey_5 0;
BA_ "GenSigTimeoutTime_TCM" SG_ 104 MKKey_5 0;
BA_ "GenSigTimeoutTime_AGSM" SG_ 104 MKKey_6 0;
BA_ "GenSigTimeoutTime_BCM" SG_ 104 MKKey_6 0;
BA_ "GenSigTimeoutTime_BSM" SG_ 104 MKKey_6 0;
BA_ "GenSigTimeoutTime_CADM" SG_ 104 MKKey_6 0;
BA_ "GenSigTimeoutTime_DMSM" SG_ 104 MKKey_6 0;
BA_ "GenSigTimeoutTime_DTCM" SG_ 104 MKKey_6 0;
BA_ "GenSigTimeoutTime_GNMM" SG_ 104 MKKey_6 0;
BA_ "GenSigTimeoutTime_HCP" SG_ 104 MKKey_6 0;
BA_ "GenSigTimeoutTime_IPC" SG_ 104 MKKey_6 0;
BA_ "GenSigTimeoutTime_RFHM" SG_ 104 MKKey_6 0;
BA_ "GenSigTimeoutTime_SGW" SG_ 104 MKKey_6 0;
BA_ "GenSigTimeoutTime_TCM" SG_ 104 MKKey_6 0;
BA_ "GenSigTimeoutTime_AGSM" SG_ 104 MKKey1org21 0;
BA_ "GenSigTimeoutTime_BCM" SG_ 104 MKKey1org21 0;
BA_ "GenSigTimeoutTime_BSM" SG_ 104 MKKey1org21 0;
BA_ "GenSigTimeoutTime_CADM" SG_ 104 MKKey1org21 0;
BA_ "GenSigTimeoutTime_DMSM" SG_ 104 MKKey1org21 0;
BA_ "GenSigTimeoutTime_DTCM" SG_ 104 MKKey1org21 0;
BA_ "GenSigTimeoutTime_GNMM" SG_ 104 MKKey1org21 0;
BA_ "GenSigTimeoutTime_HCP" SG_ 104 MKKey1org21 0;
BA_ "GenSigTimeoutTime_IPC" SG_ 104 MKKey1org21 0;
BA_ "GenSigTimeoutTime_RFHM" SG_ 104 MKKey1org21 0;
BA_ "GenSigTimeoutTime_SGW" SG_ 104 MKKey1org21 0;
BA_ "GenSigTimeoutTime_TCM" SG_ 104 MKKey1org21 0;
BA_ "GenSigTimeoutTime_AGSM" SG_ 104 MKKey2org22 0;
BA_ "GenSigTimeoutTime_BCM" SG_ 104 MKKey2org22 0;
BA_ "GenSigTimeoutTime_BSM" SG_ 104 MKKey2org22 0;
BA_ "GenSigTimeoutTime_CADM" SG_ 104 MKKey2org22 0;
BA_ "GenSigTimeoutTime_DMSM" SG_ 104 MKKey2org22 0;
BA_ "GenSigTimeoutTime_DTCM" SG_ 104 MKKey2org22 0;
BA_ "GenSigTimeoutTime_GNMM" SG_ 104 MKKey2org22 0;
BA_ "GenSigTimeoutTime_HCP" SG_ 104 MKKey2org22 0;
BA_ "GenSigTimeoutTime_IPC" SG_ 104 MKKey2org22 0;
BA_ "GenSigTimeoutTime_RFHM" SG_ 104 MKKey2org22 0;
BA_ "GenSigTimeoutTime_SGW" SG_ 104 MKKey2org22 0;
BA_ "GenSigTimeoutTime_TCM" SG_ 104 MKKey2org22 0;
BA_ "GenSigTimeoutTime_AGSM" SG_ 1626 CRC_IMPACTINFO 0;
BA_ "GenSigTimeoutTime_BCM" SG_ 1626 CRC_IMPACTINFO 0;
BA_ "GenSigTimeoutTime_BSM" SG_ 1626 CRC_IMPACTINFO 0;
BA_ "GenSigTimeoutTime_CADM" SG_ 1626 CRC_IMPACTINFO 0;
BA_ "GenSigTimeoutTime_DTCM" SG_ 1626 CRC_IMPACTINFO 0;
BA_ "GenSigTimeoutTime_ECM" SG_ 1626 CRC_IMPACTINFO 0;
BA_ "GenSigTimeoutTime_GNMM" SG_ 1626 CRC_IMPACTINFO 0;
BA_ "GenSigTimeoutTime_IPC" SG_ 1626 CRC_IMPACTINFO 0;
BA_ "GenSigTimeoutTime_RFHM" SG_ 1626 CRC_IMPACTINFO 0;
BA_ "GenSigTimeoutTime_SGW" SG_ 1626 CRC_IMPACTINFO 0;
BA_ "GenSigTimeoutTime_TCM" SG_ 1626 CRC_IMPACTINFO 0;
BA_ "GenSigSendType" SG_ 1626 IMPACTCommand 5;
BA_ "GenSigTimeoutTime_AGSM" SG_ 1626 IMPACTCommand 0;
BA_ "GenSigTimeoutTime_BCM" SG_ 1626 IMPACTCommand 0;
BA_ "GenSigTimeoutTime_BSM" SG_ 1626 IMPACTCommand 0;
BA_ "GenSigTimeoutTime_CADM" SG_ 1626 IMPACTCommand 0;
BA_ "GenSigTimeoutTime_DTCM" SG_ 1626 IMPACTCommand 0;
BA_ "GenSigTimeoutTime_GNMM" SG_ 1626 IMPACTCommand 0;
BA_ "GenSigTimeoutTime_HCP" SG_ 1626 IMPACTCommand 0;
BA_ "GenSigTimeoutTime_IPC" SG_ 1626 IMPACTCommand 0;
BA_ "GenSigTimeoutTime_RFHM" SG_ 1626 IMPACTCommand 0;
BA_ "GenSigTimeoutTime_SGW" SG_ 1626 IMPACTCommand 0;
BA_ "GenSigTimeoutTime_TCM" SG_ 1626 IMPACTCommand 0;
BA_ "GenSigStartValue" SG_ 1626 IMPACTConfirm 1;
BA_ "GenSigInactiveValue" SG_ 1626 IMPACTConfirm 1;
BA_ "GenSigSendType" SG_ 1626 IMPACTConfirm 5;
BA_ "GenSigTimeoutTime_AGSM" SG_ 1626 IMPACTConfirm 0;
BA_ "GenSigTimeoutTime_BCM" SG_ 1626 IMPACTConfirm 0;
BA_ "GenSigTimeoutTime_BSM" SG_ 1626 IMPACTConfirm 0;
BA_ "GenSigTimeoutTime_CADM" SG_ 1626 IMPACTConfirm 0;
BA_ "GenSigTimeoutTime_DTCM" SG_ 1626 IMPACTConfirm 0;
BA_ "GenSigTimeoutTime_GNMM" SG_ 1626 IMPACTConfirm 0;
BA_ "GenSigTimeoutTime_HCP" SG_ 1626 IMPACTConfirm 0;
BA_ "GenSigTimeoutTime_IPC" SG_ 1626 IMPACTConfirm 0;
BA_ "GenSigTimeoutTime_RFHM" SG_ 1626 IMPACTConfirm 0;
BA_ "GenSigTimeoutTime_SGW" SG_ 1626 IMPACTConfirm 0;
BA_ "GenSigTimeoutTime_TCM" SG_ 1626 IMPACTConfirm 0;
BA_ "GenSigTimeoutTime_AGSM" SG_ 1626 IMPACTThreshold 0;
BA_ "GenSigTimeoutTime_BCM" SG_ 1626 IMPACTThreshold 0;
BA_ "GenSigTimeoutTime_BSM" SG_ 1626 IMPACTThreshold 0;
BA_ "GenSigTimeoutTime_CADM" SG_ 1626 IMPACTThreshold 0;
BA_ "GenSigTimeoutTime_DMSM" SG_ 1626 IMPACTThreshold 0;
BA_ "GenSigTimeoutTime_DTCM" SG_ 1626 IMPACTThreshold 0;
BA_ "GenSigTimeoutTime_EVCU2" SG_ 1626 IMPACTThreshold 0;
BA_ "GenSigTimeoutTime_GNMM" SG_ 1626 IMPACTThreshold 0;
BA_ "GenSigTimeoutTime_HCP" SG_ 1626 IMPACTThreshold 0;
BA_ "GenSigTimeoutTime_IPC" SG_ 1626 IMPACTThreshold 0;
BA_ "GenSigTimeoutTime_RFHM" SG_ 1626 IMPACTThreshold 0;
BA_ "GenSigTimeoutTime_SGW" SG_ 1626 IMPACTThreshold 0;
BA_ "GenSigTimeoutTime_TCM" SG_ 1626 IMPACTThreshold 0;
BA_ "GenSigTimeoutTime_AGSM" SG_ 1626 MessageCounter_IMPACTINFO 0;
BA_ "GenSigTimeoutTime_BCM" SG_ 1626 MessageCounter_IMPACTINFO 0;
BA_ "GenSigTimeoutTime_BSM" SG_ 1626 MessageCounter_IMPACTINFO 0;
BA_ "GenSigTimeoutTime_CADM" SG_ 1626 MessageCounter_IMPACTINFO 0;
BA_ "GenSigTimeoutTime_DTCM" SG_ 1626 MessageCounter_IMPACTINFO 0;
BA_ "GenSigTimeoutTime_ECM" SG_ 1626 MessageCounter_IMPACTINFO 0;
BA_ "GenSigTimeoutTime_GNMM" SG_ 1626 MessageCounter_IMPACTINFO 0;
BA_ "GenSigTimeoutTime_IPC" SG_ 1626 MessageCounter_IMPACTINFO 0;
BA_ "GenSigTimeoutTime_RFHM" SG_ 1626 MessageCounter_IMPACTINFO 0;
BA_ "GenSigTimeoutTime_SGW" SG_ 1626 MessageCounter_IMPACTINFO 0;
BA_ "GenSigTimeoutTime_TCM" SG_ 1626 MessageCounter_IMPACTINFO 0;
BA_ "GenSigTimeoutTime_AGSM" SG_ 1829 CRC_IPC1 0;
BA_ "GenSigTimeoutTime_DTCM" SG_ 1829 CRC_IPC1 0;
BA_ "GenSigTimeoutTime_EVCU2" SG_ 1829 CRC_IPC1 0;
BA_ "GenSigTimeoutTime_GNMM" SG_ 1829 CRC_IPC1 0;
BA_ "GenSigTimeoutTime_HCP" SG_ 1829 CRC_IPC1 0;
BA_ "GenSigTimeoutTime_IPC" SG_ 1829 CRC_IPC1 0;
BA_ "GenSigTimeoutTime_RFHM" SG_ 1829 CRC_IPC1 0;
BA_ "GenSigTimeoutTime_SGW" SG_ 1829 CRC_IPC1 0;
BA_ "GenSigTimeoutTime_TCM" SG_ 1829 CRC_IPC1 0;
BA_ "GenSigTimeoutTime_AGSM" SG_ 1829 InstantaneousFuelConsumption1 0;
BA_ "GenSigTimeoutTime_BCM" SG_ 1829 InstantaneousFuelConsumption1 0;
BA_ "GenSigTimeoutTime_BSM" SG_ 1829 InstantaneousFuelConsumption1 0;
BA_ "GenSigTimeoutTime_CADM" SG_ 1829 InstantaneousFuelConsumption1 0;
BA_ "GenSigTimeoutTime_DMSM" SG_ 1829 InstantaneousFuelConsumption1 0;
BA_ "GenSigTimeoutTime_DTCM" SG_ 1829 InstantaneousFuelConsumption1 0;
BA_ "GenSigTimeoutTime_ECM" SG_ 1829 InstantaneousFuelConsumption1 0;
BA_ "GenSigTimeoutTime_EVCU2" SG_ 1829 InstantaneousFuelConsumption1 0;
BA_ "GenSigTimeoutTime_GNMM" SG_ 1829 InstantaneousFuelConsumption1 0;
BA_ "GenSigTimeoutTime_HCP" SG_ 1829 InstantaneousFuelConsumption1 0;
BA_ "GenSigTimeoutTime_IPC" SG_ 1829 InstantaneousFuelConsumption1 0;
BA_ "GenSigTimeoutTime_RFHM" SG_ 1829 InstantaneousFuelConsumption1 0;
BA_ "GenSigTimeoutTime_TCM" SG_ 1829 InstantaneousFuelConsumption1 0;
BA_ "GenSigTimeoutTime_AGSM" SG_ 1829 InstantaneousFuelConsumption2 0;
BA_ "GenSigTimeoutTime_BCM" SG_ 1829 InstantaneousFuelConsumption2 0;
BA_ "GenSigTimeoutTime_BSM" SG_ 1829 InstantaneousFuelConsumption2 0;
BA_ "GenSigTimeoutTime_CADM" SG_ 1829 InstantaneousFuelConsumption2 0;
BA_ "GenSigTimeoutTime_DMSM" SG_ 1829 InstantaneousFuelConsumption2 0;
BA_ "GenSigTimeoutTime_DTCM" SG_ 1829 InstantaneousFuelConsumption2 0;
BA_ "GenSigTimeoutTime_ECM" SG_ 1829 InstantaneousFuelConsumption2 0;
BA_ "GenSigTimeoutTime_EVCU2" SG_ 1829 InstantaneousFuelConsumption2 0;
BA_ "GenSigTimeoutTime_GNMM" SG_ 1829 InstantaneousFuelConsumption2 0;
BA_ "GenSigTimeoutTime_HCP" SG_ 1829 InstantaneousFuelConsumption2 0;
BA_ "GenSigTimeoutTime_IPC" SG_ 1829 InstantaneousFuelConsumption2 0;
BA_ "GenSigTimeoutTime_RFHM" SG_ 1829 InstantaneousFuelConsumption2 0;
BA_ "GenSigTimeoutTime_TCM" SG_ 1829 InstantaneousFuelConsumption2 0;
BA_ "GenSigTimeoutTime_AGSM" SG_ 1829 InstantaneousFuelConsumption3 0;
BA_ "GenSigTimeoutTime_BCM" SG_ 1829 InstantaneousFuelConsumption3 0;
BA_ "GenSigTimeoutTime_BSM" SG_ 1829 InstantaneousFuelConsumption3 0;
BA_ "GenSigTimeoutTime_CADM" SG_ 1829 InstantaneousFuelConsumption3 0;
BA_ "GenSigTimeoutTime_DMSM" SG_ 1829 InstantaneousFuelConsumption3 0;
BA_ "GenSigTimeoutTime_DTCM" SG_ 1829 InstantaneousFuelConsumption3 0;
BA_ "GenSigTimeoutTime_ECM" SG_ 1829 InstantaneousFuelConsumption3 0;
BA_ "GenSigTimeoutTime_EVCU2" SG_ 1829 InstantaneousFuelConsumption3 0;
BA_ "GenSigTimeoutTime_GNMM" SG_ 1829 InstantaneousFuelConsumption3 0;
BA_ "GenSigTimeoutTime_HCP" SG_ 1829 InstantaneousFuelConsumption3 0;
BA_ "GenSigTimeoutTime_IPC" SG_ 1829 InstantaneousFuelConsumption3 0;
BA_ "GenSigTimeoutTime_RFHM" SG_ 1829 InstantaneousFuelConsumption3 0;
BA_ "GenSigTimeoutTime_TCM" SG_ 1829 InstantaneousFuelConsumption3 0;
BA_ "GenSigTimeoutTime_AGSM" SG_ 1829 MessageCounter_IPC1 0;
BA_ "GenSigTimeoutTime_DTCM" SG_ 1829 MessageCounter_IPC1 0;
BA_ "GenSigTimeoutTime_EVCU2" SG_ 1829 MessageCounter_IPC1 0;
BA_ "GenSigTimeoutTime_GNMM" SG_ 1829 MessageCounter_IPC1 0;
BA_ "GenSigTimeoutTime_HCP" SG_ 1829 MessageCounter_IPC1 0;
BA_ "GenSigTimeoutTime_IPC" SG_ 1829 MessageCounter_IPC1 0;
BA_ "GenSigTimeoutTime_RFHM" SG_ 1829 MessageCounter_IPC1 0;
BA_ "GenSigTimeoutTime_SGW" SG_ 1829 MessageCounter_IPC1 0;
BA_ "GenSigTimeoutTime_TCM" SG_ 1829 MessageCounter_IPC1 0;
BA_ "GenSigSendType" SG_ 1829 PCODE_CTRL 3;
BA_ "GenSigTimeoutTime_AGSM" SG_ 1829 PCODE_CTRL 0;
BA_ "GenSigTimeoutTime_BCM" SG_ 1829 PCODE_CTRL 0;
BA_ "GenSigTimeoutTime_BSM" SG_ 1829 PCODE_CTRL 0;
BA_ "GenSigTimeoutTime_CADM" SG_ 1829 PCODE_CTRL 0;
BA_ "GenSigTimeoutTime_DMSM" SG_ 1829 PCODE_CTRL 0;
BA_ "GenSigTimeoutTime_DTCM" SG_ 1829 PCODE_CTRL 0;
BA_ "GenSigTimeoutTime_EVCU2" SG_ 1829 PCODE_CTRL 0;
BA_ "GenSigTimeoutTime_GNMM" SG_ 1829 PCODE_CTRL 0;
BA_ "GenSigTimeoutTime_HCP" SG_ 1829 PCODE_CTRL 0;
BA_ "GenSigTimeoutTime_IPC" SG_ 1829 PCODE_CTRL 0;
BA_ "GenSigTimeoutTime_RFHM" SG_ 1829 PCODE_CTRL 0;
BA_ "GenSigTimeoutTime_SGW" SG_ 1829 PCODE_CTRL 0;
BA_ "GenSigTimeoutTime_TCM" SG_ 1829 PCODE_CTRL 0;
BA_ "GenSigTimeoutTime_IPC" SG_ 1829 TotalOdometer 0;
BA_ "GenSigSendType" SG_ 1829 Trailer_Trp_Rst 3;
BA_ "GenSigTimeoutTime_AGSM" SG_ 1829 Trailer_Trp_Rst 0;
BA_ "GenSigTimeoutTime_BSM" SG_ 1829 Trailer_Trp_Rst 0;
BA_ "GenSigTimeoutTime_CADM" SG_ 1829 Trailer_Trp_Rst 0;
BA_ "GenSigTimeoutTime_DMSM" SG_ 1829 Trailer_Trp_Rst 0;
BA_ "GenSigTimeoutTime_DTCM" SG_ 1829 Trailer_Trp_Rst 0;
BA_ "GenSigTimeoutTime_ECM" SG_ 1829 Trailer_Trp_Rst 0;
BA_ "GenSigTimeoutTime_EVCU2" SG_ 1829 Trailer_Trp_Rst 0;
BA_ "GenSigTimeoutTime_GNMM" SG_ 1829 Trailer_Trp_Rst 0;
BA_ "GenSigTimeoutTime_HCP" SG_ 1829 Trailer_Trp_Rst 0;
BA_ "GenSigTimeoutTime_IPC" SG_ 1829 Trailer_Trp_Rst 0;
BA_ "GenSigTimeoutTime_RFHM" SG_ 1829 Trailer_Trp_Rst 0;
BA_ "GenSigTimeoutTime_SGW" SG_ 1829 Trailer_Trp_Rst 0;
BA_ "GenSigTimeoutTime_TCM" SG_ 1829 Trailer_Trp_Rst 0;
BA_ "GenSigStartValue" SG_ 1441 DTE_Ave_Fuel_Econ 1023;
BA_ "GenSigSendType" SG_ 1441 DTE_Ave_Fuel_Econ 3;
BA_ "GenSigTimeoutTime_AGSM" SG_ 1441 DTE_Ave_Fuel_Econ 0;
BA_ "GenSigTimeoutTime_BCM" SG_ 1441 DTE_Ave_Fuel_Econ 0;
BA_ "GenSigTimeoutTime_BSM" SG_ 1441 DTE_Ave_Fuel_Econ 0;
BA_ "GenSigTimeoutTime_CADM" SG_ 1441 DTE_Ave_Fuel_Econ 0;
BA_ "GenSigTimeoutTime_DMSM" SG_ 1441 DTE_Ave_Fuel_Econ 0;
BA_ "GenSigTimeoutTime_DTCM" SG_ 1441 DTE_Ave_Fuel_Econ 0;
BA_ "GenSigTimeoutTime_ECM" SG_ 1441 DTE_Ave_Fuel_Econ 0;
BA_ "GenSigTimeoutTime_EVCU2" SG_ 1441 DTE_Ave_Fuel_Econ 0;
BA_ "GenSigTimeoutTime_GNMM" SG_ 1441 DTE_Ave_Fuel_Econ 0;
BA_ "GenSigTimeoutTime_HCP" SG_ 1441 DTE_Ave_Fuel_Econ 0;
BA_ "GenSigTimeoutTime_IPC" SG_ 1441 DTE_Ave_Fuel_Econ 0;
BA_ "GenSigTimeoutTime_RFHM" SG_ 1441 DTE_Ave_Fuel_Econ 0;
BA_ "GenSigTimeoutTime_SGW" SG_ 1441 DTE_Ave_Fuel_Econ 0;
BA_ "GenSigTimeoutTime_TCM" SG_ 1441 DTE_Ave_Fuel_Econ 0;
BA_ "GenSigTimeoutTime_AGSM" SG_ 1455 A_EV_Kilometers 0;
BA_ "GenSigTimeoutTime_BCM" SG_ 1455 A_EV_Kilometers 0;
BA_ "GenSigTimeoutTime_BSM" SG_ 1455 A_EV_Kilometers 0;
BA_ "GenSigTimeoutTime_CADM" SG_ 1455 A_EV_Kilometers 0;
BA_ "GenSigTimeoutTime_DMSM" SG_ 1455 A_EV_Kilometers 0;
BA_ "GenSigTimeoutTime_DTCM" SG_ 1455 A_EV_Kilometers 0;
BA_ "GenSigTimeoutTime_ECM" SG_ 1455 A_EV_Kilometers 0;
BA_ "GenSigTimeoutTime_EVCU2" SG_ 1455 A_EV_Kilometers 0;
BA_ "GenSigTimeoutTime_GNMM" SG_ 1455 A_EV_Kilometers 0;
BA_ "GenSigTimeoutTime_HCP" SG_ 1455 A_EV_Kilometers 0;
BA_ "GenSigTimeoutTime_IPC" SG_ 1455 A_EV_Kilometers 0;
BA_ "GenSigTimeoutTime_RFHM" SG_ 1455 A_EV_Kilometers 0;
BA_ "GenSigTimeoutTime_TCM" SG_ 1455 A_EV_Kilometers 0;
BA_ "GenSigTimeoutTime_AGSM" SG_ 1455 A_EV_Miles 0;
BA_ "GenSigTimeoutTime_BCM" SG_ 1455 A_EV_Miles 0;
BA_ "GenSigTimeoutTime_BSM" SG_ 1455 A_EV_Miles 0;
BA_ "GenSigTimeoutTime_CADM" SG_ 1455 A_EV_Miles 0;
BA_ "GenSigTimeoutTime_DMSM" SG_ 1455 A_EV_Miles 0;
BA_ "GenSigTimeoutTime_DTCM" SG_ 1455 A_EV_Miles 0;
BA_ "GenSigTimeoutTime_ECM" SG_ 1455 A_EV_Miles 0;
BA_ "GenSigTimeoutTime_EVCU2" SG_ 1455 A_EV_Miles 0;
BA_ "GenSigTimeoutTime_GNMM" SG_ 1455 A_EV_Miles 0;
BA_ "GenSigTimeoutTime_HCP" SG_ 1455 A_EV_Miles 0;
BA_ "GenSigTimeoutTime_IPC" SG_ 1455 A_EV_Miles 0;
BA_ "GenSigTimeoutTime_RFHM" SG_ 1455 A_EV_Miles 0;
BA_ "GenSigTimeoutTime_TCM" SG_ 1455 A_EV_Miles 0;
BA_ "GenSigTimeoutTime_AGSM" SG_ 1455 A_Hybrid_Kilometers 0;
BA_ "GenSigTimeoutTime_BCM" SG_ 1455 A_Hybrid_Kilometers 0;
BA_ "GenSigTimeoutTime_BSM" SG_ 1455 A_Hybrid_Kilometers 0;
BA_ "GenSigTimeoutTime_CADM" SG_ 1455 A_Hybrid_Kilometers 0;
BA_ "GenSigTimeoutTime_DMSM" SG_ 1455 A_Hybrid_Kilometers 0;
BA_ "GenSigTimeoutTime_DTCM" SG_ 1455 A_Hybrid_Kilometers 0;
BA_ "GenSigTimeoutTime_ECM" SG_ 1455 A_Hybrid_Kilometers 0;
BA_ "GenSigTimeoutTime_EVCU2" SG_ 1455 A_Hybrid_Kilometers 0;
BA_ "GenSigTimeoutTime_GNMM" SG_ 1455 A_Hybrid_Kilometers 0;
BA_ "GenSigTimeoutTime_HCP" SG_ 1455 A_Hybrid_Kilometers 0;
BA_ "GenSigTimeoutTime_IPC" SG_ 1455 A_Hybrid_Kilometers 0;
BA_ "GenSigTimeoutTime_RFHM" SG_ 1455 A_Hybrid_Kilometers 0;
BA_ "GenSigTimeoutTime_TCM" SG_ 1455 A_Hybrid_Kilometers 0;
BA_ "GenSigTimeoutTime_AGSM" SG_ 1455 A_Hybrid_Miles 0;
BA_ "GenSigTimeoutTime_BCM" SG_ 1455 A_Hybrid_Miles 0;
BA_ "GenSigTimeoutTime_BSM" SG_ 1455 A_Hybrid_Miles 0;
BA_ "GenSigTimeoutTime_CADM" SG_ 1455 A_Hybrid_Miles 0;
BA_ "GenSigTimeoutTime_DMSM" SG_ 1455 A_Hybrid_Miles 0;
BA_ "GenSigTimeoutTime_DTCM" SG_ 1455 A_Hybrid_Miles 0;
BA_ "GenSigTimeoutTime_ECM" SG_ 1455 A_Hybrid_Miles 0;
BA_ "GenSigTimeoutTime_EVCU2" SG_ 1455 A_Hybrid_Miles 0;
BA_ "GenSigTimeoutTime_GNMM" SG_ 1455 A_Hybrid_Miles 0;
BA_ "GenSigTimeoutTime_HCP" SG_ 1455 A_Hybrid_Miles 0;
BA_ "GenSigTimeoutTime_IPC" SG_ 1455 A_Hybrid_Miles 0;
BA_ "GenSigTimeoutTime_RFHM" SG_ 1455 A_Hybrid_Miles 0;
BA_ "GenSigTimeoutTime_TCM" SG_ 1455 A_Hybrid_Miles 0;
BA_ "GenSigStartValue" SG_ 1455 AudioMenuPopup 1;
BA_ "GenSigSendType" SG_ 1455 AudioMenuPopup 3;
BA_ "GenSigTimeoutTime_AGSM" SG_ 1455 AudioMenuPopup 0;
BA_ "GenSigTimeoutTime_BCM" SG_ 1455 AudioMenuPopup 0;
BA_ "GenSigTimeoutTime_BSM" SG_ 1455 AudioMenuPopup 0;
BA_ "GenSigTimeoutTime_CADM" SG_ 1455 AudioMenuPopup 0;
BA_ "GenSigTimeoutTime_DMSM" SG_ 1455 AudioMenuPopup 0;
BA_ "GenSigTimeoutTime_DTCM" SG_ 1455 AudioMenuPopup 0;
BA_ "GenSigTimeoutTime_ECM" SG_ 1455 AudioMenuPopup 0;
BA_ "GenSigTimeoutTime_EVCU2" SG_ 1455 AudioMenuPopup 0;
BA_ "GenSigTimeoutTime_GNMM" SG_ 1455 AudioMenuPopup 0;
BA_ "GenSigTimeoutTime_HCP" SG_ 1455 AudioMenuPopup 0;
BA_ "GenSigTimeoutTime_IPC" SG_ 1455 AudioMenuPopup 0;
BA_ "GenSigTimeoutTime_RFHM" SG_ 1455 AudioMenuPopup 0;
BA_ "GenSigTimeoutTime_TCM" SG_ 1455 AudioMenuPopup 0;
BA_ "GenSigStartValue" SG_ 1455 Avg_Fuel_Econ 1023;
BA_ "GenSigSendType" SG_ 1455 Avg_Fuel_Econ 3;
BA_ "GenSigTimeoutTime_AGSM" SG_ 1455 Avg_Fuel_Econ 0;
BA_ "GenSigTimeoutTime_BCM" SG_ 1455 Avg_Fuel_Econ 0;
BA_ "GenSigTimeoutTime_BSM" SG_ 1455 Avg_Fuel_Econ 0;
BA_ "GenSigTimeoutTime_CADM" SG_ 1455 Avg_Fuel_Econ 0;
BA_ "GenSigTimeoutTime_DMSM" SG_ 1455 Avg_Fuel_Econ 0;
BA_ "GenSigTimeoutTime_DTCM" SG_ 1455 Avg_Fuel_Econ 0;
BA_ "GenSigTimeoutTime_ECM" SG_ 1455 Avg_Fuel_Econ 0;
BA_ "GenSigTimeoutTime_EVCU2" SG_ 1455 Avg_Fuel_Econ 0;
BA_ "GenSigTimeoutTime_GNMM" SG_ 1455 Avg_Fuel_Econ 0;
BA_ "GenSigTimeoutTime_HCP" SG_ 1455 Avg_Fuel_Econ 0;
BA_ "GenSigTimeoutTime_IPC" SG_ 1455 Avg_Fuel_Econ 0;
BA_ "GenSigTimeoutTime_RFHM" SG_ 1455 Avg_Fuel_Econ 0;
BA_ "GenSigTimeoutTime_TCM" SG_ 1455 Avg_Fuel_Econ 0;
BA_ "GenSigStartValue" SG_ 1455 Cluster_In_Audio_Md 1;
BA_ "GenSigSendType" SG_ 1455 Cluster_In_Audio_Md 3;
BA_ "GenSigTimeoutTime_AGSM" SG_ 1455 Cluster_In_Audio_Md 0;
BA_ "GenSigTimeoutTime_BCM" SG_ 1455 Cluster_In_Audio_Md 0;
BA_ "GenSigTimeoutTime_BSM" SG_ 1455 Cluster_In_Audio_Md 0;
BA_ "GenSigTimeoutTime_CADM" SG_ 1455 Cluster_In_Audio_Md 0;
BA_ "GenSigTimeoutTime_DMSM" SG_ 1455 Cluster_In_Audio_Md 0;
BA_ "GenSigTimeoutTime_DTCM" SG_ 1455 Cluster_In_Audio_Md 0;
BA_ "GenSigTimeoutTime_ECM" SG_ 1455 Cluster_In_Audio_Md 0;
BA_ "GenSigTimeoutTime_EVCU2" SG_ 1455 Cluster_In_Audio_Md 0;
BA_ "GenSigTimeoutTime_GNMM" SG_ 1455 Cluster_In_Audio_Md 0;
BA_ "GenSigTimeoutTime_HCP" SG_ 1455 Cluster_In_Audio_Md 0;
BA_ "GenSigTimeoutTime_IPC" SG_ 1455 Cluster_In_Audio_Md 0;
BA_ "GenSigTimeoutTime_RFHM" SG_ 1455 Cluster_In_Audio_Md 0;
BA_ "GenSigTimeoutTime_TCM" SG_ 1455 Cluster_In_Audio_Md 0;
BA_ "GenSigSendType" SG_ 1455 IC_ETM_HUDCustom_Req 3;
BA_ "GenSigTimeoutTime_AGSM" SG_ 1455 IC_ETM_HUDCustom_Req 0;
BA_ "GenSigTimeoutTime_BCM" SG_ 1455 IC_ETM_HUDCustom_Req 0;
BA_ "GenSigTimeoutTime_BSM" SG_ 1455 IC_ETM_HUDCustom_Req 0;
BA_ "GenSigTimeoutTime_CADM" SG_ 1455 IC_ETM_HUDCustom_Req 0;
BA_ "GenSigTimeoutTime_DMSM" SG_ 1455 IC_ETM_HUDCustom_Req 0;
BA_ "GenSigTimeoutTime_DTCM" SG_ 1455 IC_ETM_HUDCustom_Req 0;
BA_ "GenSigTimeoutTime_ECM" SG_ 1455 IC_ETM_HUDCustom_Req 0;
BA_ "GenSigTimeoutTime_EVCU2" SG_ 1455 IC_ETM_HUDCustom_Req 0;
BA_ "GenSigTimeoutTime_GNMM" SG_ 1455 IC_ETM_HUDCustom_Req 0;
BA_ "GenSigTimeoutTime_HCP" SG_ 1455 IC_ETM_HUDCustom_Req 0;
BA_ "GenSigTimeoutTime_IPC" SG_ 1455 IC_ETM_HUDCustom_Req 0;
BA_ "GenSigTimeoutTime_RFHM" SG_ 1455 IC_ETM_HUDCustom_Req 0;
BA_ "GenSigTimeoutTime_TCM" SG_ 1455 IC_ETM_HUDCustom_Req 0;
BA_ "GenSigStartValue" SG_ 1455 IPC_NavigationMap_Req 1;
BA_ "GenSigSendType" SG_ 1455 IPC_NavigationMap_Req 3;
BA_ "GenSigTimeoutTime_AGSM" SG_ 1455 IPC_NavigationMap_Req 0;
BA_ "GenSigTimeoutTime_BCM" SG_ 1455 IPC_NavigationMap_Req 0;
BA_ "GenSigTimeoutTime_BSM" SG_ 1455 IPC_NavigationMap_Req 0;
BA_ "GenSigTimeoutTime_CADM" SG_ 1455 IPC_NavigationMap_Req 0;
BA_ "GenSigTimeoutTime_DMSM" SG_ 1455 IPC_NavigationMap_Req 0;
BA_ "GenSigTimeoutTime_DTCM" SG_ 1455 IPC_NavigationMap_Req 0;
BA_ "GenSigTimeoutTime_ECM" SG_ 1455 IPC_NavigationMap_Req 0;
BA_ "GenSigTimeoutTime_EVCU2" SG_ 1455 IPC_NavigationMap_Req 0;
BA_ "GenSigTimeoutTime_GNMM" SG_ 1455 IPC_NavigationMap_Req 0;
BA_ "GenSigTimeoutTime_HCP" SG_ 1455 IPC_NavigationMap_Req 0;
BA_ "GenSigTimeoutTime_IPC" SG_ 1455 IPC_NavigationMap_Req 0;
BA_ "GenSigTimeoutTime_RFHM" SG_ 1455 IPC_NavigationMap_Req 0;
BA_ "GenSigTimeoutTime_TCM" SG_ 1455 IPC_NavigationMap_Req 0;
BA_ "GenSigStartValue" SG_ 1455 NavigationMapPopUP 1;
BA_ "GenSigSendType" SG_ 1455 NavigationMapPopUP 3;
BA_ "GenSigTimeoutTime_AGSM" SG_ 1455 NavigationMapPopUP 0;
BA_ "GenSigTimeoutTime_BCM" SG_ 1455 NavigationMapPopUP 0;
BA_ "GenSigTimeoutTime_BSM" SG_ 1455 NavigationMapPopUP 0;
BA_ "GenSigTimeoutTime_CADM" SG_ 1455 NavigationMapPopUP 0;
BA_ "GenSigTimeoutTime_DMSM" SG_ 1455 NavigationMapPopUP 0;
BA_ "GenSigTimeoutTime_DTCM" SG_ 1455 NavigationMapPopUP 0;
BA_ "GenSigTimeoutTime_ECM" SG_ 1455 NavigationMapPopUP 0;
BA_ "GenSigTimeoutTime_EVCU2" SG_ 1455 NavigationMapPopUP 0;
BA_ "GenSigTimeoutTime_GNMM" SG_ 1455 NavigationMapPopUP 0;
BA_ "GenSigTimeoutTime_HCP" SG_ 1455 NavigationMapPopUP 0;
BA_ "GenSigTimeoutTime_IPC" SG_ 1455 NavigationMapPopUP 0;
BA_ "GenSigTimeoutTime_RFHM" SG_ 1455 NavigationMapPopUP 0;
BA_ "GenSigTimeoutTime_TCM" SG_ 1455 NavigationMapPopUP 0;
BA_ "GenSigSendType" SG_ 1455 NextNavInstructionPanelTheme 3;
BA_ "GenSigTimeoutTime_AGSM" SG_ 1455 NextNavInstructionPanelTheme 0;
BA_ "GenSigTimeoutTime_BCM" SG_ 1455 NextNavInstructionPanelTheme 0;
BA_ "GenSigTimeoutTime_BSM" SG_ 1455 NextNavInstructionPanelTheme 0;
BA_ "GenSigTimeoutTime_CADM" SG_ 1455 NextNavInstructionPanelTheme 0;
BA_ "GenSigTimeoutTime_DMSM" SG_ 1455 NextNavInstructionPanelTheme 0;
BA_ "GenSigTimeoutTime_DTCM" SG_ 1455 NextNavInstructionPanelTheme 0;
BA_ "GenSigTimeoutTime_ECM" SG_ 1455 NextNavInstructionPanelTheme 0;
BA_ "GenSigTimeoutTime_EVCU2" SG_ 1455 NextNavInstructionPanelTheme 0;
BA_ "GenSigTimeoutTime_GNMM" SG_ 1455 NextNavInstructionPanelTheme 0;
BA_ "GenSigTimeoutTime_HCP" SG_ 1455 NextNavInstructionPanelTheme 0;
BA_ "GenSigTimeoutTime_IPC" SG_ 1455 NextNavInstructionPanelTheme 0;
BA_ "GenSigTimeoutTime_RFHM" SG_ 1455 NextNavInstructionPanelTheme 0;
BA_ "GenSigTimeoutTime_TCM" SG_ 1455 NextNavInstructionPanelTheme 0;
BA_ "GenSigTimeoutTime_AGSM" SG_ 1844 B_EV_Kilometers 0;
BA_ "GenSigTimeoutTime_BCM" SG_ 1844 B_EV_Kilometers 0;
BA_ "GenSigTimeoutTime_BSM" SG_ 1844 B_EV_Kilometers 0;
BA_ "GenSigTimeoutTime_CADM" SG_ 1844 B_EV_Kilometers 0;
BA_ "GenSigTimeoutTime_DMSM" SG_ 1844 B_EV_Kilometers 0;
BA_ "GenSigTimeoutTime_DTCM" SG_ 1844 B_EV_Kilometers 0;
BA_ "GenSigTimeoutTime_ECM" SG_ 1844 B_EV_Kilometers 0;
BA_ "GenSigTimeoutTime_EVCU2" SG_ 1844 B_EV_Kilometers 0;
BA_ "GenSigTimeoutTime_GNMM" SG_ 1844 B_EV_Kilometers 0;
BA_ "GenSigTimeoutTime_HCP" SG_ 1844 B_EV_Kilometers 0;
BA_ "GenSigTimeoutTime_IPC" SG_ 1844 B_EV_Kilometers 0;
BA_ "GenSigTimeoutTime_RFHM" SG_ 1844 B_EV_Kilometers 0;
BA_ "GenSigTimeoutTime_TCM" SG_ 1844 B_EV_Kilometers 0;
BA_ "GenSigTimeoutTime_AGSM" SG_ 1844 B_EV_Miles 0;
BA_ "GenSigTimeoutTime_BCM" SG_ 1844 B_EV_Miles 0;
BA_ "GenSigTimeoutTime_BSM" SG_ 1844 B_EV_Miles 0;
BA_ "GenSigTimeoutTime_CADM" SG_ 1844 B_EV_Miles 0;
BA_ "GenSigTimeoutTime_DMSM" SG_ 1844 B_EV_Miles 0;
BA_ "GenSigTimeoutTime_DTCM" SG_ 1844 B_EV_Miles 0;
BA_ "GenSigTimeoutTime_ECM" SG_ 1844 B_EV_Miles 0;
BA_ "GenSigTimeoutTime_EVCU2" SG_ 1844 B_EV_Miles 0;
BA_ "GenSigTimeoutTime_GNMM" SG_ 1844 B_EV_Miles 0;
BA_ "GenSigTimeoutTime_HCP" SG_ 1844 B_EV_Miles 0;
BA_ "GenSigTimeoutTime_IPC" SG_ 1844 B_EV_Miles 0;
BA_ "GenSigTimeoutTime_RFHM" SG_ 1844 B_EV_Miles 0;
BA_ "GenSigTimeoutTime_TCM" SG_ 1844 B_EV_Miles 0;
BA_ "GenSigTimeoutTime_AGSM" SG_ 1844 B_Hybrid_Kilometers 0;
BA_ "GenSigTimeoutTime_BCM" SG_ 1844 B_Hybrid_Kilometers 0;
BA_ "GenSigTimeoutTime_BSM" SG_ 1844 B_Hybrid_Kilometers 0;
BA_ "GenSigTimeoutTime_CADM" SG_ 1844 B_Hybrid_Kilometers 0;
BA_ "GenSigTimeoutTime_DMSM" SG_ 1844 B_Hybrid_Kilometers 0;
BA_ "GenSigTimeoutTime_DTCM" SG_ 1844 B_Hybrid_Kilometers 0;
BA_ "GenSigTimeoutTime_ECM" SG_ 1844 B_Hybrid_Kilometers 0;
BA_ "GenSigTimeoutTime_EVCU2" SG_ 1844 B_Hybrid_Kilometers 0;
BA_ "GenSigTimeoutTime_GNMM" SG_ 1844 B_Hybrid_Kilometers 0;
BA_ "GenSigTimeoutTime_HCP" SG_ 1844 B_Hybrid_Kilometers 0;
BA_ "GenSigTimeoutTime_IPC" SG_ 1844 B_Hybrid_Kilometers 0;
BA_ "GenSigTimeoutTime_RFHM" SG_ 1844 B_Hybrid_Kilometers 0;
BA_ "GenSigTimeoutTime_TCM" SG_ 1844 B_Hybrid_Kilometers 0;
BA_ "GenSigTimeoutTime_AGSM" SG_ 1844 B_Hybrid_Miles 0;
BA_ "GenSigTimeoutTime_BCM" SG_ 1844 B_Hybrid_Miles 0;
BA_ "GenSigTimeoutTime_BSM" SG_ 1844 B_Hybrid_Miles 0;
BA_ "GenSigTimeoutTime_CADM" SG_ 1844 B_Hybrid_Miles 0;
BA_ "GenSigTimeoutTime_DMSM" SG_ 1844 B_Hybrid_Miles 0;
BA_ "GenSigTimeoutTime_DTCM" SG_ 1844 B_Hybrid_Miles 0;
BA_ "GenSigTimeoutTime_ECM" SG_ 1844 B_Hybrid_Miles 0;
BA_ "GenSigTimeoutTime_EVCU2" SG_ 1844 B_Hybrid_Miles 0;
BA_ "GenSigTimeoutTime_GNMM" SG_ 1844 B_Hybrid_Miles 0;
BA_ "GenSigTimeoutTime_HCP" SG_ 1844 B_Hybrid_Miles 0;
BA_ "GenSigTimeoutTime_IPC" SG_ 1844 B_Hybrid_Miles 0;
BA_ "GenSigTimeoutTime_RFHM" SG_ 1844 B_Hybrid_Miles 0;
BA_ "GenSigTimeoutTime_TCM" SG_ 1844 B_Hybrid_Miles 0;
BA_ "GenSigTimeoutTime_AGSM" SG_ 1842 FuelLvlIndicator 0;
BA_ "GenSigTimeoutTime_BCM" SG_ 1842 FuelLvlIndicator 0;
BA_ "GenSigTimeoutTime_BSM" SG_ 1842 FuelLvlIndicator 0;
BA_ "GenSigTimeoutTime_CADM" SG_ 1842 FuelLvlIndicator 0;
BA_ "GenSigTimeoutTime_DMSM" SG_ 1842 FuelLvlIndicator 0;
BA_ "GenSigTimeoutTime_DTCM" SG_ 1842 FuelLvlIndicator 0;
BA_ "GenSigTimeoutTime_ECM" SG_ 1842 FuelLvlIndicator 0;
BA_ "GenSigTimeoutTime_EVCU2" SG_ 1842 FuelLvlIndicator 0;
BA_ "GenSigTimeoutTime_GNMM" SG_ 1842 FuelLvlIndicator 0;
BA_ "GenSigTimeoutTime_HCP" SG_ 1842 FuelLvlIndicator 0;
BA_ "GenSigTimeoutTime_IPC" SG_ 1842 FuelLvlIndicator 0;
BA_ "GenSigTimeoutTime_RFHM" SG_ 1842 FuelLvlIndicator 0;
BA_ "GenSigTimeoutTime_TCM" SG_ 1842 FuelLvlIndicator 0;
BA_ "GenSigStartValue" SG_ 1842 Gas_Range 1023;
BA_ "GenSigSendType" SG_ 1842 Gas_Range 3;
BA_ "GenSigTimeoutTime_AGSM" SG_ 1842 Gas_Range 0;
BA_ "GenSigTimeoutTime_BSM" SG_ 1842 Gas_Range 0;
BA_ "GenSigTimeoutTime_CADM" SG_ 1842 Gas_Range 0;
BA_ "GenSigTimeoutTime_DMSM" SG_ 1842 Gas_Range 0;
BA_ "GenSigTimeoutTime_DTCM" SG_ 1842 Gas_Range 0;
BA_ "GenSigTimeoutTime_ECM" SG_ 1842 Gas_Range 0;
BA_ "GenSigTimeoutTime_EVCU2" SG_ 1842 Gas_Range 0;
BA_ "GenSigTimeoutTime_GNMM" SG_ 1842 Gas_Range 0;
BA_ "GenSigTimeoutTime_HCP" SG_ 1842 Gas_Range 0;
BA_ "GenSigTimeoutTime_IPC" SG_ 1842 Gas_Range 0;
BA_ "GenSigTimeoutTime_RFHM" SG_ 1842 Gas_Range 0;
BA_ "GenSigTimeoutTime_TCM" SG_ 1842 Gas_Range 0;
BA_ "GenSigStartValue" SG_ 1842 Total_Range 2047;
BA_ "GenSigSendType" SG_ 1842 Total_Range 3;
BA_ "GenSigTimeoutTime_AGSM" SG_ 1842 Total_Range 0;
BA_ "GenSigTimeoutTime_BCM" SG_ 1842 Total_Range 0;
BA_ "GenSigTimeoutTime_BSM" SG_ 1842 Total_Range 0;
BA_ "GenSigTimeoutTime_CADM" SG_ 1842 Total_Range 0;
BA_ "GenSigTimeoutTime_DMSM" SG_ 1842 Total_Range 0;
BA_ "GenSigTimeoutTime_DTCM" SG_ 1842 Total_Range 0;
BA_ "GenSigTimeoutTime_ECM" SG_ 1842 Total_Range 0;
BA_ "GenSigTimeoutTime_EVCU2" SG_ 1842 Total_Range 0;
BA_ "GenSigTimeoutTime_GNMM" SG_ 1842 Total_Range 0;
BA_ "GenSigTimeoutTime_HCP" SG_ 1842 Total_Range 0;
BA_ "GenSigTimeoutTime_IPC" SG_ 1842 Total_Range 0;
BA_ "GenSigTimeoutTime_RFHM" SG_ 1842 Total_Range 0;
BA_ "GenSigTimeoutTime_TCM" SG_ 1842 Total_Range 0;
BA_ "GenSigTimeoutTime_AGSM" SG_ 1831 ABS_IND_STAT 0;
BA_ "GenSigTimeoutTime_BCM" SG_ 1831 ABS_IND_STAT 0;
BA_ "GenSigTimeoutTime_BSM" SG_ 1831 ABS_IND_STAT 0;
BA_ "GenSigTimeoutTime_CADM" SG_ 1831 ABS_IND_STAT 0;
BA_ "GenSigTimeoutTime_DMSM" SG_ 1831 ABS_IND_STAT 0;
BA_ "GenSigTimeoutTime_DTCM" SG_ 1831 ABS_IND_STAT 0;
BA_ "GenSigTimeoutTime_ECM" SG_ 1831 ABS_IND_STAT 0;
BA_ "GenSigTimeoutTime_EVCU2" SG_ 1831 ABS_IND_STAT 0;
BA_ "GenSigTimeoutTime_GNMM" SG_ 1831 ABS_IND_STAT 0;
BA_ "GenSigTimeoutTime_HCP" SG_ 1831 ABS_IND_STAT 0;
BA_ "GenSigTimeoutTime_IPC" SG_ 1831 ABS_IND_STAT 0;
BA_ "GenSigTimeoutTime_RFHM" SG_ 1831 ABS_IND_STAT 0;
BA_ "GenSigTimeoutTime_TCM" SG_ 1831 ABS_IND_STAT 0;
BA_ "GenSigTimeoutTime_AGSM" SG_ 1831 ACC_WARN_STAT 0;
BA_ "GenSigTimeoutTime_BCM" SG_ 1831 ACC_WARN_STAT 0;
BA_ "GenSigTimeoutTime_BSM" SG_ 1831 ACC_WARN_STAT 0;
BA_ "GenSigTimeoutTime_CADM" SG_ 1831 ACC_WARN_STAT 0;
BA_ "GenSigTimeoutTime_DMSM" SG_ 1831 ACC_WARN_STAT 0;
BA_ "GenSigTimeoutTime_DTCM" SG_ 1831 ACC_WARN_STAT 0;
BA_ "GenSigTimeoutTime_ECM" SG_ 1831 ACC_WARN_STAT 0;
BA_ "GenSigTimeoutTime_EVCU2" SG_ 1831 ACC_WARN_STAT 0;
BA_ "GenSigTimeoutTime_GNMM" SG_ 1831 ACC_WARN_STAT 0;
BA_ "GenSigTimeoutTime_HCP" SG_ 1831 ACC_WARN_STAT 0;
BA_ "GenSigTimeoutTime_IPC" SG_ 1831 ACC_WARN_STAT 0;
BA_ "GenSigTimeoutTime_RFHM" SG_ 1831 ACC_WARN_STAT 0;
BA_ "GenSigTimeoutTime_TCM" SG_ 1831 ACC_WARN_STAT 0;
BA_ "GenSigTimeoutTime_AGSM" SG_ 1831 AIR_BAG_STAT 0;
BA_ "GenSigTimeoutTime_BCM" SG_ 1831 AIR_BAG_STAT 0;
BA_ "GenSigTimeoutTime_BSM" SG_ 1831 AIR_BAG_STAT 0;
BA_ "GenSigTimeoutTime_CADM" SG_ 1831 AIR_BAG_STAT 0;
BA_ "GenSigTimeoutTime_DMSM" SG_ 1831 AIR_BAG_STAT 0;
BA_ "GenSigTimeoutTime_DTCM" SG_ 1831 AIR_BAG_STAT 0;
BA_ "GenSigTimeoutTime_ECM" SG_ 1831 AIR_BAG_STAT 0;
BA_ "GenSigTimeoutTime_EVCU2" SG_ 1831 AIR_BAG_STAT 0;
BA_ "GenSigTimeoutTime_GNMM" SG_ 1831 AIR_BAG_STAT 0;
BA_ "GenSigTimeoutTime_HCP" SG_ 1831 AIR_BAG_STAT 0;
BA_ "GenSigTimeoutTime_IPC" SG_ 1831 AIR_BAG_STAT 0;
BA_ "GenSigTimeoutTime_RFHM" SG_ 1831 AIR_BAG_STAT 0;
BA_ "GenSigTimeoutTime_TCM" SG_ 1831 AIR_BAG_STAT 0;
BA_ "GenSigTimeoutTime_AGSM" SG_ 1831 AWD_IND_STAT 0;
BA_ "GenSigTimeoutTime_BCM" SG_ 1831 AWD_IND_STAT 0;
BA_ "GenSigTimeoutTime_BSM" SG_ 1831 AWD_IND_STAT 0;
BA_ "GenSigTimeoutTime_CADM" SG_ 1831 AWD_IND_STAT 0;
BA_ "GenSigTimeoutTime_DMSM" SG_ 1831 AWD_IND_STAT 0;
BA_ "GenSigTimeoutTime_DTCM" SG_ 1831 AWD_IND_STAT 0;
BA_ "GenSigTimeoutTime_ECM" SG_ 1831 AWD_IND_STAT 0;
BA_ "GenSigTimeoutTime_EVCU2" SG_ 1831 AWD_IND_STAT 0;
BA_ "GenSigTimeoutTime_GNMM" SG_ 1831 AWD_IND_STAT 0;
BA_ "GenSigTimeoutTime_HCP" SG_ 1831 AWD_IND_STAT 0;
BA_ "GenSigTimeoutTime_IPC" SG_ 1831 AWD_IND_STAT 0;
BA_ "GenSigTimeoutTime_RFHM" SG_ 1831 AWD_IND_STAT 0;
BA_ "GenSigTimeoutTime_TCM" SG_ 1831 AWD_IND_STAT 0;
BA_ "GenSigTimeoutTime_AGSM" SG_ 1831 AWD_SERVICE_STAT 0;
BA_ "GenSigTimeoutTime_BCM" SG_ 1831 AWD_SERVICE_STAT 0;
BA_ "GenSigTimeoutTime_BSM" SG_ 1831 AWD_SERVICE_STAT 0;
BA_ "GenSigTimeoutTime_CADM" SG_ 1831 AWD_SERVICE_STAT 0;
BA_ "GenSigTimeoutTime_DMSM" SG_ 1831 AWD_SERVICE_STAT 0;
BA_ "GenSigTimeoutTime_DTCM" SG_ 1831 AWD_SERVICE_STAT 0;
BA_ "GenSigTimeoutTime_ECM" SG_ 1831 AWD_SERVICE_STAT 0;
BA_ "GenSigTimeoutTime_EVCU2" SG_ 1831 AWD_SERVICE_STAT 0;
BA_ "GenSigTimeoutTime_GNMM" SG_ 1831 AWD_SERVICE_STAT 0;
BA_ "GenSigTimeoutTime_HCP" SG_ 1831 AWD_SERVICE_STAT 0;
BA_ "GenSigTimeoutTime_IPC" SG_ 1831 AWD_SERVICE_STAT 0;
BA_ "GenSigTimeoutTime_RFHM" SG_ 1831 AWD_SERVICE_STAT 0;
BA_ "GenSigTimeoutTime_TCM" SG_ 1831 AWD_SERVICE_STAT 0;
BA_ "GenSigTimeoutTime_AGSM" SG_ 1831 BATTERY_CHARGE_STAT 0;
BA_ "GenSigTimeoutTime_BCM" SG_ 1831 BATTERY_CHARGE_STAT 0;
BA_ "GenSigTimeoutTime_BSM" SG_ 1831 BATTERY_CHARGE_STAT 0;
BA_ "GenSigTimeoutTime_CADM" SG_ 1831 BATTERY_CHARGE_STAT 0;
BA_ "GenSigTimeoutTime_DMSM" SG_ 1831 BATTERY_CHARGE_STAT 0;
BA_ "GenSigTimeoutTime_DTCM" SG_ 1831 BATTERY_CHARGE_STAT 0;
BA_ "GenSigTimeoutTime_ECM" SG_ 1831 BATTERY_CHARGE_STAT 0;
BA_ "GenSigTimeoutTime_EVCU2" SG_ 1831 BATTERY_CHARGE_STAT 0;
BA_ "GenSigTimeoutTime_GNMM" SG_ 1831 BATTERY_CHARGE_STAT 0;
BA_ "GenSigTimeoutTime_HCP" SG_ 1831 BATTERY_CHARGE_STAT 0;
BA_ "GenSigTimeoutTime_IPC" SG_ 1831 BATTERY_CHARGE_STAT 0;
BA_ "GenSigTimeoutTime_RFHM" SG_ 1831 BATTERY_CHARGE_STAT 0;
BA_ "GenSigTimeoutTime_TCM" SG_ 1831 BATTERY_CHARGE_STAT 0;
BA_ "GenSigTimeoutTime_AGSM" SG_ 1831 BRAKE_PAD_STAT 0;
BA_ "GenSigTimeoutTime_BCM" SG_ 1831 BRAKE_PAD_STAT 0;
BA_ "GenSigTimeoutTime_BSM" SG_ 1831 BRAKE_PAD_STAT 0;
BA_ "GenSigTimeoutTime_CADM" SG_ 1831 BRAKE_PAD_STAT 0;
BA_ "GenSigTimeoutTime_DMSM" SG_ 1831 BRAKE_PAD_STAT 0;
BA_ "GenSigTimeoutTime_DTCM" SG_ 1831 BRAKE_PAD_STAT 0;
BA_ "GenSigTimeoutTime_ECM" SG_ 1831 BRAKE_PAD_STAT 0;
BA_ "GenSigTimeoutTime_EVCU2" SG_ 1831 BRAKE_PAD_STAT 0;
BA_ "GenSigTimeoutTime_GNMM" SG_ 1831 BRAKE_PAD_STAT 0;
BA_ "GenSigTimeoutTime_HCP" SG_ 1831 BRAKE_PAD_STAT 0;
BA_ "GenSigTimeoutTime_IPC" SG_ 1831 BRAKE_PAD_STAT 0;
BA_ "GenSigTimeoutTime_RFHM" SG_ 1831 BRAKE_PAD_STAT 0;
BA_ "GenSigTimeoutTime_TCM" SG_ 1831 BRAKE_PAD_STAT 0;
BA_ "GenSigTimeoutTime_AGSM" SG_ 1831 BRK_IND_STAT 0;
BA_ "GenSigTimeoutTime_BCM" SG_ 1831 BRK_IND_STAT 0;
BA_ "GenSigTimeoutTime_BSM" SG_ 1831 BRK_IND_STAT 0;
BA_ "GenSigTimeoutTime_CADM" SG_ 1831 BRK_IND_STAT 0;
BA_ "GenSigTimeoutTime_DMSM" SG_ 1831 BRK_IND_STAT 0;
BA_ "GenSigTimeoutTime_DTCM" SG_ 1831 BRK_IND_STAT 0;
BA_ "GenSigTimeoutTime_ECM" SG_ 1831 BRK_IND_STAT 0;
BA_ "GenSigTimeoutTime_EVCU2" SG_ 1831 BRK_IND_STAT 0;
BA_ "GenSigTimeoutTime_GNMM" SG_ 1831 BRK_IND_STAT 0;
BA_ "GenSigTimeoutTime_HCP" SG_ 1831 BRK_IND_STAT 0;
BA_ "GenSigTimeoutTime_IPC" SG_ 1831 BRK_IND_STAT 0;
BA_ "GenSigTimeoutTime_RFHM" SG_ 1831 BRK_IND_STAT 0;
BA_ "GenSigTimeoutTime_TCM" SG_ 1831 BRK_IND_STAT 0;
BA_ "GenSigTimeoutTime_AGSM" SG_ 1831 CARGO_LT_STAT 0;
BA_ "GenSigTimeoutTime_BCM" SG_ 1831 CARGO_LT_STAT 0;
BA_ "GenSigTimeoutTime_BSM" SG_ 1831 CARGO_LT_STAT 0;
BA_ "GenSigTimeoutTime_CADM" SG_ 1831 CARGO_LT_STAT 0;
BA_ "GenSigTimeoutTime_DMSM" SG_ 1831 CARGO_LT_STAT 0;
BA_ "GenSigTimeoutTime_DTCM" SG_ 1831 CARGO_LT_STAT 0;
BA_ "GenSigTimeoutTime_ECM" SG_ 1831 CARGO_LT_STAT 0;
BA_ "GenSigTimeoutTime_EVCU2" SG_ 1831 CARGO_LT_STAT 0;
BA_ "GenSigTimeoutTime_GNMM" SG_ 1831 CARGO_LT_STAT 0;
BA_ "GenSigTimeoutTime_HCP" SG_ 1831 CARGO_LT_STAT 0;
BA_ "GenSigTimeoutTime_IPC" SG_ 1831 CARGO_LT_STAT 0;
BA_ "GenSigTimeoutTime_RFHM" SG_ 1831 CARGO_LT_STAT 0;
BA_ "GenSigTimeoutTime_TCM" SG_ 1831 CARGO_LT_STAT 0;
BA_ "GenSigTimeoutTime_AGSM" SG_ 1831 CATALYST_TEMP_STAT 0;
BA_ "GenSigTimeoutTime_BCM" SG_ 1831 CATALYST_TEMP_STAT 0;
BA_ "GenSigTimeoutTime_BSM" SG_ 1831 CATALYST_TEMP_STAT 0;
BA_ "GenSigTimeoutTime_CADM" SG_ 1831 CATALYST_TEMP_STAT 0;
BA_ "GenSigTimeoutTime_DMSM" SG_ 1831 CATALYST_TEMP_STAT 0;
BA_ "GenSigTimeoutTime_DTCM" SG_ 1831 CATALYST_TEMP_STAT 0;
BA_ "GenSigTimeoutTime_ECM" SG_ 1831 CATALYST_TEMP_STAT 0;
BA_ "GenSigTimeoutTime_EVCU2" SG_ 1831 CATALYST_TEMP_STAT 0;
BA_ "GenSigTimeoutTime_GNMM" SG_ 1831 CATALYST_TEMP_STAT 0;
BA_ "GenSigTimeoutTime_HCP" SG_ 1831 CATALYST_TEMP_STAT 0;
BA_ "GenSigTimeoutTime_IPC" SG_ 1831 CATALYST_TEMP_STAT 0;
BA_ "GenSigTimeoutTime_RFHM" SG_ 1831 CATALYST_TEMP_STAT 0;
BA_ "GenSigTimeoutTime_TCM" SG_ 1831 CATALYST_TEMP_STAT 0;
BA_ "GenSigTimeoutTime_AGSM" SG_ 1831 COOLENT_LEVEL_STAT 0;
BA_ "GenSigTimeoutTime_BCM" SG_ 1831 COOLENT_LEVEL_STAT 0;
BA_ "GenSigTimeoutTime_BSM" SG_ 1831 COOLENT_LEVEL_STAT 0;
BA_ "GenSigTimeoutTime_CADM" SG_ 1831 COOLENT_LEVEL_STAT 0;
BA_ "GenSigTimeoutTime_DMSM" SG_ 1831 COOLENT_LEVEL_STAT 0;
BA_ "GenSigTimeoutTime_DTCM" SG_ 1831 COOLENT_LEVEL_STAT 0;
BA_ "GenSigTimeoutTime_ECM" SG_ 1831 COOLENT_LEVEL_STAT 0;
BA_ "GenSigTimeoutTime_EVCU2" SG_ 1831 COOLENT_LEVEL_STAT 0;
BA_ "GenSigTimeoutTime_GNMM" SG_ 1831 COOLENT_LEVEL_STAT 0;
BA_ "GenSigTimeoutTime_HCP" SG_ 1831 COOLENT_LEVEL_STAT 0;
BA_ "GenSigTimeoutTime_IPC" SG_ 1831 COOLENT_LEVEL_STAT 0;
BA_ "GenSigTimeoutTime_RFHM" SG_ 1831 COOLENT_LEVEL_STAT 0;
BA_ "GenSigTimeoutTime_TCM" SG_ 1831 COOLENT_LEVEL_STAT 0;
BA_ "GenSigTimeoutTime_AGSM" SG_ 1831 CRUISE_SET_STAT 0;
BA_ "GenSigTimeoutTime_BCM" SG_ 1831 CRUISE_SET_STAT 0;
BA_ "GenSigTimeoutTime_BSM" SG_ 1831 CRUISE_SET_STAT 0;
BA_ "GenSigTimeoutTime_CADM" SG_ 1831 CRUISE_SET_STAT 0;
BA_ "GenSigTimeoutTime_DMSM" SG_ 1831 CRUISE_SET_STAT 0;
BA_ "GenSigTimeoutTime_DTCM" SG_ 1831 CRUISE_SET_STAT 0;
BA_ "GenSigTimeoutTime_ECM" SG_ 1831 CRUISE_SET_STAT 0;
BA_ "GenSigTimeoutTime_EVCU2" SG_ 1831 CRUISE_SET_STAT 0;
BA_ "GenSigTimeoutTime_GNMM" SG_ 1831 CRUISE_SET_STAT 0;
BA_ "GenSigTimeoutTime_HCP" SG_ 1831 CRUISE_SET_STAT 0;
BA_ "GenSigTimeoutTime_IPC" SG_ 1831 CRUISE_SET_STAT 0;
BA_ "GenSigTimeoutTime_RFHM" SG_ 1831 CRUISE_SET_STAT 0;
BA_ "GenSigTimeoutTime_TCM" SG_ 1831 CRUISE_SET_STAT 0;
BA_ "GenSigTimeoutTime_AGSM" SG_ 1831 DAMPING_SYSTEM_STAT 0;
BA_ "GenSigTimeoutTime_BCM" SG_ 1831 DAMPING_SYSTEM_STAT 0;
BA_ "GenSigTimeoutTime_BSM" SG_ 1831 DAMPING_SYSTEM_STAT 0;
BA_ "GenSigTimeoutTime_CADM" SG_ 1831 DAMPING_SYSTEM_STAT 0;
BA_ "GenSigTimeoutTime_DMSM" SG_ 1831 DAMPING_SYSTEM_STAT 0;
BA_ "GenSigTimeoutTime_DTCM" SG_ 1831 DAMPING_SYSTEM_STAT 0;
BA_ "GenSigTimeoutTime_ECM" SG_ 1831 DAMPING_SYSTEM_STAT 0;
BA_ "GenSigTimeoutTime_EVCU2" SG_ 1831 DAMPING_SYSTEM_STAT 0;
BA_ "GenSigTimeoutTime_GNMM" SG_ 1831 DAMPING_SYSTEM_STAT 0;
BA_ "GenSigTimeoutTime_HCP" SG_ 1831 DAMPING_SYSTEM_STAT 0;
BA_ "GenSigTimeoutTime_IPC" SG_ 1831 DAMPING_SYSTEM_STAT 0;
BA_ "GenSigTimeoutTime_RFHM" SG_ 1831 DAMPING_SYSTEM_STAT 0;
BA_ "GenSigTimeoutTime_TCM" SG_ 1831 DAMPING_SYSTEM_STAT 0;
BA_ "GenSigTimeoutTime_AGSM" SG_ 1831 DEF_STAT 0;
BA_ "GenSigTimeoutTime_BCM" SG_ 1831 DEF_STAT 0;
BA_ "GenSigTimeoutTime_BSM" SG_ 1831 DEF_STAT 0;
BA_ "GenSigTimeoutTime_CADM" SG_ 1831 DEF_STAT 0;
BA_ "GenSigTimeoutTime_DMSM" SG_ 1831 DEF_STAT 0;
BA_ "GenSigTimeoutTime_DTCM" SG_ 1831 DEF_STAT 0;
BA_ "GenSigTimeoutTime_ECM" SG_ 1831 DEF_STAT 0;
BA_ "GenSigTimeoutTime_EVCU2" SG_ 1831 DEF_STAT 0;
BA_ "GenSigTimeoutTime_GNMM" SG_ 1831 DEF_STAT 0;
BA_ "GenSigTimeoutTime_HCP" SG_ 1831 DEF_STAT 0;
BA_ "GenSigTimeoutTime_IPC" SG_ 1831 DEF_STAT 0;
BA_ "GenSigTimeoutTime_RFHM" SG_ 1831 DEF_STAT 0;
BA_ "GenSigTimeoutTime_TCM" SG_ 1831 DEF_STAT 0;
BA_ "GenSigTimeoutTime_AGSM" SG_ 1831 DOORS_STAT 0;
BA_ "GenSigTimeoutTime_BCM" SG_ 1831 DOORS_STAT 0;
BA_ "GenSigTimeoutTime_BSM" SG_ 1831 DOORS_STAT 0;
BA_ "GenSigTimeoutTime_CADM" SG_ 1831 DOORS_STAT 0;
BA_ "GenSigTimeoutTime_DMSM" SG_ 1831 DOORS_STAT 0;
BA_ "GenSigTimeoutTime_DTCM" SG_ 1831 DOORS_STAT 0;
BA_ "GenSigTimeoutTime_ECM" SG_ 1831 DOORS_STAT 0;
BA_ "GenSigTimeoutTime_EVCU2" SG_ 1831 DOORS_STAT 0;
BA_ "GenSigTimeoutTime_GNMM" SG_ 1831 DOORS_STAT 0;
BA_ "GenSigTimeoutTime_HCP" SG_ 1831 DOORS_STAT 0;
BA_ "GenSigTimeoutTime_IPC" SG_ 1831 DOORS_STAT 0;
BA_ "GenSigTimeoutTime_RFHM" SG_ 1831 DOORS_STAT 0;
BA_ "GenSigTimeoutTime_TCM" SG_ 1831 DOORS_STAT 0;
BA_ "GenSigTimeoutTime_AGSM" SG_ 1831 ECO_MODE_STAT 0;
BA_ "GenSigTimeoutTime_BCM" SG_ 1831 ECO_MODE_STAT 0;
BA_ "GenSigTimeoutTime_BSM" SG_ 1831 ECO_MODE_STAT 0;
BA_ "GenSigTimeoutTime_CADM" SG_ 1831 ECO_MODE_STAT 0;
BA_ "GenSigTimeoutTime_DMSM" SG_ 1831 ECO_MODE_STAT 0;
BA_ "GenSigTimeoutTime_DTCM" SG_ 1831 ECO_MODE_STAT 0;
BA_ "GenSigTimeoutTime_ECM" SG_ 1831 ECO_MODE_STAT 0;
BA_ "GenSigTimeoutTime_EVCU2" SG_ 1831 ECO_MODE_STAT 0;
BA_ "GenSigTimeoutTime_GNMM" SG_ 1831 ECO_MODE_STAT 0;
BA_ "GenSigTimeoutTime_HCP" SG_ 1831 ECO_MODE_STAT 0;
BA_ "GenSigTimeoutTime_IPC" SG_ 1831 ECO_MODE_STAT 0;
BA_ "GenSigTimeoutTime_RFHM" SG_ 1831 ECO_MODE_STAT 0;
BA_ "GenSigTimeoutTime_TCM" SG_ 1831 ECO_MODE_STAT 0;
BA_ "GenSigTimeoutTime_AGSM" SG_ 1831 ELEC_STAB_STAT 0;
BA_ "GenSigTimeoutTime_BCM" SG_ 1831 ELEC_STAB_STAT 0;
BA_ "GenSigTimeoutTime_BSM" SG_ 1831 ELEC_STAB_STAT 0;
BA_ "GenSigTimeoutTime_CADM" SG_ 1831 ELEC_STAB_STAT 0;
BA_ "GenSigTimeoutTime_DMSM" SG_ 1831 ELEC_STAB_STAT 0;
BA_ "GenSigTimeoutTime_DTCM" SG_ 1831 ELEC_STAB_STAT 0;
BA_ "GenSigTimeoutTime_ECM" SG_ 1831 ELEC_STAB_STAT 0;
BA_ "GenSigTimeoutTime_EVCU2" SG_ 1831 ELEC_STAB_STAT 0;
BA_ "GenSigTimeoutTime_GNMM" SG_ 1831 ELEC_STAB_STAT 0;
BA_ "GenSigTimeoutTime_HCP" SG_ 1831 ELEC_STAB_STAT 0;
BA_ "GenSigTimeoutTime_IPC" SG_ 1831 ELEC_STAB_STAT 0;
BA_ "GenSigTimeoutTime_RFHM" SG_ 1831 ELEC_STAB_STAT 0;
BA_ "GenSigTimeoutTime_TCM" SG_ 1831 ELEC_STAB_STAT 0;
BA_ "GenSigTimeoutTime_AGSM" SG_ 1831 ELECTRIC_WRENCH_STAT 0;
BA_ "GenSigTimeoutTime_BCM" SG_ 1831 ELECTRIC_WRENCH_STAT 0;
BA_ "GenSigTimeoutTime_BSM" SG_ 1831 ELECTRIC_WRENCH_STAT 0;
BA_ "GenSigTimeoutTime_CADM" SG_ 1831 ELECTRIC_WRENCH_STAT 0;
BA_ "GenSigTimeoutTime_DMSM" SG_ 1831 ELECTRIC_WRENCH_STAT 0;
BA_ "GenSigTimeoutTime_DTCM" SG_ 1831 ELECTRIC_WRENCH_STAT 0;
BA_ "GenSigTimeoutTime_ECM" SG_ 1831 ELECTRIC_WRENCH_STAT 0;
BA_ "GenSigTimeoutTime_EVCU2" SG_ 1831 ELECTRIC_WRENCH_STAT 0;
BA_ "GenSigTimeoutTime_GNMM" SG_ 1831 ELECTRIC_WRENCH_STAT 0;
BA_ "GenSigTimeoutTime_HCP" SG_ 1831 ELECTRIC_WRENCH_STAT 0;
BA_ "GenSigTimeoutTime_IPC" SG_ 1831 ELECTRIC_WRENCH_STAT 0;
BA_ "GenSigTimeoutTime_RFHM" SG_ 1831 ELECTRIC_WRENCH_STAT 0;
BA_ "GenSigTimeoutTime_TCM" SG_ 1831 ELECTRIC_WRENCH_STAT 0;
BA_ "GenSigTimeoutTime_AGSM" SG_ 1831 ENGINE_MIL_STAT 0;
BA_ "GenSigTimeoutTime_BCM" SG_ 1831 ENGINE_MIL_STAT 0;
BA_ "GenSigTimeoutTime_BSM" SG_ 1831 ENGINE_MIL_STAT 0;
BA_ "GenSigTimeoutTime_CADM" SG_ 1831 ENGINE_MIL_STAT 0;
BA_ "GenSigTimeoutTime_DMSM" SG_ 1831 ENGINE_MIL_STAT 0;
BA_ "GenSigTimeoutTime_DTCM" SG_ 1831 ENGINE_MIL_STAT 0;
BA_ "GenSigTimeoutTime_ECM" SG_ 1831 ENGINE_MIL_STAT 0;
BA_ "GenSigTimeoutTime_EVCU2" SG_ 1831 ENGINE_MIL_STAT 0;
BA_ "GenSigTimeoutTime_GNMM" SG_ 1831 ENGINE_MIL_STAT 0;
BA_ "GenSigTimeoutTime_HCP" SG_ 1831 ENGINE_MIL_STAT 0;
BA_ "GenSigTimeoutTime_IPC" SG_ 1831 ENGINE_MIL_STAT 0;
BA_ "GenSigTimeoutTime_RFHM" SG_ 1831 ENGINE_MIL_STAT 0;
BA_ "GenSigTimeoutTime_TCM" SG_ 1831 ENGINE_MIL_STAT 0;
BA_ "GenSigTimeoutTime_AGSM" SG_ 1831 ENGINE_TEMP_STAT 0;
BA_ "GenSigTimeoutTime_BCM" SG_ 1831 ENGINE_TEMP_STAT 0;
BA_ "GenSigTimeoutTime_BSM" SG_ 1831 ENGINE_TEMP_STAT 0;
BA_ "GenSigTimeoutTime_CADM" SG_ 1831 ENGINE_TEMP_STAT 0;
BA_ "GenSigTimeoutTime_DMSM" SG_ 1831 ENGINE_TEMP_STAT 0;
BA_ "GenSigTimeoutTime_DTCM" SG_ 1831 ENGINE_TEMP_STAT 0;
BA_ "GenSigTimeoutTime_ECM" SG_ 1831 ENGINE_TEMP_STAT 0;
BA_ "GenSigTimeoutTime_EVCU2" SG_ 1831 ENGINE_TEMP_STAT 0;
BA_ "GenSigTimeoutTime_GNMM" SG_ 1831 ENGINE_TEMP_STAT 0;
BA_ "GenSigTimeoutTime_HCP" SG_ 1831 ENGINE_TEMP_STAT 0;
BA_ "GenSigTimeoutTime_IPC" SG_ 1831 ENGINE_TEMP_STAT 0;
BA_ "GenSigTimeoutTime_RFHM" SG_ 1831 ENGINE_TEMP_STAT 0;
BA_ "GenSigTimeoutTime_TCM" SG_ 1831 ENGINE_TEMP_STAT 0;
BA_ "GenSigTimeoutTime_AGSM" SG_ 1831 EPB_WARN_STAT 0;
BA_ "GenSigTimeoutTime_BCM" SG_ 1831 EPB_WARN_STAT 0;
BA_ "GenSigTimeoutTime_BSM" SG_ 1831 EPB_WARN_STAT 0;
BA_ "GenSigTimeoutTime_CADM" SG_ 1831 EPB_WARN_STAT 0;
BA_ "GenSigTimeoutTime_DMSM" SG_ 1831 EPB_WARN_STAT 0;
BA_ "GenSigTimeoutTime_DTCM" SG_ 1831 EPB_WARN_STAT 0;
BA_ "GenSigTimeoutTime_ECM" SG_ 1831 EPB_WARN_STAT 0;
BA_ "GenSigTimeoutTime_EVCU2" SG_ 1831 EPB_WARN_STAT 0;
BA_ "GenSigTimeoutTime_GNMM" SG_ 1831 EPB_WARN_STAT 0;
BA_ "GenSigTimeoutTime_HCP" SG_ 1831 EPB_WARN_STAT 0;
BA_ "GenSigTimeoutTime_IPC" SG_ 1831 EPB_WARN_STAT 0;
BA_ "GenSigTimeoutTime_RFHM" SG_ 1831 EPB_WARN_STAT 0;
BA_ "GenSigTimeoutTime_TCM" SG_ 1831 EPB_WARN_STAT 0;
BA_ "GenSigTimeoutTime_AGSM" SG_ 1831 EPS_STAT 0;
BA_ "GenSigTimeoutTime_BCM" SG_ 1831 EPS_STAT 0;
BA_ "GenSigTimeoutTime_BSM" SG_ 1831 EPS_STAT 0;
BA_ "GenSigTimeoutTime_CADM" SG_ 1831 EPS_STAT 0;
BA_ "GenSigTimeoutTime_DMSM" SG_ 1831 EPS_STAT 0;
BA_ "GenSigTimeoutTime_DTCM" SG_ 1831 EPS_STAT 0;
BA_ "GenSigTimeoutTime_ECM" SG_ 1831 EPS_STAT 0;
BA_ "GenSigTimeoutTime_EVCU2" SG_ 1831 EPS_STAT 0;
BA_ "GenSigTimeoutTime_GNMM" SG_ 1831 EPS_STAT 0;
BA_ "GenSigTimeoutTime_HCP" SG_ 1831 EPS_STAT 0;
BA_ "GenSigTimeoutTime_IPC" SG_ 1831 EPS_STAT 0;
BA_ "GenSigTimeoutTime_RFHM" SG_ 1831 EPS_STAT 0;
BA_ "GenSigTimeoutTime_TCM" SG_ 1831 EPS_STAT 0;
BA_ "GenSigTimeoutTime_AGSM" SG_ 1831 ESC_OFF_STAT 0;
BA_ "GenSigTimeoutTime_BCM" SG_ 1831 ESC_OFF_STAT 0;
BA_ "GenSigTimeoutTime_BSM" SG_ 1831 ESC_OFF_STAT 0;
BA_ "GenSigTimeoutTime_CADM" SG_ 1831 ESC_OFF_STAT 0;
BA_ "GenSigTimeoutTime_DMSM" SG_ 1831 ESC_OFF_STAT 0;
BA_ "GenSigTimeoutTime_DTCM" SG_ 1831 ESC_OFF_STAT 0;
BA_ "GenSigTimeoutTime_ECM" SG_ 1831 ESC_OFF_STAT 0;
BA_ "GenSigTimeoutTime_EVCU2" SG_ 1831 ESC_OFF_STAT 0;
BA_ "GenSigTimeoutTime_GNMM" SG_ 1831 ESC_OFF_STAT 0;
BA_ "GenSigTimeoutTime_HCP" SG_ 1831 ESC_OFF_STAT 0;
BA_ "GenSigTimeoutTime_IPC" SG_ 1831 ESC_OFF_STAT 0;
BA_ "GenSigTimeoutTime_RFHM" SG_ 1831 ESC_OFF_STAT 0;
BA_ "GenSigTimeoutTime_TCM" SG_ 1831 ESC_OFF_STAT 0;
BA_ "GenSigTimeoutTime_AGSM" SG_ 1831 ETC_CONTROL_STAT 0;
BA_ "GenSigTimeoutTime_BCM" SG_ 1831 ETC_CONTROL_STAT 0;
BA_ "GenSigTimeoutTime_BSM" SG_ 1831 ETC_CONTROL_STAT 0;
BA_ "GenSigTimeoutTime_CADM" SG_ 1831 ETC_CONTROL_STAT 0;
BA_ "GenSigTimeoutTime_DMSM" SG_ 1831 ETC_CONTROL_STAT 0;
BA_ "GenSigTimeoutTime_DTCM" SG_ 1831 ETC_CONTROL_STAT 0;
BA_ "GenSigTimeoutTime_ECM" SG_ 1831 ETC_CONTROL_STAT 0;
BA_ "GenSigTimeoutTime_EVCU2" SG_ 1831 ETC_CONTROL_STAT 0;
BA_ "GenSigTimeoutTime_GNMM" SG_ 1831 ETC_CONTROL_STAT 0;
BA_ "GenSigTimeoutTime_HCP" SG_ 1831 ETC_CONTROL_STAT 0;
BA_ "GenSigTimeoutTime_IPC" SG_ 1831 ETC_CONTROL_STAT 0;
BA_ "GenSigTimeoutTime_RFHM" SG_ 1831 ETC_CONTROL_STAT 0;
BA_ "GenSigTimeoutTime_TCM" SG_ 1831 ETC_CONTROL_STAT 0;
BA_ "GenSigTimeoutTime_AGSM" SG_ 1831 EXH_BRK_STAT 0;
BA_ "GenSigTimeoutTime_BCM" SG_ 1831 EXH_BRK_STAT 0;
BA_ "GenSigTimeoutTime_BSM" SG_ 1831 EXH_BRK_STAT 0;
BA_ "GenSigTimeoutTime_CADM" SG_ 1831 EXH_BRK_STAT 0;
BA_ "GenSigTimeoutTime_DMSM" SG_ 1831 EXH_BRK_STAT 0;
BA_ "GenSigTimeoutTime_DTCM" SG_ 1831 EXH_BRK_STAT 0;
BA_ "GenSigTimeoutTime_ECM" SG_ 1831 EXH_BRK_STAT 0;
BA_ "GenSigTimeoutTime_EVCU2" SG_ 1831 EXH_BRK_STAT 0;
BA_ "GenSigTimeoutTime_GNMM" SG_ 1831 EXH_BRK_STAT 0;
BA_ "GenSigTimeoutTime_HCP" SG_ 1831 EXH_BRK_STAT 0;
BA_ "GenSigTimeoutTime_IPC" SG_ 1831 EXH_BRK_STAT 0;
BA_ "GenSigTimeoutTime_RFHM" SG_ 1831 EXH_BRK_STAT 0;
BA_ "GenSigTimeoutTime_TCM" SG_ 1831 EXH_BRK_STAT 0;
BA_ "GenSigTimeoutTime_AGSM" SG_ 1831 FCW_SYSTEM_STAT 0;
BA_ "GenSigTimeoutTime_BCM" SG_ 1831 FCW_SYSTEM_STAT 0;
BA_ "GenSigTimeoutTime_BSM" SG_ 1831 FCW_SYSTEM_STAT 0;
BA_ "GenSigTimeoutTime_CADM" SG_ 1831 FCW_SYSTEM_STAT 0;
BA_ "GenSigTimeoutTime_DMSM" SG_ 1831 FCW_SYSTEM_STAT 0;
BA_ "GenSigTimeoutTime_DTCM" SG_ 1831 FCW_SYSTEM_STAT 0;
BA_ "GenSigTimeoutTime_ECM" SG_ 1831 FCW_SYSTEM_STAT 0;
BA_ "GenSigTimeoutTime_EVCU2" SG_ 1831 FCW_SYSTEM_STAT 0;
BA_ "GenSigTimeoutTime_GNMM" SG_ 1831 FCW_SYSTEM_STAT 0;
BA_ "GenSigTimeoutTime_HCP" SG_ 1831 FCW_SYSTEM_STAT 0;
BA_ "GenSigTimeoutTime_IPC" SG_ 1831 FCW_SYSTEM_STAT 0;
BA_ "GenSigTimeoutTime_RFHM" SG_ 1831 FCW_SYSTEM_STAT 0;
BA_ "GenSigTimeoutTime_TCM" SG_ 1831 FCW_SYSTEM_STAT 0;
BA_ "GenSigTimeoutTime_AGSM" SG_ 1831 FOUR_WD_SERVICE_STAT 0;
BA_ "GenSigTimeoutTime_BCM" SG_ 1831 FOUR_WD_SERVICE_STAT 0;
BA_ "GenSigTimeoutTime_BSM" SG_ 1831 FOUR_WD_SERVICE_STAT 0;
BA_ "GenSigTimeoutTime_CADM" SG_ 1831 FOUR_WD_SERVICE_STAT 0;
BA_ "GenSigTimeoutTime_DMSM" SG_ 1831 FOUR_WD_SERVICE_STAT 0;
BA_ "GenSigTimeoutTime_DTCM" SG_ 1831 FOUR_WD_SERVICE_STAT 0;
BA_ "GenSigTimeoutTime_ECM" SG_ 1831 FOUR_WD_SERVICE_STAT 0;
BA_ "GenSigTimeoutTime_EVCU2" SG_ 1831 FOUR_WD_SERVICE_STAT 0;
BA_ "GenSigTimeoutTime_GNMM" SG_ 1831 FOUR_WD_SERVICE_STAT 0;
BA_ "GenSigTimeoutTime_HCP" SG_ 1831 FOUR_WD_SERVICE_STAT 0;
BA_ "GenSigTimeoutTime_IPC" SG_ 1831 FOUR_WD_SERVICE_STAT 0;
BA_ "GenSigTimeoutTime_RFHM" SG_ 1831 FOUR_WD_SERVICE_STAT 0;
BA_ "GenSigTimeoutTime_TCM" SG_ 1831 FOUR_WD_SERVICE_STAT 0;
BA_ "GenSigTimeoutTime_AGSM" SG_ 1831 FT_FOG_STAT 0;
BA_ "GenSigTimeoutTime_BCM" SG_ 1831 FT_FOG_STAT 0;
BA_ "GenSigTimeoutTime_BSM" SG_ 1831 FT_FOG_STAT 0;
BA_ "GenSigTimeoutTime_CADM" SG_ 1831 FT_FOG_STAT 0;
BA_ "GenSigTimeoutTime_DMSM" SG_ 1831 FT_FOG_STAT 0;
BA_ "GenSigTimeoutTime_DTCM" SG_ 1831 FT_FOG_STAT 0;
BA_ "GenSigTimeoutTime_ECM" SG_ 1831 FT_FOG_STAT 0;
BA_ "GenSigTimeoutTime_EVCU2" SG_ 1831 FT_FOG_STAT 0;
BA_ "GenSigTimeoutTime_GNMM" SG_ 1831 FT_FOG_STAT 0;
BA_ "GenSigTimeoutTime_HCP" SG_ 1831 FT_FOG_STAT 0;
BA_ "GenSigTimeoutTime_IPC" SG_ 1831 FT_FOG_STAT 0;
BA_ "GenSigTimeoutTime_RFHM" SG_ 1831 FT_FOG_STAT 0;
BA_ "GenSigTimeoutTime_TCM" SG_ 1831 FT_FOG_STAT 0;
BA_ "GenSigTimeoutTime_AGSM" SG_ 1831 FUEL_CAP_STAT 0;
BA_ "GenSigTimeoutTime_BCM" SG_ 1831 FUEL_CAP_STAT 0;
BA_ "GenSigTimeoutTime_BSM" SG_ 1831 FUEL_CAP_STAT 0;
BA_ "GenSigTimeoutTime_CADM" SG_ 1831 FUEL_CAP_STAT 0;
BA_ "GenSigTimeoutTime_DMSM" SG_ 1831 FUEL_CAP_STAT 0;
BA_ "GenSigTimeoutTime_DTCM" SG_ 1831 FUEL_CAP_STAT 0;
BA_ "GenSigTimeoutTime_ECM" SG_ 1831 FUEL_CAP_STAT 0;
BA_ "GenSigTimeoutTime_EVCU2" SG_ 1831 FUEL_CAP_STAT 0;
BA_ "GenSigTimeoutTime_GNMM" SG_ 1831 FUEL_CAP_STAT 0;
BA_ "GenSigTimeoutTime_HCP" SG_ 1831 FUEL_CAP_STAT 0;
BA_ "GenSigTimeoutTime_IPC" SG_ 1831 FUEL_CAP_STAT 0;
BA_ "GenSigTimeoutTime_RFHM" SG_ 1831 FUEL_CAP_STAT 0;
BA_ "GenSigTimeoutTime_TCM" SG_ 1831 FUEL_CAP_STAT 0;
BA_ "GenSigTimeoutTime_AGSM" SG_ 1831 FUEL_CUT_OFF_STAT 0;
BA_ "GenSigTimeoutTime_BCM" SG_ 1831 FUEL_CUT_OFF_STAT 0;
BA_ "GenSigTimeoutTime_BSM" SG_ 1831 FUEL_CUT_OFF_STAT 0;
BA_ "GenSigTimeoutTime_CADM" SG_ 1831 FUEL_CUT_OFF_STAT 0;
BA_ "GenSigTimeoutTime_DMSM" SG_ 1831 FUEL_CUT_OFF_STAT 0;
BA_ "GenSigTimeoutTime_DTCM" SG_ 1831 FUEL_CUT_OFF_STAT 0;
BA_ "GenSigTimeoutTime_ECM" SG_ 1831 FUEL_CUT_OFF_STAT 0;
BA_ "GenSigTimeoutTime_EVCU2" SG_ 1831 FUEL_CUT_OFF_STAT 0;
BA_ "GenSigTimeoutTime_GNMM" SG_ 1831 FUEL_CUT_OFF_STAT 0;
BA_ "GenSigTimeoutTime_HCP" SG_ 1831 FUEL_CUT_OFF_STAT 0;
BA_ "GenSigTimeoutTime_IPC" SG_ 1831 FUEL_CUT_OFF_STAT 0;
BA_ "GenSigTimeoutTime_RFHM" SG_ 1831 FUEL_CUT_OFF_STAT 0;
BA_ "GenSigTimeoutTime_TCM" SG_ 1831 FUEL_CUT_OFF_STAT 0;
BA_ "GenSigTimeoutTime_AGSM" SG_ 1831 HDLT_LVL_STAT 0;
BA_ "GenSigTimeoutTime_BCM" SG_ 1831 HDLT_LVL_STAT 0;
BA_ "GenSigTimeoutTime_BSM" SG_ 1831 HDLT_LVL_STAT 0;
BA_ "GenSigTimeoutTime_CADM" SG_ 1831 HDLT_LVL_STAT 0;
BA_ "GenSigTimeoutTime_DMSM" SG_ 1831 HDLT_LVL_STAT 0;
BA_ "GenSigTimeoutTime_DTCM" SG_ 1831 HDLT_LVL_STAT 0;
BA_ "GenSigTimeoutTime_ECM" SG_ 1831 HDLT_LVL_STAT 0;
BA_ "GenSigTimeoutTime_EVCU2" SG_ 1831 HDLT_LVL_STAT 0;
BA_ "GenSigTimeoutTime_GNMM" SG_ 1831 HDLT_LVL_STAT 0;
BA_ "GenSigTimeoutTime_HCP" SG_ 1831 HDLT_LVL_STAT 0;
BA_ "GenSigTimeoutTime_IPC" SG_ 1831 HDLT_LVL_STAT 0;
BA_ "GenSigTimeoutTime_RFHM" SG_ 1831 HDLT_LVL_STAT 0;
BA_ "GenSigTimeoutTime_TCM" SG_ 1831 HDLT_LVL_STAT 0;
BA_ "GenSigTimeoutTime_AGSM" SG_ 1831 HI_BEAM_STAT 0;
BA_ "GenSigTimeoutTime_BCM" SG_ 1831 HI_BEAM_STAT 0;
BA_ "GenSigTimeoutTime_BSM" SG_ 1831 HI_BEAM_STAT 0;
BA_ "GenSigTimeoutTime_CADM" SG_ 1831 HI_BEAM_STAT 0;
BA_ "GenSigTimeoutTime_DMSM" SG_ 1831 HI_BEAM_STAT 0;
BA_ "GenSigTimeoutTime_DTCM" SG_ 1831 HI_BEAM_STAT 0;
BA_ "GenSigTimeoutTime_ECM" SG_ 1831 HI_BEAM_STAT 0;
BA_ "GenSigTimeoutTime_EVCU2" SG_ 1831 HI_BEAM_STAT 0;
BA_ "GenSigTimeoutTime_GNMM" SG_ 1831 HI_BEAM_STAT 0;
BA_ "GenSigTimeoutTime_HCP" SG_ 1831 HI_BEAM_STAT 0;
BA_ "GenSigTimeoutTime_IPC" SG_ 1831 HI_BEAM_STAT 0;
BA_ "GenSigTimeoutTime_RFHM" SG_ 1831 HI_BEAM_STAT 0;
BA_ "GenSigTimeoutTime_TCM" SG_ 1831 HI_BEAM_STAT 0;
BA_ "GenSigTimeoutTime_AGSM" SG_ 1831 HILL_DESCENT_STAT 0;
BA_ "GenSigTimeoutTime_BCM" SG_ 1831 HILL_DESCENT_STAT 0;
BA_ "GenSigTimeoutTime_BSM" SG_ 1831 HILL_DESCENT_STAT 0;
BA_ "GenSigTimeoutTime_CADM" SG_ 1831 HILL_DESCENT_STAT 0;
BA_ "GenSigTimeoutTime_DMSM" SG_ 1831 HILL_DESCENT_STAT 0;
BA_ "GenSigTimeoutTime_DTCM" SG_ 1831 HILL_DESCENT_STAT 0;
BA_ "GenSigTimeoutTime_ECM" SG_ 1831 HILL_DESCENT_STAT 0;
BA_ "GenSigTimeoutTime_EVCU2" SG_ 1831 HILL_DESCENT_STAT 0;
BA_ "GenSigTimeoutTime_GNMM" SG_ 1831 HILL_DESCENT_STAT 0;
BA_ "GenSigTimeoutTime_HCP" SG_ 1831 HILL_DESCENT_STAT 0;
BA_ "GenSigTimeoutTime_IPC" SG_ 1831 HILL_DESCENT_STAT 0;
BA_ "GenSigTimeoutTime_RFHM" SG_ 1831 HILL_DESCENT_STAT 0;
BA_ "GenSigTimeoutTime_TCM" SG_ 1831 HILL_DESCENT_STAT 0;
BA_ "GenSigTimeoutTime_AGSM" SG_ 1831 HVY_EXH_STAT 0;
BA_ "GenSigTimeoutTime_BCM" SG_ 1831 HVY_EXH_STAT 0;
BA_ "GenSigTimeoutTime_BSM" SG_ 1831 HVY_EXH_STAT 0;
BA_ "GenSigTimeoutTime_CADM" SG_ 1831 HVY_EXH_STAT 0;
BA_ "GenSigTimeoutTime_DMSM" SG_ 1831 HVY_EXH_STAT 0;
BA_ "GenSigTimeoutTime_DTCM" SG_ 1831 HVY_EXH_STAT 0;
BA_ "GenSigTimeoutTime_ECM" SG_ 1831 HVY_EXH_STAT 0;
BA_ "GenSigTimeoutTime_EVCU2" SG_ 1831 HVY_EXH_STAT 0;
BA_ "GenSigTimeoutTime_GNMM" SG_ 1831 HVY_EXH_STAT 0;
BA_ "GenSigTimeoutTime_HCP" SG_ 1831 HVY_EXH_STAT 0;
BA_ "GenSigTimeoutTime_IPC" SG_ 1831 HVY_EXH_STAT 0;
BA_ "GenSigTimeoutTime_RFHM" SG_ 1831 HVY_EXH_STAT 0;
BA_ "GenSigTimeoutTime_TCM" SG_ 1831 HVY_EXH_STAT 0;
BA_ "GenSigTimeoutTime_AGSM" SG_ 1831 LANE_DEPART_FAIL_STAT 0;
BA_ "GenSigTimeoutTime_BCM" SG_ 1831 LANE_DEPART_FAIL_STAT 0;
BA_ "GenSigTimeoutTime_BSM" SG_ 1831 LANE_DEPART_FAIL_STAT 0;
BA_ "GenSigTimeoutTime_CADM" SG_ 1831 LANE_DEPART_FAIL_STAT 0;
BA_ "GenSigTimeoutTime_DMSM" SG_ 1831 LANE_DEPART_FAIL_STAT 0;
BA_ "GenSigTimeoutTime_DTCM" SG_ 1831 LANE_DEPART_FAIL_STAT 0;
BA_ "GenSigTimeoutTime_ECM" SG_ 1831 LANE_DEPART_FAIL_STAT 0;
BA_ "GenSigTimeoutTime_EVCU2" SG_ 1831 LANE_DEPART_FAIL_STAT 0;
BA_ "GenSigTimeoutTime_GNMM" SG_ 1831 LANE_DEPART_FAIL_STAT 0;
BA_ "GenSigTimeoutTime_HCP" SG_ 1831 LANE_DEPART_FAIL_STAT 0;
BA_ "GenSigTimeoutTime_IPC" SG_ 1831 LANE_DEPART_FAIL_STAT 0;
BA_ "GenSigTimeoutTime_RFHM" SG_ 1831 LANE_DEPART_FAIL_STAT 0;
BA_ "GenSigTimeoutTime_TCM" SG_ 1831 LANE_DEPART_FAIL_STAT 0;
BA_ "GenSigTimeoutTime_AGSM" SG_ 1831 LANE_DEPART_STAT 0;
BA_ "GenSigTimeoutTime_BCM" SG_ 1831 LANE_DEPART_STAT 0;
BA_ "GenSigTimeoutTime_BSM" SG_ 1831 LANE_DEPART_STAT 0;
BA_ "GenSigTimeoutTime_CADM" SG_ 1831 LANE_DEPART_STAT 0;
BA_ "GenSigTimeoutTime_DMSM" SG_ 1831 LANE_DEPART_STAT 0;
BA_ "GenSigTimeoutTime_DTCM" SG_ 1831 LANE_DEPART_STAT 0;
BA_ "GenSigTimeoutTime_ECM" SG_ 1831 LANE_DEPART_STAT 0;
BA_ "GenSigTimeoutTime_EVCU2" SG_ 1831 LANE_DEPART_STAT 0;
BA_ "GenSigTimeoutTime_GNMM" SG_ 1831 LANE_DEPART_STAT 0;
BA_ "GenSigTimeoutTime_HCP" SG_ 1831 LANE_DEPART_STAT 0;
BA_ "GenSigTimeoutTime_IPC" SG_ 1831 LANE_DEPART_STAT 0;
BA_ "GenSigTimeoutTime_RFHM" SG_ 1831 LANE_DEPART_STAT 0;
BA_ "GenSigTimeoutTime_TCM" SG_ 1831 LANE_DEPART_STAT 0;
BA_ "GenSigTimeoutTime_AGSM" SG_ 1831 LANE_SENSE_STAT 0;
BA_ "GenSigTimeoutTime_BCM" SG_ 1831 LANE_SENSE_STAT 0;
BA_ "GenSigTimeoutTime_BSM" SG_ 1831 LANE_SENSE_STAT 0;
BA_ "GenSigTimeoutTime_CADM" SG_ 1831 LANE_SENSE_STAT 0;
BA_ "GenSigTimeoutTime_DMSM" SG_ 1831 LANE_SENSE_STAT 0;
BA_ "GenSigTimeoutTime_DTCM" SG_ 1831 LANE_SENSE_STAT 0;
BA_ "GenSigTimeoutTime_ECM" SG_ 1831 LANE_SENSE_STAT 0;
BA_ "GenSigTimeoutTime_EVCU2" SG_ 1831 LANE_SENSE_STAT 0;
BA_ "GenSigTimeoutTime_GNMM" SG_ 1831 LANE_SENSE_STAT 0;
BA_ "GenSigTimeoutTime_HCP" SG_ 1831 LANE_SENSE_STAT 0;
BA_ "GenSigTimeoutTime_IPC" SG_ 1831 LANE_SENSE_STAT 0;
BA_ "GenSigTimeoutTime_RFHM" SG_ 1831 LANE_SENSE_STAT 0;
BA_ "GenSigTimeoutTime_TCM" SG_ 1831 LANE_SENSE_STAT 0;
BA_ "GenSigTimeoutTime_AGSM" SG_ 1831 LIFT_GATE_STAT 0;
BA_ "GenSigTimeoutTime_BCM" SG_ 1831 LIFT_GATE_STAT 0;
BA_ "GenSigTimeoutTime_BSM" SG_ 1831 LIFT_GATE_STAT 0;
BA_ "GenSigTimeoutTime_CADM" SG_ 1831 LIFT_GATE_STAT 0;
BA_ "GenSigTimeoutTime_DMSM" SG_ 1831 LIFT_GATE_STAT 0;
BA_ "GenSigTimeoutTime_DTCM" SG_ 1831 LIFT_GATE_STAT 0;
BA_ "GenSigTimeoutTime_ECM" SG_ 1831 LIFT_GATE_STAT 0;
BA_ "GenSigTimeoutTime_EVCU2" SG_ 1831 LIFT_GATE_STAT 0;
BA_ "GenSigTimeoutTime_GNMM" SG_ 1831 LIFT_GATE_STAT 0;
BA_ "GenSigTimeoutTime_HCP" SG_ 1831 LIFT_GATE_STAT 0;
BA_ "GenSigTimeoutTime_IPC" SG_ 1831 LIFT_GATE_STAT 0;
BA_ "GenSigTimeoutTime_RFHM" SG_ 1831 LIFT_GATE_STAT 0;
BA_ "GenSigTimeoutTime_TCM" SG_ 1831 LIFT_GATE_STAT 0;
BA_ "GenSigTimeoutTime_AGSM" SG_ 1831 LT_EXH_STAT 0;
BA_ "GenSigTimeoutTime_BCM" SG_ 1831 LT_EXH_STAT 0;
BA_ "GenSigTimeoutTime_BSM" SG_ 1831 LT_EXH_STAT 0;
BA_ "GenSigTimeoutTime_CADM" SG_ 1831 LT_EXH_STAT 0;
BA_ "GenSigTimeoutTime_DMSM" SG_ 1831 LT_EXH_STAT 0;
BA_ "GenSigTimeoutTime_DTCM" SG_ 1831 LT_EXH_STAT 0;
BA_ "GenSigTimeoutTime_ECM" SG_ 1831 LT_EXH_STAT 0;
BA_ "GenSigTimeoutTime_EVCU2" SG_ 1831 LT_EXH_STAT 0;
BA_ "GenSigTimeoutTime_GNMM" SG_ 1831 LT_EXH_STAT 0;
BA_ "GenSigTimeoutTime_HCP" SG_ 1831 LT_EXH_STAT 0;
BA_ "GenSigTimeoutTime_IPC" SG_ 1831 LT_EXH_STAT 0;
BA_ "GenSigTimeoutTime_RFHM" SG_ 1831 LT_EXH_STAT 0;
BA_ "GenSigTimeoutTime_TCM" SG_ 1831 LT_EXH_STAT 0;
BA_ "GenSigTimeoutTime_AGSM" SG_ 1831 NAT_GAS_STAT 0;
BA_ "GenSigTimeoutTime_BCM" SG_ 1831 NAT_GAS_STAT 0;
BA_ "GenSigTimeoutTime_BSM" SG_ 1831 NAT_GAS_STAT 0;
BA_ "GenSigTimeoutTime_CADM" SG_ 1831 NAT_GAS_STAT 0;
BA_ "GenSigTimeoutTime_DMSM" SG_ 1831 NAT_GAS_STAT 0;
BA_ "GenSigTimeoutTime_DTCM" SG_ 1831 NAT_GAS_STAT 0;
BA_ "GenSigTimeoutTime_ECM" SG_ 1831 NAT_GAS_STAT 0;
BA_ "GenSigTimeoutTime_EVCU2" SG_ 1831 NAT_GAS_STAT 0;
BA_ "GenSigTimeoutTime_GNMM" SG_ 1831 NAT_GAS_STAT 0;
BA_ "GenSigTimeoutTime_HCP" SG_ 1831 NAT_GAS_STAT 0;
BA_ "GenSigTimeoutTime_IPC" SG_ 1831 NAT_GAS_STAT 0;
BA_ "GenSigTimeoutTime_RFHM" SG_ 1831 NAT_GAS_STAT 0;
BA_ "GenSigTimeoutTime_TCM" SG_ 1831 NAT_GAS_STAT 0;
BA_ "GenSigTimeoutTime_AGSM" SG_ 1831 OIL_LEVEL_STAT 0;
BA_ "GenSigTimeoutTime_BCM" SG_ 1831 OIL_LEVEL_STAT 0;
BA_ "GenSigTimeoutTime_BSM" SG_ 1831 OIL_LEVEL_STAT 0;
BA_ "GenSigTimeoutTime_CADM" SG_ 1831 OIL_LEVEL_STAT 0;
BA_ "GenSigTimeoutTime_DMSM" SG_ 1831 OIL_LEVEL_STAT 0;
BA_ "GenSigTimeoutTime_DTCM" SG_ 1831 OIL_LEVEL_STAT 0;
BA_ "GenSigTimeoutTime_ECM" SG_ 1831 OIL_LEVEL_STAT 0;
BA_ "GenSigTimeoutTime_EVCU2" SG_ 1831 OIL_LEVEL_STAT 0;
BA_ "GenSigTimeoutTime_GNMM" SG_ 1831 OIL_LEVEL_STAT 0;
BA_ "GenSigTimeoutTime_HCP" SG_ 1831 OIL_LEVEL_STAT 0;
BA_ "GenSigTimeoutTime_IPC" SG_ 1831 OIL_LEVEL_STAT 0;
BA_ "GenSigTimeoutTime_RFHM" SG_ 1831 OIL_LEVEL_STAT 0;
BA_ "GenSigTimeoutTime_TCM" SG_ 1831 OIL_LEVEL_STAT 0;
BA_ "GenSigTimeoutTime_AGSM" SG_ 1831 OIL_PRESSURE_STAT 0;
BA_ "GenSigTimeoutTime_BCM" SG_ 1831 OIL_PRESSURE_STAT 0;
BA_ "GenSigTimeoutTime_BSM" SG_ 1831 OIL_PRESSURE_STAT 0;
BA_ "GenSigTimeoutTime_CADM" SG_ 1831 OIL_PRESSURE_STAT 0;
BA_ "GenSigTimeoutTime_DMSM" SG_ 1831 OIL_PRESSURE_STAT 0;
BA_ "GenSigTimeoutTime_DTCM" SG_ 1831 OIL_PRESSURE_STAT 0;
BA_ "GenSigTimeoutTime_ECM" SG_ 1831 OIL_PRESSURE_STAT 0;
BA_ "GenSigTimeoutTime_EVCU2" SG_ 1831 OIL_PRESSURE_STAT 0;
BA_ "GenSigTimeoutTime_GNMM" SG_ 1831 OIL_PRESSURE_STAT 0;
BA_ "GenSigTimeoutTime_HCP" SG_ 1831 OIL_PRESSURE_STAT 0;
BA_ "GenSigTimeoutTime_IPC" SG_ 1831 OIL_PRESSURE_STAT 0;
BA_ "GenSigTimeoutTime_RFHM" SG_ 1831 OIL_PRESSURE_STAT 0;
BA_ "GenSigTimeoutTime_TCM" SG_ 1831 OIL_PRESSURE_STAT 0;
BA_ "GenSigTimeoutTime_AGSM" SG_ 1831 OIL_TEMP_STAT 0;
BA_ "GenSigTimeoutTime_BCM" SG_ 1831 OIL_TEMP_STAT 0;
BA_ "GenSigTimeoutTime_BSM" SG_ 1831 OIL_TEMP_STAT 0;
BA_ "GenSigTimeoutTime_CADM" SG_ 1831 OIL_TEMP_STAT 0;
BA_ "GenSigTimeoutTime_DMSM" SG_ 1831 OIL_TEMP_STAT 0;
BA_ "GenSigTimeoutTime_DTCM" SG_ 1831 OIL_TEMP_STAT 0;
BA_ "GenSigTimeoutTime_ECM" SG_ 1831 OIL_TEMP_STAT 0;
BA_ "GenSigTimeoutTime_EVCU2" SG_ 1831 OIL_TEMP_STAT 0;
BA_ "GenSigTimeoutTime_GNMM" SG_ 1831 OIL_TEMP_STAT 0;
BA_ "GenSigTimeoutTime_HCP" SG_ 1831 OIL_TEMP_STAT 0;
BA_ "GenSigTimeoutTime_IPC" SG_ 1831 OIL_TEMP_STAT 0;
BA_ "GenSigTimeoutTime_RFHM" SG_ 1831 OIL_TEMP_STAT 0;
BA_ "GenSigTimeoutTime_TCM" SG_ 1831 OIL_TEMP_STAT 0;
BA_ "GenSigTimeoutTime_AGSM" SG_ 1831 OVER_TEMP_STAT 0;
BA_ "GenSigTimeoutTime_BCM" SG_ 1831 OVER_TEMP_STAT 0;
BA_ "GenSigTimeoutTime_BSM" SG_ 1831 OVER_TEMP_STAT 0;
BA_ "GenSigTimeoutTime_CADM" SG_ 1831 OVER_TEMP_STAT 0;
BA_ "GenSigTimeoutTime_DMSM" SG_ 1831 OVER_TEMP_STAT 0;
BA_ "GenSigTimeoutTime_DTCM" SG_ 1831 OVER_TEMP_STAT 0;
BA_ "GenSigTimeoutTime_ECM" SG_ 1831 OVER_TEMP_STAT 0;
BA_ "GenSigTimeoutTime_EVCU2" SG_ 1831 OVER_TEMP_STAT 0;
BA_ "GenSigTimeoutTime_GNMM" SG_ 1831 OVER_TEMP_STAT 0;
BA_ "GenSigTimeoutTime_HCP" SG_ 1831 OVER_TEMP_STAT 0;
BA_ "GenSigTimeoutTime_IPC" SG_ 1831 OVER_TEMP_STAT 0;
BA_ "GenSigTimeoutTime_RFHM" SG_ 1831 OVER_TEMP_STAT 0;
BA_ "GenSigTimeoutTime_TCM" SG_ 1831 OVER_TEMP_STAT 0;
BA_ "GenSigTimeoutTime_AGSM" SG_ 1831 PARK_BRAKE_STAT 0;
BA_ "GenSigTimeoutTime_BCM" SG_ 1831 PARK_BRAKE_STAT 0;
BA_ "GenSigTimeoutTime_BSM" SG_ 1831 PARK_BRAKE_STAT 0;
BA_ "GenSigTimeoutTime_CADM" SG_ 1831 PARK_BRAKE_STAT 0;
BA_ "GenSigTimeoutTime_DMSM" SG_ 1831 PARK_BRAKE_STAT 0;
BA_ "GenSigTimeoutTime_DTCM" SG_ 1831 PARK_BRAKE_STAT 0;
BA_ "GenSigTimeoutTime_ECM" SG_ 1831 PARK_BRAKE_STAT 0;
BA_ "GenSigTimeoutTime_EVCU2" SG_ 1831 PARK_BRAKE_STAT 0;
BA_ "GenSigTimeoutTime_GNMM" SG_ 1831 PARK_BRAKE_STAT 0;
BA_ "GenSigTimeoutTime_HCP" SG_ 1831 PARK_BRAKE_STAT 0;
BA_ "GenSigTimeoutTime_IPC" SG_ 1831 PARK_BRAKE_STAT 0;
BA_ "GenSigTimeoutTime_RFHM" SG_ 1831 PARK_BRAKE_STAT 0;
BA_ "GenSigTimeoutTime_TCM" SG_ 1831 PARK_BRAKE_STAT 0;
BA_ "GenSigTimeoutTime_AGSM" SG_ 1831 POS_LIGHT_STAT 0;
BA_ "GenSigTimeoutTime_BCM" SG_ 1831 POS_LIGHT_STAT 0;
BA_ "GenSigTimeoutTime_BSM" SG_ 1831 POS_LIGHT_STAT 0;
BA_ "GenSigTimeoutTime_CADM" SG_ 1831 POS_LIGHT_STAT 0;
BA_ "GenSigTimeoutTime_DMSM" SG_ 1831 POS_LIGHT_STAT 0;
BA_ "GenSigTimeoutTime_DTCM" SG_ 1831 POS_LIGHT_STAT 0;
BA_ "GenSigTimeoutTime_ECM" SG_ 1831 POS_LIGHT_STAT 0;
BA_ "GenSigTimeoutTime_EVCU2" SG_ 1831 POS_LIGHT_STAT 0;
BA_ "GenSigTimeoutTime_GNMM" SG_ 1831 POS_LIGHT_STAT 0;
BA_ "GenSigTimeoutTime_HCP" SG_ 1831 POS_LIGHT_STAT 0;
BA_ "GenSigTimeoutTime_IPC" SG_ 1831 POS_LIGHT_STAT 0;
BA_ "GenSigTimeoutTime_RFHM" SG_ 1831 POS_LIGHT_STAT 0;
BA_ "GenSigTimeoutTime_TCM" SG_ 1831 POS_LIGHT_STAT 0;
BA_ "GenSigTimeoutTime_AGSM" SG_ 1831 SEAT_BELT_STAT 0;
BA_ "GenSigTimeoutTime_BCM" SG_ 1831 SEAT_BELT_STAT 0;
BA_ "GenSigTimeoutTime_BSM" SG_ 1831 SEAT_BELT_STAT 0;
BA_ "GenSigTimeoutTime_CADM" SG_ 1831 SEAT_BELT_STAT 0;
BA_ "GenSigTimeoutTime_DMSM" SG_ 1831 SEAT_BELT_STAT 0;
BA_ "GenSigTimeoutTime_DTCM" SG_ 1831 SEAT_BELT_STAT 0;
BA_ "GenSigTimeoutTime_ECM" SG_ 1831 SEAT_BELT_STAT 0;
BA_ "GenSigTimeoutTime_EVCU2" SG_ 1831 SEAT_BELT_STAT 0;
BA_ "GenSigTimeoutTime_GNMM" SG_ 1831 SEAT_BELT_STAT 0;
BA_ "GenSigTimeoutTime_HCP" SG_ 1831 SEAT_BELT_STAT 0;
BA_ "GenSigTimeoutTime_IPC" SG_ 1831 SEAT_BELT_STAT 0;
BA_ "GenSigTimeoutTime_RFHM" SG_ 1831 SEAT_BELT_STAT 0;
BA_ "GenSigTimeoutTime_TCM" SG_ 1831 SEAT_BELT_STAT 0;
BA_ "GenSigTimeoutTime_AGSM" SG_ 1831 SERVICE_ACC_STAT 0;
BA_ "GenSigTimeoutTime_BCM" SG_ 1831 SERVICE_ACC_STAT 0;
BA_ "GenSigTimeoutTime_BSM" SG_ 1831 SERVICE_ACC_STAT 0;
BA_ "GenSigTimeoutTime_CADM" SG_ 1831 SERVICE_ACC_STAT 0;
BA_ "GenSigTimeoutTime_DMSM" SG_ 1831 SERVICE_ACC_STAT 0;
BA_ "GenSigTimeoutTime_DTCM" SG_ 1831 SERVICE_ACC_STAT 0;
BA_ "GenSigTimeoutTime_ECM" SG_ 1831 SERVICE_ACC_STAT 0;
BA_ "GenSigTimeoutTime_EVCU2" SG_ 1831 SERVICE_ACC_STAT 0;
BA_ "GenSigTimeoutTime_GNMM" SG_ 1831 SERVICE_ACC_STAT 0;
BA_ "GenSigTimeoutTime_HCP" SG_ 1831 SERVICE_ACC_STAT 0;
BA_ "GenSigTimeoutTime_IPC" SG_ 1831 SERVICE_ACC_STAT 0;
BA_ "GenSigTimeoutTime_RFHM" SG_ 1831 SERVICE_ACC_STAT 0;
BA_ "GenSigTimeoutTime_TCM" SG_ 1831 SERVICE_ACC_STAT 0;
BA_ "GenSigTimeoutTime_AGSM" SG_ 1831 SERVICE_STAT 0;
BA_ "GenSigTimeoutTime_BCM" SG_ 1831 SERVICE_STAT 0;
BA_ "GenSigTimeoutTime_BSM" SG_ 1831 SERVICE_STAT 0;
BA_ "GenSigTimeoutTime_CADM" SG_ 1831 SERVICE_STAT 0;
BA_ "GenSigTimeoutTime_DMSM" SG_ 1831 SERVICE_STAT 0;
BA_ "GenSigTimeoutTime_DTCM" SG_ 1831 SERVICE_STAT 0;
BA_ "GenSigTimeoutTime_ECM" SG_ 1831 SERVICE_STAT 0;
BA_ "GenSigTimeoutTime_EVCU2" SG_ 1831 SERVICE_STAT 0;
BA_ "GenSigTimeoutTime_GNMM" SG_ 1831 SERVICE_STAT 0;
BA_ "GenSigTimeoutTime_HCP" SG_ 1831 SERVICE_STAT 0;
BA_ "GenSigTimeoutTime_IPC" SG_ 1831 SERVICE_STAT 0;
BA_ "GenSigTimeoutTime_RFHM" SG_ 1831 SERVICE_STAT 0;
BA_ "GenSigTimeoutTime_TCM" SG_ 1831 SERVICE_STAT 0;
BA_ "GenSigTimeoutTime_AGSM" SG_ 1831 SPEED_CTRL_STAT 0;
BA_ "GenSigTimeoutTime_BCM" SG_ 1831 SPEED_CTRL_STAT 0;
BA_ "GenSigTimeoutTime_BSM" SG_ 1831 SPEED_CTRL_STAT 0;
BA_ "GenSigTimeoutTime_CADM" SG_ 1831 SPEED_CTRL_STAT 0;
BA_ "GenSigTimeoutTime_DMSM" SG_ 1831 SPEED_CTRL_STAT 0;
BA_ "GenSigTimeoutTime_DTCM" SG_ 1831 SPEED_CTRL_STAT 0;
BA_ "GenSigTimeoutTime_ECM" SG_ 1831 SPEED_CTRL_STAT 0;
BA_ "GenSigTimeoutTime_EVCU2" SG_ 1831 SPEED_CTRL_STAT 0;
BA_ "GenSigTimeoutTime_GNMM" SG_ 1831 SPEED_CTRL_STAT 0;
BA_ "GenSigTimeoutTime_HCP" SG_ 1831 SPEED_CTRL_STAT 0;
BA_ "GenSigTimeoutTime_IPC" SG_ 1831 SPEED_CTRL_STAT 0;
BA_ "GenSigTimeoutTime_RFHM" SG_ 1831 SPEED_CTRL_STAT 0;
BA_ "GenSigTimeoutTime_TCM" SG_ 1831 SPEED_CTRL_STAT 0;
BA_ "GenSigTimeoutTime_AGSM" SG_ 1831 SPEED_LMT_STAT 0;
BA_ "GenSigTimeoutTime_BCM" SG_ 1831 SPEED_LMT_STAT 0;
BA_ "GenSigTimeoutTime_BSM" SG_ 1831 SPEED_LMT_STAT 0;
BA_ "GenSigTimeoutTime_CADM" SG_ 1831 SPEED_LMT_STAT 0;
BA_ "GenSigTimeoutTime_DMSM" SG_ 1831 SPEED_LMT_STAT 0;
BA_ "GenSigTimeoutTime_DTCM" SG_ 1831 SPEED_LMT_STAT 0;
BA_ "GenSigTimeoutTime_ECM" SG_ 1831 SPEED_LMT_STAT 0;
BA_ "GenSigTimeoutTime_EVCU2" SG_ 1831 SPEED_LMT_STAT 0;
BA_ "GenSigTimeoutTime_GNMM" SG_ 1831 SPEED_LMT_STAT 0;
BA_ "GenSigTimeoutTime_HCP" SG_ 1831 SPEED_LMT_STAT 0;
BA_ "GenSigTimeoutTime_IPC" SG_ 1831 SPEED_LMT_STAT 0;
BA_ "GenSigTimeoutTime_RFHM" SG_ 1831 SPEED_LMT_STAT 0;
BA_ "GenSigTimeoutTime_TCM" SG_ 1831 SPEED_LMT_STAT 0;
BA_ "GenSigTimeoutTime_AGSM" SG_ 1831 STOP_START_STAT 0;
BA_ "GenSigTimeoutTime_BCM" SG_ 1831 STOP_START_STAT 0;
BA_ "GenSigTimeoutTime_BSM" SG_ 1831 STOP_START_STAT 0;
BA_ "GenSigTimeoutTime_CADM" SG_ 1831 STOP_START_STAT 0;
BA_ "GenSigTimeoutTime_DMSM" SG_ 1831 STOP_START_STAT 0;
BA_ "GenSigTimeoutTime_DTCM" SG_ 1831 STOP_START_STAT 0;
BA_ "GenSigTimeoutTime_ECM" SG_ 1831 STOP_START_STAT 0;
BA_ "GenSigTimeoutTime_EVCU2" SG_ 1831 STOP_START_STAT 0;
BA_ "GenSigTimeoutTime_GNMM" SG_ 1831 STOP_START_STAT 0;
BA_ "GenSigTimeoutTime_HCP" SG_ 1831 STOP_START_STAT 0;
BA_ "GenSigTimeoutTime_IPC" SG_ 1831 STOP_START_STAT 0;
BA_ "GenSigTimeoutTime_RFHM" SG_ 1831 STOP_START_STAT 0;
BA_ "GenSigTimeoutTime_TCM" SG_ 1831 STOP_START_STAT 0;
BA_ "GenSigTimeoutTime_AGSM" SG_ 1831 STR_DIR_LT_STAT 0;
BA_ "GenSigTimeoutTime_BCM" SG_ 1831 STR_DIR_LT_STAT 0;
BA_ "GenSigTimeoutTime_BSM" SG_ 1831 STR_DIR_LT_STAT 0;
BA_ "GenSigTimeoutTime_CADM" SG_ 1831 STR_DIR_LT_STAT 0;
BA_ "GenSigTimeoutTime_DMSM" SG_ 1831 STR_DIR_LT_STAT 0;
BA_ "GenSigTimeoutTime_DTCM" SG_ 1831 STR_DIR_LT_STAT 0;
BA_ "GenSigTimeoutTime_ECM" SG_ 1831 STR_DIR_LT_STAT 0;
BA_ "GenSigTimeoutTime_EVCU2" SG_ 1831 STR_DIR_LT_STAT 0;
BA_ "GenSigTimeoutTime_GNMM" SG_ 1831 STR_DIR_LT_STAT 0;
BA_ "GenSigTimeoutTime_HCP" SG_ 1831 STR_DIR_LT_STAT 0;
BA_ "GenSigTimeoutTime_IPC" SG_ 1831 STR_DIR_LT_STAT 0;
BA_ "GenSigTimeoutTime_RFHM" SG_ 1831 STR_DIR_LT_STAT 0;
BA_ "GenSigTimeoutTime_TCM" SG_ 1831 STR_DIR_LT_STAT 0;
BA_ "GenSigTimeoutTime_AGSM" SG_ 1831 THEFT_ALARM_STAT 0;
BA_ "GenSigTimeoutTime_BCM" SG_ 1831 THEFT_ALARM_STAT 0;
BA_ "GenSigTimeoutTime_BSM" SG_ 1831 THEFT_ALARM_STAT 0;
BA_ "GenSigTimeoutTime_CADM" SG_ 1831 THEFT_ALARM_STAT 0;
BA_ "GenSigTimeoutTime_DMSM" SG_ 1831 THEFT_ALARM_STAT 0;
BA_ "GenSigTimeoutTime_DTCM" SG_ 1831 THEFT_ALARM_STAT 0;
BA_ "GenSigTimeoutTime_ECM" SG_ 1831 THEFT_ALARM_STAT 0;
BA_ "GenSigTimeoutTime_EVCU2" SG_ 1831 THEFT_ALARM_STAT 0;
BA_ "GenSigTimeoutTime_GNMM" SG_ 1831 THEFT_ALARM_STAT 0;
BA_ "GenSigTimeoutTime_HCP" SG_ 1831 THEFT_ALARM_STAT 0;
BA_ "GenSigTimeoutTime_IPC" SG_ 1831 THEFT_ALARM_STAT 0;
BA_ "GenSigTimeoutTime_RFHM" SG_ 1831 THEFT_ALARM_STAT 0;
BA_ "GenSigTimeoutTime_TCM" SG_ 1831 THEFT_ALARM_STAT 0;
BA_ "GenSigTimeoutTime_AGSM" SG_ 1831 TIRE_PRESSURE_STAT 0;
BA_ "GenSigTimeoutTime_BCM" SG_ 1831 TIRE_PRESSURE_STAT 0;
BA_ "GenSigTimeoutTime_BSM" SG_ 1831 TIRE_PRESSURE_STAT 0;
BA_ "GenSigTimeoutTime_CADM" SG_ 1831 TIRE_PRESSURE_STAT 0;
BA_ "GenSigTimeoutTime_DMSM" SG_ 1831 TIRE_PRESSURE_STAT 0;
BA_ "GenSigTimeoutTime_DTCM" SG_ 1831 TIRE_PRESSURE_STAT 0;
BA_ "GenSigTimeoutTime_ECM" SG_ 1831 TIRE_PRESSURE_STAT 0;
BA_ "GenSigTimeoutTime_EVCU2" SG_ 1831 TIRE_PRESSURE_STAT 0;
BA_ "GenSigTimeoutTime_GNMM" SG_ 1831 TIRE_PRESSURE_STAT 0;
BA_ "GenSigTimeoutTime_HCP" SG_ 1831 TIRE_PRESSURE_STAT 0;
BA_ "GenSigTimeoutTime_IPC" SG_ 1831 TIRE_PRESSURE_STAT 0;
BA_ "GenSigTimeoutTime_RFHM" SG_ 1831 TIRE_PRESSURE_STAT 0;
BA_ "GenSigTimeoutTime_TCM" SG_ 1831 TIRE_PRESSURE_STAT 0;
BA_ "GenSigTimeoutTime_AGSM" SG_ 1831 TORQUE_STAT 0;
BA_ "GenSigTimeoutTime_BCM" SG_ 1831 TORQUE_STAT 0;
BA_ "GenSigTimeoutTime_BSM" SG_ 1831 TORQUE_STAT 0;
BA_ "GenSigTimeoutTime_CADM" SG_ 1831 TORQUE_STAT 0;
BA_ "GenSigTimeoutTime_DMSM" SG_ 1831 TORQUE_STAT 0;
BA_ "GenSigTimeoutTime_DTCM" SG_ 1831 TORQUE_STAT 0;
BA_ "GenSigTimeoutTime_ECM" SG_ 1831 TORQUE_STAT 0;
BA_ "GenSigTimeoutTime_EVCU2" SG_ 1831 TORQUE_STAT 0;
BA_ "GenSigTimeoutTime_GNMM" SG_ 1831 TORQUE_STAT 0;
BA_ "GenSigTimeoutTime_HCP" SG_ 1831 TORQUE_STAT 0;
BA_ "GenSigTimeoutTime_IPC" SG_ 1831 TORQUE_STAT 0;
BA_ "GenSigTimeoutTime_RFHM" SG_ 1831 TORQUE_STAT 0;
BA_ "GenSigTimeoutTime_TCM" SG_ 1831 TORQUE_STAT 0;
BA_ "GenSigTimeoutTime_AGSM" SG_ 1831 TOW_HAUL_STAT 0;
BA_ "GenSigTimeoutTime_BCM" SG_ 1831 TOW_HAUL_STAT 0;
BA_ "GenSigTimeoutTime_BSM" SG_ 1831 TOW_HAUL_STAT 0;
BA_ "GenSigTimeoutTime_CADM" SG_ 1831 TOW_HAUL_STAT 0;
BA_ "GenSigTimeoutTime_DMSM" SG_ 1831 TOW_HAUL_STAT 0;
BA_ "GenSigTimeoutTime_DTCM" SG_ 1831 TOW_HAUL_STAT 0;
BA_ "GenSigTimeoutTime_ECM" SG_ 1831 TOW_HAUL_STAT 0;
BA_ "GenSigTimeoutTime_EVCU2" SG_ 1831 TOW_HAUL_STAT 0;
BA_ "GenSigTimeoutTime_GNMM" SG_ 1831 TOW_HAUL_STAT 0;
BA_ "GenSigTimeoutTime_HCP" SG_ 1831 TOW_HAUL_STAT 0;
BA_ "GenSigTimeoutTime_IPC" SG_ 1831 TOW_HAUL_STAT 0;
BA_ "GenSigTimeoutTime_RFHM" SG_ 1831 TOW_HAUL_STAT 0;
BA_ "GenSigTimeoutTime_TCM" SG_ 1831 TOW_HAUL_STAT 0;
BA_ "GenSigTimeoutTime_AGSM" SG_ 1831 TRK_OPN_STAT 0;
BA_ "GenSigTimeoutTime_BCM" SG_ 1831 TRK_OPN_STAT 0;
BA_ "GenSigTimeoutTime_BSM" SG_ 1831 TRK_OPN_STAT 0;
BA_ "GenSigTimeoutTime_CADM" SG_ 1831 TRK_OPN_STAT 0;
BA_ "GenSigTimeoutTime_DMSM" SG_ 1831 TRK_OPN_STAT 0;
BA_ "GenSigTimeoutTime_DTCM" SG_ 1831 TRK_OPN_STAT 0;
BA_ "GenSigTimeoutTime_ECM" SG_ 1831 TRK_OPN_STAT 0;
BA_ "GenSigTimeoutTime_EVCU2" SG_ 1831 TRK_OPN_STAT 0;
BA_ "GenSigTimeoutTime_GNMM" SG_ 1831 TRK_OPN_STAT 0;
BA_ "GenSigTimeoutTime_HCP" SG_ 1831 TRK_OPN_STAT 0;
BA_ "GenSigTimeoutTime_IPC" SG_ 1831 TRK_OPN_STAT 0;
BA_ "GenSigTimeoutTime_RFHM" SG_ 1831 TRK_OPN_STAT 0;
BA_ "GenSigTimeoutTime_TCM" SG_ 1831 TRK_OPN_STAT 0;
BA_ "GenSigTimeoutTime_AGSM" SG_ 1831 WATER_IN_FUEL_STAT 0;
BA_ "GenSigTimeoutTime_BCM" SG_ 1831 WATER_IN_FUEL_STAT 0;
BA_ "GenSigTimeoutTime_BSM" SG_ 1831 WATER_IN_FUEL_STAT 0;
BA_ "GenSigTimeoutTime_CADM" SG_ 1831 WATER_IN_FUEL_STAT 0;
BA_ "GenSigTimeoutTime_DMSM" SG_ 1831 WATER_IN_FUEL_STAT 0;
BA_ "GenSigTimeoutTime_DTCM" SG_ 1831 WATER_IN_FUEL_STAT 0;
BA_ "GenSigTimeoutTime_ECM" SG_ 1831 WATER_IN_FUEL_STAT 0;
BA_ "GenSigTimeoutTime_EVCU2" SG_ 1831 WATER_IN_FUEL_STAT 0;
BA_ "GenSigTimeoutTime_GNMM" SG_ 1831 WATER_IN_FUEL_STAT 0;
BA_ "GenSigTimeoutTime_HCP" SG_ 1831 WATER_IN_FUEL_STAT 0;
BA_ "GenSigTimeoutTime_IPC" SG_ 1831 WATER_IN_FUEL_STAT 0;
BA_ "GenSigTimeoutTime_RFHM" SG_ 1831 WATER_IN_FUEL_STAT 0;
BA_ "GenSigTimeoutTime_TCM" SG_ 1831 WATER_IN_FUEL_STAT 0;
BA_ "GenSigTimeoutTime_AGSM" SG_ 1831 WINDSHIELD_FLUID_STAT 0;
BA_ "GenSigTimeoutTime_BCM" SG_ 1831 WINDSHIELD_FLUID_STAT 0;
BA_ "GenSigTimeoutTime_BSM" SG_ 1831 WINDSHIELD_FLUID_STAT 0;
BA_ "GenSigTimeoutTime_CADM" SG_ 1831 WINDSHIELD_FLUID_STAT 0;
BA_ "GenSigTimeoutTime_DMSM" SG_ 1831 WINDSHIELD_FLUID_STAT 0;
BA_ "GenSigTimeoutTime_DTCM" SG_ 1831 WINDSHIELD_FLUID_STAT 0;
BA_ "GenSigTimeoutTime_ECM" SG_ 1831 WINDSHIELD_FLUID_STAT 0;
BA_ "GenSigTimeoutTime_EVCU2" SG_ 1831 WINDSHIELD_FLUID_STAT 0;
BA_ "GenSigTimeoutTime_GNMM" SG_ 1831 WINDSHIELD_FLUID_STAT 0;
BA_ "GenSigTimeoutTime_HCP" SG_ 1831 WINDSHIELD_FLUID_STAT 0;
BA_ "GenSigTimeoutTime_IPC" SG_ 1831 WINDSHIELD_FLUID_STAT 0;
BA_ "GenSigTimeoutTime_RFHM" SG_ 1831 WINDSHIELD_FLUID_STAT 0;
BA_ "GenSigTimeoutTime_TCM" SG_ 1831 WINDSHIELD_FLUID_STAT 0;
BA_ "GenSigTimeoutTime_AGSM" SG_ 600 AirBagLamp_FailSts 0;
BA_ "GenSigTimeoutTime_BSM" SG_ 600 AirBagLamp_FailSts 0;
BA_ "GenSigTimeoutTime_CADM" SG_ 600 AirBagLamp_FailSts 0;
BA_ "GenSigTimeoutTime_DMSM" SG_ 600 AirBagLamp_FailSts 0;
BA_ "GenSigTimeoutTime_DTCM" SG_ 600 AirBagLamp_FailSts 0;
BA_ "GenSigTimeoutTime_ECM" SG_ 600 AirBagLamp_FailSts 0;
BA_ "GenSigTimeoutTime_EVCU2" SG_ 600 AirBagLamp_FailSts 0;
BA_ "GenSigTimeoutTime_GNMM" SG_ 600 AirBagLamp_FailSts 0;
BA_ "GenSigTimeoutTime_HCP" SG_ 600 AirBagLamp_FailSts 0;
BA_ "GenSigTimeoutTime_IPC" SG_ 600 AirBagLamp_FailSts 0;
BA_ "GenSigTimeoutTime_RFHM" SG_ 600 AirBagLamp_FailSts 0;
BA_ "GenSigTimeoutTime_TCM" SG_ 600 AirBagLamp_FailSts 0;
BA_ "GenSigSendType" SG_ 600 DisplayedSpeedLimSts 3;
BA_ "GenSigTimeoutTime_AGSM" SG_ 600 DisplayedSpeedLimSts 0;
BA_ "GenSigTimeoutTime_BCM" SG_ 600 DisplayedSpeedLimSts 0;
BA_ "GenSigTimeoutTime_BSM" SG_ 600 DisplayedSpeedLimSts 0;
BA_ "GenSigTimeoutTime_CADM" SG_ 600 DisplayedSpeedLimSts 0;
BA_ "GenSigTimeoutTime_DMSM" SG_ 600 DisplayedSpeedLimSts 0;
BA_ "GenSigTimeoutTime_DTCM" SG_ 600 DisplayedSpeedLimSts 0;
BA_ "GenSigTimeoutTime_ECM" SG_ 600 DisplayedSpeedLimSts 0;
BA_ "GenSigTimeoutTime_GNMM" SG_ 600 DisplayedSpeedLimSts 0;
BA_ "GenSigTimeoutTime_HCP" SG_ 600 DisplayedSpeedLimSts 0;
BA_ "GenSigTimeoutTime_IPC" SG_ 600 DisplayedSpeedLimSts 0;
BA_ "GenSigTimeoutTime_RFHM" SG_ 600 DisplayedSpeedLimSts 0;
BA_ "GenSigTimeoutTime_TCM" SG_ 600 DisplayedSpeedLimSts 0;
BA_ "GenSigTimeoutTime_AGSM" SG_ 600 OilChgRst 0;
BA_ "GenSigTimeoutTime_BCM" SG_ 600 OilChgRst 0;
BA_ "GenSigTimeoutTime_BSM" SG_ 600 OilChgRst 0;
BA_ "GenSigTimeoutTime_CADM" SG_ 600 OilChgRst 0;
BA_ "GenSigTimeoutTime_DMSM" SG_ 600 OilChgRst 0;
BA_ "GenSigTimeoutTime_DTCM" SG_ 600 OilChgRst 0;
BA_ "GenSigTimeoutTime_EVCU2" SG_ 600 OilChgRst 0;
BA_ "GenSigTimeoutTime_GNMM" SG_ 600 OilChgRst 0;
BA_ "GenSigTimeoutTime_HCP" SG_ 600 OilChgRst 0;
BA_ "GenSigTimeoutTime_IPC" SG_ 600 OilChgRst 0;
BA_ "GenSigTimeoutTime_RFHM" SG_ 600 OilChgRst 0;
BA_ "GenSigTimeoutTime_SGW" SG_ 600 OilChgRst 0;
BA_ "GenSigTimeoutTime_TCM" SG_ 600 OilChgRst 0;
BA_ "GenSigTimeoutTime_AGSM" SG_ 1154 Est_Range_Disp 0;
BA_ "GenSigTimeoutTime_BCM" SG_ 1154 Est_Range_Disp 0;
BA_ "GenSigTimeoutTime_BSM" SG_ 1154 Est_Range_Disp 0;
BA_ "GenSigTimeoutTime_CADM" SG_ 1154 Est_Range_Disp 0;
BA_ "GenSigTimeoutTime_DMSM" SG_ 1154 Est_Range_Disp 0;
BA_ "GenSigTimeoutTime_DTCM" SG_ 1154 Est_Range_Disp 0;
BA_ "GenSigTimeoutTime_ECM" SG_ 1154 Est_Range_Disp 0;
BA_ "GenSigTimeoutTime_EVCU2" SG_ 1154 Est_Range_Disp 0;
BA_ "GenSigTimeoutTime_GNMM" SG_ 1154 Est_Range_Disp 0;
BA_ "GenSigTimeoutTime_HCP" SG_ 1154 Est_Range_Disp 0;
BA_ "GenSigTimeoutTime_IPC" SG_ 1154 Est_Range_Disp 0;
BA_ "GenSigTimeoutTime_RFHM" SG_ 1154 Est_Range_Disp 0;
BA_ "GenSigTimeoutTime_TCM" SG_ 1154 Est_Range_Disp 0;
BA_ "GenSigTimeoutTime_AGSM" SG_ 1154 Est_Range_Disp_Long 0;
BA_ "GenSigTimeoutTime_BCM" SG_ 1154 Est_Range_Disp_Long 0;
BA_ "GenSigTimeoutTime_BSM" SG_ 1154 Est_Range_Disp_Long 0;
BA_ "GenSigTimeoutTime_CADM" SG_ 1154 Est_Range_Disp_Long 0;
BA_ "GenSigTimeoutTime_DMSM" SG_ 1154 Est_Range_Disp_Long 0;
BA_ "GenSigTimeoutTime_DTCM" SG_ 1154 Est_Range_Disp_Long 0;
BA_ "GenSigTimeoutTime_ECM" SG_ 1154 Est_Range_Disp_Long 0;
BA_ "GenSigTimeoutTime_EVCU2" SG_ 1154 Est_Range_Disp_Long 0;
BA_ "GenSigTimeoutTime_GNMM" SG_ 1154 Est_Range_Disp_Long 0;
BA_ "GenSigTimeoutTime_HCP" SG_ 1154 Est_Range_Disp_Long 0;
BA_ "GenSigTimeoutTime_IPC" SG_ 1154 Est_Range_Disp_Long 0;
BA_ "GenSigTimeoutTime_RFHM" SG_ 1154 Est_Range_Disp_Long 0;
BA_ "GenSigTimeoutTime_TCM" SG_ 1154 Est_Range_Disp_Long 0;
BA_ "GenSigTimeoutTime_AGSM" SG_ 1154 VehSpd_MPH 0;
BA_ "GenSigTimeoutTime_BCM" SG_ 1154 VehSpd_MPH 0;
BA_ "GenSigTimeoutTime_BSM" SG_ 1154 VehSpd_MPH 0;
BA_ "GenSigTimeoutTime_CADM" SG_ 1154 VehSpd_MPH 0;
BA_ "GenSigTimeoutTime_DMSM" SG_ 1154 VehSpd_MPH 0;
BA_ "GenSigTimeoutTime_DTCM" SG_ 1154 VehSpd_MPH 0;
BA_ "GenSigTimeoutTime_ECM" SG_ 1154 VehSpd_MPH 0;
BA_ "GenSigTimeoutTime_EVCU2" SG_ 1154 VehSpd_MPH 0;
BA_ "GenSigTimeoutTime_GNMM" SG_ 1154 VehSpd_MPH 0;
BA_ "GenSigTimeoutTime_HCP" SG_ 1154 VehSpd_MPH 0;
BA_ "GenSigTimeoutTime_IPC" SG_ 1154 VehSpd_MPH 0;
BA_ "GenSigTimeoutTime_RFHM" SG_ 1154 VehSpd_MPH 0;
BA_ "GenSigTimeoutTime_TCM" SG_ 1154 VehSpd_MPH 0;
BA_ "GenSigStartValue" SG_ 1154 VehSpdDisp 65535;
BA_ "GenSigTimeoutTime_AGSM" SG_ 1154 VehSpdDisp 0;
BA_ "GenSigTimeoutTime_BCM" SG_ 1154 VehSpdDisp 0;
BA_ "GenSigTimeoutTime_BSM" SG_ 1154 VehSpdDisp 0;
BA_ "GenSigTimeoutTime_CADM" SG_ 1154 VehSpdDisp 0;
BA_ "GenSigTimeoutTime_DMSM" SG_ 1154 VehSpdDisp 0;
BA_ "GenSigTimeoutTime_DTCM" SG_ 1154 VehSpdDisp 0;
BA_ "GenSigTimeoutTime_ECM" SG_ 1154 VehSpdDisp 0;
BA_ "GenSigTimeoutTime_EVCU2" SG_ 1154 VehSpdDisp 0;
BA_ "GenSigTimeoutTime_GNMM" SG_ 1154 VehSpdDisp 0;
BA_ "GenSigTimeoutTime_HCP" SG_ 1154 VehSpdDisp 0;
BA_ "GenSigTimeoutTime_IPC" SG_ 1154 VehSpdDisp 0;
BA_ "GenSigTimeoutTime_RFHM" SG_ 1154 VehSpdDisp 0;
BA_ "GenSigTimeoutTime_TCM" SG_ 1154 VehSpdDisp 0;
VAL_ 1956 MotorA_InverterState 0 "NORMAL_PWR_STAGE_OFF" 1 "NORMAL_PWR_STAGE_ON" 2 "PWR_STAGE_ON_SHUTDWN_PNDING" 3 "ACTIVE_DISCHARGE" 4 "INVERTER_FAULTED";
VAL_ 1956 MotorB_InverterState 0 "NORMAL_PWR_STAGE_OFF" 1 "NORMAL_PWR_STAGE_ON" 2 "PWR_STAGE_ON_SHUTDWN_PNDING" 3 "ACTIVE_DISCHARGE" 4 "INVERTER_FAULTED";
VAL_ 1956 Warning_DCDCPerformance_DPT 0 "Normal" 1 "Warning";
VAL_ 1956 Warning_DCDCTemp_DPT 0 "Normal" 1 "Warning";
VAL_ 1956 Warning_InverterA_Overtemp 0 "Normal" 1 "Warning";
VAL_ 1956 Warning_InverterB_Overtemp 0 "Normal" 1 "Warning";
VAL_ 1956 Warning_MotorA_Overtemp 0 "Normal" 1 "Warning";
VAL_ 1956 Warning_MotorB_Overtemp 0 "Normal" 1 "Warning";
VAL_ 1853 APM_CtrlSts_Fbk 0 "IDLE" 1 "Buck_CV_voltage" 2 "Buck_CC_current_control" 3 "APM_Temporary_Fault" 4 "Buck_Special" 6 "PreCharge" 7 "DisCharge" 8 "OFF" 9 "Derating" 10 "APM_Critical_Fault" 15 "SNA";
VAL_ 1853 APM_FailureReason 0 "No_Failure" 1 "Fail_high_voltage_at_HV" 2 "Fail_low_voltage_at_HV" 3 "Fail_high_voltage_at_LV" 4 "Fail_low_voltage_at_LV" 5 "Fail_high_PCB_temperature" 6 "Fail_high_DCB_temperature" 7 "Fail_high_cur_at_LV" 8 "Fail_high_cur_at_HV" 9 "Fail_short_circ_at_LV" 10 "Fail_short_circ_at_HV" 11 "Fail_open_circ_at_LV" 12 "Fail_open_circ_at_HV" 13 "Fail_init_failure" 14 "Fail_wake_up_issue" 15 "Fail_internal_hardware" 16 "Fail_bat_feed_low" 17 "Fail_bat_feed_high" 18 "Fail_Aux_OV" 19 "Fail_Aux_UV" 20 "Fail_HVIL_fault" 21 "Fail_LOC_with_HCP" 22 "Fail_LOC_with_BPCM" 23 "Fail_cont_not_closed" 24 "Fail_SBC_fault" 25 "Memory_Fail" 26 "Implausible_data_from_HCP" 27 "Implausible_data_from_BPCM" 28 "CAN_bus_off" 29 "Fail_temp_diff_is_high" 30 "Fail_high_voltage_diff_is_high" 31 "Fail_for_other_reason" 32 "LOC_ORC" 33 "Implausble_data_ORC" 63 "SNA";
VAL_ 1853 APM_OutputPower 1023 "SNA";
VAL_ 1032 AirflowRequest 127 "SNA";
VAL_ 1032 LTR_PumpFlowRequest 127 "SNA";
VAL_ 1032 RadiatorFanSts 127 "SNA";
VAL_ 752 CurrBattFailStatus 0 "Fail_not_present" 1 "Fail_present";
VAL_ 752 IBS3_Error_Internal 0 "NO_ERROR" 1 "ERROR";
VAL_ 752 IBS3_Ibatt 65535 "SNA";
VAL_ 752 IBS3_SOF_V_Accuracy 0 "Inaccurate" 1 "Accurate";
VAL_ 752 IBS3_SOF_VC 127 "SNA";
VAL_ 752 IBS3_Vbatt 511 "SNA";
VAL_ 752 RsErrIBS3 0 "NO_ERROR" 1 "ERROR";
VAL_ 752 VoltBattFailStatus 0 "Fail_not_present" 1 "Fail_present";
VAL_ 754 CurrBattFailStatus_2 0 "Fail_not_present" 1 "Fail_present";
VAL_ 754 IBS3_Error_Internal_2 0 "NO_ERROR" 1 "ERROR";
VAL_ 754 RsErrIBS3_2 0 "NO_ERROR" 1 "ERROR";
VAL_ 754 VoltBattFailStatus_2 0 "Fail_not_present" 1 "Fail_present";
VAL_ 1955 IBS3_FLAG_DISCONNECT 0 "No_Disconnect" 1 "Disconnect";
VAL_ 1955 IBS3_FLAG_DISCONNECT_ADAS 0 "NOT_DISCONNECTED" 1 "DISCONNECTED_DETECTED" 2 "not_used" 3 "SNA";
VAL_ 1955 IBS3_FLAG_DISCONNECT_ADAS_2 0 "NOT_DISCONNECTED" 1 "DISCONNECTED_DETECTED" 2 "not_used" 3 "SNA";
VAL_ 1955 IBS3_IBS_ADAS_OK 0 "unknown" 1 "OK" 2 "NOT_OK" 3 "SNA";
VAL_ 1955 IBS3_IBS_ADAS_OK_2 0 "unknown" 1 "OK" 2 "NOT_OK" 3 "SNA";
VAL_ 1955 IBS3_Q_received 65535 "SNA";
VAL_ 1955 IBS3_Q_released 65535 "SNA";
VAL_ 1955 IBS3_R_Batt 255 "SNA";
VAL_ 1955 IBS3_R_Batt_25 255 "SNA";
VAL_ 1955 IBS3_SOC 127 "SNA";
VAL_ 1955 IBS3_SOC_Accuracy 0 "Inaccurate" 1 "Accurate";
VAL_ 1955 IBS3_SOF_Q 255 "SNA";
VAL_ 1955 IBS3_SOF_Q_Accuracy 0 "Inaccurate" 1 "Accurate";
VAL_ 1955 IBS3_SOH_COR 127 "SNA";
VAL_ 1955 IBS3_SOH_COR_Accuracy 0 "Inaccurate" 1 "Accurate";
VAL_ 1955 IBS3_SOH_Q 127 "SNA";
VAL_ 1955 IBS3_SOH_Q_Accuracy 0 "Inaccurate" 1 "Accurate";
VAL_ 1955 IBS3_SOH_SUL 127 "SNA";
VAL_ 1955 IBS3_SOH_SUL_Accuracy 0 "Inaccurate" 1 "Accurate";
VAL_ 1955 IBS3_T_BATT 255 "SNA";
VAL_ 1955 IBS3_TempFailStatus 0 "Fail_not_present" 1 "Fail_present";
VAL_ 1955 IBS3_Tm_Lst_Reset_Days 4095 "SNA";
VAL_ 1955 IBS3_Tm_Lst_Reset_Sec 65535 "SNA";
VAL_ 100 ControlEncodingReq 5 "ControlEncoding_ENQ" 6 "ControlEncoding_ACK" 21 "ControlEncoding_NACK" 132 "ControlEncoding_EOTp" 133 "ControlEncoding_ENQp" 134 "ControlEncoding_ACK1p" 135 "ControlEncoding_ACK2p";
VAL_ 100 f1_1 0 "Val1_f1_1" 81 "Val5_f1_1" 119 "Val2_f1_1" 145 "Val3_f1_1" 159 "Val4_f1_1";
VAL_ 100 f1_2 0 "Val1_f1_2" 5 "Val2_f1_2" 13 "Val4_f1_2" 14 "Val3_f1_2" 15 "Val5_f1_2";
VAL_ 100 rnd_1 0 "Val1_rnd_1" 58 "Val2_rnd_1" 59 "Val3_rnd_1" 60 "Val4_rnd_1" 61 "Val5_rnd_1" 62 "Val6_rnd_1" 63 "Val7_rnd_1" 64 "Val8_rnd_1" 65 "Val9_rnd_1" 66 "ValA_rnd_1" 67 "ValB_rnd_1" 68 "ValC_rnd_1" 69 "ValD_rnd_1" 70 "ValE_rnd_1" 71 "ValF_rnd_1";
VAL_ 100 rnd_2 0 "Val1_rnd_2" 26 "Val3_rnd_2" 43 "Val5_rnd_2" 79 "Val2_rnd_2" 168 "Val4_rnd_2";
VAL_ 100 rnd_3 0 "Val1_rnd_3" 19 "Val3_rnd_3" 21 "Val5_rnd_3" 32 "Val4_rnd_3" 129 "Val2_rnd_3";
VAL_ 100 rnd_4 0 "Val1_rnd_4" 170 "Val5_rnd_4" 203 "Val2_rnd_4" 221 "Val3_rnd_4" 238 "Val4_rnd_4";
VAL_ 104 ImmoParkReq 0 "None" 1 "Request Park";
VAL_ 104 MKKey_3 36 "FIX__MKKey_3";
VAL_ 104 MKKey_4 214 "FIX__MKKey_4";
VAL_ 104 MKKey_5 1 "FIX__MKKey_5";
VAL_ 104 MKKey_6 77 "FIX__MKKey_6";
VAL_ 104 MKKey1org21 84 "FIX__MKKey_1";
VAL_ 104 MKKey2org22 85 "FIX__MKKey_2";
VAL_ 1626 IMPACTCommand 0 "Do_Not_Actuate" 1 "Actuate";
VAL_ 1626 IMPACTConfirm 0 "Actuate" 1 "Do_Not_Actuate";
VAL_ 1626 IMPACTThreshold 0 "Threshold_Not_Met" 1 "Threshold_Met";
VAL_ 1829 InstantaneousFuelConsumption1 15 "SNA";
VAL_ 1829 InstantaneousFuelConsumption2 15 "SNA";
VAL_ 1829 InstantaneousFuelConsumption3 15 "SNA";
VAL_ 1829 PCODE_CTRL 0 "NO_CODE" 1 "SEND_CODE" 2 "DISP_CODE" 3 "SNA";
VAL_ 1829 Trailer_Trp_Rst 0 "False" 1 "True";
VAL_ 1441 DTE_Ave_Fuel_Econ 1023 "SNA";
VAL_ 1455 A_EV_Kilometers 16777215 "SNA";
VAL_ 1455 A_EV_Miles 16777215 "SNA";
VAL_ 1455 A_Hybrid_Kilometers 16777215 "SNA";
VAL_ 1455 A_Hybrid_Miles 16777215 "SNA";
VAL_ 1455 AudioMenuPopup 0 "Not_Active" 1 "Active";
VAL_ 1455 Avg_Fuel_Econ 1023 "SNA";
VAL_ 1455 Cluster_In_Audio_Md 0 "Not_Active" 1 "Active";
VAL_ 1455 IC_ETM_HUDCustom_Req 0 "Default" 1 "ETM Settings Being Active work by User" 2 "ETM Settings Saved by Cutomer" 3 "SNA";
VAL_ 1455 IPC_NavigationMap_Req 0 "Send_Nav_Map" 1 "Not_Active" 2 "Disable_Projection";
VAL_ 1455 NavigationMapPopUP 0 "Active" 1 "NotActive";
VAL_ 1455 NextNavInstructionPanelTheme 0 "Analog" 1 "Digital" 15 "SNA";
VAL_ 1844 B_EV_Kilometers 16777215 "SNA";
VAL_ 1844 B_EV_Miles 16777215 "SNA";
VAL_ 1844 B_Hybrid_Kilometers 16777215 "SNA";
VAL_ 1844 B_Hybrid_Miles 16777215 "SNA";
VAL_ 1842 Gas_Range 1023 "SNA";
VAL_ 1842 Total_Range 2047 "SNA";
VAL_ 1831 ABS_IND_STAT 0 "Off" 1 "On" 2 "Blinking" 3 "SNA";
VAL_ 1831 ACC_WARN_STAT 0 "Off" 1 "On" 2 "Blinking" 3 "SNA";
VAL_ 1831 AIR_BAG_STAT 0 "Off" 1 "On" 2 "Blinking" 3 "SNA";
VAL_ 1831 AWD_IND_STAT 0 "Off" 1 "On" 2 "Blinking" 3 "SNA";
VAL_ 1831 AWD_SERVICE_STAT 0 "Off" 1 "On" 2 "Blinking" 3 "SNA";
VAL_ 1831 BATTERY_CHARGE_STAT 0 "Off" 1 "On" 2 "Blinking" 3 "SNA";
VAL_ 1831 BRAKE_PAD_STAT 0 "Off" 1 "On" 2 "Blinking" 3 "SNA";
VAL_ 1831 BRK_IND_STAT 0 "Off" 1 "On" 2 "Blinking" 3 "SNA";
VAL_ 1831 CARGO_LT_STAT 0 "Off" 1 "On" 2 "Blinking" 3 "SNA";
VAL_ 1831 CATALYST_TEMP_STAT 0 "Off" 1 "On" 2 "Blinking" 3 "SNA";
VAL_ 1831 COOLENT_LEVEL_STAT 0 "Off" 1 "On" 2 "Blinking" 3 "SNA";
VAL_ 1831 CRUISE_SET_STAT 0 "Off" 1 "On" 2 "Blinking" 3 "SNA";
VAL_ 1831 DAMPING_SYSTEM_STAT 0 "Off" 1 "On" 2 "Blinking" 3 "SNA";
VAL_ 1831 DEF_STAT 0 "Off" 1 "On" 2 "Blinking" 3 "SNA";
VAL_ 1831 DOORS_STAT 0 "Off" 1 "On" 2 "Blinking" 3 "SNA";
VAL_ 1831 ECO_MODE_STAT 0 "Off" 1 "On" 2 "Blinking" 3 "SNA";
VAL_ 1831 ELEC_STAB_STAT 0 "Off" 1 "On" 2 "Blinking" 3 "SNA";
VAL_ 1831 ELECTRIC_WRENCH_STAT 0 "Off" 1 "On" 2 "Blinking" 3 "SNA";
VAL_ 1831 ENGINE_MIL_STAT 0 "Off" 1 "On" 2 "Blinking" 3 "SNA";
VAL_ 1831 ENGINE_TEMP_STAT 0 "Off" 1 "On" 2 "Blinking" 3 "SNA";
VAL_ 1831 EPB_WARN_STAT 0 "Off" 1 "On" 2 "Blinking" 3 "SNA";
VAL_ 1831 EPS_STAT 0 "Off" 1 "On" 2 "Blinking" 3 "SNA";
VAL_ 1831 ESC_OFF_STAT 0 "Off" 1 "On" 2 "Blinking" 3 "SNA";
VAL_ 1831 ETC_CONTROL_STAT 0 "Off" 1 "On" 2 "Blinking" 3 "SNA";
VAL_ 1831 EXH_BRK_STAT 0 "Off" 1 "On" 2 "Blinking" 3 "SNA";
VAL_ 1831 FCW_SYSTEM_STAT 0 "Off" 1 "On" 2 "Blinking" 3 "SNA";
VAL_ 1831 FOUR_WD_SERVICE_STAT 0 "Off" 1 "On" 2 "Blinking" 3 "SNA";
VAL_ 1831 FT_FOG_STAT 0 "Off" 1 "On" 2 "Blinking" 3 "SNA";
VAL_ 1831 FUEL_CAP_STAT 0 "Off" 1 "On" 2 "Blinking" 3 "SNA";
VAL_ 1831 FUEL_CUT_OFF_STAT 0 "Off" 1 "On" 2 "Blinking" 3 "SNA";
VAL_ 1831 HDLT_LVL_STAT 0 "Off" 1 "On" 2 "Blinking" 3 "SNA";
VAL_ 1831 HI_BEAM_STAT 0 "Off" 1 "On" 2 "Blinking" 3 "SNA";
VAL_ 1831 HILL_DESCENT_STAT 0 "Off" 1 "On" 2 "Blinking" 3 "SNA";
VAL_ 1831 HVY_EXH_STAT 0 "Off" 1 "On" 2 "Blinking" 3 "SNA";
VAL_ 1831 LANE_DEPART_FAIL_STAT 0 "Off" 1 "On" 2 "Blinking" 3 "SNA";
VAL_ 1831 LANE_DEPART_STAT 0 "Off" 1 "On" 2 "Blinking" 3 "SNA";
VAL_ 1831 LANE_SENSE_STAT 0 "Off" 1 "On" 2 "Blinking" 3 "SNA";
VAL_ 1831 LIFT_GATE_STAT 0 "Off" 1 "On" 2 "Blinking" 3 "SNA";
VAL_ 1831 LT_EXH_STAT 0 "Off" 1 "On" 2 "Blinking" 3 "SNA";
VAL_ 1831 NAT_GAS_STAT 0 "Off" 1 "On" 2 "Blinking" 3 "SNA";
VAL_ 1831 OIL_LEVEL_STAT 0 "Off" 1 "On" 2 "Blinking" 3 "SNA";
VAL_ 1831 OIL_PRESSURE_STAT 0 "Off" 1 "On" 2 "Blinking" 3 "SNA";
VAL_ 1831 OIL_TEMP_STAT 0 "Off" 1 "On" 2 "Blinking" 3 "SNA";
VAL_ 1831 OVER_TEMP_STAT 0 "Off" 1 "On" 2 "Blinking" 3 "SNA";
VAL_ 1831 PARK_BRAKE_STAT 0 "Off" 1 "On" 2 "Blinking" 3 "SNA";
VAL_ 1831 POS_LIGHT_STAT 0 "Off" 1 "On" 2 "Blinking" 3 "SNA";
VAL_ 1831 SEAT_BELT_STAT 0 "Off" 1 "On" 2 "Blinking" 3 "SNA";
VAL_ 1831 SERVICE_ACC_STAT 0 "Off" 1 "On" 2 "Blinking" 3 "SNA";
VAL_ 1831 SERVICE_STAT 0 "Off" 1 "On" 2 "Blinking" 3 "SNA";
VAL_ 1831 SPEED_CTRL_STAT 0 "Off" 1 "On" 2 "Blinking" 3 "SNA";
VAL_ 1831 SPEED_LMT_STAT 0 "Off" 1 "On" 2 "Blinking" 3 "SNA";
VAL_ 1831 STOP_START_STAT 0 "Off" 1 "On" 2 "Blinking" 3 "SNA";
VAL_ 1831 STR_DIR_LT_STAT 0 "Off" 1 "On" 2 "Blinking" 3 "SNA";
VAL_ 1831 THEFT_ALARM_STAT 0 "Off" 1 "On" 2 "Blinking" 3 "SNA";
VAL_ 1831 TIRE_PRESSURE_STAT 0 "Off" 1 "On" 2 "Blinking" 3 "SNA";
VAL_ 1831 TORQUE_STAT 0 "Off" 1 "On" 2 "Blinking" 3 "SNA";
VAL_ 1831 TOW_HAUL_STAT 0 "Off" 1 "On" 2 "Blinking" 3 "SNA";
VAL_ 1831 TRK_OPN_STAT 0 "Off" 1 "On" 2 "Blinking" 3 "SNA";
VAL_ 1831 WATER_IN_FUEL_STAT 0 "Off" 1 "On" 2 "Blinking" 3 "SNA";
VAL_ 1831 WINDSHIELD_FLUID_STAT 0 "Off" 1 "On" 2 "Blinking" 3 "SNA";
VAL_ 600 AirBagLamp_FailSts 0 "OFF_Fail_not_present" 1 "OFF_Fail_present" 2 "ON_Fail_not_present" 3 "BLINKING_Fail_not_present";
VAL_ 600 DisplayedSpeedLimSts 0 "Sign_Not_Detected" 1 "Speed_Limit_0" 2 "Speed_Limit_1" 3 "Speed_Limit_2" 4 "Speed_Limit_3" 5 "Speed_Limit_4" 6 "Speed_Limit_5" 7 "Speed_Limit_6" 8 "Speed_Limit_7" 9 "Speed_Limit_8" 10 "Speed_Limit_9" 11 "Speed_Limit_10" 12 "Speed_Limit_11" 13 "Speed_Limit_12" 14 "Speed_Limit_13" 15 "Speed_Limit_14" 16 "Speed_Limit_15" 17 "Speed_Limit_16" 18 "Speed_Limit_17" 19 "Speed_Limit_18" 20 "Speed_Limit_19" 21 "Speed_Limit_20" 22 "Speed_Limit_21" 23 "Speed_Limit_22" 24 "Speed_Limit_23" 25 "Speed_Limit_24" 26 "Speed_Limit_25" 27 "Speed_Limit_26" 28 "Speed_Limit_27" 29 "Speed_Limit_28" 30 "Speed_Limit_29" 31 "Speed_Limit_30" 32 "Speed_Limit_31" 33 "Speed_Limit_32" 34 "Speed_Limit_33" 35 "Speed_Limit_34" 36 "Speed_Limit_35" 37 "Speed_Limit_36" 38 "Speed_Limit_37" 39 "Speed_Limit_38" 40 "Speed_Limit_39" 41 "Speed_Limit_40" 42 "Speed_Limit_41" 43 "Speed_Limit_42" 44 "Speed_Limit_43" 45 "Speed_Limit_44" 46 "Speed_Limit_45" 47 "Speed_Limit_46" 48 "Speed_Limit_47" 49 "Speed_Limit_48" 50 "Speed_Limit_49" 51 "Speed_Limit_50" 52 "Speed_Limit_51" 53 "Speed_Limit_52" 54 "Speed_Limit_53" 55 "Speed_Limit_54" 56 "Speed_Limit_55" 57 "Speed_Limit_56" 58 "Speed_Limit_57" 59 "Speed_Limit_58" 60 "Speed_Limit_59" 61 "Speed_Limit_60" 62 "Speed_Limit_61" 63 "Speed_Limit_62" 64 "Speed_Limit_63" 65 "Speed_Limit_64" 66 "Speed_Limit_65" 67 "Speed_Limit_66" 68 "Speed_Limit_67" 69 "Speed_Limit_68" 70 "Speed_Limit_69" 71 "Speed_Limit_70" 72 "Speed_Limit_71" 73 "Speed_Limit_72" 74 "Speed_Limit_73" 75 "Speed_Limit_74" 76 "Speed_Limit_75" 77 "Speed_Limit_76" 78 "Speed_Limit_77" 79 "Speed_Limit_78" 80 "Speed_Limit_79" 81 "Speed_Limit_80" 82 "Speed_Limit_81" 83 "Speed_Limit_82" 84 "Speed_Limit_83" 85 "Speed_Limit_84" 86 "Speed_Limit_85" 87 "Speed_Limit_86" 88 "Speed_Limit_87" 89 "Speed_Limit_88" 90 "Speed_Limit_89" 91 "Speed_Limit_90" 92 "Speed_Limit_91" 93 "Speed_Limit_92" 94 "Speed_Limit_93" 95 "Speed_Limit_94" 96 "Speed_Limit_95" 97 "Speed_Limit_96" 98 "Speed_Limit_97" 99 "Speed_Limit_98" 100 "Speed_Limit_99" 101 "Speed_Limit_100" 102 "Speed_Limit_101" 103 "Speed_Limit_102" 104 "Speed_Limit_103" 105 "Speed_Limit_104" 106 "Speed_Limit_105" 107 "Speed_Limit_106" 108 "Speed_Limit_107" 109 "Speed_Limit_108" 110 "Speed_Limit_109" 111 "Speed_Limit_110" 112 "Speed_Limit_111" 113 "Speed_Limit_112" 114 "Speed_Limit_113" 115 "Speed_Limit_114" 116 "Speed_Limit_115" 117 "Speed_Limit_116" 118 "Speed_Limit_117" 119 "Speed_Limit_118" 120 "Speed_Limit_119" 121 "Speed_Limit_120" 122 "Speed_Limit_121" 123 "Speed_Limit_122" 124 "Speed_Limit_123" 125 "Speed_Limit_124" 126 "Speed_Limit_125" 127 "Speed_Limit_126" 128 "Speed_Limit_127" 129 "Speed_Limit_128" 130 "Speed_Limit_129" 131 "Speed_Limit_130" 132 "Speed_Limit_131" 133 "Speed_Limit_132" 134 "Speed_Limit_133" 135 "Speed_Limit_134" 136 "Speed_Limit_135" 137 "Speed_Limit_136" 138 "Speed_Limit_137" 139 "Speed_Limit_138" 140 "Speed_Limit_139" 141 "Speed_Limit_140" 142 "Speed_Limit_141" 143 "Speed_Limit_142" 144 "Speed_Limit_143" 145 "Speed_Limit_144" 146 "Speed_Limit_145" 147 "Speed_Limit_146" 148 "Speed_Limit_147" 149 "Speed_Limit_148" 150 "Speed_Limit_149" 151 "Speed_Limit_150" 152 "Speed_Limit_151" 153 "Speed_Limit_152" 154 "Speed_Limit_153" 155 "Speed_Limit_154" 156 "Speed_Limit_155" 157 "Speed_Limit_156" 158 "Speed_Limit_157" 159 "Speed_Limit_158" 160 "Speed_Limit_159" 161 "Speed_Limit_160" 162 "Speed_Limit_161" 163 "Speed_Limit_162" 164 "Speed_Limit_163" 165 "Speed_Limit_164" 166 "Speed_Limit_165" 167 "Speed_Limit_166" 168 "Speed_Limit_167" 169 "Speed_Limit_168" 170 "Speed_Limit_169" 171 "Speed_Limit_170" 172 "Speed_Limit_171" 173 "Speed_Limit_172" 174 "Speed_Limit_173" 175 "Speed_Limit_174" 176 "Speed_Limit_175" 177 "Speed_Limit_176" 178 "Speed_Limit_177" 179 "Speed_Limit_178" 180 "Speed_Limit_179" 181 "Speed_Limit_180" 182 "Speed_Limit_181" 183 "Speed_Limit_182" 184 "Speed_Limit_183" 185 "Speed_Limit_184" 186 "Speed_Limit_185" 187 "Speed_Limit_186" 188 "Speed_Limit_187" 189 "Speed_Limit_188" 190 "Speed_Limit_189" 191 "Speed_Limit_190" 192 "Speed_Limit_191" 193 "Speed_Limit_192" 194 "Speed_Limit_193" 195 "Speed_Limit_194" 196 "Speed_Limit_195" 197 "Speed_Limit_196" 198 "Speed_Limit_197" 199 "Speed_Limit_198" 200 "Speed_Limit_199" 201 "Speed_Limit_200" 202 "Speed_Limit_201" 203 "Speed_Limit_202" 204 "Speed_Limit_203" 205 "Speed_Limit_204" 206 "Speed_Limit_205" 207 "Speed_Limit_206" 208 "Speed_Limit_207" 209 "Speed_Limit_208" 210 "Speed_Limit_209" 211 "Speed_Limit_210" 212 "Speed_Limit_211" 213 "Speed_Limit_212" 214 "Speed_Limit_213" 215 "Speed_Limit_214" 216 "Speed_Limit_215" 217 "Speed_Limit_216" 218 "Speed_Limit_217" 219 "Speed_Limit_218" 220 "Speed_Limit_219" 221 "Speed_Limit_220" 222 "Speed_Limit_221" 223 "Speed_Limit_222" 224 "Speed_Limit_223" 225 "Speed_Limit_224" 226 "Speed_Limit_225" 227 "Speed_Limit_226" 228 "Speed_Limit_227" 229 "Speed_Limit_228" 230 "Speed_Limit_229" 231 "Speed_Limit_230" 232 "Speed_Limit_231" 233 "Speed_Limit_232" 234 "Speed_Limit_233" 254 "Speed_Limit_Unlimited" 255 "End_Speed_Limit";
VAL_ 600 OilChgRst 0 "Not_Active" 1 "Active";
VAL_ 1154 Est_Range_Disp 255 "SNA";
VAL_ 1154 Est_Range_Disp_Long 2047 "SNA";
VAL_ 1154 VehSpd_MPH 0 "kph" 1 "mph";
VAL_ 1154 VehSpdDisp 65535 "SNA";
