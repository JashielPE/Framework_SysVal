VERSION ""

NS_ :

BS_:

BU_: AGSM BCM BSM CADM DMSM DTCM ECM EVCU2 GNMM HCP IPC RFHM SGW TCM
BO_ 1846 FOTA_RSP_CADM: 32 CADM
 SG_ Big_ECU_Ready_CADM : 3|2@0+ (1,0) [0|3] "" SGW
 SG_ Download_Status_CADM : 7|2@0+ (1,0) [0|3] "" SGW
 SG_ Update_Status_CADM : 5|2@0+ (1,0) [0|3] "" SGW

BO_ 1825 FOTA_RSP_EVCU2: 32 EVCU2
 SG_ Ready_Status_EVCU2 : 7|2@0+ (1,0) [0|3] "" SGW

BO_ 835 GLIWA_T1_RX: 8 SGW
 SG_ N_PDU : 7|64@0+ (1,0) [0|0] "" ECM

BO_ 834 GLIWA_T1_TX: 8 ECM
 SG_ N_PDU : 7|64@0+ (1,0) [0|0] "" SGW

BO_ 525 GLOB_NAV_FD: 64 GNMM
 SG_ Altitude_RMSE : 143|8@0+ (2,0) [0|506] "cm" CADM
 SG_ CRC_GLOB_NAV : 447|8@0+ (1,0) [0|255] "-" BCM,CADM
 SG_ GNMM_Health : 7|4@0+ (1,0) [0|6] "" BCM,CADM
 SG_ Heading_Angle : 127|16@0+ (0.01,0) [0|360] "deg" CADM
 SG_ Lat_GNMM : 407|32@0+ (5E-08,-90) [-90|124.7483647] "deg" CADM
 SG_ LatAcceleration_GNMM : 19|12@0+ (0.02,-40.96) [-40.96|40.92] "m/s2" CADM
 SG_ LateralVelocity_GNMM : 181|14@0+ (0.01,-81.92) [-81.92|81.9] "m/s" CADM
 SG_ Latitude_RMSE : 103|8@0+ (2,0) [0|506] "cm" CADM
 SG_ Long_GNMM : 327|32@0+ (1E-07,-180) [-180|249.4967294] "deg" CADM
 SG_ LongAcceleration_GNMM : 3|12@0+ (0.02,-40.96) [-40.96|40.92] "m/s2" CADM
 SG_ Longitude_RMSE : 111|8@0+ (2,0) [0|506] "cm" CADM
 SG_ LongitudinalVelocity_GNMM : 213|14@0+ (0.01,-81.92) [-81.92|81.9] "m/s" CADM
 SG_ MessageCounter_GLOB_NAV : 435|4@0+ (1,0) [0|15] "-" BCM,CADM
 SG_ Pitch_RMSE : 159|8@0+ (2,0) [0|506] "deg" CADM
 SG_ PitchRate_GNMM : 83|12@0+ (0.08,-163.84) [-163.84|163.68] "deg/s" CADM
 SG_ Roll_RMSE : 151|8@0+ (2,0) [0|506] "deg" CADM
 SG_ RollRate_GNMM : 67|12@0+ (0.08,-163.84) [-163.84|163.68] "deg/s" CADM
 SG_ VerticalAcceleration_GNMM : 35|12@0+ (0.02,-40.96) [-40.96|40.92] "m/s2" CADM
 SG_ VerticalVelocity_GNMM : 197|14@0+ (0.01,-81.92) [-81.92|81.9] "m/s" CADM
 SG_ YawRate_GNMM : 166|15@0+ (0.01,-163.83) [-163.83|163.83] "deg/s" CADM
 SG_ YawRate_RMSE : 119|8@0+ (2,0) [0|506] "deg" CADM

BO_ 1487 HCP_CHARGING_STAT: 64 EVCU2
 SG_ Chargeport_Lock_Status : 7|2@0+ (1,0) [0|3] "" SGW
 SG_ Cooperative_Status : 66|3@0+ (1,0) [0|7] "" SGW
 SG_ Energy_to_Battery : 9|9@0+ (0.1,0) [0|51.1] "kW" SGW
 SG_ Est_Range_FullCharge : 16|11@0+ (1,0) [0|2047] "km" SGW
 SG_ EV_Charge_Current : 44|11@0+ (0.1,0) [0|204.70] "Amp" SGW
 SG_ EVSE_Power : 37|9@0+ (0.1,0) [0|51.1] "kW" SGW
 SG_ Lv1_EstChargeTime_80 : 63|13@0+ (1,0) [0|8191] "Min" SGW
 SG_ Lv2_EstChargeTime_80 : 79|13@0+ (1,0) [0|8191] "Min" SGW
 SG_ Total_Battery_Capacity : 5|12@0+ (0.1,0) [0|409.5] "kWh" SGW

BO_ 266 HVBATTERY1: 32 HCP
 SG_ HVBatCellVoltage_Max : 36|13@0+ (0.001,0) [0|5] "Volts" SGW
 SG_ HVBatCellVoltage_Min : 108|13@0+ (0.001,0) [0|5] "Volts" SGW
 SG_ HVBatCellVoltage_NumMax : 71|4@0+ (1,0) [0|15] "Volts" SGW
 SG_ HVBatContactorSts : 23|3@0+ (1,0) [0|0] "-" BCM
 SG_ HVBatModuleVoltage_NumMax : 124|5@0+ (1,0) [0|31] "-" SGW
 SG_ HVBatModuleVoltage_NumMin : 132|5@0+ (1,0) [0|31] "-" SGW
 SG_ HVBatteryCurrent : 5|14@0+ (0.1,-512.1) [-512|512] "Amp" ECM,SGW
 SG_ HVBatteryVoltage : 67|12@0+ (0.1,180) [180|511] "Volts" SGW
 SG_ IsolationSts_HVBattery : 38|2@0+ (1,0) [0|0] "-" SGW
 SG_ IsolationSts_HVPowertrain : 54|2@0+ (1,0) [0|0] "-" SGW

BO_ 1027 HVBATTERY2: 32 EVCU2
 SG_ CRC_HVBATTERY2 : 191|8@0+ (1,0) [0|255] "-" BSM,IPC
 SG_ HVBatteryMILRequest : 7|1@0+ (1,0) [0|0] "-" ECM,IPC,SGW
 SG_ MessageCounter_HVBATTERY2 : 179|4@0+ (1,0) [0|15] "-" BSM,IPC

BO_ 1834 HVBATTERY5: 32 EVCU2
 SG_ HVBattery_RealTimeClock : 7|32@0+ (1,0) [0|4294967294] "sec" ECM
 SG_ HVBattery_RealTimeClockV : 36|1@0+ (1,0) [0|0] "-" ECM

BO_ 1579 HYBRID_CHARGING_STATUS: 32 EVCU2
 SG_ ChargeSystemSts : 7|3@0+ (1,0) [0|6] "-" ECM

BO_ 1049 HYBRID_DISPLAY: 32 EVCU2
 SG_ BatteryPowerUsage : 55|8@0+ (1,-125) [-125|130] "kW" SGW
 SG_ BatteryPowerUsageV : 65|1@0+ (1,0) [0|0] "" SGW
 SG_ BatteryPowerUse_Display : 111|8@0+ (1,-125) [-125|130] "kW" SGW
 SG_ BatteryPowerUse_DisplayV : 138|1@0+ (1,0) [0|1] "-" SGW
 SG_ ChargeSystemFault_DPT : 142|1@0+ (1,0) [0|1] "-" IPC,SGW
 SG_ ChargeSystemSts_DPT : 7|3@0+ (1,0) [0|6] "-" BCM,ECM,IPC,SGW
 SG_ ChargingLevelForDisplay : 166|4@0+ (1,0) [0|14] "" IPC,SGW
 SG_ CRC_HYBRID_DISPLAY : 191|8@0+ (1,0) [0|255] "-" BCM,CADM,IPC
 SG_ EnginePowerUse_Display : 33|10@0+ (1,0) [0|1023] "kW" SGW
 SG_ EnginePowerUse_DisplayV : 139|1@0+ (1,0) [0|1] "-" SGW
 SG_ EstimatedRange : 127|8@0+ (1,0) [0|254] "km" SGW
 SG_ FOTA_Schedule_Conflict : 143|1@0+ (1,0) [0|0] "" SGW
 SG_ HCP_EVServiceLampOn : 20|2@0+ (1,0) [0|2] "-" IPC,SGW
 SG_ HVACPowerUse_Display : 134|7@0+ (1,0) [0|127] "kW" SGW
 SG_ HVACPowerUse_DisplayV : 140|1@0+ (1,0) [0|1] "-" SGW
 SG_ HVBatterySOC_Display : 119|8@0+ (0.3922,0) [0|100] "%" BCM,IPC,SGW
 SG_ HVBatterySOC_DisplayV : 141|1@0+ (1,0) [0|1] "-" IPC,SGW
 SG_ HybridEfficiencyCoach : 87|8@0+ (1,-100) [-100|100] "%" SGW
 SG_ HybridEfficiencyCoachV : 67|1@0+ (1,0) [0|1] "-" SGW
 SG_ HybridMILRequest : 135|1@0+ (1,0) [0|1] "-" ECM,SGW
 SG_ HybridOutputPower : 63|8@0+ (1,-100) [-100|100] "%" IPC,SGW
 SG_ HybridOutputPowerV : 66|1@0+ (1,0) [0|1] "-" IPC,SGW
 SG_ Lv1_EstChargeTime : 4|13@0+ (1,0) [0|8190] "min" IPC,SGW
 SG_ Lv2_EstChargeTime : 18|11@0+ (1,0) [0|2046] "min" IPC,SGW
 SG_ MessageCounter_HYBRID_DISPLAY : 179|4@0+ (1,0) [0|15] "-" BCM,CADM,IPC
 SG_ OnePedal_Drive_Sts : 169|2@0+ (1,0) [0|3] "-" BSM,IPC
 SG_ PlugAndChargeSts : 144|1@0+ (1,0) [0|1] "" SGW
 SG_ PopUpMessage1 : 23|1@0+ (1,0) [0|1] "-" IPC,SGW
 SG_ PopUpMessage10 : 70|1@0+ (1,0) [0|1] "-" IPC
 SG_ PopUpMessage11 : 71|1@0+ (1,0) [0|1] "-" IPC
 SG_ PopUpMessage15 : 173|1@0+ (1,0) [0|1] "" IPC
 SG_ PopUpMessage2 : 34|1@0+ (1,0) [0|1] "-" IPC
 SG_ PopUpMessage3 : 35|1@0+ (1,0) [0|1] "-" IPC
 SG_ PopUpMessage4 : 36|1@0+ (1,0) [0|1] "-" IPC
 SG_ PopUpMessage5 : 37|1@0+ (1,0) [0|1] "-" IPC
 SG_ PopUpMessage6 : 38|1@0+ (1,0) [0|1] "-" IPC
 SG_ PopUpMessage7 : 39|1@0+ (1,0) [0|1] "-" IPC
 SG_ PopUpMessage9 : 69|1@0+ (1,0) [0|1] "-" IPC,SGW
 SG_ RefrigerantPressure : 64|9@0+ (0.1,0) [0|40] "bar" BCM
 SG_ Regen_Status : 172|3@0+ (1,0) [0|7] "-" IPC

BO_ 1044 HYBRID_DISPLAY2: 64 EVCU2
 SG_ AWD_Failure_Status : 105|1@0+ (1,0) [0|1] "" IPC
 SG_ BPCM_HV_Temp_Avg : 119|11@0+ (0.1,-40) [-40|164.7] "°C" Vector__XXX
 SG_ DischargingSysStatus : 66|2@0+ (1,0) [0|3] "" RFHM
 SG_ PnC_Failure : 67|1@0+ (1,0) [0|1] "" IPC,SGW
 SG_ PnC_Reattepmt_Failure : 68|1@0+ (1,0) [0|1] "" IPC
 SG_ RI_AC_FAN_Range : 7|10@0+ (0.1,0) [0|102.30] "km" SGW
 SG_ RI_AUDIO_Range : 27|10@0+ (0.1,0) [0|102.3] "km" SGW
 SG_ RI_DEFROST_Range : 13|9@0+ (0.1,0) [0|51.1] "km" SGW
 SG_ RI_LIGHTS_Range : 33|9@0+ (0.1,0) [0|51.1] "km" SGW
 SG_ RI_OTHER_Range : 40|9@0+ (0.1,0) [0|51.1] "km" SGW
 SG_ RI_SEATSWHL_Range : 20|9@0+ (0.1,0) [0|51.1] "km" SGW
 SG_ RI_TOTAL_Range_Add : 63|11@0+ (0.1,0) [0|204.70] "km" SGW

BO_ 1952 HYBRID_HVAC: 32 EVCU2
 SG_ CabinConditioningSts : 15|4@0+ (1,0) [0|9] "-" BCM,SGW
 SG_ CabinPreconditionReqSts : 85|4@0+ (1,0) [0|14] "" IPC
 SG_ CompressorState : 11|4@0+ (1,0) [0|14] "" BCM,SGW
 SG_ ElecClntHtrInletTemp : 39|8@0+ (1,-40) [-40|214] "°C" ECM,SGW
 SG_ ElecCoolantHtrPwr : 23|8@0+ (0.04,0) [0|10.16] "kW" BCM,ECM,SGW
 SG_ FRfShVlvSts : 80|1@0+ (1,0) [0|1] "" BCM,SGW
 SG_ HeaterCoreInletTemp : 7|8@0+ (1,-40) [-40|214] "°C" BCM,ECM
 SG_ HTAuxPmpMontrngRPM : 89|2@0+ (1,0) [0|2] "-" ECM,SGW
 SG_ HTAuxPmpRPMAct : 31|8@0+ (24,0) [0|6096] "rpm" BCM,ECM,SGW
 SG_ HTShtOffVlvReq : 47|1@0+ (1,0) [0|1] "-" BCM,ECM,SGW
 SG_ HVBatCoolantLevelLow_DPT : 87|2@0+ (1,0) [0|2] "" IPC,SGW
 SG_ HVBatCritCondT : 81|1@0+ (1,0) [0|1] "" BCM,SGW
 SG_ Sch_PreCondition_Sts : 97|2@0+ (1,0) [0|2] "" BCM
 SG_ SchCond_Time_Till_Dep : 78|7@0+ (1,0) [0|126] "min" BCM

BO_ 276 HYBRID_POWERTRAIN1: 64 EVCU2
 SG_ Belt_Slip_Detected : 69|1@0+ (1,0) [0|1] "" ECM
 SG_ BSGMaxTrqDyn : 209|10@0+ (0.32,-163.52) [-163.52|163.52] "Nm" ECM
 SG_ BSGMinTrqDyn : 225|10@0+ (0.32,-163.52) [-163.52|163.52] "Nm" ECM
 SG_ CODE_CLEAR_BPCM_GW : 416|1@0+ (1,0) [0|1] "-" ECM
 SG_ CODE_CLEAR_EVCU2 : 418|1@0+ (1,0) [0|1] "-" ECM
 SG_ CRC_HYBRID_POWERTRAIN1 : 447|8@0+ (1,0) [0|255] "-" BSM,CADM,ECM,IPC,TCM
 SG_ DriveMode_PopUpRequest : 431|4@0+ (1,0) [0|14] "-" IPC
 SG_ DriveModeSts_EPT : 427|4@0+ (1,0) [0|14] "-" SGW
 SG_ DriveReady : 423|1@0+ (1,0) [0|1] "-" BCM,IPC,SGW
 SG_ ECMPrepIdleRes : 295|1@0+ (1,0) [0|0] "-" ECM
 SG_ Eng_Off_Allowed : 292|1@0+ (1,0) [0|0] "-" ECM
 SG_ EngActDmpgDsblReq : 291|1@0+ (1,0) [0|0] "-" ECM
 SG_ EngCntrlMode : 283|1@0+ (1,0) [0|0] "-" ECM
 SG_ EngTrqReserveCmd : 263|8@0+ (0.32,0) [0|81.28] "Nm" ECM
 SG_ GeneratorSetpointOverride : 422|1@0+ (1,0) [0|0] "-" ECM
 SG_ HCP_VTD_Freeze : 7|2@0+ (1,0) [0|3] "-" ECM
 SG_ HEV_ESS_Mode : 271|4@0+ (1,0) [0|0] "-" ECM
 SG_ HVBatteryShutOff : 54|1@0+ (1,0) [0|1] "" IPC
 SG_ HybCmndEngTorqImmed : 131|12@0+ (0.32,-300.16) [-300.16|1008] "Nm" ECM
 SG_ HybCmndEngTorqPrdtd : 147|12@0+ (0.32,-300.16) [-300.16|1008] "Nm" ECM
 SG_ HybCmndEngTorqRespTyp : 277|2@0+ (1,0) [0|0] "-" ECM
 SG_ HybCrnkAbrted : 282|1@0+ (1,0) [0|0] "-" ECM
 SG_ HybDFCO_Req : 281|1@0+ (1,0) [0|0] "-" ECM
 SG_ HybEngCylDeactReq : 289|1@0+ (1,0) [0|0] "-" ECM
 SG_ HybFeedback_Engine : 294|1@0+ (1,0) [0|0] "-" ECM
 SG_ HybFstTrqRq_Trans : 293|1@0+ (1,0) [0|0] "-" ECM
 SG_ Hybrid_Remedial_Stop : 290|1@0+ (1,0) [0|0] "-" ECM
 SG_ HybTransSt : 255|8@0+ (1,0) [0|0] "-" ECM
 SG_ InputSpdRaw : 179|12@0+ (1,-2048) [-2048|2046] "rpm" ECM
 SG_ LV_SystemFailure : 421|1@0+ (1,0) [0|0] "-" ECM
 SG_ MessageCounter_HYBRID_POWERTRAI : 435|4@0+ (1,0) [0|15] "-" BSM,CADM,ECM,IPC,TCM
 SG_ NiTi_Disable : 55|1@0+ (1,0) [0|1] "-" ECM
 SG_ PropulsionSystemActive : 408|1@0+ (1,0) [0|1] "-" BCM,ECM,IPC,SGW
 SG_ RegenTarget : 195|12@0+ (0.32,-300.16) [-300.16|1008] "Nm" ECM
 SG_ REPRGD_PFC_CLEAR_BPCM_GW : 417|1@0+ (1,0) [0|1] "-" ECM
 SG_ REPRGD_PFC_CLEAR_EVCU2 : 419|1@0+ (1,0) [0|1] "-" ECM
 SG_ RollingIdleSpeedTarget : 84|13@0+ (1,0) [0|8191] "rpm" ECM
 SG_ TransInpSpdPrfl : 68|13@0+ (1,0) [0|8191] "rpm" ECM

BO_ 269 HYBRID_POWERTRAIN2: 64 HCP
 SG_ BSGActualTorque : 257|10@0+ (0.32,-163.52) [-163.52|163.2] "Nm" BCM,ECM
 SG_ BSGChrgIdleSpeedTarget : 52|13@0+ (1,0) [0|8190] "rpm" ECM
 SG_ CODE_CLR_HCP : 288|1@0+ (1,0) [0|1] "-" ECM
 SG_ CRC_HYBRID_POWERTRAIN2 : 447|8@0+ (1,0) [0|255] "-" BSM,ECM,TCM
 SG_ HybridEngineMaxTorqAllowed : 115|12@0+ (0.32,-300.16) [-300.16|1008] "Nm" ECM
 SG_ IdleSpeedActiveSts : 302|1@0+ (1,0) [0|0] "-" ECM
 SG_ MessageCounter_HYBRID_POWERTRAI : 435|4@0+ (1,0) [0|15] "-" BSM,ECM,TCM
 SG_ REPRGD_PFC_CLR_HCP : 303|1@0+ (1,0) [0|1] "-" ECM
 SG_ ReqTorqueOverLayActive : 297|1@0+ (1,0) [0|1] "-" BCM,TCM
 SG_ TCC_Slip_Rgn : 296|1@0+ (1,0) [0|0] "-" TCM

BO_ 1033 HYBRID_POWERTRAIN5: 32 EVCU2
 SG_ BattPowerUse_Display : 146|11@0+ (1,-750) [-750|1297] "kW" IPC,SGW
 SG_ BattPowerUse_DisplayV : 87|1@0+ (1,0) [0|1] "-" IPC,SGW
 SG_ CRC_HYBRID_POWERTRAIN5 : 191|8@0+ (1,0) [0|255] "-" ECM,TCM
 SG_ ElectricTrqMult4Pedal : 55|8@0+ (0.0078125,-0.9921875) [-0.9921875|0.9921875] "-" ECM
 SG_ HCP_Stop_Start_Fault : 21|1@0+ (1,0) [0|1] "-" ECM
 SG_ HCPMaxEngRPM : 63|8@0+ (32,0) [0|8128] "rpm" ECM
 SG_ HEV_HybPwrtrnRdcdPerfCmnd : 22|1@0+ (1,0) [0|0] "-" ECM
 SG_ Hybrid_AGS2Position : 103|7@0+ (1,0) [0|127] "%" ECM
 SG_ Hybrid_AGSPosition : 31|7@0+ (1,0) [0|127] "%" ECM
 SG_ Hybrid_EVT_ModeSts : 7|1@0+ (1,0) [0|1] "-" BCM,SGW
 SG_ HybridEmissionsMalfunction : 20|1@0+ (1,0) [0|1] "-" Vector__XXX
 SG_ IdleCLoopTrq : 33|10@0+ (0.32,-163.52) [-163.52|163.52] "Nm" ECM
 SG_ MessageCounter_HYBRID_POWERTRAI : 179|4@0+ (1,0) [0|15] "-" ECM,TCM
 SG_ Motor1PowerUse_Display : 96|9@0+ (1,-255) [-255|256] "kW" SGW
 SG_ Motor1PowerUse_DisplayV : 86|1@0+ (1,0) [0|1] "-" SGW
 SG_ Motor2PowerUse_Display : 112|9@0+ (1,-255) [-255|256] "kW" SGW
 SG_ Motor2PowerUse_DisplayV : 85|1@0+ (1,0) [0|1] "-" SGW
 SG_ MotorsPowerUse_Display : 162|11@0+ (1,-1023) [-1023|1024] "kW" SGW
 SG_ MotorsPowerUse_DisplayV : 183|1@0+ (1,0) [0|1] "-" SGW
 SG_ PT_WorkSite_Invtr_Capacity_HCP : 95|5@0+ (100,0) [0|3100] "W" BCM
 SG_ PT_WorkSite_Invtr_Sts_HCP : 182|2@0+ (1,0) [0|3] "" BCM
 SG_ Smartload_Actv : 89|2@0+ (1,0) [0|1] "" ECM

BO_ 1580 HYBRID_POWERTRAIN6: 32 EVCU2
 SG_ V2H_Discharge_Capacity : 55|12@0+ (0.1,0) [0|409.5] "kW" SGW

BO_TX_BU_ 1027 : EVCU2,HCP;
BO_TX_BU_ 1049 : EVCU2,HCP;
BO_TX_BU_ 276 : EVCU2,HCP;
BO_TX_BU_ 1033 : EVCU2,HCP;
CM_ SG_ 1846 Big_ECU_Ready_CADM "Big_ECU_Ready_CADM";
CM_ SG_ 1846 Download_Status_CADM "Download_Status_CADM";
CM_ SG_ 1846 Update_Status_CADM "Update_Status_CADM";
CM_ SG_ 1825 Ready_Status_EVCU2 "This signal is used to communicate from EVCU2 to SGW regarding the status of regarding charging/discharging";
CM_ SG_ 835 N_PDU "This signal is used for diagnostic purposes";
CM_ SG_ 834 N_PDU "This signal is used for diagnostic purposes";
CM_ SG_ 525 Altitude_RMSE "Altitude_RMSE";
CM_ SG_ 525 CRC_GLOB_NAV "CRC according to SAE J1850 standard at each frame transmission.";
CM_ SG_ 525 GNMM_Health "Reported capability of GNMM to provide positioning and acceleration data";
CM_ SG_ 525 Heading_Angle "Heading Angle";
CM_ SG_ 525 Lat_GNMM "Latitude decimal degrees, positive North of the equator";
CM_ SG_ 525 LatAcceleration_GNMM "Lateral Acceleration Value from the GNMM";
CM_ SG_ 525 LateralVelocity_GNMM "Lateral Velocity";
CM_ SG_ 525 Latitude_RMSE "RMS error for Latitude";
CM_ SG_ 525 Long_GNMM "Longitude decimal degrees, positive East of the prime meridian";
CM_ SG_ 525 LongAcceleration_GNMM "Longitudinal Acceleration Value from the GNMM";
CM_ SG_ 525 Longitude_RMSE "RMS error for Longitude";
CM_ SG_ 525 LongitudinalVelocity_GNMM "Longitudinal Velocity";
CM_ SG_ 525 MessageCounter_GLOB_NAV "This signal is a counter used for safety checks strategies. This counter is incremented of 1 (one) unit at each frame transmission.";
CM_ SG_ 525 Pitch_RMSE "Pitch_RMSE";
CM_ SG_ 525 PitchRate_GNMM "Pitch Rate Value from the GNMM";
CM_ SG_ 525 Roll_RMSE "Roll_RMSE";
CM_ SG_ 525 RollRate_GNMM "Roll Rate Value from the GNMM";
CM_ SG_ 525 VerticalAcceleration_GNMM "Vertical Acceleration Value from the GNMM";
CM_ SG_ 525 VerticalVelocity_GNMM "Vertical Velocity";
CM_ SG_ 525 YawRate_GNMM "Yaw Rate Value from the GNMM";
CM_ SG_ 525 YawRate_RMSE "RMS error for YawRate";
CM_ SG_ 1487 Chargeport_Lock_Status "Charge Port Lock Status";
CM_ SG_ 1487 Cooperative_Status "Cooperative charging status";
CM_ SG_ 1487 Energy_to_Battery "HV Battery Charging Energy Rate";
CM_ SG_ 1487 Est_Range_FullCharge "Estimated Range at 100% SOC";
CM_ SG_ 1487 EV_Charge_Current "HV Charging Current Draw from EVSE";
CM_ SG_ 1487 EVSE_Power "EVSE Power available";
CM_ SG_ 1487 Lv1_EstChargeTime_80 "Estimated time to charge to 80% on Level 1";
CM_ SG_ 1487 Lv2_EstChargeTime_80 "Estimated time to charge to 80% on Level 2";
CM_ SG_ 1487 Total_Battery_Capacity "Total Battery capacity in kWh";
CM_ SG_ 266 HVBatCellVoltage_Max "Max cell voltage";
CM_ SG_ 266 HVBatCellVoltage_Min "Min cell voltage";
CM_ SG_ 266 HVBatCellVoltage_NumMax "Cell number - maximum voltage";
CM_ SG_ 266 HVBatContactorSts "HV Battery pack contactor state";
CM_ SG_ 266 HVBatModuleVoltage_NumMax "Module number - maximum voltage; Enumeration  0 = Module 1 ...31 = Module 32.";
CM_ SG_ 266 HVBatModuleVoltage_NumMin "Module number - Minimum voltage; Enumeration  0 = Module 1, ...31 = Module 32.";
CM_ SG_ 266 HVBatteryCurrent "High voltage Battery pack current...";
CM_ SG_ 266 HVBatteryVoltage "High voltage battery pack voltage";
CM_ SG_ 266 IsolationSts_HVBattery "High voltage battery pack Isolation state";
CM_ SG_ 266 IsolationSts_HVPowertrain "Powertrain High voltage Isolation state";
CM_ SG_ 1027 CRC_HVBATTERY2 "CRC according to SAE J1850 standard at each frame transmission.";
CM_ SG_ 1027 HVBatteryMILRequest "MIL Lamp request from BPCM.";
CM_ SG_ 1027 MessageCounter_HVBATTERY2 "This signal is a counter used for safety checks strategies. This counter is incremented of 1 (one) unit at each frame transmission.";
CM_ SG_ 1834 HVBattery_RealTimeClock "32 bit Real Time Clock";
CM_ SG_ 1834 HVBattery_RealTimeClockV "-";
CM_ SG_ 1579 ChargeSystemSts "Charging System status";
CM_ SG_ 1049 BatteryPowerUsage "None";
CM_ SG_ 1049 BatteryPowerUse_Display "Battery power usage for HMI, in KW";
CM_ SG_ 1049 BatteryPowerUse_DisplayV "Validity bit for signal BatPwrUsageDisp, 0=Valid";
CM_ SG_ 1049 ChargeSystemFault_DPT "Charging System Fault status";
CM_ SG_ 1049 ChargeSystemSts_DPT "Charging System status";
CM_ SG_ 1049 ChargingLevelForDisplay "Charging level and type for display";
CM_ SG_ 1049 CRC_HYBRID_DISPLAY "CRC according to SAE J1850 standard at each frame transmission.";
CM_ SG_ 1049 EnginePowerUse_Display "Engine power usage for HMI, in KW";
CM_ SG_ 1049 EnginePowerUse_DisplayV "Validity bit for signal EngPwrUsageDisp, 0=Valid";
CM_ SG_ 1049 EstimatedRange "Estimated electric range sent to HMI";
CM_ SG_ 1049 FOTA_Schedule_Conflict "Scheduled FOTA Installation conflicts present";
CM_ SG_ 1049 HCP_EVServiceLampOn "HEV service lamp request";
CM_ SG_ 1049 HVACPowerUse_Display "HVAC power usage for HMI, in KW";
CM_ SG_ 1049 HVACPowerUse_DisplayV "Validity bit for signal HVACPwrUsageDisp, 0=Valid";
CM_ SG_ 1049 HVBatterySOC_Display "High voltage battery state of charge";
CM_ SG_ 1049 HVBatterySOC_DisplayV "High voltage battery state of charge validity: invalid = [1]";
CM_ SG_ 1049 HybridEfficiencyCoach "Percentage output acceleration & deceleration to support Efficiency Coaching HMI";
CM_ SG_ 1049 HybridEfficiencyCoachV "Acceleration & deceleration to support Efficiency Coaching validtiy, 0 = Valid, 1 = Invalid";
CM_ SG_ 1049 HybridMILRequest "MIL on request from the HCP";
CM_ SG_ 1049 HybridOutputPower "Percentage output power from HCP for HMI";
CM_ SG_ 1049 HybridOutputPowerV "Percentage output power from HCP for HMI validity, 0 = Valid, 1 = Invalid";
CM_ SG_ 1049 Lv1_EstChargeTime "Estimated Time to charge on Level 1";
CM_ SG_ 1049 Lv2_EstChargeTime "Estimated Time to charge on Level 2";
CM_ SG_ 1049 MessageCounter_HYBRID_DISPLAY "This signal is a counter used for safety checks strategies. This counter is incremented of 1 (one) unit at each frame transmission.";
CM_ SG_ 1049 OnePedal_Drive_Sts "Status of the OnePedal Drive feature (OnePedal_Drive_sts on is creep Off)";
CM_ SG_ 1049 PlugAndChargeSts "EVCU Confirmation of Plug and Change status";
CM_ SG_ 1049 PopUpMessage1 "Vehicle speed may be limited; True = [1]";
CM_ SG_ 1049 PopUpMessage10 "High Voltage Functionalities rejected due to Hood Open; True = [1]";
CM_ SG_ 1049 PopUpMessage11 "Charge port door open; True = [1]";
CM_ SG_ 1049 PopUpMessage15 "Propulsion system service required; True=[1]";
CM_ SG_ 1049 PopUpMessage2 "Plug in vehicle to keep battery warm; True = [1]";
CM_ SG_ 1049 PopUpMessage3 "Remote start canceled - hv battery temperature; True = [1]";
CM_ SG_ 1049 PopUpMessage4 "Turn on vehicle to use climate controls; True = [1]";
CM_ SG_ 1049 PopUpMessage5 "Please check plug status before driving; True = [1]";
CM_ SG_ 1049 PopUpMessage6 "There may be a problem with the charging unit; True = [1]";
CM_ SG_ 1049 PopUpMessage7 "Please leave key in run - battery conditioning needed; True = [1]";
CM_ SG_ 1049 PopUpMessage9 "Stop safely. Vehicle will shut off soon; True = [1]";
CM_ SG_ 1049 RefrigerantPressure "Refrigerant pressure (R134a or R1234YF)";
CM_ SG_ 1049 Regen_Status "Level of regeneration(negative torque)";
CM_ SG_ 1044 AWD_Failure_Status "AWD system Failure Status";
CM_ SG_ 1044 BPCM_HV_Temp_Avg "Battery Average Temperature";
CM_ SG_ 1044 DischargingSysStatus "Vehicle to Load/Vehicle - Discharging system status";
CM_ SG_ 1044 PnC_Failure "A Plug and Charge failure has been detected";
CM_ SG_ 1044 PnC_Reattepmt_Failure "The maximum number of authentication retry attempts has been reached";
CM_ SG_ 1044 RI_AC_FAN_Range "Range Impact of Turning AC Off";
CM_ SG_ 1044 RI_AUDIO_Range "Range Impact of Turning Audio Off";
CM_ SG_ 1044 RI_DEFROST_Range "Range Impact of Turning Defrost Off";
CM_ SG_ 1044 RI_LIGHTS_Range "Range Impact of Turning External Lights Off";
CM_ SG_ 1044 RI_OTHER_Range "Range Impact of Turning Other Non-Propulsive Power Consuming Features Off";
CM_ SG_ 1044 RI_SEATSWHL_Range "Range Impact of Turning Seats and Wheel Heating/Venting Off";
CM_ SG_ 1044 RI_TOTAL_Range_Add "Total Range Impact of Turning All Non-Propulsive Power Consuming Features Off";
CM_ SG_ 1952 CabinConditioningSts "Cabin condition status";
CM_ SG_ 1952 CabinPreconditionReqSts "Cabin Preconditioning Request Status";
CM_ SG_ 1952 CompressorState "comppressor state";
CM_ SG_ 1952 ElecClntHtrInletTemp "Electric Coolant Heater Inlet Temperature";
CM_ SG_ 1952 ElecCoolantHtrPwr "Electric Coolant Heater Power";
CM_ SG_ 1952 FRfShVlvSts "Front Refrigerant Shutoff Valve Status  [0] = Open, [1] = Closed";
CM_ SG_ 1952 HeaterCoreInletTemp "Heater Core Inlet Temp";
CM_ SG_ 1952 HTAuxPmpMontrngRPM "High Temp Aux Pump RPM monitoring active";
CM_ SG_ 1952 HTAuxPmpRPMAct "High Temp Aux Pump Status";
CM_ SG_ 1952 HTShtOffVlvReq "High temp shut off valve request; [0] = Open, [1] = Closed";
CM_ SG_ 1952 HVBatCoolantLevelLow_DPT "Battery coolant level low";
CM_ SG_ 1952 HVBatCritCondT "High Voltage Battery Temperature Critical Condition, [1] = True";
CM_ SG_ 1952 Sch_PreCondition_Sts "HCP Status for Scheduled Pre Conditioning Request";
CM_ SG_ 1952 SchCond_Time_Till_Dep "Schedule Cabin Conditonting - Time till Departure for HVAC";
CM_ SG_ 276 Belt_Slip_Detected "Signal to indicate belt slip of BSG";
CM_ SG_ 276 CODE_CLEAR_BPCM_GW "Clear emission related faults; [0] = not clear; [1] = Clear";
CM_ SG_ 276 CODE_CLEAR_EVCU2 "Clear emission related faults; [0] = not clear; [1] = Clear";
CM_ SG_ 276 CRC_HYBRID_POWERTRAIN1 "CRC according to SAE J1850 standard at each frame transmission.";
CM_ SG_ 276 DriveMode_PopUpRequest "Drive modes HMI pop-up message request";
CM_ SG_ 276 DriveModeSts_EPT "Final eDrive mode status";
CM_ SG_ 276 DriveReady "Ready to Drive, [1] = Vehicle is allowed to shift out of park or neutral";
CM_ SG_ 276 ECMPrepIdleRes "ECM to prep for rolling idle reserve";
CM_ SG_ 276 Eng_Off_Allowed "Engine Stop Allowed. 0 = ENG_OFF_NOT_ALLOWED, 1 = ENG_OFF_ALLOWED";
CM_ SG_ 276 EngActDmpgDsblReq "Engine Active Damping Disable Request";
CM_ SG_ 276 EngCntrlMode "EngCntrlMode, [0] = Torque Mode, [1] = Speed Mode";
CM_ SG_ 276 EngTrqReserveCmd "Engine torque reserve command";
CM_ SG_ 276 GeneratorSetpointOverride "Hybrid generator setpoint duty cycle powertrain override active";
CM_ SG_ 276 HCP_VTD_Freeze "HCP request for ITID Freeze";
CM_ SG_ 276 HEV_ESS_Mode "Engine start stop information:  engine start stop mode";
CM_ SG_ 276 HVBatteryShutOff "HV Battery Shutoff indication for China market";
CM_ SG_ 276 HybCmndEngTorqImmed "Hybrid commanded engine torque immediate torque (fast path)";
CM_ SG_ 276 HybCmndEngTorqPrdtd "Hybrid commanded engine torque predicted torque (slow path).";
CM_ SG_ 276 HybCmndEngTorqRespTyp "Hybrid Commanded Engine Torque Response Type";
CM_ SG_ 276 HybCrnkAbrted "Hybrid Crank Aborted";
CM_ SG_ 276 HybDFCO_Req "Hybrid deceleration fuel cut off request";
CM_ SG_ 276 HybEngCylDeactReq "Hybrid engine cylinder deactivation request";
CM_ SG_ 276 HybFeedback_Engine "Indication that the HCP is receiving valid data from the ECM. 0 - False; 1 - True.";
CM_ SG_ 276 HybFstTrqRq_Trans "HCP request for Spark Retard to honor Trans Torque reduction request. 0 - False; 1 - True.";
CM_ SG_ 276 Hybrid_Remedial_Stop "Engine Start Allowed.0 = ENG_ON_ALLOWED, 1 = ENG_ON_NOT_ALLOW";
CM_ SG_ 276 HybTransSt "Hybrid transmission state";
CM_ SG_ 276 InputSpdRaw "Trans input speed from HCP.";
CM_ SG_ 276 LV_SystemFailure "Low voltage system failed";
CM_ SG_ 276 MessageCounter_HYBRID_POWERTRAI "This signal is a counter used for safety checks strategies. This counter is incremented of 1 (one) unit at each frame transmission.";
CM_ SG_ 276 NiTi_Disable "NiTi is disabled by HCP; True = [1]";
CM_ SG_ 276 PropulsionSystemActive "Propulsion system active, [1] = active";
CM_ SG_ 276 RegenTarget "Offset for sum torque request due to regen";
CM_ SG_ 276 REPRGD_PFC_CLEAR_BPCM_GW "Set readiness to 'incomplete' ; [0] = Do nothing, [1] = Set incomplete";
CM_ SG_ 276 REPRGD_PFC_CLEAR_EVCU2 "Set readiness to 'incomplete' ; [0] = Do nothing, [1] = Set incomplete";
CM_ SG_ 276 RollingIdleSpeedTarget "Idle Speed Target";
CM_ SG_ 276 TransInpSpdPrfl "Transmission Input Speed Profile";
CM_ SG_ 269 BSGActualTorque "BSG Actual Torque";
CM_ SG_ 269 BSGChrgIdleSpeedTarget "BSG Charge Idle Speed Target";
CM_ SG_ 269 CODE_CLR_HCP "Clear emission related faults";
CM_ SG_ 269 CRC_HYBRID_POWERTRAIN2 "CRC according to SAE J1850 standard at each frame transmission.";
CM_ SG_ 269 HybridEngineMaxTorqAllowed "HCP maximum torque limit";
CM_ SG_ 269 IdleSpeedActiveSts "Flag to indicate idle speed target [1] = TRUE";
CM_ SG_ 269 MessageCounter_HYBRID_POWERTRAI "This signal is a counter used for safety checks strategies. This counter is incremented of 1 (one) unit at each frame transmission.";
CM_ SG_ 269 REPRGD_PFC_CLR_HCP "Set readiness to \"incomplete\"";
CM_ SG_ 269 ReqTorqueOverLayActive "Regeneration Shift Schedule Request (1 = Active)";
CM_ SG_ 269 TCC_Slip_Rgn "TCC slip during transition regen; Active = [1]";
CM_ SG_ 1033 BattPowerUse_Display "Battery power usage for HMI, in KW";
CM_ SG_ 1033 BattPowerUse_DisplayV "Validity bit for signal BatPwrUsageDisp, 0=Valid";
CM_ SG_ 1033 CRC_HYBRID_POWERTRAIN5 "CRC according to SAE J1850 standard at each frame transmission.";
CM_ SG_ 1033 ElectricTrqMult4Pedal "Adjustment factor for elctric components of pedal max torque.";
CM_ SG_ 1033 HCP_Stop_Start_Fault "Stop/Start Fault, [1] = Active";
CM_ SG_ 1033 HCPMaxEngRPM "Engine rev limit due to HCP/MGU limits";
CM_ SG_ 1033 HEV_HybPwrtrnRdcdPerfCmnd "Driver torque request modifier due to system remedial acion";
CM_ SG_ 1033 Hybrid_AGS2Position "AGS2 position sent to ECM on CAN by the hybrid controller";
CM_ SG_ 1033 Hybrid_AGSPosition "AGS position sent to ECM on CAN by the hybrid controller";
CM_ SG_ 1033 Hybrid_EVT_ModeSts "The system is in EVT mode; Hybrid mode = [0], EV Mode = [1]";
CM_ SG_ 1033 HybridEmissionsMalfunction "Emissions Related Malfunction Active";
CM_ SG_ 1033 IdleCLoopTrq "Electric motor PID torque to maintain idle speed.";
CM_ SG_ 1033 MessageCounter_HYBRID_POWERTRAI "This signal is a counter used for safety checks strategies. This counter is incremented of 1 (one) unit at each frame transmission.";
CM_ SG_ 1033 Motor1PowerUse_Display "Motor A power usage for HMI, in KW";
CM_ SG_ 1033 Motor1PowerUse_DisplayV "Validity bit for signal MtrPwrUsageDisp, 0=Valid";
CM_ SG_ 1033 Motor2PowerUse_Display "Motor B power usage for HMI, in KW";
CM_ SG_ 1033 Motor2PowerUse_DisplayV "Validity bit for signal MtrPwrUsageDisp, 0=Valid";
CM_ SG_ 1033 MotorsPowerUse_Display "Motor Sum power usage for HMI, in KW";
CM_ SG_ 1033 MotorsPowerUse_DisplayV "Validity bit for signal MtrPwrUsageDisp, 0=Valid";
CM_ SG_ 1033 PT_WorkSite_Invtr_Capacity_HCP "Powertrain power support capacity for the 2KW Inverter";
CM_ SG_ 1033 PT_WorkSite_Invtr_Sts_HCP "Powertrain 2KW Inverter support status";
CM_ SG_ 1033 Smartload_Actv "Smartload engagement";
CM_ SG_ 1580 V2H_Discharge_Capacity "This signal indicates the maximum power to be drained during V2H event";

BA_DEF_ SG_ "GenSigStartValue" INT 0 2147483647;
BA_DEF_ SG_ "GenSigInactiveValue" INT 0 2147483647;
BA_DEF_ SG_ "GenSigSendType" ENUM "NotUsed","OnWrite","OnWriteWithRepetition","OnChange","OnChangeWithRepetition","IfActive","IfActiveWithRepetition","NoSigSendType";
BA_DEF_ SG_ "SystemSignalLongSymbol" STRING ;
BA_DEF_ SG_ "GenSigTimeoutTime_AGSM" INT 0 65535;
BA_DEF_ SG_ "GenSigTimeoutTime_BCM" INT 0 65535;
BA_DEF_ SG_ "GenSigTimeoutTime_BSM" INT 0 65535;
BA_DEF_ SG_ "GenSigTimeoutTime_CADM" INT 0 65535;
BA_DEF_ SG_ "GenSigTimeoutTime_DMSM" INT 0 65535;
BA_DEF_ SG_ "GenSigTimeoutTime_DTCM" INT 0 65535;
BA_DEF_ SG_ "GenSigTimeoutTime_ECM" INT 0 65535;
BA_DEF_ SG_ "GenSigTimeoutTime_EVCU2" INT 0 65535;
BA_DEF_ SG_ "GenSigTimeoutTime_GNMM" INT 0 65535;
BA_DEF_ SG_ "GenSigTimeoutTime_HCP" INT 0 65535;
BA_DEF_ SG_ "GenSigTimeoutTime_IPC" INT 0 65535;
BA_DEF_ SG_ "GenSigTimeoutTime_RFHM" INT 0 65535;
BA_DEF_ SG_ "GenSigTimeoutTime_SGW" INT 0 65535;
BA_DEF_ SG_ "GenSigTimeoutTime_TCM" INT 0 65535;
BA_DEF_ BO_ "DiagRequest" ENUM "No","Yes";
BA_DEF_ BO_ "Type" ENUM "P","C","PE","COC","PE_Cntrl","E","E_Cntrl","OC","S","BAF","DC","EM","MM","ISO-TP","-";
BA_DEF_ BO_ "DiagResponse" ENUM "No","Yes";
BA_DEF_ BO_ "NmMessage" ENUM "No","Yes";
BA_DEF_ BO_ "GenMsgSendType" ENUM "Cyclic","NotUsed","NotUsed","NotUsed","NotUsed","NotUsed","NotUsed","NotUsed","NoMsgSendType";
BA_DEF_ BO_ "GenMsgNrOfRepetition" INT 0 255;
BA_DEF_ BO_ "GenMsgILSupport" ENUM "No","Yes";
BA_DEF_ BO_ "GenMsgStartDelayTime" INT 0 65535;
BA_DEF_ BO_ "GenMsgCycleTimeFast" INT 0 65535;
BA_DEF_ BO_ "GenMsgCycleTime" INT 0 65535;
BA_DEF_ BO_ "GenMsgDelayTime" INT 0 65535;
BA_DEF_ BO_ "NmAsrMessage" ENUM "No","Yes";
BA_DEF_ BO_ "DiagState" ENUM "No","Yes";
BA_DEF_ BO_ "DiagConnection" HEX 0 65535;
BA_DEF_ BO_ "VFrameFormat" ENUM "StandardCAN","ExtendedCAN","reserved","reserved","reserved","reserved","reserved","reserved","reserved","reserved","reserved","reserved","reserved","reserved","StandardCAN_FD","ExtendedCAN_FD";
BA_DEF_ BO_ "CANFD_BRS" ENUM "0","1";
BA_DEF_DEF_ "DiagRequest" "No";
BA_DEF_DEF_ "Type" "-";
BA_DEF_DEF_ "DiagResponse" "No";
BA_DEF_DEF_ "NmMessage" "No";
BA_DEF_DEF_ "GenMsgSendType" "NoMsgSendType";
BA_DEF_DEF_ "GenMsgNrOfRepetition" 0;
BA_DEF_DEF_ "GenMsgILSupport" "No";
BA_DEF_DEF_ "GenMsgStartDelayTime" 0;
BA_DEF_DEF_ "GenMsgCycleTimeFast" 0;
BA_DEF_DEF_ "GenMsgCycleTime" 0;
BA_DEF_DEF_ "GenMsgDelayTime" 0;
BA_DEF_DEF_ "NmAsrMessage" "No";
BA_DEF_DEF_ "DiagState" "No";
BA_DEF_DEF_ "DiagConnection" 0;
BA_DEF_DEF_ "VFrameFormat" "StandardCAN_FD";
BA_DEF_DEF_ "CANFD_BRS" "0";
BA_DEF_DEF_ "GenSigStartValue" 0;
BA_DEF_DEF_ "GenSigInactiveValue" 0;
BA_DEF_DEF_ "GenSigSendType" "NoSigSendType";
BA_DEF_DEF_ "SystemSignalLongSymbol" "";
BA_DEF_DEF_ "GenSigTimeoutTime_AGSM" 2500;
BA_DEF_DEF_ "GenSigTimeoutTime_BCM" 2500;
BA_DEF_DEF_ "GenSigTimeoutTime_BSM" 2500;
BA_DEF_DEF_ "GenSigTimeoutTime_CADM" 2500;
BA_DEF_DEF_ "GenSigTimeoutTime_DMSM" 2500;
BA_DEF_DEF_ "GenSigTimeoutTime_DTCM" 2500;
BA_DEF_DEF_ "GenSigTimeoutTime_ECM" 2500;
BA_DEF_DEF_ "GenSigTimeoutTime_EVCU2" 2500;
BA_DEF_DEF_ "GenSigTimeoutTime_GNMM" 2500;
BA_DEF_DEF_ "GenSigTimeoutTime_HCP" 2500;
BA_DEF_DEF_ "GenSigTimeoutTime_IPC" 2500;
BA_DEF_DEF_ "GenSigTimeoutTime_RFHM" 2500;
BA_DEF_DEF_ "GenSigTimeoutTime_SGW" 2500;
BA_DEF_DEF_ "GenSigTimeoutTime_TCM" 2500;
BA_ "Type" BO_ 1846 1;
BA_ "GenMsgSendType" BO_ 1846 0;
BA_ "GenMsgNrOfRepetition" BO_ 1846 2;
BA_ "GenMsgILSupport" BO_ 1846 1;
BA_ "GenMsgCycleTimeFast" BO_ 1846 20;
BA_ "GenMsgCycleTime" BO_ 1846 1000;
BA_ "GenMsgDelayTime" BO_ 1846 20;
BA_ "CANFD_BRS" BO_ 1846 1;
BA_ "Type" BO_ 1825 1;
BA_ "GenMsgSendType" BO_ 1825 0;
BA_ "GenMsgNrOfRepetition" BO_ 1825 2;
BA_ "GenMsgILSupport" BO_ 1825 1;
BA_ "GenMsgCycleTimeFast" BO_ 1825 20;
BA_ "GenMsgCycleTime" BO_ 1825 1000;
BA_ "GenMsgDelayTime" BO_ 1825 20;
BA_ "CANFD_BRS" BO_ 1825 1;
BA_ "Type" BO_ 835 8;
BA_ "GenMsgILSupport" BO_ 835 1;
BA_ "CANFD_BRS" BO_ 835 1;
BA_ "Type" BO_ 834 8;
BA_ "GenMsgILSupport" BO_ 834 1;
BA_ "CANFD_BRS" BO_ 834 1;
BA_ "Type" BO_ 525 1;
BA_ "GenMsgSendType" BO_ 525 0;
BA_ "GenMsgNrOfRepetition" BO_ 525 2;
BA_ "GenMsgILSupport" BO_ 525 1;
BA_ "GenMsgCycleTimeFast" BO_ 525 20;
BA_ "GenMsgCycleTime" BO_ 525 20;
BA_ "GenMsgDelayTime" BO_ 525 20;
BA_ "CANFD_BRS" BO_ 525 1;
BA_ "Type" BO_ 1487 1;
BA_ "GenMsgSendType" BO_ 1487 0;
BA_ "GenMsgILSupport" BO_ 1487 1;
BA_ "GenMsgCycleTime" BO_ 1487 1000;
BA_ "GenMsgDelayTime" BO_ 1487 20;
BA_ "CANFD_BRS" BO_ 1487 1;
BA_ "Type" BO_ 266 1;
BA_ "GenMsgSendType" BO_ 266 0;
BA_ "GenMsgILSupport" BO_ 266 1;
BA_ "GenMsgCycleTime" BO_ 266 10;
BA_ "CANFD_BRS" BO_ 266 1;
BA_ "Type" BO_ 1027 1;
BA_ "GenMsgSendType" BO_ 1027 0;
BA_ "GenMsgILSupport" BO_ 1027 1;
BA_ "GenMsgCycleTime" BO_ 1027 100;
BA_ "CANFD_BRS" BO_ 1027 1;
BA_ "Type" BO_ 1834 1;
BA_ "GenMsgSendType" BO_ 1834 0;
BA_ "GenMsgILSupport" BO_ 1834 1;
BA_ "GenMsgCycleTime" BO_ 1834 1000;
BA_ "CANFD_BRS" BO_ 1834 1;
BA_ "Type" BO_ 1579 1;
BA_ "GenMsgSendType" BO_ 1579 0;
BA_ "GenMsgILSupport" BO_ 1579 1;
BA_ "GenMsgCycleTime" BO_ 1579 500;
BA_ "CANFD_BRS" BO_ 1579 1;
BA_ "Type" BO_ 1049 1;
BA_ "GenMsgSendType" BO_ 1049 0;
BA_ "GenMsgILSupport" BO_ 1049 1;
BA_ "GenMsgCycleTime" BO_ 1049 100;
BA_ "CANFD_BRS" BO_ 1049 1;
BA_ "Type" BO_ 1044 1;
BA_ "GenMsgSendType" BO_ 1044 0;
BA_ "GenMsgILSupport" BO_ 1044 1;
BA_ "GenMsgCycleTime" BO_ 1044 100;
BA_ "GenMsgDelayTime" BO_ 1044 20;
BA_ "CANFD_BRS" BO_ 1044 1;
BA_ "Type" BO_ 1952 1;
BA_ "GenMsgSendType" BO_ 1952 0;
BA_ "GenMsgILSupport" BO_ 1952 1;
BA_ "GenMsgCycleTime" BO_ 1952 1000;
BA_ "CANFD_BRS" BO_ 1952 1;
BA_ "Type" BO_ 276 1;
BA_ "GenMsgSendType" BO_ 276 0;
BA_ "GenMsgILSupport" BO_ 276 1;
BA_ "GenMsgCycleTime" BO_ 276 10;
BA_ "CANFD_BRS" BO_ 276 1;
BA_ "Type" BO_ 269 1;
BA_ "GenMsgSendType" BO_ 269 0;
BA_ "GenMsgILSupport" BO_ 269 1;
BA_ "GenMsgCycleTime" BO_ 269 10;
BA_ "CANFD_BRS" BO_ 269 1;
BA_ "Type" BO_ 1033 1;
BA_ "GenMsgSendType" BO_ 1033 0;
BA_ "GenMsgILSupport" BO_ 1033 1;
BA_ "GenMsgCycleTime" BO_ 1033 100;
BA_ "CANFD_BRS" BO_ 1033 1;
BA_ "Type" BO_ 1580 1;
BA_ "GenMsgSendType" BO_ 1580 0;
BA_ "GenMsgILSupport" BO_ 1580 1;
BA_ "GenMsgCycleTime" BO_ 1580 500;
BA_ "CANFD_BRS" BO_ 1580 1;
BA_ "GenSigTimeoutTime_AGSM" SG_ 1846 Big_ECU_Ready_CADM 0;
BA_ "GenSigTimeoutTime_BCM" SG_ 1846 Big_ECU_Ready_CADM 0;
BA_ "GenSigTimeoutTime_BSM" SG_ 1846 Big_ECU_Ready_CADM 0;
BA_ "GenSigTimeoutTime_CADM" SG_ 1846 Big_ECU_Ready_CADM 0;
BA_ "GenSigTimeoutTime_DMSM" SG_ 1846 Big_ECU_Ready_CADM 0;
BA_ "GenSigTimeoutTime_DTCM" SG_ 1846 Big_ECU_Ready_CADM 0;
BA_ "GenSigTimeoutTime_ECM" SG_ 1846 Big_ECU_Ready_CADM 0;
BA_ "GenSigTimeoutTime_EVCU2" SG_ 1846 Big_ECU_Ready_CADM 0;
BA_ "GenSigTimeoutTime_GNMM" SG_ 1846 Big_ECU_Ready_CADM 0;
BA_ "GenSigTimeoutTime_HCP" SG_ 1846 Big_ECU_Ready_CADM 0;
BA_ "GenSigTimeoutTime_IPC" SG_ 1846 Big_ECU_Ready_CADM 0;
BA_ "GenSigTimeoutTime_RFHM" SG_ 1846 Big_ECU_Ready_CADM 0;
BA_ "GenSigTimeoutTime_TCM" SG_ 1846 Big_ECU_Ready_CADM 0;
BA_ "GenSigTimeoutTime_AGSM" SG_ 1846 Download_Status_CADM 0;
BA_ "GenSigTimeoutTime_BCM" SG_ 1846 Download_Status_CADM 0;
BA_ "GenSigTimeoutTime_BSM" SG_ 1846 Download_Status_CADM 0;
BA_ "GenSigTimeoutTime_CADM" SG_ 1846 Download_Status_CADM 0;
BA_ "GenSigTimeoutTime_DMSM" SG_ 1846 Download_Status_CADM 0;
BA_ "GenSigTimeoutTime_DTCM" SG_ 1846 Download_Status_CADM 0;
BA_ "GenSigTimeoutTime_ECM" SG_ 1846 Download_Status_CADM 0;
BA_ "GenSigTimeoutTime_EVCU2" SG_ 1846 Download_Status_CADM 0;
BA_ "GenSigTimeoutTime_GNMM" SG_ 1846 Download_Status_CADM 0;
BA_ "GenSigTimeoutTime_HCP" SG_ 1846 Download_Status_CADM 0;
BA_ "GenSigTimeoutTime_IPC" SG_ 1846 Download_Status_CADM 0;
BA_ "GenSigTimeoutTime_RFHM" SG_ 1846 Download_Status_CADM 0;
BA_ "GenSigTimeoutTime_TCM" SG_ 1846 Download_Status_CADM 0;
BA_ "GenSigTimeoutTime_AGSM" SG_ 1846 Update_Status_CADM 0;
BA_ "GenSigTimeoutTime_BCM" SG_ 1846 Update_Status_CADM 0;
BA_ "GenSigTimeoutTime_BSM" SG_ 1846 Update_Status_CADM 0;
BA_ "GenSigTimeoutTime_CADM" SG_ 1846 Update_Status_CADM 0;
BA_ "GenSigTimeoutTime_DMSM" SG_ 1846 Update_Status_CADM 0;
BA_ "GenSigTimeoutTime_DTCM" SG_ 1846 Update_Status_CADM 0;
BA_ "GenSigTimeoutTime_ECM" SG_ 1846 Update_Status_CADM 0;
BA_ "GenSigTimeoutTime_EVCU2" SG_ 1846 Update_Status_CADM 0;
BA_ "GenSigTimeoutTime_GNMM" SG_ 1846 Update_Status_CADM 0;
BA_ "GenSigTimeoutTime_HCP" SG_ 1846 Update_Status_CADM 0;
BA_ "GenSigTimeoutTime_IPC" SG_ 1846 Update_Status_CADM 0;
BA_ "GenSigTimeoutTime_RFHM" SG_ 1846 Update_Status_CADM 0;
BA_ "GenSigTimeoutTime_TCM" SG_ 1846 Update_Status_CADM 0;
BA_ "GenSigTimeoutTime_AGSM" SG_ 1825 Ready_Status_EVCU2 0;
BA_ "GenSigTimeoutTime_BCM" SG_ 1825 Ready_Status_EVCU2 0;
BA_ "GenSigTimeoutTime_BSM" SG_ 1825 Ready_Status_EVCU2 0;
BA_ "GenSigTimeoutTime_CADM" SG_ 1825 Ready_Status_EVCU2 0;
BA_ "GenSigTimeoutTime_DMSM" SG_ 1825 Ready_Status_EVCU2 0;
BA_ "GenSigTimeoutTime_DTCM" SG_ 1825 Ready_Status_EVCU2 0;
BA_ "GenSigTimeoutTime_ECM" SG_ 1825 Ready_Status_EVCU2 0;
BA_ "GenSigTimeoutTime_EVCU2" SG_ 1825 Ready_Status_EVCU2 0;
BA_ "GenSigTimeoutTime_GNMM" SG_ 1825 Ready_Status_EVCU2 0;
BA_ "GenSigTimeoutTime_HCP" SG_ 1825 Ready_Status_EVCU2 0;
BA_ "GenSigTimeoutTime_IPC" SG_ 1825 Ready_Status_EVCU2 0;
BA_ "GenSigTimeoutTime_RFHM" SG_ 1825 Ready_Status_EVCU2 0;
BA_ "GenSigTimeoutTime_TCM" SG_ 1825 Ready_Status_EVCU2 0;
BA_ "GenSigTimeoutTime_AGSM" SG_ 835 N_PDU 0;
BA_ "GenSigTimeoutTime_BCM" SG_ 835 N_PDU 0;
BA_ "GenSigTimeoutTime_BSM" SG_ 835 N_PDU 0;
BA_ "GenSigTimeoutTime_CADM" SG_ 835 N_PDU 0;
BA_ "GenSigTimeoutTime_DMSM" SG_ 835 N_PDU 0;
BA_ "GenSigTimeoutTime_DTCM" SG_ 835 N_PDU 0;
BA_ "GenSigTimeoutTime_EVCU2" SG_ 835 N_PDU 0;
BA_ "GenSigTimeoutTime_GNMM" SG_ 835 N_PDU 0;
BA_ "GenSigTimeoutTime_HCP" SG_ 835 N_PDU 0;
BA_ "GenSigTimeoutTime_IPC" SG_ 835 N_PDU 0;
BA_ "GenSigTimeoutTime_RFHM" SG_ 835 N_PDU 0;
BA_ "GenSigTimeoutTime_SGW" SG_ 835 N_PDU 0;
BA_ "GenSigTimeoutTime_TCM" SG_ 835 N_PDU 0;
BA_ "GenSigTimeoutTime_AGSM" SG_ 834 N_PDU 0;
BA_ "GenSigTimeoutTime_BCM" SG_ 834 N_PDU 0;
BA_ "GenSigTimeoutTime_BSM" SG_ 834 N_PDU 0;
BA_ "GenSigTimeoutTime_CADM" SG_ 834 N_PDU 0;
BA_ "GenSigTimeoutTime_DMSM" SG_ 834 N_PDU 0;
BA_ "GenSigTimeoutTime_DTCM" SG_ 834 N_PDU 0;
BA_ "GenSigTimeoutTime_ECM" SG_ 834 N_PDU 0;
BA_ "GenSigTimeoutTime_EVCU2" SG_ 834 N_PDU 0;
BA_ "GenSigTimeoutTime_GNMM" SG_ 834 N_PDU 0;
BA_ "GenSigTimeoutTime_HCP" SG_ 834 N_PDU 0;
BA_ "GenSigTimeoutTime_IPC" SG_ 834 N_PDU 0;
BA_ "GenSigTimeoutTime_RFHM" SG_ 834 N_PDU 0;
BA_ "GenSigTimeoutTime_TCM" SG_ 834 N_PDU 0;
BA_ "GenSigStartValue" SG_ 525 Altitude_RMSE 255;
BA_ "GenSigTimeoutTime_AGSM" SG_ 525 Altitude_RMSE 0;
BA_ "GenSigTimeoutTime_BCM" SG_ 525 Altitude_RMSE 0;
BA_ "GenSigTimeoutTime_BSM" SG_ 525 Altitude_RMSE 0;
BA_ "GenSigTimeoutTime_DMSM" SG_ 525 Altitude_RMSE 0;
BA_ "GenSigTimeoutTime_DTCM" SG_ 525 Altitude_RMSE 0;
BA_ "GenSigTimeoutTime_ECM" SG_ 525 Altitude_RMSE 0;
BA_ "GenSigTimeoutTime_EVCU2" SG_ 525 Altitude_RMSE 0;
BA_ "GenSigTimeoutTime_GNMM" SG_ 525 Altitude_RMSE 0;
BA_ "GenSigTimeoutTime_HCP" SG_ 525 Altitude_RMSE 0;
BA_ "GenSigTimeoutTime_IPC" SG_ 525 Altitude_RMSE 0;
BA_ "GenSigTimeoutTime_RFHM" SG_ 525 Altitude_RMSE 0;
BA_ "GenSigTimeoutTime_SGW" SG_ 525 Altitude_RMSE 0;
BA_ "GenSigTimeoutTime_TCM" SG_ 525 Altitude_RMSE 0;
BA_ "GenSigTimeoutTime_AGSM" SG_ 525 CRC_GLOB_NAV 0;
BA_ "GenSigTimeoutTime_BSM" SG_ 525 CRC_GLOB_NAV 0;
BA_ "GenSigTimeoutTime_DMSM" SG_ 525 CRC_GLOB_NAV 0;
BA_ "GenSigTimeoutTime_DTCM" SG_ 525 CRC_GLOB_NAV 0;
BA_ "GenSigTimeoutTime_ECM" SG_ 525 CRC_GLOB_NAV 0;
BA_ "GenSigTimeoutTime_EVCU2" SG_ 525 CRC_GLOB_NAV 0;
BA_ "GenSigTimeoutTime_GNMM" SG_ 525 CRC_GLOB_NAV 0;
BA_ "GenSigTimeoutTime_HCP" SG_ 525 CRC_GLOB_NAV 0;
BA_ "GenSigTimeoutTime_IPC" SG_ 525 CRC_GLOB_NAV 0;
BA_ "GenSigTimeoutTime_RFHM" SG_ 525 CRC_GLOB_NAV 0;
BA_ "GenSigTimeoutTime_SGW" SG_ 525 CRC_GLOB_NAV 0;
BA_ "GenSigTimeoutTime_TCM" SG_ 525 CRC_GLOB_NAV 0;
BA_ "GenSigTimeoutTime_AGSM" SG_ 525 GNMM_Health 0;
BA_ "GenSigTimeoutTime_BSM" SG_ 525 GNMM_Health 0;
BA_ "GenSigTimeoutTime_DMSM" SG_ 525 GNMM_Health 0;
BA_ "GenSigTimeoutTime_DTCM" SG_ 525 GNMM_Health 0;
BA_ "GenSigTimeoutTime_ECM" SG_ 525 GNMM_Health 0;
BA_ "GenSigTimeoutTime_EVCU2" SG_ 525 GNMM_Health 0;
BA_ "GenSigTimeoutTime_GNMM" SG_ 525 GNMM_Health 0;
BA_ "GenSigTimeoutTime_HCP" SG_ 525 GNMM_Health 0;
BA_ "GenSigTimeoutTime_IPC" SG_ 525 GNMM_Health 0;
BA_ "GenSigTimeoutTime_RFHM" SG_ 525 GNMM_Health 0;
BA_ "GenSigTimeoutTime_SGW" SG_ 525 GNMM_Health 0;
BA_ "GenSigTimeoutTime_TCM" SG_ 525 GNMM_Health 0;
BA_ "GenSigStartValue" SG_ 525 Heading_Angle 65535;
BA_ "GenSigTimeoutTime_AGSM" SG_ 525 Heading_Angle 0;
BA_ "GenSigTimeoutTime_BCM" SG_ 525 Heading_Angle 0;
BA_ "GenSigTimeoutTime_BSM" SG_ 525 Heading_Angle 0;
BA_ "GenSigTimeoutTime_DMSM" SG_ 525 Heading_Angle 0;
BA_ "GenSigTimeoutTime_DTCM" SG_ 525 Heading_Angle 0;
BA_ "GenSigTimeoutTime_ECM" SG_ 525 Heading_Angle 0;
BA_ "GenSigTimeoutTime_EVCU2" SG_ 525 Heading_Angle 0;
BA_ "GenSigTimeoutTime_GNMM" SG_ 525 Heading_Angle 0;
BA_ "GenSigTimeoutTime_HCP" SG_ 525 Heading_Angle 0;
BA_ "GenSigTimeoutTime_IPC" SG_ 525 Heading_Angle 0;
BA_ "GenSigTimeoutTime_RFHM" SG_ 525 Heading_Angle 0;
BA_ "GenSigTimeoutTime_SGW" SG_ 525 Heading_Angle 0;
BA_ "GenSigTimeoutTime_TCM" SG_ 525 Heading_Angle 0;
BA_ "GenSigTimeoutTime_AGSM" SG_ 525 Lat_GNMM 0;
BA_ "GenSigTimeoutTime_BCM" SG_ 525 Lat_GNMM 0;
BA_ "GenSigTimeoutTime_BSM" SG_ 525 Lat_GNMM 0;
BA_ "GenSigTimeoutTime_DMSM" SG_ 525 Lat_GNMM 0;
BA_ "GenSigTimeoutTime_DTCM" SG_ 525 Lat_GNMM 0;
BA_ "GenSigTimeoutTime_ECM" SG_ 525 Lat_GNMM 0;
BA_ "GenSigTimeoutTime_EVCU2" SG_ 525 Lat_GNMM 0;
BA_ "GenSigTimeoutTime_GNMM" SG_ 525 Lat_GNMM 0;
BA_ "GenSigTimeoutTime_HCP" SG_ 525 Lat_GNMM 0;
BA_ "GenSigTimeoutTime_IPC" SG_ 525 Lat_GNMM 0;
BA_ "GenSigTimeoutTime_RFHM" SG_ 525 Lat_GNMM 0;
BA_ "GenSigTimeoutTime_SGW" SG_ 525 Lat_GNMM 0;
BA_ "GenSigTimeoutTime_TCM" SG_ 525 Lat_GNMM 0;
BA_ "GenSigStartValue" SG_ 525 LatAcceleration_GNMM 4095;
BA_ "GenSigTimeoutTime_AGSM" SG_ 525 LatAcceleration_GNMM 0;
BA_ "GenSigTimeoutTime_BCM" SG_ 525 LatAcceleration_GNMM 0;
BA_ "GenSigTimeoutTime_BSM" SG_ 525 LatAcceleration_GNMM 0;
BA_ "GenSigTimeoutTime_DMSM" SG_ 525 LatAcceleration_GNMM 0;
BA_ "GenSigTimeoutTime_DTCM" SG_ 525 LatAcceleration_GNMM 0;
BA_ "GenSigTimeoutTime_ECM" SG_ 525 LatAcceleration_GNMM 0;
BA_ "GenSigTimeoutTime_EVCU2" SG_ 525 LatAcceleration_GNMM 0;
BA_ "GenSigTimeoutTime_GNMM" SG_ 525 LatAcceleration_GNMM 0;
BA_ "GenSigTimeoutTime_HCP" SG_ 525 LatAcceleration_GNMM 0;
BA_ "GenSigTimeoutTime_IPC" SG_ 525 LatAcceleration_GNMM 0;
BA_ "GenSigTimeoutTime_RFHM" SG_ 525 LatAcceleration_GNMM 0;
BA_ "GenSigTimeoutTime_SGW" SG_ 525 LatAcceleration_GNMM 0;
BA_ "GenSigTimeoutTime_TCM" SG_ 525 LatAcceleration_GNMM 0;
BA_ "GenSigStartValue" SG_ 525 LateralVelocity_GNMM 16383;
BA_ "GenSigTimeoutTime_AGSM" SG_ 525 LateralVelocity_GNMM 0;
BA_ "GenSigTimeoutTime_BCM" SG_ 525 LateralVelocity_GNMM 0;
BA_ "GenSigTimeoutTime_BSM" SG_ 525 LateralVelocity_GNMM 0;
BA_ "GenSigTimeoutTime_DMSM" SG_ 525 LateralVelocity_GNMM 0;
BA_ "GenSigTimeoutTime_DTCM" SG_ 525 LateralVelocity_GNMM 0;
BA_ "GenSigTimeoutTime_ECM" SG_ 525 LateralVelocity_GNMM 0;
BA_ "GenSigTimeoutTime_EVCU2" SG_ 525 LateralVelocity_GNMM 0;
BA_ "GenSigTimeoutTime_GNMM" SG_ 525 LateralVelocity_GNMM 0;
BA_ "GenSigTimeoutTime_HCP" SG_ 525 LateralVelocity_GNMM 0;
BA_ "GenSigTimeoutTime_IPC" SG_ 525 LateralVelocity_GNMM 0;
BA_ "GenSigTimeoutTime_RFHM" SG_ 525 LateralVelocity_GNMM 0;
BA_ "GenSigTimeoutTime_SGW" SG_ 525 LateralVelocity_GNMM 0;
BA_ "GenSigTimeoutTime_TCM" SG_ 525 LateralVelocity_GNMM 0;
BA_ "GenSigStartValue" SG_ 525 Latitude_RMSE 255;
BA_ "GenSigTimeoutTime_AGSM" SG_ 525 Latitude_RMSE 0;
BA_ "GenSigTimeoutTime_BCM" SG_ 525 Latitude_RMSE 0;
BA_ "GenSigTimeoutTime_BSM" SG_ 525 Latitude_RMSE 0;
BA_ "GenSigTimeoutTime_DMSM" SG_ 525 Latitude_RMSE 0;
BA_ "GenSigTimeoutTime_DTCM" SG_ 525 Latitude_RMSE 0;
BA_ "GenSigTimeoutTime_ECM" SG_ 525 Latitude_RMSE 0;
BA_ "GenSigTimeoutTime_EVCU2" SG_ 525 Latitude_RMSE 0;
BA_ "GenSigTimeoutTime_GNMM" SG_ 525 Latitude_RMSE 0;
BA_ "GenSigTimeoutTime_HCP" SG_ 525 Latitude_RMSE 0;
BA_ "GenSigTimeoutTime_IPC" SG_ 525 Latitude_RMSE 0;
BA_ "GenSigTimeoutTime_RFHM" SG_ 525 Latitude_RMSE 0;
BA_ "GenSigTimeoutTime_SGW" SG_ 525 Latitude_RMSE 0;
BA_ "GenSigTimeoutTime_TCM" SG_ 525 Latitude_RMSE 0;
BA_ "GenSigTimeoutTime_AGSM" SG_ 525 Long_GNMM 0;
BA_ "GenSigTimeoutTime_BCM" SG_ 525 Long_GNMM 0;
BA_ "GenSigTimeoutTime_BSM" SG_ 525 Long_GNMM 0;
BA_ "GenSigTimeoutTime_DMSM" SG_ 525 Long_GNMM 0;
BA_ "GenSigTimeoutTime_DTCM" SG_ 525 Long_GNMM 0;
BA_ "GenSigTimeoutTime_ECM" SG_ 525 Long_GNMM 0;
BA_ "GenSigTimeoutTime_EVCU2" SG_ 525 Long_GNMM 0;
BA_ "GenSigTimeoutTime_GNMM" SG_ 525 Long_GNMM 0;
BA_ "GenSigTimeoutTime_HCP" SG_ 525 Long_GNMM 0;
BA_ "GenSigTimeoutTime_IPC" SG_ 525 Long_GNMM 0;
BA_ "GenSigTimeoutTime_RFHM" SG_ 525 Long_GNMM 0;
BA_ "GenSigTimeoutTime_SGW" SG_ 525 Long_GNMM 0;
BA_ "GenSigTimeoutTime_TCM" SG_ 525 Long_GNMM 0;
BA_ "GenSigStartValue" SG_ 525 LongAcceleration_GNMM 4095;
BA_ "GenSigTimeoutTime_AGSM" SG_ 525 LongAcceleration_GNMM 0;
BA_ "GenSigTimeoutTime_BCM" SG_ 525 LongAcceleration_GNMM 0;
BA_ "GenSigTimeoutTime_BSM" SG_ 525 LongAcceleration_GNMM 0;
BA_ "GenSigTimeoutTime_DMSM" SG_ 525 LongAcceleration_GNMM 0;
BA_ "GenSigTimeoutTime_DTCM" SG_ 525 LongAcceleration_GNMM 0;
BA_ "GenSigTimeoutTime_ECM" SG_ 525 LongAcceleration_GNMM 0;
BA_ "GenSigTimeoutTime_EVCU2" SG_ 525 LongAcceleration_GNMM 0;
BA_ "GenSigTimeoutTime_GNMM" SG_ 525 LongAcceleration_GNMM 0;
BA_ "GenSigTimeoutTime_HCP" SG_ 525 LongAcceleration_GNMM 0;
BA_ "GenSigTimeoutTime_IPC" SG_ 525 LongAcceleration_GNMM 0;
BA_ "GenSigTimeoutTime_RFHM" SG_ 525 LongAcceleration_GNMM 0;
BA_ "GenSigTimeoutTime_SGW" SG_ 525 LongAcceleration_GNMM 0;
BA_ "GenSigTimeoutTime_TCM" SG_ 525 LongAcceleration_GNMM 0;
BA_ "GenSigStartValue" SG_ 525 Longitude_RMSE 255;
BA_ "GenSigTimeoutTime_AGSM" SG_ 525 Longitude_RMSE 0;
BA_ "GenSigTimeoutTime_BCM" SG_ 525 Longitude_RMSE 0;
BA_ "GenSigTimeoutTime_BSM" SG_ 525 Longitude_RMSE 0;
BA_ "GenSigTimeoutTime_DMSM" SG_ 525 Longitude_RMSE 0;
BA_ "GenSigTimeoutTime_DTCM" SG_ 525 Longitude_RMSE 0;
BA_ "GenSigTimeoutTime_ECM" SG_ 525 Longitude_RMSE 0;
BA_ "GenSigTimeoutTime_EVCU2" SG_ 525 Longitude_RMSE 0;
BA_ "GenSigTimeoutTime_GNMM" SG_ 525 Longitude_RMSE 0;
BA_ "GenSigTimeoutTime_HCP" SG_ 525 Longitude_RMSE 0;
BA_ "GenSigTimeoutTime_IPC" SG_ 525 Longitude_RMSE 0;
BA_ "GenSigTimeoutTime_RFHM" SG_ 525 Longitude_RMSE 0;
BA_ "GenSigTimeoutTime_SGW" SG_ 525 Longitude_RMSE 0;
BA_ "GenSigTimeoutTime_TCM" SG_ 525 Longitude_RMSE 0;
BA_ "GenSigStartValue" SG_ 525 LongitudinalVelocity_GNMM 16383;
BA_ "GenSigTimeoutTime_AGSM" SG_ 525 LongitudinalVelocity_GNMM 0;
BA_ "GenSigTimeoutTime_BCM" SG_ 525 LongitudinalVelocity_GNMM 0;
BA_ "GenSigTimeoutTime_BSM" SG_ 525 LongitudinalVelocity_GNMM 0;
BA_ "GenSigTimeoutTime_DMSM" SG_ 525 LongitudinalVelocity_GNMM 0;
BA_ "GenSigTimeoutTime_DTCM" SG_ 525 LongitudinalVelocity_GNMM 0;
BA_ "GenSigTimeoutTime_ECM" SG_ 525 LongitudinalVelocity_GNMM 0;
BA_ "GenSigTimeoutTime_EVCU2" SG_ 525 LongitudinalVelocity_GNMM 0;
BA_ "GenSigTimeoutTime_GNMM" SG_ 525 LongitudinalVelocity_GNMM 0;
BA_ "GenSigTimeoutTime_HCP" SG_ 525 LongitudinalVelocity_GNMM 0;
BA_ "GenSigTimeoutTime_IPC" SG_ 525 LongitudinalVelocity_GNMM 0;
BA_ "GenSigTimeoutTime_RFHM" SG_ 525 LongitudinalVelocity_GNMM 0;
BA_ "GenSigTimeoutTime_SGW" SG_ 525 LongitudinalVelocity_GNMM 0;
BA_ "GenSigTimeoutTime_TCM" SG_ 525 LongitudinalVelocity_GNMM 0;
BA_ "GenSigTimeoutTime_AGSM" SG_ 525 MessageCounter_GLOB_NAV 0;
BA_ "GenSigTimeoutTime_BSM" SG_ 525 MessageCounter_GLOB_NAV 0;
BA_ "GenSigTimeoutTime_DMSM" SG_ 525 MessageCounter_GLOB_NAV 0;
BA_ "GenSigTimeoutTime_DTCM" SG_ 525 MessageCounter_GLOB_NAV 0;
BA_ "GenSigTimeoutTime_ECM" SG_ 525 MessageCounter_GLOB_NAV 0;
BA_ "GenSigTimeoutTime_EVCU2" SG_ 525 MessageCounter_GLOB_NAV 0;
BA_ "GenSigTimeoutTime_GNMM" SG_ 525 MessageCounter_GLOB_NAV 0;
BA_ "GenSigTimeoutTime_HCP" SG_ 525 MessageCounter_GLOB_NAV 0;
BA_ "GenSigTimeoutTime_IPC" SG_ 525 MessageCounter_GLOB_NAV 0;
BA_ "GenSigTimeoutTime_RFHM" SG_ 525 MessageCounter_GLOB_NAV 0;
BA_ "GenSigTimeoutTime_SGW" SG_ 525 MessageCounter_GLOB_NAV 0;
BA_ "GenSigTimeoutTime_TCM" SG_ 525 MessageCounter_GLOB_NAV 0;
BA_ "GenSigStartValue" SG_ 525 Pitch_RMSE 255;
BA_ "GenSigTimeoutTime_AGSM" SG_ 525 Pitch_RMSE 0;
BA_ "GenSigTimeoutTime_BCM" SG_ 525 Pitch_RMSE 0;
BA_ "GenSigTimeoutTime_BSM" SG_ 525 Pitch_RMSE 0;
BA_ "GenSigTimeoutTime_DMSM" SG_ 525 Pitch_RMSE 0;
BA_ "GenSigTimeoutTime_DTCM" SG_ 525 Pitch_RMSE 0;
BA_ "GenSigTimeoutTime_ECM" SG_ 525 Pitch_RMSE 0;
BA_ "GenSigTimeoutTime_EVCU2" SG_ 525 Pitch_RMSE 0;
BA_ "GenSigTimeoutTime_GNMM" SG_ 525 Pitch_RMSE 0;
BA_ "GenSigTimeoutTime_HCP" SG_ 525 Pitch_RMSE 0;
BA_ "GenSigTimeoutTime_IPC" SG_ 525 Pitch_RMSE 0;
BA_ "GenSigTimeoutTime_RFHM" SG_ 525 Pitch_RMSE 0;
BA_ "GenSigTimeoutTime_SGW" SG_ 525 Pitch_RMSE 0;
BA_ "GenSigTimeoutTime_TCM" SG_ 525 Pitch_RMSE 0;
BA_ "GenSigStartValue" SG_ 525 PitchRate_GNMM 4095;
BA_ "GenSigTimeoutTime_AGSM" SG_ 525 PitchRate_GNMM 0;
BA_ "GenSigTimeoutTime_BCM" SG_ 525 PitchRate_GNMM 0;
BA_ "GenSigTimeoutTime_BSM" SG_ 525 PitchRate_GNMM 0;
BA_ "GenSigTimeoutTime_DMSM" SG_ 525 PitchRate_GNMM 0;
BA_ "GenSigTimeoutTime_DTCM" SG_ 525 PitchRate_GNMM 0;
BA_ "GenSigTimeoutTime_ECM" SG_ 525 PitchRate_GNMM 0;
BA_ "GenSigTimeoutTime_EVCU2" SG_ 525 PitchRate_GNMM 0;
BA_ "GenSigTimeoutTime_GNMM" SG_ 525 PitchRate_GNMM 0;
BA_ "GenSigTimeoutTime_HCP" SG_ 525 PitchRate_GNMM 0;
BA_ "GenSigTimeoutTime_IPC" SG_ 525 PitchRate_GNMM 0;
BA_ "GenSigTimeoutTime_RFHM" SG_ 525 PitchRate_GNMM 0;
BA_ "GenSigTimeoutTime_SGW" SG_ 525 PitchRate_GNMM 0;
BA_ "GenSigTimeoutTime_TCM" SG_ 525 PitchRate_GNMM 0;
BA_ "GenSigStartValue" SG_ 525 Roll_RMSE 255;
BA_ "GenSigTimeoutTime_AGSM" SG_ 525 Roll_RMSE 0;
BA_ "GenSigTimeoutTime_BCM" SG_ 525 Roll_RMSE 0;
BA_ "GenSigTimeoutTime_BSM" SG_ 525 Roll_RMSE 0;
BA_ "GenSigTimeoutTime_DMSM" SG_ 525 Roll_RMSE 0;
BA_ "GenSigTimeoutTime_DTCM" SG_ 525 Roll_RMSE 0;
BA_ "GenSigTimeoutTime_ECM" SG_ 525 Roll_RMSE 0;
BA_ "GenSigTimeoutTime_EVCU2" SG_ 525 Roll_RMSE 0;
BA_ "GenSigTimeoutTime_GNMM" SG_ 525 Roll_RMSE 0;
BA_ "GenSigTimeoutTime_HCP" SG_ 525 Roll_RMSE 0;
BA_ "GenSigTimeoutTime_IPC" SG_ 525 Roll_RMSE 0;
BA_ "GenSigTimeoutTime_RFHM" SG_ 525 Roll_RMSE 0;
BA_ "GenSigTimeoutTime_SGW" SG_ 525 Roll_RMSE 0;
BA_ "GenSigTimeoutTime_TCM" SG_ 525 Roll_RMSE 0;
BA_ "GenSigStartValue" SG_ 525 RollRate_GNMM 4095;
BA_ "GenSigTimeoutTime_AGSM" SG_ 525 RollRate_GNMM 0;
BA_ "GenSigTimeoutTime_BCM" SG_ 525 RollRate_GNMM 0;
BA_ "GenSigTimeoutTime_BSM" SG_ 525 RollRate_GNMM 0;
BA_ "GenSigTimeoutTime_DMSM" SG_ 525 RollRate_GNMM 0;
BA_ "GenSigTimeoutTime_DTCM" SG_ 525 RollRate_GNMM 0;
BA_ "GenSigTimeoutTime_ECM" SG_ 525 RollRate_GNMM 0;
BA_ "GenSigTimeoutTime_EVCU2" SG_ 525 RollRate_GNMM 0;
BA_ "GenSigTimeoutTime_GNMM" SG_ 525 RollRate_GNMM 0;
BA_ "GenSigTimeoutTime_HCP" SG_ 525 RollRate_GNMM 0;
BA_ "GenSigTimeoutTime_IPC" SG_ 525 RollRate_GNMM 0;
BA_ "GenSigTimeoutTime_RFHM" SG_ 525 RollRate_GNMM 0;
BA_ "GenSigTimeoutTime_SGW" SG_ 525 RollRate_GNMM 0;
BA_ "GenSigTimeoutTime_TCM" SG_ 525 RollRate_GNMM 0;
BA_ "GenSigStartValue" SG_ 525 VerticalAcceleration_GNMM 4095;
BA_ "GenSigTimeoutTime_AGSM" SG_ 525 VerticalAcceleration_GNMM 0;
BA_ "GenSigTimeoutTime_BCM" SG_ 525 VerticalAcceleration_GNMM 0;
BA_ "GenSigTimeoutTime_BSM" SG_ 525 VerticalAcceleration_GNMM 0;
BA_ "GenSigTimeoutTime_DMSM" SG_ 525 VerticalAcceleration_GNMM 0;
BA_ "GenSigTimeoutTime_DTCM" SG_ 525 VerticalAcceleration_GNMM 0;
BA_ "GenSigTimeoutTime_ECM" SG_ 525 VerticalAcceleration_GNMM 0;
BA_ "GenSigTimeoutTime_EVCU2" SG_ 525 VerticalAcceleration_GNMM 0;
BA_ "GenSigTimeoutTime_GNMM" SG_ 525 VerticalAcceleration_GNMM 0;
BA_ "GenSigTimeoutTime_HCP" SG_ 525 VerticalAcceleration_GNMM 0;
BA_ "GenSigTimeoutTime_IPC" SG_ 525 VerticalAcceleration_GNMM 0;
BA_ "GenSigTimeoutTime_RFHM" SG_ 525 VerticalAcceleration_GNMM 0;
BA_ "GenSigTimeoutTime_SGW" SG_ 525 VerticalAcceleration_GNMM 0;
BA_ "GenSigTimeoutTime_TCM" SG_ 525 VerticalAcceleration_GNMM 0;
BA_ "GenSigStartValue" SG_ 525 VerticalVelocity_GNMM 16383;
BA_ "GenSigTimeoutTime_AGSM" SG_ 525 VerticalVelocity_GNMM 0;
BA_ "GenSigTimeoutTime_BCM" SG_ 525 VerticalVelocity_GNMM 0;
BA_ "GenSigTimeoutTime_BSM" SG_ 525 VerticalVelocity_GNMM 0;
BA_ "GenSigTimeoutTime_DMSM" SG_ 525 VerticalVelocity_GNMM 0;
BA_ "GenSigTimeoutTime_DTCM" SG_ 525 VerticalVelocity_GNMM 0;
BA_ "GenSigTimeoutTime_ECM" SG_ 525 VerticalVelocity_GNMM 0;
BA_ "GenSigTimeoutTime_EVCU2" SG_ 525 VerticalVelocity_GNMM 0;
BA_ "GenSigTimeoutTime_GNMM" SG_ 525 VerticalVelocity_GNMM 0;
BA_ "GenSigTimeoutTime_HCP" SG_ 525 VerticalVelocity_GNMM 0;
BA_ "GenSigTimeoutTime_IPC" SG_ 525 VerticalVelocity_GNMM 0;
BA_ "GenSigTimeoutTime_RFHM" SG_ 525 VerticalVelocity_GNMM 0;
BA_ "GenSigTimeoutTime_SGW" SG_ 525 VerticalVelocity_GNMM 0;
BA_ "GenSigTimeoutTime_TCM" SG_ 525 VerticalVelocity_GNMM 0;
BA_ "GenSigStartValue" SG_ 525 YawRate_GNMM 32767;
BA_ "GenSigTimeoutTime_AGSM" SG_ 525 YawRate_GNMM 0;
BA_ "GenSigTimeoutTime_BCM" SG_ 525 YawRate_GNMM 0;
BA_ "GenSigTimeoutTime_BSM" SG_ 525 YawRate_GNMM 0;
BA_ "GenSigTimeoutTime_DMSM" SG_ 525 YawRate_GNMM 0;
BA_ "GenSigTimeoutTime_DTCM" SG_ 525 YawRate_GNMM 0;
BA_ "GenSigTimeoutTime_ECM" SG_ 525 YawRate_GNMM 0;
BA_ "GenSigTimeoutTime_EVCU2" SG_ 525 YawRate_GNMM 0;
BA_ "GenSigTimeoutTime_GNMM" SG_ 525 YawRate_GNMM 0;
BA_ "GenSigTimeoutTime_HCP" SG_ 525 YawRate_GNMM 0;
BA_ "GenSigTimeoutTime_IPC" SG_ 525 YawRate_GNMM 0;
BA_ "GenSigTimeoutTime_RFHM" SG_ 525 YawRate_GNMM 0;
BA_ "GenSigTimeoutTime_SGW" SG_ 525 YawRate_GNMM 0;
BA_ "GenSigTimeoutTime_TCM" SG_ 525 YawRate_GNMM 0;
BA_ "GenSigStartValue" SG_ 525 YawRate_RMSE 255;
BA_ "GenSigTimeoutTime_AGSM" SG_ 525 YawRate_RMSE 0;
BA_ "GenSigTimeoutTime_BCM" SG_ 525 YawRate_RMSE 0;
BA_ "GenSigTimeoutTime_BSM" SG_ 525 YawRate_RMSE 0;
BA_ "GenSigTimeoutTime_DMSM" SG_ 525 YawRate_RMSE 0;
BA_ "GenSigTimeoutTime_DTCM" SG_ 525 YawRate_RMSE 0;
BA_ "GenSigTimeoutTime_ECM" SG_ 525 YawRate_RMSE 0;
BA_ "GenSigTimeoutTime_EVCU2" SG_ 525 YawRate_RMSE 0;
BA_ "GenSigTimeoutTime_GNMM" SG_ 525 YawRate_RMSE 0;
BA_ "GenSigTimeoutTime_HCP" SG_ 525 YawRate_RMSE 0;
BA_ "GenSigTimeoutTime_IPC" SG_ 525 YawRate_RMSE 0;
BA_ "GenSigTimeoutTime_RFHM" SG_ 525 YawRate_RMSE 0;
BA_ "GenSigTimeoutTime_SGW" SG_ 525 YawRate_RMSE 0;
BA_ "GenSigTimeoutTime_TCM" SG_ 525 YawRate_RMSE 0;
BA_ "GenSigTimeoutTime_AGSM" SG_ 1487 Chargeport_Lock_Status 0;
BA_ "GenSigTimeoutTime_BCM" SG_ 1487 Chargeport_Lock_Status 0;
BA_ "GenSigTimeoutTime_BSM" SG_ 1487 Chargeport_Lock_Status 0;
BA_ "GenSigTimeoutTime_CADM" SG_ 1487 Chargeport_Lock_Status 0;
BA_ "GenSigTimeoutTime_DMSM" SG_ 1487 Chargeport_Lock_Status 0;
BA_ "GenSigTimeoutTime_DTCM" SG_ 1487 Chargeport_Lock_Status 0;
BA_ "GenSigTimeoutTime_ECM" SG_ 1487 Chargeport_Lock_Status 0;
BA_ "GenSigTimeoutTime_EVCU2" SG_ 1487 Chargeport_Lock_Status 0;
BA_ "GenSigTimeoutTime_GNMM" SG_ 1487 Chargeport_Lock_Status 0;
BA_ "GenSigTimeoutTime_HCP" SG_ 1487 Chargeport_Lock_Status 0;
BA_ "GenSigTimeoutTime_IPC" SG_ 1487 Chargeport_Lock_Status 0;
BA_ "GenSigTimeoutTime_RFHM" SG_ 1487 Chargeport_Lock_Status 0;
BA_ "GenSigTimeoutTime_TCM" SG_ 1487 Chargeport_Lock_Status 0;
BA_ "GenSigTimeoutTime_AGSM" SG_ 1487 Cooperative_Status 0;
BA_ "GenSigTimeoutTime_BCM" SG_ 1487 Cooperative_Status 0;
BA_ "GenSigTimeoutTime_BSM" SG_ 1487 Cooperative_Status 0;
BA_ "GenSigTimeoutTime_CADM" SG_ 1487 Cooperative_Status 0;
BA_ "GenSigTimeoutTime_DMSM" SG_ 1487 Cooperative_Status 0;
BA_ "GenSigTimeoutTime_DTCM" SG_ 1487 Cooperative_Status 0;
BA_ "GenSigTimeoutTime_ECM" SG_ 1487 Cooperative_Status 0;
BA_ "GenSigTimeoutTime_EVCU2" SG_ 1487 Cooperative_Status 0;
BA_ "GenSigTimeoutTime_GNMM" SG_ 1487 Cooperative_Status 0;
BA_ "GenSigTimeoutTime_HCP" SG_ 1487 Cooperative_Status 0;
BA_ "GenSigTimeoutTime_IPC" SG_ 1487 Cooperative_Status 0;
BA_ "GenSigTimeoutTime_RFHM" SG_ 1487 Cooperative_Status 0;
BA_ "GenSigTimeoutTime_TCM" SG_ 1487 Cooperative_Status 0;
BA_ "GenSigTimeoutTime_AGSM" SG_ 1487 Energy_to_Battery 0;
BA_ "GenSigTimeoutTime_BCM" SG_ 1487 Energy_to_Battery 0;
BA_ "GenSigTimeoutTime_BSM" SG_ 1487 Energy_to_Battery 0;
BA_ "GenSigTimeoutTime_CADM" SG_ 1487 Energy_to_Battery 0;
BA_ "GenSigTimeoutTime_DMSM" SG_ 1487 Energy_to_Battery 0;
BA_ "GenSigTimeoutTime_DTCM" SG_ 1487 Energy_to_Battery 0;
BA_ "GenSigTimeoutTime_ECM" SG_ 1487 Energy_to_Battery 0;
BA_ "GenSigTimeoutTime_EVCU2" SG_ 1487 Energy_to_Battery 0;
BA_ "GenSigTimeoutTime_GNMM" SG_ 1487 Energy_to_Battery 0;
BA_ "GenSigTimeoutTime_HCP" SG_ 1487 Energy_to_Battery 0;
BA_ "GenSigTimeoutTime_IPC" SG_ 1487 Energy_to_Battery 0;
BA_ "GenSigTimeoutTime_RFHM" SG_ 1487 Energy_to_Battery 0;
BA_ "GenSigTimeoutTime_TCM" SG_ 1487 Energy_to_Battery 0;
BA_ "GenSigTimeoutTime_AGSM" SG_ 1487 Est_Range_FullCharge 0;
BA_ "GenSigTimeoutTime_BCM" SG_ 1487 Est_Range_FullCharge 0;
BA_ "GenSigTimeoutTime_BSM" SG_ 1487 Est_Range_FullCharge 0;
BA_ "GenSigTimeoutTime_CADM" SG_ 1487 Est_Range_FullCharge 0;
BA_ "GenSigTimeoutTime_DMSM" SG_ 1487 Est_Range_FullCharge 0;
BA_ "GenSigTimeoutTime_DTCM" SG_ 1487 Est_Range_FullCharge 0;
BA_ "GenSigTimeoutTime_ECM" SG_ 1487 Est_Range_FullCharge 0;
BA_ "GenSigTimeoutTime_EVCU2" SG_ 1487 Est_Range_FullCharge 0;
BA_ "GenSigTimeoutTime_GNMM" SG_ 1487 Est_Range_FullCharge 0;
BA_ "GenSigTimeoutTime_HCP" SG_ 1487 Est_Range_FullCharge 0;
BA_ "GenSigTimeoutTime_IPC" SG_ 1487 Est_Range_FullCharge 0;
BA_ "GenSigTimeoutTime_RFHM" SG_ 1487 Est_Range_FullCharge 0;
BA_ "GenSigTimeoutTime_TCM" SG_ 1487 Est_Range_FullCharge 0;
BA_ "GenSigTimeoutTime_AGSM" SG_ 1487 EV_Charge_Current 0;
BA_ "GenSigTimeoutTime_BCM" SG_ 1487 EV_Charge_Current 0;
BA_ "GenSigTimeoutTime_BSM" SG_ 1487 EV_Charge_Current 0;
BA_ "GenSigTimeoutTime_CADM" SG_ 1487 EV_Charge_Current 0;
BA_ "GenSigTimeoutTime_DMSM" SG_ 1487 EV_Charge_Current 0;
BA_ "GenSigTimeoutTime_DTCM" SG_ 1487 EV_Charge_Current 0;
BA_ "GenSigTimeoutTime_ECM" SG_ 1487 EV_Charge_Current 0;
BA_ "GenSigTimeoutTime_EVCU2" SG_ 1487 EV_Charge_Current 0;
BA_ "GenSigTimeoutTime_GNMM" SG_ 1487 EV_Charge_Current 0;
BA_ "GenSigTimeoutTime_HCP" SG_ 1487 EV_Charge_Current 0;
BA_ "GenSigTimeoutTime_IPC" SG_ 1487 EV_Charge_Current 0;
BA_ "GenSigTimeoutTime_RFHM" SG_ 1487 EV_Charge_Current 0;
BA_ "GenSigTimeoutTime_TCM" SG_ 1487 EV_Charge_Current 0;
BA_ "GenSigTimeoutTime_AGSM" SG_ 1487 EVSE_Power 0;
BA_ "GenSigTimeoutTime_BCM" SG_ 1487 EVSE_Power 0;
BA_ "GenSigTimeoutTime_BSM" SG_ 1487 EVSE_Power 0;
BA_ "GenSigTimeoutTime_CADM" SG_ 1487 EVSE_Power 0;
BA_ "GenSigTimeoutTime_DMSM" SG_ 1487 EVSE_Power 0;
BA_ "GenSigTimeoutTime_DTCM" SG_ 1487 EVSE_Power 0;
BA_ "GenSigTimeoutTime_ECM" SG_ 1487 EVSE_Power 0;
BA_ "GenSigTimeoutTime_EVCU2" SG_ 1487 EVSE_Power 0;
BA_ "GenSigTimeoutTime_GNMM" SG_ 1487 EVSE_Power 0;
BA_ "GenSigTimeoutTime_HCP" SG_ 1487 EVSE_Power 0;
BA_ "GenSigTimeoutTime_IPC" SG_ 1487 EVSE_Power 0;
BA_ "GenSigTimeoutTime_RFHM" SG_ 1487 EVSE_Power 0;
BA_ "GenSigTimeoutTime_TCM" SG_ 1487 EVSE_Power 0;
BA_ "GenSigTimeoutTime_AGSM" SG_ 1487 Lv1_EstChargeTime_80 0;
BA_ "GenSigTimeoutTime_BCM" SG_ 1487 Lv1_EstChargeTime_80 0;
BA_ "GenSigTimeoutTime_BSM" SG_ 1487 Lv1_EstChargeTime_80 0;
BA_ "GenSigTimeoutTime_CADM" SG_ 1487 Lv1_EstChargeTime_80 0;
BA_ "GenSigTimeoutTime_DMSM" SG_ 1487 Lv1_EstChargeTime_80 0;
BA_ "GenSigTimeoutTime_DTCM" SG_ 1487 Lv1_EstChargeTime_80 0;
BA_ "GenSigTimeoutTime_ECM" SG_ 1487 Lv1_EstChargeTime_80 0;
BA_ "GenSigTimeoutTime_EVCU2" SG_ 1487 Lv1_EstChargeTime_80 0;
BA_ "GenSigTimeoutTime_GNMM" SG_ 1487 Lv1_EstChargeTime_80 0;
BA_ "GenSigTimeoutTime_HCP" SG_ 1487 Lv1_EstChargeTime_80 0;
BA_ "GenSigTimeoutTime_IPC" SG_ 1487 Lv1_EstChargeTime_80 0;
BA_ "GenSigTimeoutTime_RFHM" SG_ 1487 Lv1_EstChargeTime_80 0;
BA_ "GenSigTimeoutTime_TCM" SG_ 1487 Lv1_EstChargeTime_80 0;
BA_ "GenSigTimeoutTime_AGSM" SG_ 1487 Lv2_EstChargeTime_80 0;
BA_ "GenSigTimeoutTime_BCM" SG_ 1487 Lv2_EstChargeTime_80 0;
BA_ "GenSigTimeoutTime_BSM" SG_ 1487 Lv2_EstChargeTime_80 0;
BA_ "GenSigTimeoutTime_CADM" SG_ 1487 Lv2_EstChargeTime_80 0;
BA_ "GenSigTimeoutTime_DMSM" SG_ 1487 Lv2_EstChargeTime_80 0;
BA_ "GenSigTimeoutTime_DTCM" SG_ 1487 Lv2_EstChargeTime_80 0;
BA_ "GenSigTimeoutTime_ECM" SG_ 1487 Lv2_EstChargeTime_80 0;
BA_ "GenSigTimeoutTime_EVCU2" SG_ 1487 Lv2_EstChargeTime_80 0;
BA_ "GenSigTimeoutTime_GNMM" SG_ 1487 Lv2_EstChargeTime_80 0;
BA_ "GenSigTimeoutTime_HCP" SG_ 1487 Lv2_EstChargeTime_80 0;
BA_ "GenSigTimeoutTime_IPC" SG_ 1487 Lv2_EstChargeTime_80 0;
BA_ "GenSigTimeoutTime_RFHM" SG_ 1487 Lv2_EstChargeTime_80 0;
BA_ "GenSigTimeoutTime_TCM" SG_ 1487 Lv2_EstChargeTime_80 0;
BA_ "GenSigTimeoutTime_AGSM" SG_ 1487 Total_Battery_Capacity 0;
BA_ "GenSigTimeoutTime_BCM" SG_ 1487 Total_Battery_Capacity 0;
BA_ "GenSigTimeoutTime_BSM" SG_ 1487 Total_Battery_Capacity 0;
BA_ "GenSigTimeoutTime_CADM" SG_ 1487 Total_Battery_Capacity 0;
BA_ "GenSigTimeoutTime_DMSM" SG_ 1487 Total_Battery_Capacity 0;
BA_ "GenSigTimeoutTime_DTCM" SG_ 1487 Total_Battery_Capacity 0;
BA_ "GenSigTimeoutTime_ECM" SG_ 1487 Total_Battery_Capacity 0;
BA_ "GenSigTimeoutTime_EVCU2" SG_ 1487 Total_Battery_Capacity 0;
BA_ "GenSigTimeoutTime_GNMM" SG_ 1487 Total_Battery_Capacity 0;
BA_ "GenSigTimeoutTime_HCP" SG_ 1487 Total_Battery_Capacity 0;
BA_ "GenSigTimeoutTime_IPC" SG_ 1487 Total_Battery_Capacity 0;
BA_ "GenSigTimeoutTime_RFHM" SG_ 1487 Total_Battery_Capacity 0;
BA_ "GenSigTimeoutTime_TCM" SG_ 1487 Total_Battery_Capacity 0;
BA_ "GenSigTimeoutTime_AGSM" SG_ 266 HVBatCellVoltage_Max 0;
BA_ "GenSigTimeoutTime_BCM" SG_ 266 HVBatCellVoltage_Max 0;
BA_ "GenSigTimeoutTime_BSM" SG_ 266 HVBatCellVoltage_Max 0;
BA_ "GenSigTimeoutTime_CADM" SG_ 266 HVBatCellVoltage_Max 0;
BA_ "GenSigTimeoutTime_DMSM" SG_ 266 HVBatCellVoltage_Max 0;
BA_ "GenSigTimeoutTime_DTCM" SG_ 266 HVBatCellVoltage_Max 0;
BA_ "GenSigTimeoutTime_ECM" SG_ 266 HVBatCellVoltage_Max 0;
BA_ "GenSigTimeoutTime_EVCU2" SG_ 266 HVBatCellVoltage_Max 0;
BA_ "GenSigTimeoutTime_GNMM" SG_ 266 HVBatCellVoltage_Max 0;
BA_ "GenSigTimeoutTime_HCP" SG_ 266 HVBatCellVoltage_Max 0;
BA_ "GenSigTimeoutTime_IPC" SG_ 266 HVBatCellVoltage_Max 0;
BA_ "GenSigTimeoutTime_RFHM" SG_ 266 HVBatCellVoltage_Max 0;
BA_ "GenSigTimeoutTime_TCM" SG_ 266 HVBatCellVoltage_Max 0;
BA_ "GenSigTimeoutTime_AGSM" SG_ 266 HVBatCellVoltage_Min 0;
BA_ "GenSigTimeoutTime_BCM" SG_ 266 HVBatCellVoltage_Min 0;
BA_ "GenSigTimeoutTime_BSM" SG_ 266 HVBatCellVoltage_Min 0;
BA_ "GenSigTimeoutTime_CADM" SG_ 266 HVBatCellVoltage_Min 0;
BA_ "GenSigTimeoutTime_DMSM" SG_ 266 HVBatCellVoltage_Min 0;
BA_ "GenSigTimeoutTime_DTCM" SG_ 266 HVBatCellVoltage_Min 0;
BA_ "GenSigTimeoutTime_ECM" SG_ 266 HVBatCellVoltage_Min 0;
BA_ "GenSigTimeoutTime_EVCU2" SG_ 266 HVBatCellVoltage_Min 0;
BA_ "GenSigTimeoutTime_GNMM" SG_ 266 HVBatCellVoltage_Min 0;
BA_ "GenSigTimeoutTime_HCP" SG_ 266 HVBatCellVoltage_Min 0;
BA_ "GenSigTimeoutTime_IPC" SG_ 266 HVBatCellVoltage_Min 0;
BA_ "GenSigTimeoutTime_RFHM" SG_ 266 HVBatCellVoltage_Min 0;
BA_ "GenSigTimeoutTime_TCM" SG_ 266 HVBatCellVoltage_Min 0;
BA_ "GenSigTimeoutTime_AGSM" SG_ 266 HVBatCellVoltage_NumMax 0;
BA_ "GenSigTimeoutTime_BCM" SG_ 266 HVBatCellVoltage_NumMax 0;
BA_ "GenSigTimeoutTime_BSM" SG_ 266 HVBatCellVoltage_NumMax 0;
BA_ "GenSigTimeoutTime_CADM" SG_ 266 HVBatCellVoltage_NumMax 0;
BA_ "GenSigTimeoutTime_DMSM" SG_ 266 HVBatCellVoltage_NumMax 0;
BA_ "GenSigTimeoutTime_DTCM" SG_ 266 HVBatCellVoltage_NumMax 0;
BA_ "GenSigTimeoutTime_ECM" SG_ 266 HVBatCellVoltage_NumMax 0;
BA_ "GenSigTimeoutTime_EVCU2" SG_ 266 HVBatCellVoltage_NumMax 0;
BA_ "GenSigTimeoutTime_GNMM" SG_ 266 HVBatCellVoltage_NumMax 0;
BA_ "GenSigTimeoutTime_HCP" SG_ 266 HVBatCellVoltage_NumMax 0;
BA_ "GenSigTimeoutTime_IPC" SG_ 266 HVBatCellVoltage_NumMax 0;
BA_ "GenSigTimeoutTime_RFHM" SG_ 266 HVBatCellVoltage_NumMax 0;
BA_ "GenSigTimeoutTime_TCM" SG_ 266 HVBatCellVoltage_NumMax 0;
BA_ "GenSigTimeoutTime_AGSM" SG_ 266 HVBatContactorSts 0;
BA_ "GenSigTimeoutTime_BSM" SG_ 266 HVBatContactorSts 0;
BA_ "GenSigTimeoutTime_CADM" SG_ 266 HVBatContactorSts 0;
BA_ "GenSigTimeoutTime_DMSM" SG_ 266 HVBatContactorSts 0;
BA_ "GenSigTimeoutTime_DTCM" SG_ 266 HVBatContactorSts 0;
BA_ "GenSigTimeoutTime_ECM" SG_ 266 HVBatContactorSts 0;
BA_ "GenSigTimeoutTime_EVCU2" SG_ 266 HVBatContactorSts 0;
BA_ "GenSigTimeoutTime_GNMM" SG_ 266 HVBatContactorSts 0;
BA_ "GenSigTimeoutTime_HCP" SG_ 266 HVBatContactorSts 0;
BA_ "GenSigTimeoutTime_IPC" SG_ 266 HVBatContactorSts 0;
BA_ "GenSigTimeoutTime_RFHM" SG_ 266 HVBatContactorSts 0;
BA_ "GenSigTimeoutTime_SGW" SG_ 266 HVBatContactorSts 0;
BA_ "GenSigTimeoutTime_TCM" SG_ 266 HVBatContactorSts 0;
BA_ "GenSigTimeoutTime_AGSM" SG_ 266 HVBatModuleVoltage_NumMax 0;
BA_ "GenSigTimeoutTime_BCM" SG_ 266 HVBatModuleVoltage_NumMax 0;
BA_ "GenSigTimeoutTime_BSM" SG_ 266 HVBatModuleVoltage_NumMax 0;
BA_ "GenSigTimeoutTime_CADM" SG_ 266 HVBatModuleVoltage_NumMax 0;
BA_ "GenSigTimeoutTime_DMSM" SG_ 266 HVBatModuleVoltage_NumMax 0;
BA_ "GenSigTimeoutTime_DTCM" SG_ 266 HVBatModuleVoltage_NumMax 0;
BA_ "GenSigTimeoutTime_ECM" SG_ 266 HVBatModuleVoltage_NumMax 0;
BA_ "GenSigTimeoutTime_EVCU2" SG_ 266 HVBatModuleVoltage_NumMax 0;
BA_ "GenSigTimeoutTime_GNMM" SG_ 266 HVBatModuleVoltage_NumMax 0;
BA_ "GenSigTimeoutTime_HCP" SG_ 266 HVBatModuleVoltage_NumMax 0;
BA_ "GenSigTimeoutTime_IPC" SG_ 266 HVBatModuleVoltage_NumMax 0;
BA_ "GenSigTimeoutTime_RFHM" SG_ 266 HVBatModuleVoltage_NumMax 0;
BA_ "GenSigTimeoutTime_TCM" SG_ 266 HVBatModuleVoltage_NumMax 0;
BA_ "GenSigTimeoutTime_AGSM" SG_ 266 HVBatModuleVoltage_NumMin 0;
BA_ "GenSigTimeoutTime_BCM" SG_ 266 HVBatModuleVoltage_NumMin 0;
BA_ "GenSigTimeoutTime_BSM" SG_ 266 HVBatModuleVoltage_NumMin 0;
BA_ "GenSigTimeoutTime_CADM" SG_ 266 HVBatModuleVoltage_NumMin 0;
BA_ "GenSigTimeoutTime_DMSM" SG_ 266 HVBatModuleVoltage_NumMin 0;
BA_ "GenSigTimeoutTime_DTCM" SG_ 266 HVBatModuleVoltage_NumMin 0;
BA_ "GenSigTimeoutTime_ECM" SG_ 266 HVBatModuleVoltage_NumMin 0;
BA_ "GenSigTimeoutTime_EVCU2" SG_ 266 HVBatModuleVoltage_NumMin 0;
BA_ "GenSigTimeoutTime_GNMM" SG_ 266 HVBatModuleVoltage_NumMin 0;
BA_ "GenSigTimeoutTime_HCP" SG_ 266 HVBatModuleVoltage_NumMin 0;
BA_ "GenSigTimeoutTime_IPC" SG_ 266 HVBatModuleVoltage_NumMin 0;
BA_ "GenSigTimeoutTime_RFHM" SG_ 266 HVBatModuleVoltage_NumMin 0;
BA_ "GenSigTimeoutTime_TCM" SG_ 266 HVBatModuleVoltage_NumMin 0;
BA_ "GenSigTimeoutTime_AGSM" SG_ 266 HVBatteryCurrent 0;
BA_ "GenSigTimeoutTime_BCM" SG_ 266 HVBatteryCurrent 0;
BA_ "GenSigTimeoutTime_BSM" SG_ 266 HVBatteryCurrent 0;
BA_ "GenSigTimeoutTime_CADM" SG_ 266 HVBatteryCurrent 0;
BA_ "GenSigTimeoutTime_DMSM" SG_ 266 HVBatteryCurrent 0;
BA_ "GenSigTimeoutTime_DTCM" SG_ 266 HVBatteryCurrent 0;
BA_ "GenSigTimeoutTime_EVCU2" SG_ 266 HVBatteryCurrent 0;
BA_ "GenSigTimeoutTime_GNMM" SG_ 266 HVBatteryCurrent 0;
BA_ "GenSigTimeoutTime_HCP" SG_ 266 HVBatteryCurrent 0;
BA_ "GenSigTimeoutTime_IPC" SG_ 266 HVBatteryCurrent 0;
BA_ "GenSigTimeoutTime_RFHM" SG_ 266 HVBatteryCurrent 0;
BA_ "GenSigTimeoutTime_TCM" SG_ 266 HVBatteryCurrent 0;
BA_ "GenSigTimeoutTime_AGSM" SG_ 266 HVBatteryVoltage 0;
BA_ "GenSigTimeoutTime_BCM" SG_ 266 HVBatteryVoltage 0;
BA_ "GenSigTimeoutTime_BSM" SG_ 266 HVBatteryVoltage 0;
BA_ "GenSigTimeoutTime_CADM" SG_ 266 HVBatteryVoltage 0;
BA_ "GenSigTimeoutTime_DMSM" SG_ 266 HVBatteryVoltage 0;
BA_ "GenSigTimeoutTime_DTCM" SG_ 266 HVBatteryVoltage 0;
BA_ "GenSigTimeoutTime_ECM" SG_ 266 HVBatteryVoltage 0;
BA_ "GenSigTimeoutTime_EVCU2" SG_ 266 HVBatteryVoltage 0;
BA_ "GenSigTimeoutTime_GNMM" SG_ 266 HVBatteryVoltage 0;
BA_ "GenSigTimeoutTime_HCP" SG_ 266 HVBatteryVoltage 0;
BA_ "GenSigTimeoutTime_IPC" SG_ 266 HVBatteryVoltage 0;
BA_ "GenSigTimeoutTime_RFHM" SG_ 266 HVBatteryVoltage 0;
BA_ "GenSigTimeoutTime_TCM" SG_ 266 HVBatteryVoltage 0;
BA_ "GenSigTimeoutTime_AGSM" SG_ 266 IsolationSts_HVBattery 0;
BA_ "GenSigTimeoutTime_BCM" SG_ 266 IsolationSts_HVBattery 0;
BA_ "GenSigTimeoutTime_BSM" SG_ 266 IsolationSts_HVBattery 0;
BA_ "GenSigTimeoutTime_CADM" SG_ 266 IsolationSts_HVBattery 0;
BA_ "GenSigTimeoutTime_DMSM" SG_ 266 IsolationSts_HVBattery 0;
BA_ "GenSigTimeoutTime_DTCM" SG_ 266 IsolationSts_HVBattery 0;
BA_ "GenSigTimeoutTime_ECM" SG_ 266 IsolationSts_HVBattery 0;
BA_ "GenSigTimeoutTime_EVCU2" SG_ 266 IsolationSts_HVBattery 0;
BA_ "GenSigTimeoutTime_GNMM" SG_ 266 IsolationSts_HVBattery 0;
BA_ "GenSigTimeoutTime_HCP" SG_ 266 IsolationSts_HVBattery 0;
BA_ "GenSigTimeoutTime_IPC" SG_ 266 IsolationSts_HVBattery 0;
BA_ "GenSigTimeoutTime_RFHM" SG_ 266 IsolationSts_HVBattery 0;
BA_ "GenSigTimeoutTime_TCM" SG_ 266 IsolationSts_HVBattery 0;
BA_ "GenSigTimeoutTime_AGSM" SG_ 266 IsolationSts_HVPowertrain 0;
BA_ "GenSigTimeoutTime_BCM" SG_ 266 IsolationSts_HVPowertrain 0;
BA_ "GenSigTimeoutTime_BSM" SG_ 266 IsolationSts_HVPowertrain 0;
BA_ "GenSigTimeoutTime_CADM" SG_ 266 IsolationSts_HVPowertrain 0;
BA_ "GenSigTimeoutTime_DMSM" SG_ 266 IsolationSts_HVPowertrain 0;
BA_ "GenSigTimeoutTime_DTCM" SG_ 266 IsolationSts_HVPowertrain 0;
BA_ "GenSigTimeoutTime_ECM" SG_ 266 IsolationSts_HVPowertrain 0;
BA_ "GenSigTimeoutTime_EVCU2" SG_ 266 IsolationSts_HVPowertrain 0;
BA_ "GenSigTimeoutTime_GNMM" SG_ 266 IsolationSts_HVPowertrain 0;
BA_ "GenSigTimeoutTime_HCP" SG_ 266 IsolationSts_HVPowertrain 0;
BA_ "GenSigTimeoutTime_IPC" SG_ 266 IsolationSts_HVPowertrain 0;
BA_ "GenSigTimeoutTime_RFHM" SG_ 266 IsolationSts_HVPowertrain 0;
BA_ "GenSigTimeoutTime_TCM" SG_ 266 IsolationSts_HVPowertrain 0;
BA_ "GenSigTimeoutTime_AGSM" SG_ 1027 CRC_HVBATTERY2 0;
BA_ "GenSigTimeoutTime_BCM" SG_ 1027 CRC_HVBATTERY2 0;
BA_ "GenSigTimeoutTime_CADM" SG_ 1027 CRC_HVBATTERY2 0;
BA_ "GenSigTimeoutTime_DMSM" SG_ 1027 CRC_HVBATTERY2 0;
BA_ "GenSigTimeoutTime_DTCM" SG_ 1027 CRC_HVBATTERY2 0;
BA_ "GenSigTimeoutTime_ECM" SG_ 1027 CRC_HVBATTERY2 0;
BA_ "GenSigTimeoutTime_EVCU2" SG_ 1027 CRC_HVBATTERY2 0;
BA_ "GenSigTimeoutTime_GNMM" SG_ 1027 CRC_HVBATTERY2 0;
BA_ "GenSigTimeoutTime_HCP" SG_ 1027 CRC_HVBATTERY2 0;
BA_ "GenSigTimeoutTime_RFHM" SG_ 1027 CRC_HVBATTERY2 0;
BA_ "GenSigTimeoutTime_SGW" SG_ 1027 CRC_HVBATTERY2 0;
BA_ "GenSigTimeoutTime_TCM" SG_ 1027 CRC_HVBATTERY2 0;
BA_ "GenSigTimeoutTime_AGSM" SG_ 1027 HVBatteryMILRequest 0;
BA_ "GenSigTimeoutTime_BCM" SG_ 1027 HVBatteryMILRequest 0;
BA_ "GenSigTimeoutTime_BSM" SG_ 1027 HVBatteryMILRequest 0;
BA_ "GenSigTimeoutTime_CADM" SG_ 1027 HVBatteryMILRequest 0;
BA_ "GenSigTimeoutTime_DMSM" SG_ 1027 HVBatteryMILRequest 0;
BA_ "GenSigTimeoutTime_DTCM" SG_ 1027 HVBatteryMILRequest 0;
BA_ "GenSigTimeoutTime_EVCU2" SG_ 1027 HVBatteryMILRequest 0;
BA_ "GenSigTimeoutTime_GNMM" SG_ 1027 HVBatteryMILRequest 0;
BA_ "GenSigTimeoutTime_HCP" SG_ 1027 HVBatteryMILRequest 0;
BA_ "GenSigTimeoutTime_RFHM" SG_ 1027 HVBatteryMILRequest 0;
BA_ "GenSigTimeoutTime_TCM" SG_ 1027 HVBatteryMILRequest 0;
BA_ "GenSigTimeoutTime_AGSM" SG_ 1027 MessageCounter_HVBATTERY2 0;
BA_ "GenSigTimeoutTime_BCM" SG_ 1027 MessageCounter_HVBATTERY2 0;
BA_ "GenSigTimeoutTime_CADM" SG_ 1027 MessageCounter_HVBATTERY2 0;
BA_ "GenSigTimeoutTime_DMSM" SG_ 1027 MessageCounter_HVBATTERY2 0;
BA_ "GenSigTimeoutTime_DTCM" SG_ 1027 MessageCounter_HVBATTERY2 0;
BA_ "GenSigTimeoutTime_ECM" SG_ 1027 MessageCounter_HVBATTERY2 0;
BA_ "GenSigTimeoutTime_EVCU2" SG_ 1027 MessageCounter_HVBATTERY2 0;
BA_ "GenSigTimeoutTime_GNMM" SG_ 1027 MessageCounter_HVBATTERY2 0;
BA_ "GenSigTimeoutTime_HCP" SG_ 1027 MessageCounter_HVBATTERY2 0;
BA_ "GenSigTimeoutTime_RFHM" SG_ 1027 MessageCounter_HVBATTERY2 0;
BA_ "GenSigTimeoutTime_SGW" SG_ 1027 MessageCounter_HVBATTERY2 0;
BA_ "GenSigTimeoutTime_TCM" SG_ 1027 MessageCounter_HVBATTERY2 0;
BA_ "GenSigTimeoutTime_AGSM" SG_ 1834 HVBattery_RealTimeClock 0;
BA_ "GenSigTimeoutTime_BCM" SG_ 1834 HVBattery_RealTimeClock 0;
BA_ "GenSigTimeoutTime_BSM" SG_ 1834 HVBattery_RealTimeClock 0;
BA_ "GenSigTimeoutTime_CADM" SG_ 1834 HVBattery_RealTimeClock 0;
BA_ "GenSigTimeoutTime_DMSM" SG_ 1834 HVBattery_RealTimeClock 0;
BA_ "GenSigTimeoutTime_DTCM" SG_ 1834 HVBattery_RealTimeClock 0;
BA_ "GenSigTimeoutTime_EVCU2" SG_ 1834 HVBattery_RealTimeClock 0;
BA_ "GenSigTimeoutTime_GNMM" SG_ 1834 HVBattery_RealTimeClock 0;
BA_ "GenSigTimeoutTime_HCP" SG_ 1834 HVBattery_RealTimeClock 0;
BA_ "GenSigTimeoutTime_IPC" SG_ 1834 HVBattery_RealTimeClock 0;
BA_ "GenSigTimeoutTime_RFHM" SG_ 1834 HVBattery_RealTimeClock 0;
BA_ "GenSigTimeoutTime_SGW" SG_ 1834 HVBattery_RealTimeClock 0;
BA_ "GenSigTimeoutTime_TCM" SG_ 1834 HVBattery_RealTimeClock 0;
BA_ "GenSigTimeoutTime_AGSM" SG_ 1834 HVBattery_RealTimeClockV 0;
BA_ "GenSigTimeoutTime_BCM" SG_ 1834 HVBattery_RealTimeClockV 0;
BA_ "GenSigTimeoutTime_BSM" SG_ 1834 HVBattery_RealTimeClockV 0;
BA_ "GenSigTimeoutTime_CADM" SG_ 1834 HVBattery_RealTimeClockV 0;
BA_ "GenSigTimeoutTime_DMSM" SG_ 1834 HVBattery_RealTimeClockV 0;
BA_ "GenSigTimeoutTime_DTCM" SG_ 1834 HVBattery_RealTimeClockV 0;
BA_ "GenSigTimeoutTime_EVCU2" SG_ 1834 HVBattery_RealTimeClockV 0;
BA_ "GenSigTimeoutTime_GNMM" SG_ 1834 HVBattery_RealTimeClockV 0;
BA_ "GenSigTimeoutTime_HCP" SG_ 1834 HVBattery_RealTimeClockV 0;
BA_ "GenSigTimeoutTime_IPC" SG_ 1834 HVBattery_RealTimeClockV 0;
BA_ "GenSigTimeoutTime_RFHM" SG_ 1834 HVBattery_RealTimeClockV 0;
BA_ "GenSigTimeoutTime_SGW" SG_ 1834 HVBattery_RealTimeClockV 0;
BA_ "GenSigTimeoutTime_TCM" SG_ 1834 HVBattery_RealTimeClockV 0;
BA_ "GenSigTimeoutTime_AGSM" SG_ 1579 ChargeSystemSts 0;
BA_ "GenSigTimeoutTime_BCM" SG_ 1579 ChargeSystemSts 0;
BA_ "GenSigTimeoutTime_BSM" SG_ 1579 ChargeSystemSts 0;
BA_ "GenSigTimeoutTime_CADM" SG_ 1579 ChargeSystemSts 0;
BA_ "GenSigTimeoutTime_DMSM" SG_ 1579 ChargeSystemSts 0;
BA_ "GenSigTimeoutTime_DTCM" SG_ 1579 ChargeSystemSts 0;
BA_ "GenSigTimeoutTime_EVCU2" SG_ 1579 ChargeSystemSts 0;
BA_ "GenSigTimeoutTime_GNMM" SG_ 1579 ChargeSystemSts 0;
BA_ "GenSigTimeoutTime_HCP" SG_ 1579 ChargeSystemSts 0;
BA_ "GenSigTimeoutTime_IPC" SG_ 1579 ChargeSystemSts 0;
BA_ "GenSigTimeoutTime_RFHM" SG_ 1579 ChargeSystemSts 0;
BA_ "GenSigTimeoutTime_SGW" SG_ 1579 ChargeSystemSts 0;
BA_ "GenSigTimeoutTime_TCM" SG_ 1579 ChargeSystemSts 0;
BA_ "GenSigTimeoutTime_AGSM" SG_ 1049 BatteryPowerUsage 0;
BA_ "GenSigTimeoutTime_BCM" SG_ 1049 BatteryPowerUsage 0;
BA_ "GenSigTimeoutTime_BSM" SG_ 1049 BatteryPowerUsage 0;
BA_ "GenSigTimeoutTime_CADM" SG_ 1049 BatteryPowerUsage 0;
BA_ "GenSigTimeoutTime_DMSM" SG_ 1049 BatteryPowerUsage 0;
BA_ "GenSigTimeoutTime_DTCM" SG_ 1049 BatteryPowerUsage 0;
BA_ "GenSigTimeoutTime_ECM" SG_ 1049 BatteryPowerUsage 0;
BA_ "GenSigTimeoutTime_EVCU2" SG_ 1049 BatteryPowerUsage 0;
BA_ "GenSigTimeoutTime_GNMM" SG_ 1049 BatteryPowerUsage 0;
BA_ "GenSigTimeoutTime_HCP" SG_ 1049 BatteryPowerUsage 0;
BA_ "GenSigTimeoutTime_IPC" SG_ 1049 BatteryPowerUsage 0;
BA_ "GenSigTimeoutTime_RFHM" SG_ 1049 BatteryPowerUsage 0;
BA_ "GenSigTimeoutTime_TCM" SG_ 1049 BatteryPowerUsage 0;
BA_ "GenSigTimeoutTime_AGSM" SG_ 1049 BatteryPowerUsageV 0;
BA_ "GenSigTimeoutTime_BCM" SG_ 1049 BatteryPowerUsageV 0;
BA_ "GenSigTimeoutTime_BSM" SG_ 1049 BatteryPowerUsageV 0;
BA_ "GenSigTimeoutTime_CADM" SG_ 1049 BatteryPowerUsageV 0;
BA_ "GenSigTimeoutTime_DMSM" SG_ 1049 BatteryPowerUsageV 0;
BA_ "GenSigTimeoutTime_DTCM" SG_ 1049 BatteryPowerUsageV 0;
BA_ "GenSigTimeoutTime_ECM" SG_ 1049 BatteryPowerUsageV 0;
BA_ "GenSigTimeoutTime_EVCU2" SG_ 1049 BatteryPowerUsageV 0;
BA_ "GenSigTimeoutTime_GNMM" SG_ 1049 BatteryPowerUsageV 0;
BA_ "GenSigTimeoutTime_HCP" SG_ 1049 BatteryPowerUsageV 0;
BA_ "GenSigTimeoutTime_IPC" SG_ 1049 BatteryPowerUsageV 0;
BA_ "GenSigTimeoutTime_RFHM" SG_ 1049 BatteryPowerUsageV 0;
BA_ "GenSigTimeoutTime_TCM" SG_ 1049 BatteryPowerUsageV 0;
BA_ "GenSigTimeoutTime_AGSM" SG_ 1049 BatteryPowerUse_Display 0;
BA_ "GenSigTimeoutTime_BCM" SG_ 1049 BatteryPowerUse_Display 0;
BA_ "GenSigTimeoutTime_BSM" SG_ 1049 BatteryPowerUse_Display 0;
BA_ "GenSigTimeoutTime_CADM" SG_ 1049 BatteryPowerUse_Display 0;
BA_ "GenSigTimeoutTime_DMSM" SG_ 1049 BatteryPowerUse_Display 0;
BA_ "GenSigTimeoutTime_DTCM" SG_ 1049 BatteryPowerUse_Display 0;
BA_ "GenSigTimeoutTime_ECM" SG_ 1049 BatteryPowerUse_Display 0;
BA_ "GenSigTimeoutTime_EVCU2" SG_ 1049 BatteryPowerUse_Display 0;
BA_ "GenSigTimeoutTime_GNMM" SG_ 1049 BatteryPowerUse_Display 0;
BA_ "GenSigTimeoutTime_HCP" SG_ 1049 BatteryPowerUse_Display 0;
BA_ "GenSigTimeoutTime_IPC" SG_ 1049 BatteryPowerUse_Display 0;
BA_ "GenSigTimeoutTime_RFHM" SG_ 1049 BatteryPowerUse_Display 0;
BA_ "GenSigTimeoutTime_TCM" SG_ 1049 BatteryPowerUse_Display 0;
BA_ "GenSigTimeoutTime_AGSM" SG_ 1049 BatteryPowerUse_DisplayV 0;
BA_ "GenSigTimeoutTime_BCM" SG_ 1049 BatteryPowerUse_DisplayV 0;
BA_ "GenSigTimeoutTime_BSM" SG_ 1049 BatteryPowerUse_DisplayV 0;
BA_ "GenSigTimeoutTime_CADM" SG_ 1049 BatteryPowerUse_DisplayV 0;
BA_ "GenSigTimeoutTime_DMSM" SG_ 1049 BatteryPowerUse_DisplayV 0;
BA_ "GenSigTimeoutTime_DTCM" SG_ 1049 BatteryPowerUse_DisplayV 0;
BA_ "GenSigTimeoutTime_ECM" SG_ 1049 BatteryPowerUse_DisplayV 0;
BA_ "GenSigTimeoutTime_EVCU2" SG_ 1049 BatteryPowerUse_DisplayV 0;
BA_ "GenSigTimeoutTime_GNMM" SG_ 1049 BatteryPowerUse_DisplayV 0;
BA_ "GenSigTimeoutTime_HCP" SG_ 1049 BatteryPowerUse_DisplayV 0;
BA_ "GenSigTimeoutTime_IPC" SG_ 1049 BatteryPowerUse_DisplayV 0;
BA_ "GenSigTimeoutTime_RFHM" SG_ 1049 BatteryPowerUse_DisplayV 0;
BA_ "GenSigTimeoutTime_TCM" SG_ 1049 BatteryPowerUse_DisplayV 0;
BA_ "GenSigTimeoutTime_AGSM" SG_ 1049 ChargeSystemFault_DPT 0;
BA_ "GenSigTimeoutTime_BCM" SG_ 1049 ChargeSystemFault_DPT 0;
BA_ "GenSigTimeoutTime_BSM" SG_ 1049 ChargeSystemFault_DPT 0;
BA_ "GenSigTimeoutTime_CADM" SG_ 1049 ChargeSystemFault_DPT 0;
BA_ "GenSigTimeoutTime_DMSM" SG_ 1049 ChargeSystemFault_DPT 0;
BA_ "GenSigTimeoutTime_DTCM" SG_ 1049 ChargeSystemFault_DPT 0;
BA_ "GenSigTimeoutTime_ECM" SG_ 1049 ChargeSystemFault_DPT 0;
BA_ "GenSigTimeoutTime_EVCU2" SG_ 1049 ChargeSystemFault_DPT 0;
BA_ "GenSigTimeoutTime_GNMM" SG_ 1049 ChargeSystemFault_DPT 0;
BA_ "GenSigTimeoutTime_HCP" SG_ 1049 ChargeSystemFault_DPT 0;
BA_ "GenSigTimeoutTime_RFHM" SG_ 1049 ChargeSystemFault_DPT 0;
BA_ "GenSigTimeoutTime_TCM" SG_ 1049 ChargeSystemFault_DPT 0;
BA_ "GenSigSendType" SG_ 1049 ChargeSystemSts_DPT 3;
BA_ "GenSigTimeoutTime_AGSM" SG_ 1049 ChargeSystemSts_DPT 0;
BA_ "GenSigTimeoutTime_BSM" SG_ 1049 ChargeSystemSts_DPT 0;
BA_ "GenSigTimeoutTime_CADM" SG_ 1049 ChargeSystemSts_DPT 0;
BA_ "GenSigTimeoutTime_DMSM" SG_ 1049 ChargeSystemSts_DPT 0;
BA_ "GenSigTimeoutTime_DTCM" SG_ 1049 ChargeSystemSts_DPT 0;
BA_ "GenSigTimeoutTime_EVCU2" SG_ 1049 ChargeSystemSts_DPT 0;
BA_ "GenSigTimeoutTime_GNMM" SG_ 1049 ChargeSystemSts_DPT 0;
BA_ "GenSigTimeoutTime_HCP" SG_ 1049 ChargeSystemSts_DPT 0;
BA_ "GenSigTimeoutTime_RFHM" SG_ 1049 ChargeSystemSts_DPT 0;
BA_ "GenSigTimeoutTime_TCM" SG_ 1049 ChargeSystemSts_DPT 0;
BA_ "GenSigTimeoutTime_AGSM" SG_ 1049 ChargingLevelForDisplay 0;
BA_ "GenSigTimeoutTime_BCM" SG_ 1049 ChargingLevelForDisplay 0;
BA_ "GenSigTimeoutTime_BSM" SG_ 1049 ChargingLevelForDisplay 0;
BA_ "GenSigTimeoutTime_CADM" SG_ 1049 ChargingLevelForDisplay 0;
BA_ "GenSigTimeoutTime_DMSM" SG_ 1049 ChargingLevelForDisplay 0;
BA_ "GenSigTimeoutTime_DTCM" SG_ 1049 ChargingLevelForDisplay 0;
BA_ "GenSigTimeoutTime_ECM" SG_ 1049 ChargingLevelForDisplay 0;
BA_ "GenSigTimeoutTime_EVCU2" SG_ 1049 ChargingLevelForDisplay 0;
BA_ "GenSigTimeoutTime_GNMM" SG_ 1049 ChargingLevelForDisplay 0;
BA_ "GenSigTimeoutTime_HCP" SG_ 1049 ChargingLevelForDisplay 0;
BA_ "GenSigTimeoutTime_RFHM" SG_ 1049 ChargingLevelForDisplay 0;
BA_ "GenSigTimeoutTime_TCM" SG_ 1049 ChargingLevelForDisplay 0;
BA_ "GenSigTimeoutTime_AGSM" SG_ 1049 CRC_HYBRID_DISPLAY 0;
BA_ "GenSigTimeoutTime_BSM" SG_ 1049 CRC_HYBRID_DISPLAY 0;
BA_ "GenSigTimeoutTime_DMSM" SG_ 1049 CRC_HYBRID_DISPLAY 0;
BA_ "GenSigTimeoutTime_DTCM" SG_ 1049 CRC_HYBRID_DISPLAY 0;
BA_ "GenSigTimeoutTime_ECM" SG_ 1049 CRC_HYBRID_DISPLAY 0;
BA_ "GenSigTimeoutTime_EVCU2" SG_ 1049 CRC_HYBRID_DISPLAY 0;
BA_ "GenSigTimeoutTime_GNMM" SG_ 1049 CRC_HYBRID_DISPLAY 0;
BA_ "GenSigTimeoutTime_HCP" SG_ 1049 CRC_HYBRID_DISPLAY 0;
BA_ "GenSigTimeoutTime_RFHM" SG_ 1049 CRC_HYBRID_DISPLAY 0;
BA_ "GenSigTimeoutTime_SGW" SG_ 1049 CRC_HYBRID_DISPLAY 0;
BA_ "GenSigTimeoutTime_TCM" SG_ 1049 CRC_HYBRID_DISPLAY 0;
BA_ "GenSigTimeoutTime_AGSM" SG_ 1049 EnginePowerUse_Display 0;
BA_ "GenSigTimeoutTime_BCM" SG_ 1049 EnginePowerUse_Display 0;
BA_ "GenSigTimeoutTime_BSM" SG_ 1049 EnginePowerUse_Display 0;
BA_ "GenSigTimeoutTime_CADM" SG_ 1049 EnginePowerUse_Display 0;
BA_ "GenSigTimeoutTime_DMSM" SG_ 1049 EnginePowerUse_Display 0;
BA_ "GenSigTimeoutTime_DTCM" SG_ 1049 EnginePowerUse_Display 0;
BA_ "GenSigTimeoutTime_ECM" SG_ 1049 EnginePowerUse_Display 0;
BA_ "GenSigTimeoutTime_EVCU2" SG_ 1049 EnginePowerUse_Display 0;
BA_ "GenSigTimeoutTime_GNMM" SG_ 1049 EnginePowerUse_Display 0;
BA_ "GenSigTimeoutTime_HCP" SG_ 1049 EnginePowerUse_Display 0;
BA_ "GenSigTimeoutTime_IPC" SG_ 1049 EnginePowerUse_Display 0;
BA_ "GenSigTimeoutTime_RFHM" SG_ 1049 EnginePowerUse_Display 0;
BA_ "GenSigTimeoutTime_TCM" SG_ 1049 EnginePowerUse_Display 0;
BA_ "GenSigTimeoutTime_AGSM" SG_ 1049 EnginePowerUse_DisplayV 0;
BA_ "GenSigTimeoutTime_BCM" SG_ 1049 EnginePowerUse_DisplayV 0;
BA_ "GenSigTimeoutTime_BSM" SG_ 1049 EnginePowerUse_DisplayV 0;
BA_ "GenSigTimeoutTime_CADM" SG_ 1049 EnginePowerUse_DisplayV 0;
BA_ "GenSigTimeoutTime_DMSM" SG_ 1049 EnginePowerUse_DisplayV 0;
BA_ "GenSigTimeoutTime_DTCM" SG_ 1049 EnginePowerUse_DisplayV 0;
BA_ "GenSigTimeoutTime_ECM" SG_ 1049 EnginePowerUse_DisplayV 0;
BA_ "GenSigTimeoutTime_EVCU2" SG_ 1049 EnginePowerUse_DisplayV 0;
BA_ "GenSigTimeoutTime_GNMM" SG_ 1049 EnginePowerUse_DisplayV 0;
BA_ "GenSigTimeoutTime_HCP" SG_ 1049 EnginePowerUse_DisplayV 0;
BA_ "GenSigTimeoutTime_IPC" SG_ 1049 EnginePowerUse_DisplayV 0;
BA_ "GenSigTimeoutTime_RFHM" SG_ 1049 EnginePowerUse_DisplayV 0;
BA_ "GenSigTimeoutTime_TCM" SG_ 1049 EnginePowerUse_DisplayV 0;
BA_ "GenSigStartValue" SG_ 1049 EstimatedRange 255;
BA_ "GenSigTimeoutTime_AGSM" SG_ 1049 EstimatedRange 0;
BA_ "GenSigTimeoutTime_BCM" SG_ 1049 EstimatedRange 0;
BA_ "GenSigTimeoutTime_BSM" SG_ 1049 EstimatedRange 0;
BA_ "GenSigTimeoutTime_CADM" SG_ 1049 EstimatedRange 0;
BA_ "GenSigTimeoutTime_DMSM" SG_ 1049 EstimatedRange 0;
BA_ "GenSigTimeoutTime_DTCM" SG_ 1049 EstimatedRange 0;
BA_ "GenSigTimeoutTime_ECM" SG_ 1049 EstimatedRange 0;
BA_ "GenSigTimeoutTime_EVCU2" SG_ 1049 EstimatedRange 0;
BA_ "GenSigTimeoutTime_GNMM" SG_ 1049 EstimatedRange 0;
BA_ "GenSigTimeoutTime_HCP" SG_ 1049 EstimatedRange 0;
BA_ "GenSigTimeoutTime_IPC" SG_ 1049 EstimatedRange 0;
BA_ "GenSigTimeoutTime_RFHM" SG_ 1049 EstimatedRange 0;
BA_ "GenSigTimeoutTime_TCM" SG_ 1049 EstimatedRange 0;
BA_ "GenSigTimeoutTime_AGSM" SG_ 1049 FOTA_Schedule_Conflict 0;
BA_ "GenSigTimeoutTime_BCM" SG_ 1049 FOTA_Schedule_Conflict 0;
BA_ "GenSigTimeoutTime_BSM" SG_ 1049 FOTA_Schedule_Conflict 0;
BA_ "GenSigTimeoutTime_CADM" SG_ 1049 FOTA_Schedule_Conflict 0;
BA_ "GenSigTimeoutTime_DMSM" SG_ 1049 FOTA_Schedule_Conflict 0;
BA_ "GenSigTimeoutTime_DTCM" SG_ 1049 FOTA_Schedule_Conflict 0;
BA_ "GenSigTimeoutTime_ECM" SG_ 1049 FOTA_Schedule_Conflict 0;
BA_ "GenSigTimeoutTime_EVCU2" SG_ 1049 FOTA_Schedule_Conflict 0;
BA_ "GenSigTimeoutTime_GNMM" SG_ 1049 FOTA_Schedule_Conflict 0;
BA_ "GenSigTimeoutTime_HCP" SG_ 1049 FOTA_Schedule_Conflict 0;
BA_ "GenSigTimeoutTime_IPC" SG_ 1049 FOTA_Schedule_Conflict 0;
BA_ "GenSigTimeoutTime_RFHM" SG_ 1049 FOTA_Schedule_Conflict 0;
BA_ "GenSigTimeoutTime_TCM" SG_ 1049 FOTA_Schedule_Conflict 0;
BA_ "GenSigTimeoutTime_AGSM" SG_ 1049 HCP_EVServiceLampOn 0;
BA_ "GenSigTimeoutTime_BCM" SG_ 1049 HCP_EVServiceLampOn 0;
BA_ "GenSigTimeoutTime_BSM" SG_ 1049 HCP_EVServiceLampOn 0;
BA_ "GenSigTimeoutTime_CADM" SG_ 1049 HCP_EVServiceLampOn 0;
BA_ "GenSigTimeoutTime_DMSM" SG_ 1049 HCP_EVServiceLampOn 0;
BA_ "GenSigTimeoutTime_DTCM" SG_ 1049 HCP_EVServiceLampOn 0;
BA_ "GenSigTimeoutTime_ECM" SG_ 1049 HCP_EVServiceLampOn 0;
BA_ "GenSigTimeoutTime_EVCU2" SG_ 1049 HCP_EVServiceLampOn 0;
BA_ "GenSigTimeoutTime_GNMM" SG_ 1049 HCP_EVServiceLampOn 0;
BA_ "GenSigTimeoutTime_HCP" SG_ 1049 HCP_EVServiceLampOn 0;
BA_ "GenSigTimeoutTime_RFHM" SG_ 1049 HCP_EVServiceLampOn 0;
BA_ "GenSigTimeoutTime_TCM" SG_ 1049 HCP_EVServiceLampOn 0;
BA_ "GenSigTimeoutTime_AGSM" SG_ 1049 HVACPowerUse_Display 0;
BA_ "GenSigTimeoutTime_BCM" SG_ 1049 HVACPowerUse_Display 0;
BA_ "GenSigTimeoutTime_BSM" SG_ 1049 HVACPowerUse_Display 0;
BA_ "GenSigTimeoutTime_CADM" SG_ 1049 HVACPowerUse_Display 0;
BA_ "GenSigTimeoutTime_DMSM" SG_ 1049 HVACPowerUse_Display 0;
BA_ "GenSigTimeoutTime_DTCM" SG_ 1049 HVACPowerUse_Display 0;
BA_ "GenSigTimeoutTime_ECM" SG_ 1049 HVACPowerUse_Display 0;
BA_ "GenSigTimeoutTime_EVCU2" SG_ 1049 HVACPowerUse_Display 0;
BA_ "GenSigTimeoutTime_GNMM" SG_ 1049 HVACPowerUse_Display 0;
BA_ "GenSigTimeoutTime_HCP" SG_ 1049 HVACPowerUse_Display 0;
BA_ "GenSigTimeoutTime_IPC" SG_ 1049 HVACPowerUse_Display 0;
BA_ "GenSigTimeoutTime_RFHM" SG_ 1049 HVACPowerUse_Display 0;
BA_ "GenSigTimeoutTime_TCM" SG_ 1049 HVACPowerUse_Display 0;
BA_ "GenSigTimeoutTime_AGSM" SG_ 1049 HVACPowerUse_DisplayV 0;
BA_ "GenSigTimeoutTime_BCM" SG_ 1049 HVACPowerUse_DisplayV 0;
BA_ "GenSigTimeoutTime_BSM" SG_ 1049 HVACPowerUse_DisplayV 0;
BA_ "GenSigTimeoutTime_CADM" SG_ 1049 HVACPowerUse_DisplayV 0;
BA_ "GenSigTimeoutTime_DMSM" SG_ 1049 HVACPowerUse_DisplayV 0;
BA_ "GenSigTimeoutTime_DTCM" SG_ 1049 HVACPowerUse_DisplayV 0;
BA_ "GenSigTimeoutTime_ECM" SG_ 1049 HVACPowerUse_DisplayV 0;
BA_ "GenSigTimeoutTime_EVCU2" SG_ 1049 HVACPowerUse_DisplayV 0;
BA_ "GenSigTimeoutTime_GNMM" SG_ 1049 HVACPowerUse_DisplayV 0;
BA_ "GenSigTimeoutTime_HCP" SG_ 1049 HVACPowerUse_DisplayV 0;
BA_ "GenSigTimeoutTime_IPC" SG_ 1049 HVACPowerUse_DisplayV 0;
BA_ "GenSigTimeoutTime_RFHM" SG_ 1049 HVACPowerUse_DisplayV 0;
BA_ "GenSigTimeoutTime_TCM" SG_ 1049 HVACPowerUse_DisplayV 0;
BA_ "GenSigTimeoutTime_AGSM" SG_ 1049 HVBatterySOC_Display 0;
BA_ "GenSigTimeoutTime_BSM" SG_ 1049 HVBatterySOC_Display 0;
BA_ "GenSigTimeoutTime_CADM" SG_ 1049 HVBatterySOC_Display 0;
BA_ "GenSigTimeoutTime_DMSM" SG_ 1049 HVBatterySOC_Display 0;
BA_ "GenSigTimeoutTime_DTCM" SG_ 1049 HVBatterySOC_Display 0;
BA_ "GenSigTimeoutTime_ECM" SG_ 1049 HVBatterySOC_Display 0;
BA_ "GenSigTimeoutTime_EVCU2" SG_ 1049 HVBatterySOC_Display 0;
BA_ "GenSigTimeoutTime_GNMM" SG_ 1049 HVBatterySOC_Display 0;
BA_ "GenSigTimeoutTime_HCP" SG_ 1049 HVBatterySOC_Display 0;
BA_ "GenSigTimeoutTime_RFHM" SG_ 1049 HVBatterySOC_Display 0;
BA_ "GenSigTimeoutTime_TCM" SG_ 1049 HVBatterySOC_Display 0;
BA_ "GenSigTimeoutTime_AGSM" SG_ 1049 HVBatterySOC_DisplayV 0;
BA_ "GenSigTimeoutTime_BCM" SG_ 1049 HVBatterySOC_DisplayV 0;
BA_ "GenSigTimeoutTime_BSM" SG_ 1049 HVBatterySOC_DisplayV 0;
BA_ "GenSigTimeoutTime_CADM" SG_ 1049 HVBatterySOC_DisplayV 0;
BA_ "GenSigTimeoutTime_DMSM" SG_ 1049 HVBatterySOC_DisplayV 0;
BA_ "GenSigTimeoutTime_DTCM" SG_ 1049 HVBatterySOC_DisplayV 0;
BA_ "GenSigTimeoutTime_ECM" SG_ 1049 HVBatterySOC_DisplayV 0;
BA_ "GenSigTimeoutTime_EVCU2" SG_ 1049 HVBatterySOC_DisplayV 0;
BA_ "GenSigTimeoutTime_GNMM" SG_ 1049 HVBatterySOC_DisplayV 0;
BA_ "GenSigTimeoutTime_HCP" SG_ 1049 HVBatterySOC_DisplayV 0;
BA_ "GenSigTimeoutTime_RFHM" SG_ 1049 HVBatterySOC_DisplayV 0;
BA_ "GenSigTimeoutTime_TCM" SG_ 1049 HVBatterySOC_DisplayV 0;
BA_ "GenSigStartValue" SG_ 1049 HybridEfficiencyCoach 64;
BA_ "GenSigTimeoutTime_AGSM" SG_ 1049 HybridEfficiencyCoach 0;
BA_ "GenSigTimeoutTime_BCM" SG_ 1049 HybridEfficiencyCoach 0;
BA_ "GenSigTimeoutTime_BSM" SG_ 1049 HybridEfficiencyCoach 0;
BA_ "GenSigTimeoutTime_CADM" SG_ 1049 HybridEfficiencyCoach 0;
BA_ "GenSigTimeoutTime_DMSM" SG_ 1049 HybridEfficiencyCoach 0;
BA_ "GenSigTimeoutTime_DTCM" SG_ 1049 HybridEfficiencyCoach 0;
BA_ "GenSigTimeoutTime_ECM" SG_ 1049 HybridEfficiencyCoach 0;
BA_ "GenSigTimeoutTime_EVCU2" SG_ 1049 HybridEfficiencyCoach 0;
BA_ "GenSigTimeoutTime_GNMM" SG_ 1049 HybridEfficiencyCoach 0;
BA_ "GenSigTimeoutTime_HCP" SG_ 1049 HybridEfficiencyCoach 0;
BA_ "GenSigTimeoutTime_IPC" SG_ 1049 HybridEfficiencyCoach 0;
BA_ "GenSigTimeoutTime_RFHM" SG_ 1049 HybridEfficiencyCoach 0;
BA_ "GenSigTimeoutTime_TCM" SG_ 1049 HybridEfficiencyCoach 0;
BA_ "GenSigTimeoutTime_AGSM" SG_ 1049 HybridEfficiencyCoachV 0;
BA_ "GenSigTimeoutTime_BCM" SG_ 1049 HybridEfficiencyCoachV 0;
BA_ "GenSigTimeoutTime_BSM" SG_ 1049 HybridEfficiencyCoachV 0;
BA_ "GenSigTimeoutTime_CADM" SG_ 1049 HybridEfficiencyCoachV 0;
BA_ "GenSigTimeoutTime_DMSM" SG_ 1049 HybridEfficiencyCoachV 0;
BA_ "GenSigTimeoutTime_DTCM" SG_ 1049 HybridEfficiencyCoachV 0;
BA_ "GenSigTimeoutTime_ECM" SG_ 1049 HybridEfficiencyCoachV 0;
BA_ "GenSigTimeoutTime_EVCU2" SG_ 1049 HybridEfficiencyCoachV 0;
BA_ "GenSigTimeoutTime_GNMM" SG_ 1049 HybridEfficiencyCoachV 0;
BA_ "GenSigTimeoutTime_HCP" SG_ 1049 HybridEfficiencyCoachV 0;
BA_ "GenSigTimeoutTime_IPC" SG_ 1049 HybridEfficiencyCoachV 0;
BA_ "GenSigTimeoutTime_RFHM" SG_ 1049 HybridEfficiencyCoachV 0;
BA_ "GenSigTimeoutTime_TCM" SG_ 1049 HybridEfficiencyCoachV 0;
BA_ "GenSigTimeoutTime_AGSM" SG_ 1049 HybridMILRequest 0;
BA_ "GenSigTimeoutTime_BCM" SG_ 1049 HybridMILRequest 0;
BA_ "GenSigTimeoutTime_BSM" SG_ 1049 HybridMILRequest 0;
BA_ "GenSigTimeoutTime_CADM" SG_ 1049 HybridMILRequest 0;
BA_ "GenSigTimeoutTime_DMSM" SG_ 1049 HybridMILRequest 0;
BA_ "GenSigTimeoutTime_DTCM" SG_ 1049 HybridMILRequest 0;
BA_ "GenSigTimeoutTime_EVCU2" SG_ 1049 HybridMILRequest 0;
BA_ "GenSigTimeoutTime_GNMM" SG_ 1049 HybridMILRequest 0;
BA_ "GenSigTimeoutTime_HCP" SG_ 1049 HybridMILRequest 0;
BA_ "GenSigTimeoutTime_IPC" SG_ 1049 HybridMILRequest 0;
BA_ "GenSigTimeoutTime_RFHM" SG_ 1049 HybridMILRequest 0;
BA_ "GenSigTimeoutTime_TCM" SG_ 1049 HybridMILRequest 0;
BA_ "GenSigStartValue" SG_ 1049 HybridOutputPower 64;
BA_ "GenSigTimeoutTime_AGSM" SG_ 1049 HybridOutputPower 0;
BA_ "GenSigTimeoutTime_BCM" SG_ 1049 HybridOutputPower 0;
BA_ "GenSigTimeoutTime_BSM" SG_ 1049 HybridOutputPower 0;
BA_ "GenSigTimeoutTime_CADM" SG_ 1049 HybridOutputPower 0;
BA_ "GenSigTimeoutTime_DMSM" SG_ 1049 HybridOutputPower 0;
BA_ "GenSigTimeoutTime_DTCM" SG_ 1049 HybridOutputPower 0;
BA_ "GenSigTimeoutTime_ECM" SG_ 1049 HybridOutputPower 0;
BA_ "GenSigTimeoutTime_EVCU2" SG_ 1049 HybridOutputPower 0;
BA_ "GenSigTimeoutTime_GNMM" SG_ 1049 HybridOutputPower 0;
BA_ "GenSigTimeoutTime_HCP" SG_ 1049 HybridOutputPower 0;
BA_ "GenSigTimeoutTime_RFHM" SG_ 1049 HybridOutputPower 0;
BA_ "GenSigTimeoutTime_TCM" SG_ 1049 HybridOutputPower 0;
BA_ "GenSigTimeoutTime_AGSM" SG_ 1049 HybridOutputPowerV 0;
BA_ "GenSigTimeoutTime_BCM" SG_ 1049 HybridOutputPowerV 0;
BA_ "GenSigTimeoutTime_BSM" SG_ 1049 HybridOutputPowerV 0;
BA_ "GenSigTimeoutTime_CADM" SG_ 1049 HybridOutputPowerV 0;
BA_ "GenSigTimeoutTime_DMSM" SG_ 1049 HybridOutputPowerV 0;
BA_ "GenSigTimeoutTime_DTCM" SG_ 1049 HybridOutputPowerV 0;
BA_ "GenSigTimeoutTime_ECM" SG_ 1049 HybridOutputPowerV 0;
BA_ "GenSigTimeoutTime_EVCU2" SG_ 1049 HybridOutputPowerV 0;
BA_ "GenSigTimeoutTime_GNMM" SG_ 1049 HybridOutputPowerV 0;
BA_ "GenSigTimeoutTime_HCP" SG_ 1049 HybridOutputPowerV 0;
BA_ "GenSigTimeoutTime_RFHM" SG_ 1049 HybridOutputPowerV 0;
BA_ "GenSigTimeoutTime_TCM" SG_ 1049 HybridOutputPowerV 0;
BA_ "GenSigSendType" SG_ 1049 Lv1_EstChargeTime 3;
BA_ "GenSigTimeoutTime_AGSM" SG_ 1049 Lv1_EstChargeTime 0;
BA_ "GenSigTimeoutTime_BCM" SG_ 1049 Lv1_EstChargeTime 0;
BA_ "GenSigTimeoutTime_BSM" SG_ 1049 Lv1_EstChargeTime 0;
BA_ "GenSigTimeoutTime_CADM" SG_ 1049 Lv1_EstChargeTime 0;
BA_ "GenSigTimeoutTime_DMSM" SG_ 1049 Lv1_EstChargeTime 0;
BA_ "GenSigTimeoutTime_DTCM" SG_ 1049 Lv1_EstChargeTime 0;
BA_ "GenSigTimeoutTime_ECM" SG_ 1049 Lv1_EstChargeTime 0;
BA_ "GenSigTimeoutTime_EVCU2" SG_ 1049 Lv1_EstChargeTime 0;
BA_ "GenSigTimeoutTime_GNMM" SG_ 1049 Lv1_EstChargeTime 0;
BA_ "GenSigTimeoutTime_HCP" SG_ 1049 Lv1_EstChargeTime 0;
BA_ "GenSigTimeoutTime_RFHM" SG_ 1049 Lv1_EstChargeTime 0;
BA_ "GenSigTimeoutTime_TCM" SG_ 1049 Lv1_EstChargeTime 0;
BA_ "GenSigSendType" SG_ 1049 Lv2_EstChargeTime 3;
BA_ "GenSigTimeoutTime_AGSM" SG_ 1049 Lv2_EstChargeTime 0;
BA_ "GenSigTimeoutTime_BCM" SG_ 1049 Lv2_EstChargeTime 0;
BA_ "GenSigTimeoutTime_BSM" SG_ 1049 Lv2_EstChargeTime 0;
BA_ "GenSigTimeoutTime_CADM" SG_ 1049 Lv2_EstChargeTime 0;
BA_ "GenSigTimeoutTime_DMSM" SG_ 1049 Lv2_EstChargeTime 0;
BA_ "GenSigTimeoutTime_DTCM" SG_ 1049 Lv2_EstChargeTime 0;
BA_ "GenSigTimeoutTime_ECM" SG_ 1049 Lv2_EstChargeTime 0;
BA_ "GenSigTimeoutTime_EVCU2" SG_ 1049 Lv2_EstChargeTime 0;
BA_ "GenSigTimeoutTime_GNMM" SG_ 1049 Lv2_EstChargeTime 0;
BA_ "GenSigTimeoutTime_HCP" SG_ 1049 Lv2_EstChargeTime 0;
BA_ "GenSigTimeoutTime_RFHM" SG_ 1049 Lv2_EstChargeTime 0;
BA_ "GenSigTimeoutTime_TCM" SG_ 1049 Lv2_EstChargeTime 0;
BA_ "GenSigTimeoutTime_AGSM" SG_ 1049 MessageCounter_HYBRID_DISPLAY 0;
BA_ "GenSigTimeoutTime_BSM" SG_ 1049 MessageCounter_HYBRID_DISPLAY 0;
BA_ "GenSigTimeoutTime_DMSM" SG_ 1049 MessageCounter_HYBRID_DISPLAY 0;
BA_ "GenSigTimeoutTime_DTCM" SG_ 1049 MessageCounter_HYBRID_DISPLAY 0;
BA_ "GenSigTimeoutTime_ECM" SG_ 1049 MessageCounter_HYBRID_DISPLAY 0;
BA_ "GenSigTimeoutTime_EVCU2" SG_ 1049 MessageCounter_HYBRID_DISPLAY 0;
BA_ "GenSigTimeoutTime_GNMM" SG_ 1049 MessageCounter_HYBRID_DISPLAY 0;
BA_ "GenSigTimeoutTime_HCP" SG_ 1049 MessageCounter_HYBRID_DISPLAY 0;
BA_ "GenSigTimeoutTime_RFHM" SG_ 1049 MessageCounter_HYBRID_DISPLAY 0;
BA_ "GenSigTimeoutTime_SGW" SG_ 1049 MessageCounter_HYBRID_DISPLAY 0;
BA_ "GenSigTimeoutTime_TCM" SG_ 1049 MessageCounter_HYBRID_DISPLAY 0;
BA_ "GenSigTimeoutTime_AGSM" SG_ 1049 OnePedal_Drive_Sts 0;
BA_ "GenSigTimeoutTime_BCM" SG_ 1049 OnePedal_Drive_Sts 0;
BA_ "GenSigTimeoutTime_CADM" SG_ 1049 OnePedal_Drive_Sts 0;
BA_ "GenSigTimeoutTime_DMSM" SG_ 1049 OnePedal_Drive_Sts 0;
BA_ "GenSigTimeoutTime_DTCM" SG_ 1049 OnePedal_Drive_Sts 0;
BA_ "GenSigTimeoutTime_ECM" SG_ 1049 OnePedal_Drive_Sts 0;
BA_ "GenSigTimeoutTime_EVCU2" SG_ 1049 OnePedal_Drive_Sts 0;
BA_ "GenSigTimeoutTime_GNMM" SG_ 1049 OnePedal_Drive_Sts 0;
BA_ "GenSigTimeoutTime_HCP" SG_ 1049 OnePedal_Drive_Sts 0;
BA_ "GenSigTimeoutTime_RFHM" SG_ 1049 OnePedal_Drive_Sts 0;
BA_ "GenSigTimeoutTime_SGW" SG_ 1049 OnePedal_Drive_Sts 0;
BA_ "GenSigTimeoutTime_TCM" SG_ 1049 OnePedal_Drive_Sts 0;
BA_ "GenSigTimeoutTime_AGSM" SG_ 1049 PlugAndChargeSts 0;
BA_ "GenSigTimeoutTime_BCM" SG_ 1049 PlugAndChargeSts 0;
BA_ "GenSigTimeoutTime_BSM" SG_ 1049 PlugAndChargeSts 0;
BA_ "GenSigTimeoutTime_CADM" SG_ 1049 PlugAndChargeSts 0;
BA_ "GenSigTimeoutTime_DMSM" SG_ 1049 PlugAndChargeSts 0;
BA_ "GenSigTimeoutTime_DTCM" SG_ 1049 PlugAndChargeSts 0;
BA_ "GenSigTimeoutTime_ECM" SG_ 1049 PlugAndChargeSts 0;
BA_ "GenSigTimeoutTime_EVCU2" SG_ 1049 PlugAndChargeSts 0;
BA_ "GenSigTimeoutTime_GNMM" SG_ 1049 PlugAndChargeSts 0;
BA_ "GenSigTimeoutTime_HCP" SG_ 1049 PlugAndChargeSts 0;
BA_ "GenSigTimeoutTime_IPC" SG_ 1049 PlugAndChargeSts 0;
BA_ "GenSigTimeoutTime_RFHM" SG_ 1049 PlugAndChargeSts 0;
BA_ "GenSigTimeoutTime_TCM" SG_ 1049 PlugAndChargeSts 0;
BA_ "GenSigTimeoutTime_AGSM" SG_ 1049 PopUpMessage1 0;
BA_ "GenSigTimeoutTime_BCM" SG_ 1049 PopUpMessage1 0;
BA_ "GenSigTimeoutTime_BSM" SG_ 1049 PopUpMessage1 0;
BA_ "GenSigTimeoutTime_CADM" SG_ 1049 PopUpMessage1 0;
BA_ "GenSigTimeoutTime_DMSM" SG_ 1049 PopUpMessage1 0;
BA_ "GenSigTimeoutTime_DTCM" SG_ 1049 PopUpMessage1 0;
BA_ "GenSigTimeoutTime_ECM" SG_ 1049 PopUpMessage1 0;
BA_ "GenSigTimeoutTime_EVCU2" SG_ 1049 PopUpMessage1 0;
BA_ "GenSigTimeoutTime_GNMM" SG_ 1049 PopUpMessage1 0;
BA_ "GenSigTimeoutTime_HCP" SG_ 1049 PopUpMessage1 0;
BA_ "GenSigTimeoutTime_RFHM" SG_ 1049 PopUpMessage1 0;
BA_ "GenSigTimeoutTime_TCM" SG_ 1049 PopUpMessage1 0;
BA_ "GenSigTimeoutTime_AGSM" SG_ 1049 PopUpMessage10 0;
BA_ "GenSigTimeoutTime_BCM" SG_ 1049 PopUpMessage10 0;
BA_ "GenSigTimeoutTime_BSM" SG_ 1049 PopUpMessage10 0;
BA_ "GenSigTimeoutTime_CADM" SG_ 1049 PopUpMessage10 0;
BA_ "GenSigTimeoutTime_DMSM" SG_ 1049 PopUpMessage10 0;
BA_ "GenSigTimeoutTime_DTCM" SG_ 1049 PopUpMessage10 0;
BA_ "GenSigTimeoutTime_ECM" SG_ 1049 PopUpMessage10 0;
BA_ "GenSigTimeoutTime_EVCU2" SG_ 1049 PopUpMessage10 0;
BA_ "GenSigTimeoutTime_GNMM" SG_ 1049 PopUpMessage10 0;
BA_ "GenSigTimeoutTime_HCP" SG_ 1049 PopUpMessage10 0;
BA_ "GenSigTimeoutTime_RFHM" SG_ 1049 PopUpMessage10 0;
BA_ "GenSigTimeoutTime_SGW" SG_ 1049 PopUpMessage10 0;
BA_ "GenSigTimeoutTime_TCM" SG_ 1049 PopUpMessage10 0;
BA_ "GenSigTimeoutTime_AGSM" SG_ 1049 PopUpMessage11 0;
BA_ "GenSigTimeoutTime_BCM" SG_ 1049 PopUpMessage11 0;
BA_ "GenSigTimeoutTime_BSM" SG_ 1049 PopUpMessage11 0;
BA_ "GenSigTimeoutTime_CADM" SG_ 1049 PopUpMessage11 0;
BA_ "GenSigTimeoutTime_DMSM" SG_ 1049 PopUpMessage11 0;
BA_ "GenSigTimeoutTime_DTCM" SG_ 1049 PopUpMessage11 0;
BA_ "GenSigTimeoutTime_ECM" SG_ 1049 PopUpMessage11 0;
BA_ "GenSigTimeoutTime_EVCU2" SG_ 1049 PopUpMessage11 0;
BA_ "GenSigTimeoutTime_GNMM" SG_ 1049 PopUpMessage11 0;
BA_ "GenSigTimeoutTime_HCP" SG_ 1049 PopUpMessage11 0;
BA_ "GenSigTimeoutTime_RFHM" SG_ 1049 PopUpMessage11 0;
BA_ "GenSigTimeoutTime_SGW" SG_ 1049 PopUpMessage11 0;
BA_ "GenSigTimeoutTime_TCM" SG_ 1049 PopUpMessage11 0;
BA_ "GenSigTimeoutTime_AGSM" SG_ 1049 PopUpMessage15 0;
BA_ "GenSigTimeoutTime_BCM" SG_ 1049 PopUpMessage15 0;
BA_ "GenSigTimeoutTime_BSM" SG_ 1049 PopUpMessage15 0;
BA_ "GenSigTimeoutTime_CADM" SG_ 1049 PopUpMessage15 0;
BA_ "GenSigTimeoutTime_DMSM" SG_ 1049 PopUpMessage15 0;
BA_ "GenSigTimeoutTime_DTCM" SG_ 1049 PopUpMessage15 0;
BA_ "GenSigTimeoutTime_ECM" SG_ 1049 PopUpMessage15 0;
BA_ "GenSigTimeoutTime_EVCU2" SG_ 1049 PopUpMessage15 0;
BA_ "GenSigTimeoutTime_GNMM" SG_ 1049 PopUpMessage15 0;
BA_ "GenSigTimeoutTime_HCP" SG_ 1049 PopUpMessage15 0;
BA_ "GenSigTimeoutTime_RFHM" SG_ 1049 PopUpMessage15 0;
BA_ "GenSigTimeoutTime_SGW" SG_ 1049 PopUpMessage15 0;
BA_ "GenSigTimeoutTime_TCM" SG_ 1049 PopUpMessage15 0;
BA_ "GenSigTimeoutTime_AGSM" SG_ 1049 PopUpMessage2 0;
BA_ "GenSigTimeoutTime_BCM" SG_ 1049 PopUpMessage2 0;
BA_ "GenSigTimeoutTime_BSM" SG_ 1049 PopUpMessage2 0;
BA_ "GenSigTimeoutTime_CADM" SG_ 1049 PopUpMessage2 0;
BA_ "GenSigTimeoutTime_DMSM" SG_ 1049 PopUpMessage2 0;
BA_ "GenSigTimeoutTime_DTCM" SG_ 1049 PopUpMessage2 0;
BA_ "GenSigTimeoutTime_ECM" SG_ 1049 PopUpMessage2 0;
BA_ "GenSigTimeoutTime_EVCU2" SG_ 1049 PopUpMessage2 0;
BA_ "GenSigTimeoutTime_GNMM" SG_ 1049 PopUpMessage2 0;
BA_ "GenSigTimeoutTime_HCP" SG_ 1049 PopUpMessage2 0;
BA_ "GenSigTimeoutTime_RFHM" SG_ 1049 PopUpMessage2 0;
BA_ "GenSigTimeoutTime_SGW" SG_ 1049 PopUpMessage2 0;
BA_ "GenSigTimeoutTime_TCM" SG_ 1049 PopUpMessage2 0;
BA_ "GenSigTimeoutTime_AGSM" SG_ 1049 PopUpMessage3 0;
BA_ "GenSigTimeoutTime_BCM" SG_ 1049 PopUpMessage3 0;
BA_ "GenSigTimeoutTime_BSM" SG_ 1049 PopUpMessage3 0;
BA_ "GenSigTimeoutTime_CADM" SG_ 1049 PopUpMessage3 0;
BA_ "GenSigTimeoutTime_DMSM" SG_ 1049 PopUpMessage3 0;
BA_ "GenSigTimeoutTime_DTCM" SG_ 1049 PopUpMessage3 0;
BA_ "GenSigTimeoutTime_ECM" SG_ 1049 PopUpMessage3 0;
BA_ "GenSigTimeoutTime_EVCU2" SG_ 1049 PopUpMessage3 0;
BA_ "GenSigTimeoutTime_GNMM" SG_ 1049 PopUpMessage3 0;
BA_ "GenSigTimeoutTime_HCP" SG_ 1049 PopUpMessage3 0;
BA_ "GenSigTimeoutTime_RFHM" SG_ 1049 PopUpMessage3 0;
BA_ "GenSigTimeoutTime_SGW" SG_ 1049 PopUpMessage3 0;
BA_ "GenSigTimeoutTime_TCM" SG_ 1049 PopUpMessage3 0;
BA_ "GenSigTimeoutTime_AGSM" SG_ 1049 PopUpMessage4 0;
BA_ "GenSigTimeoutTime_BCM" SG_ 1049 PopUpMessage4 0;
BA_ "GenSigTimeoutTime_BSM" SG_ 1049 PopUpMessage4 0;
BA_ "GenSigTimeoutTime_CADM" SG_ 1049 PopUpMessage4 0;
BA_ "GenSigTimeoutTime_DMSM" SG_ 1049 PopUpMessage4 0;
BA_ "GenSigTimeoutTime_DTCM" SG_ 1049 PopUpMessage4 0;
BA_ "GenSigTimeoutTime_ECM" SG_ 1049 PopUpMessage4 0;
BA_ "GenSigTimeoutTime_EVCU2" SG_ 1049 PopUpMessage4 0;
BA_ "GenSigTimeoutTime_GNMM" SG_ 1049 PopUpMessage4 0;
BA_ "GenSigTimeoutTime_HCP" SG_ 1049 PopUpMessage4 0;
BA_ "GenSigTimeoutTime_RFHM" SG_ 1049 PopUpMessage4 0;
BA_ "GenSigTimeoutTime_SGW" SG_ 1049 PopUpMessage4 0;
BA_ "GenSigTimeoutTime_TCM" SG_ 1049 PopUpMessage4 0;
BA_ "GenSigTimeoutTime_AGSM" SG_ 1049 PopUpMessage5 0;
BA_ "GenSigTimeoutTime_BCM" SG_ 1049 PopUpMessage5 0;
BA_ "GenSigTimeoutTime_BSM" SG_ 1049 PopUpMessage5 0;
BA_ "GenSigTimeoutTime_CADM" SG_ 1049 PopUpMessage5 0;
BA_ "GenSigTimeoutTime_DMSM" SG_ 1049 PopUpMessage5 0;
BA_ "GenSigTimeoutTime_DTCM" SG_ 1049 PopUpMessage5 0;
BA_ "GenSigTimeoutTime_ECM" SG_ 1049 PopUpMessage5 0;
BA_ "GenSigTimeoutTime_EVCU2" SG_ 1049 PopUpMessage5 0;
BA_ "GenSigTimeoutTime_GNMM" SG_ 1049 PopUpMessage5 0;
BA_ "GenSigTimeoutTime_HCP" SG_ 1049 PopUpMessage5 0;
BA_ "GenSigTimeoutTime_RFHM" SG_ 1049 PopUpMessage5 0;
BA_ "GenSigTimeoutTime_SGW" SG_ 1049 PopUpMessage5 0;
BA_ "GenSigTimeoutTime_TCM" SG_ 1049 PopUpMessage5 0;
BA_ "GenSigTimeoutTime_AGSM" SG_ 1049 PopUpMessage6 0;
BA_ "GenSigTimeoutTime_BCM" SG_ 1049 PopUpMessage6 0;
BA_ "GenSigTimeoutTime_BSM" SG_ 1049 PopUpMessage6 0;
BA_ "GenSigTimeoutTime_CADM" SG_ 1049 PopUpMessage6 0;
BA_ "GenSigTimeoutTime_DMSM" SG_ 1049 PopUpMessage6 0;
BA_ "GenSigTimeoutTime_DTCM" SG_ 1049 PopUpMessage6 0;
BA_ "GenSigTimeoutTime_ECM" SG_ 1049 PopUpMessage6 0;
BA_ "GenSigTimeoutTime_EVCU2" SG_ 1049 PopUpMessage6 0;
BA_ "GenSigTimeoutTime_GNMM" SG_ 1049 PopUpMessage6 0;
BA_ "GenSigTimeoutTime_HCP" SG_ 1049 PopUpMessage6 0;
BA_ "GenSigTimeoutTime_RFHM" SG_ 1049 PopUpMessage6 0;
BA_ "GenSigTimeoutTime_SGW" SG_ 1049 PopUpMessage6 0;
BA_ "GenSigTimeoutTime_TCM" SG_ 1049 PopUpMessage6 0;
BA_ "GenSigTimeoutTime_AGSM" SG_ 1049 PopUpMessage7 0;
BA_ "GenSigTimeoutTime_BCM" SG_ 1049 PopUpMessage7 0;
BA_ "GenSigTimeoutTime_BSM" SG_ 1049 PopUpMessage7 0;
BA_ "GenSigTimeoutTime_CADM" SG_ 1049 PopUpMessage7 0;
BA_ "GenSigTimeoutTime_DMSM" SG_ 1049 PopUpMessage7 0;
BA_ "GenSigTimeoutTime_DTCM" SG_ 1049 PopUpMessage7 0;
BA_ "GenSigTimeoutTime_ECM" SG_ 1049 PopUpMessage7 0;
BA_ "GenSigTimeoutTime_EVCU2" SG_ 1049 PopUpMessage7 0;
BA_ "GenSigTimeoutTime_GNMM" SG_ 1049 PopUpMessage7 0;
BA_ "GenSigTimeoutTime_HCP" SG_ 1049 PopUpMessage7 0;
BA_ "GenSigTimeoutTime_RFHM" SG_ 1049 PopUpMessage7 0;
BA_ "GenSigTimeoutTime_SGW" SG_ 1049 PopUpMessage7 0;
BA_ "GenSigTimeoutTime_TCM" SG_ 1049 PopUpMessage7 0;
BA_ "GenSigTimeoutTime_AGSM" SG_ 1049 PopUpMessage9 0;
BA_ "GenSigTimeoutTime_BCM" SG_ 1049 PopUpMessage9 0;
BA_ "GenSigTimeoutTime_BSM" SG_ 1049 PopUpMessage9 0;
BA_ "GenSigTimeoutTime_CADM" SG_ 1049 PopUpMessage9 0;
BA_ "GenSigTimeoutTime_DMSM" SG_ 1049 PopUpMessage9 0;
BA_ "GenSigTimeoutTime_DTCM" SG_ 1049 PopUpMessage9 0;
BA_ "GenSigTimeoutTime_ECM" SG_ 1049 PopUpMessage9 0;
BA_ "GenSigTimeoutTime_EVCU2" SG_ 1049 PopUpMessage9 0;
BA_ "GenSigTimeoutTime_GNMM" SG_ 1049 PopUpMessage9 0;
BA_ "GenSigTimeoutTime_HCP" SG_ 1049 PopUpMessage9 0;
BA_ "GenSigTimeoutTime_RFHM" SG_ 1049 PopUpMessage9 0;
BA_ "GenSigTimeoutTime_TCM" SG_ 1049 PopUpMessage9 0;
BA_ "GenSigTimeoutTime_AGSM" SG_ 1049 RefrigerantPressure 0;
BA_ "GenSigTimeoutTime_BSM" SG_ 1049 RefrigerantPressure 0;
BA_ "GenSigTimeoutTime_CADM" SG_ 1049 RefrigerantPressure 0;
BA_ "GenSigTimeoutTime_DMSM" SG_ 1049 RefrigerantPressure 0;
BA_ "GenSigTimeoutTime_DTCM" SG_ 1049 RefrigerantPressure 0;
BA_ "GenSigTimeoutTime_ECM" SG_ 1049 RefrigerantPressure 0;
BA_ "GenSigTimeoutTime_EVCU2" SG_ 1049 RefrigerantPressure 0;
BA_ "GenSigTimeoutTime_GNMM" SG_ 1049 RefrigerantPressure 0;
BA_ "GenSigTimeoutTime_HCP" SG_ 1049 RefrigerantPressure 0;
BA_ "GenSigTimeoutTime_IPC" SG_ 1049 RefrigerantPressure 0;
BA_ "GenSigTimeoutTime_RFHM" SG_ 1049 RefrigerantPressure 0;
BA_ "GenSigTimeoutTime_SGW" SG_ 1049 RefrigerantPressure 0;
BA_ "GenSigTimeoutTime_TCM" SG_ 1049 RefrigerantPressure 0;
BA_ "GenSigTimeoutTime_AGSM" SG_ 1049 Regen_Status 0;
BA_ "GenSigTimeoutTime_BCM" SG_ 1049 Regen_Status 0;
BA_ "GenSigTimeoutTime_BSM" SG_ 1049 Regen_Status 0;
BA_ "GenSigTimeoutTime_CADM" SG_ 1049 Regen_Status 0;
BA_ "GenSigTimeoutTime_DMSM" SG_ 1049 Regen_Status 0;
BA_ "GenSigTimeoutTime_DTCM" SG_ 1049 Regen_Status 0;
BA_ "GenSigTimeoutTime_ECM" SG_ 1049 Regen_Status 0;
BA_ "GenSigTimeoutTime_EVCU2" SG_ 1049 Regen_Status 0;
BA_ "GenSigTimeoutTime_GNMM" SG_ 1049 Regen_Status 0;
BA_ "GenSigTimeoutTime_HCP" SG_ 1049 Regen_Status 0;
BA_ "GenSigTimeoutTime_RFHM" SG_ 1049 Regen_Status 0;
BA_ "GenSigTimeoutTime_SGW" SG_ 1049 Regen_Status 0;
BA_ "GenSigTimeoutTime_TCM" SG_ 1049 Regen_Status 0;
BA_ "GenSigTimeoutTime_AGSM" SG_ 1044 AWD_Failure_Status 0;
BA_ "GenSigTimeoutTime_BCM" SG_ 1044 AWD_Failure_Status 0;
BA_ "GenSigTimeoutTime_BSM" SG_ 1044 AWD_Failure_Status 0;
BA_ "GenSigTimeoutTime_CADM" SG_ 1044 AWD_Failure_Status 0;
BA_ "GenSigTimeoutTime_DMSM" SG_ 1044 AWD_Failure_Status 0;
BA_ "GenSigTimeoutTime_DTCM" SG_ 1044 AWD_Failure_Status 0;
BA_ "GenSigTimeoutTime_ECM" SG_ 1044 AWD_Failure_Status 0;
BA_ "GenSigTimeoutTime_EVCU2" SG_ 1044 AWD_Failure_Status 0;
BA_ "GenSigTimeoutTime_GNMM" SG_ 1044 AWD_Failure_Status 0;
BA_ "GenSigTimeoutTime_HCP" SG_ 1044 AWD_Failure_Status 0;
BA_ "GenSigTimeoutTime_RFHM" SG_ 1044 AWD_Failure_Status 0;
BA_ "GenSigTimeoutTime_SGW" SG_ 1044 AWD_Failure_Status 0;
BA_ "GenSigTimeoutTime_TCM" SG_ 1044 AWD_Failure_Status 0;
BA_ "GenSigTimeoutTime_AGSM" SG_ 1044 BPCM_HV_Temp_Avg 0;
BA_ "GenSigTimeoutTime_BCM" SG_ 1044 BPCM_HV_Temp_Avg 0;
BA_ "GenSigTimeoutTime_BSM" SG_ 1044 BPCM_HV_Temp_Avg 0;
BA_ "GenSigTimeoutTime_CADM" SG_ 1044 BPCM_HV_Temp_Avg 0;
BA_ "GenSigTimeoutTime_DMSM" SG_ 1044 BPCM_HV_Temp_Avg 0;
BA_ "GenSigTimeoutTime_DTCM" SG_ 1044 BPCM_HV_Temp_Avg 0;
BA_ "GenSigTimeoutTime_ECM" SG_ 1044 BPCM_HV_Temp_Avg 0;
BA_ "GenSigTimeoutTime_EVCU2" SG_ 1044 BPCM_HV_Temp_Avg 0;
BA_ "GenSigTimeoutTime_GNMM" SG_ 1044 BPCM_HV_Temp_Avg 0;
BA_ "GenSigTimeoutTime_HCP" SG_ 1044 BPCM_HV_Temp_Avg 0;
BA_ "GenSigTimeoutTime_IPC" SG_ 1044 BPCM_HV_Temp_Avg 0;
BA_ "GenSigTimeoutTime_RFHM" SG_ 1044 BPCM_HV_Temp_Avg 0;
BA_ "GenSigTimeoutTime_SGW" SG_ 1044 BPCM_HV_Temp_Avg 0;
BA_ "GenSigTimeoutTime_TCM" SG_ 1044 BPCM_HV_Temp_Avg 0;
BA_ "GenSigTimeoutTime_AGSM" SG_ 1044 DischargingSysStatus 0;
BA_ "GenSigTimeoutTime_BCM" SG_ 1044 DischargingSysStatus 0;
BA_ "GenSigTimeoutTime_BSM" SG_ 1044 DischargingSysStatus 0;
BA_ "GenSigTimeoutTime_CADM" SG_ 1044 DischargingSysStatus 0;
BA_ "GenSigTimeoutTime_DMSM" SG_ 1044 DischargingSysStatus 0;
BA_ "GenSigTimeoutTime_DTCM" SG_ 1044 DischargingSysStatus 0;
BA_ "GenSigTimeoutTime_ECM" SG_ 1044 DischargingSysStatus 0;
BA_ "GenSigTimeoutTime_EVCU2" SG_ 1044 DischargingSysStatus 0;
BA_ "GenSigTimeoutTime_GNMM" SG_ 1044 DischargingSysStatus 0;
BA_ "GenSigTimeoutTime_HCP" SG_ 1044 DischargingSysStatus 0;
BA_ "GenSigTimeoutTime_IPC" SG_ 1044 DischargingSysStatus 0;
BA_ "GenSigTimeoutTime_SGW" SG_ 1044 DischargingSysStatus 0;
BA_ "GenSigTimeoutTime_TCM" SG_ 1044 DischargingSysStatus 0;
BA_ "GenSigTimeoutTime_AGSM" SG_ 1044 PnC_Failure 0;
BA_ "GenSigTimeoutTime_BCM" SG_ 1044 PnC_Failure 0;
BA_ "GenSigTimeoutTime_BSM" SG_ 1044 PnC_Failure 0;
BA_ "GenSigTimeoutTime_CADM" SG_ 1044 PnC_Failure 0;
BA_ "GenSigTimeoutTime_DMSM" SG_ 1044 PnC_Failure 0;
BA_ "GenSigTimeoutTime_DTCM" SG_ 1044 PnC_Failure 0;
BA_ "GenSigTimeoutTime_ECM" SG_ 1044 PnC_Failure 0;
BA_ "GenSigTimeoutTime_EVCU2" SG_ 1044 PnC_Failure 0;
BA_ "GenSigTimeoutTime_GNMM" SG_ 1044 PnC_Failure 0;
BA_ "GenSigTimeoutTime_HCP" SG_ 1044 PnC_Failure 0;
BA_ "GenSigTimeoutTime_RFHM" SG_ 1044 PnC_Failure 0;
BA_ "GenSigTimeoutTime_TCM" SG_ 1044 PnC_Failure 0;
BA_ "GenSigTimeoutTime_AGSM" SG_ 1044 PnC_Reattepmt_Failure 0;
BA_ "GenSigTimeoutTime_BCM" SG_ 1044 PnC_Reattepmt_Failure 0;
BA_ "GenSigTimeoutTime_BSM" SG_ 1044 PnC_Reattepmt_Failure 0;
BA_ "GenSigTimeoutTime_CADM" SG_ 1044 PnC_Reattepmt_Failure 0;
BA_ "GenSigTimeoutTime_DMSM" SG_ 1044 PnC_Reattepmt_Failure 0;
BA_ "GenSigTimeoutTime_DTCM" SG_ 1044 PnC_Reattepmt_Failure 0;
BA_ "GenSigTimeoutTime_ECM" SG_ 1044 PnC_Reattepmt_Failure 0;
BA_ "GenSigTimeoutTime_EVCU2" SG_ 1044 PnC_Reattepmt_Failure 0;
BA_ "GenSigTimeoutTime_GNMM" SG_ 1044 PnC_Reattepmt_Failure 0;
BA_ "GenSigTimeoutTime_HCP" SG_ 1044 PnC_Reattepmt_Failure 0;
BA_ "GenSigTimeoutTime_RFHM" SG_ 1044 PnC_Reattepmt_Failure 0;
BA_ "GenSigTimeoutTime_SGW" SG_ 1044 PnC_Reattepmt_Failure 0;
BA_ "GenSigTimeoutTime_TCM" SG_ 1044 PnC_Reattepmt_Failure 0;
BA_ "GenSigTimeoutTime_AGSM" SG_ 1044 RI_AC_FAN_Range 0;
BA_ "GenSigTimeoutTime_BCM" SG_ 1044 RI_AC_FAN_Range 0;
BA_ "GenSigTimeoutTime_BSM" SG_ 1044 RI_AC_FAN_Range 0;
BA_ "GenSigTimeoutTime_CADM" SG_ 1044 RI_AC_FAN_Range 0;
BA_ "GenSigTimeoutTime_DMSM" SG_ 1044 RI_AC_FAN_Range 0;
BA_ "GenSigTimeoutTime_DTCM" SG_ 1044 RI_AC_FAN_Range 0;
BA_ "GenSigTimeoutTime_ECM" SG_ 1044 RI_AC_FAN_Range 0;
BA_ "GenSigTimeoutTime_EVCU2" SG_ 1044 RI_AC_FAN_Range 0;
BA_ "GenSigTimeoutTime_GNMM" SG_ 1044 RI_AC_FAN_Range 0;
BA_ "GenSigTimeoutTime_HCP" SG_ 1044 RI_AC_FAN_Range 0;
BA_ "GenSigTimeoutTime_IPC" SG_ 1044 RI_AC_FAN_Range 0;
BA_ "GenSigTimeoutTime_RFHM" SG_ 1044 RI_AC_FAN_Range 0;
BA_ "GenSigTimeoutTime_TCM" SG_ 1044 RI_AC_FAN_Range 0;
BA_ "GenSigTimeoutTime_AGSM" SG_ 1044 RI_AUDIO_Range 0;
BA_ "GenSigTimeoutTime_BCM" SG_ 1044 RI_AUDIO_Range 0;
BA_ "GenSigTimeoutTime_BSM" SG_ 1044 RI_AUDIO_Range 0;
BA_ "GenSigTimeoutTime_CADM" SG_ 1044 RI_AUDIO_Range 0;
BA_ "GenSigTimeoutTime_DMSM" SG_ 1044 RI_AUDIO_Range 0;
BA_ "GenSigTimeoutTime_DTCM" SG_ 1044 RI_AUDIO_Range 0;
BA_ "GenSigTimeoutTime_ECM" SG_ 1044 RI_AUDIO_Range 0;
BA_ "GenSigTimeoutTime_EVCU2" SG_ 1044 RI_AUDIO_Range 0;
BA_ "GenSigTimeoutTime_GNMM" SG_ 1044 RI_AUDIO_Range 0;
BA_ "GenSigTimeoutTime_HCP" SG_ 1044 RI_AUDIO_Range 0;
BA_ "GenSigTimeoutTime_IPC" SG_ 1044 RI_AUDIO_Range 0;
BA_ "GenSigTimeoutTime_RFHM" SG_ 1044 RI_AUDIO_Range 0;
BA_ "GenSigTimeoutTime_TCM" SG_ 1044 RI_AUDIO_Range 0;
BA_ "GenSigTimeoutTime_AGSM" SG_ 1044 RI_DEFROST_Range 0;
BA_ "GenSigTimeoutTime_BCM" SG_ 1044 RI_DEFROST_Range 0;
BA_ "GenSigTimeoutTime_BSM" SG_ 1044 RI_DEFROST_Range 0;
BA_ "GenSigTimeoutTime_CADM" SG_ 1044 RI_DEFROST_Range 0;
BA_ "GenSigTimeoutTime_DMSM" SG_ 1044 RI_DEFROST_Range 0;
BA_ "GenSigTimeoutTime_DTCM" SG_ 1044 RI_DEFROST_Range 0;
BA_ "GenSigTimeoutTime_ECM" SG_ 1044 RI_DEFROST_Range 0;
BA_ "GenSigTimeoutTime_EVCU2" SG_ 1044 RI_DEFROST_Range 0;
BA_ "GenSigTimeoutTime_GNMM" SG_ 1044 RI_DEFROST_Range 0;
BA_ "GenSigTimeoutTime_HCP" SG_ 1044 RI_DEFROST_Range 0;
BA_ "GenSigTimeoutTime_IPC" SG_ 1044 RI_DEFROST_Range 0;
BA_ "GenSigTimeoutTime_RFHM" SG_ 1044 RI_DEFROST_Range 0;
BA_ "GenSigTimeoutTime_TCM" SG_ 1044 RI_DEFROST_Range 0;
BA_ "GenSigTimeoutTime_AGSM" SG_ 1044 RI_LIGHTS_Range 0;
BA_ "GenSigTimeoutTime_BCM" SG_ 1044 RI_LIGHTS_Range 0;
BA_ "GenSigTimeoutTime_BSM" SG_ 1044 RI_LIGHTS_Range 0;
BA_ "GenSigTimeoutTime_CADM" SG_ 1044 RI_LIGHTS_Range 0;
BA_ "GenSigTimeoutTime_DMSM" SG_ 1044 RI_LIGHTS_Range 0;
BA_ "GenSigTimeoutTime_DTCM" SG_ 1044 RI_LIGHTS_Range 0;
BA_ "GenSigTimeoutTime_ECM" SG_ 1044 RI_LIGHTS_Range 0;
BA_ "GenSigTimeoutTime_EVCU2" SG_ 1044 RI_LIGHTS_Range 0;
BA_ "GenSigTimeoutTime_GNMM" SG_ 1044 RI_LIGHTS_Range 0;
BA_ "GenSigTimeoutTime_HCP" SG_ 1044 RI_LIGHTS_Range 0;
BA_ "GenSigTimeoutTime_IPC" SG_ 1044 RI_LIGHTS_Range 0;
BA_ "GenSigTimeoutTime_RFHM" SG_ 1044 RI_LIGHTS_Range 0;
BA_ "GenSigTimeoutTime_TCM" SG_ 1044 RI_LIGHTS_Range 0;
BA_ "GenSigTimeoutTime_AGSM" SG_ 1044 RI_OTHER_Range 0;
BA_ "GenSigTimeoutTime_BCM" SG_ 1044 RI_OTHER_Range 0;
BA_ "GenSigTimeoutTime_BSM" SG_ 1044 RI_OTHER_Range 0;
BA_ "GenSigTimeoutTime_CADM" SG_ 1044 RI_OTHER_Range 0;
BA_ "GenSigTimeoutTime_DMSM" SG_ 1044 RI_OTHER_Range 0;
BA_ "GenSigTimeoutTime_DTCM" SG_ 1044 RI_OTHER_Range 0;
BA_ "GenSigTimeoutTime_ECM" SG_ 1044 RI_OTHER_Range 0;
BA_ "GenSigTimeoutTime_EVCU2" SG_ 1044 RI_OTHER_Range 0;
BA_ "GenSigTimeoutTime_GNMM" SG_ 1044 RI_OTHER_Range 0;
BA_ "GenSigTimeoutTime_HCP" SG_ 1044 RI_OTHER_Range 0;
BA_ "GenSigTimeoutTime_IPC" SG_ 1044 RI_OTHER_Range 0;
BA_ "GenSigTimeoutTime_RFHM" SG_ 1044 RI_OTHER_Range 0;
BA_ "GenSigTimeoutTime_TCM" SG_ 1044 RI_OTHER_Range 0;
BA_ "GenSigTimeoutTime_AGSM" SG_ 1044 RI_SEATSWHL_Range 0;
BA_ "GenSigTimeoutTime_BCM" SG_ 1044 RI_SEATSWHL_Range 0;
BA_ "GenSigTimeoutTime_BSM" SG_ 1044 RI_SEATSWHL_Range 0;
BA_ "GenSigTimeoutTime_CADM" SG_ 1044 RI_SEATSWHL_Range 0;
BA_ "GenSigTimeoutTime_DMSM" SG_ 1044 RI_SEATSWHL_Range 0;
BA_ "GenSigTimeoutTime_DTCM" SG_ 1044 RI_SEATSWHL_Range 0;
BA_ "GenSigTimeoutTime_ECM" SG_ 1044 RI_SEATSWHL_Range 0;
BA_ "GenSigTimeoutTime_EVCU2" SG_ 1044 RI_SEATSWHL_Range 0;
BA_ "GenSigTimeoutTime_GNMM" SG_ 1044 RI_SEATSWHL_Range 0;
BA_ "GenSigTimeoutTime_HCP" SG_ 1044 RI_SEATSWHL_Range 0;
BA_ "GenSigTimeoutTime_IPC" SG_ 1044 RI_SEATSWHL_Range 0;
BA_ "GenSigTimeoutTime_RFHM" SG_ 1044 RI_SEATSWHL_Range 0;
BA_ "GenSigTimeoutTime_TCM" SG_ 1044 RI_SEATSWHL_Range 0;
BA_ "GenSigTimeoutTime_AGSM" SG_ 1044 RI_TOTAL_Range_Add 0;
BA_ "GenSigTimeoutTime_BCM" SG_ 1044 RI_TOTAL_Range_Add 0;
BA_ "GenSigTimeoutTime_BSM" SG_ 1044 RI_TOTAL_Range_Add 0;
BA_ "GenSigTimeoutTime_CADM" SG_ 1044 RI_TOTAL_Range_Add 0;
BA_ "GenSigTimeoutTime_DMSM" SG_ 1044 RI_TOTAL_Range_Add 0;
BA_ "GenSigTimeoutTime_DTCM" SG_ 1044 RI_TOTAL_Range_Add 0;
BA_ "GenSigTimeoutTime_ECM" SG_ 1044 RI_TOTAL_Range_Add 0;
BA_ "GenSigTimeoutTime_EVCU2" SG_ 1044 RI_TOTAL_Range_Add 0;
BA_ "GenSigTimeoutTime_GNMM" SG_ 1044 RI_TOTAL_Range_Add 0;
BA_ "GenSigTimeoutTime_HCP" SG_ 1044 RI_TOTAL_Range_Add 0;
BA_ "GenSigTimeoutTime_IPC" SG_ 1044 RI_TOTAL_Range_Add 0;
BA_ "GenSigTimeoutTime_RFHM" SG_ 1044 RI_TOTAL_Range_Add 0;
BA_ "GenSigTimeoutTime_TCM" SG_ 1044 RI_TOTAL_Range_Add 0;
BA_ "GenSigSendType" SG_ 1952 CabinConditioningSts 3;
BA_ "GenSigTimeoutTime_AGSM" SG_ 1952 CabinConditioningSts 0;
BA_ "GenSigTimeoutTime_BSM" SG_ 1952 CabinConditioningSts 0;
BA_ "GenSigTimeoutTime_CADM" SG_ 1952 CabinConditioningSts 0;
BA_ "GenSigTimeoutTime_DMSM" SG_ 1952 CabinConditioningSts 0;
BA_ "GenSigTimeoutTime_DTCM" SG_ 1952 CabinConditioningSts 0;
BA_ "GenSigTimeoutTime_ECM" SG_ 1952 CabinConditioningSts 0;
BA_ "GenSigTimeoutTime_EVCU2" SG_ 1952 CabinConditioningSts 0;
BA_ "GenSigTimeoutTime_GNMM" SG_ 1952 CabinConditioningSts 0;
BA_ "GenSigTimeoutTime_HCP" SG_ 1952 CabinConditioningSts 0;
BA_ "GenSigTimeoutTime_IPC" SG_ 1952 CabinConditioningSts 0;
BA_ "GenSigTimeoutTime_RFHM" SG_ 1952 CabinConditioningSts 0;
BA_ "GenSigTimeoutTime_TCM" SG_ 1952 CabinConditioningSts 0;
BA_ "GenSigSendType" SG_ 1952 CabinPreconditionReqSts 3;
BA_ "GenSigTimeoutTime_AGSM" SG_ 1952 CabinPreconditionReqSts 0;
BA_ "GenSigTimeoutTime_BCM" SG_ 1952 CabinPreconditionReqSts 0;
BA_ "GenSigTimeoutTime_BSM" SG_ 1952 CabinPreconditionReqSts 0;
BA_ "GenSigTimeoutTime_CADM" SG_ 1952 CabinPreconditionReqSts 0;
BA_ "GenSigTimeoutTime_DMSM" SG_ 1952 CabinPreconditionReqSts 0;
BA_ "GenSigTimeoutTime_DTCM" SG_ 1952 CabinPreconditionReqSts 0;
BA_ "GenSigTimeoutTime_ECM" SG_ 1952 CabinPreconditionReqSts 0;
BA_ "GenSigTimeoutTime_EVCU2" SG_ 1952 CabinPreconditionReqSts 0;
BA_ "GenSigTimeoutTime_GNMM" SG_ 1952 CabinPreconditionReqSts 0;
BA_ "GenSigTimeoutTime_HCP" SG_ 1952 CabinPreconditionReqSts 0;
BA_ "GenSigTimeoutTime_RFHM" SG_ 1952 CabinPreconditionReqSts 0;
BA_ "GenSigTimeoutTime_SGW" SG_ 1952 CabinPreconditionReqSts 0;
BA_ "GenSigTimeoutTime_TCM" SG_ 1952 CabinPreconditionReqSts 0;
BA_ "GenSigSendType" SG_ 1952 CompressorState 3;
BA_ "GenSigTimeoutTime_AGSM" SG_ 1952 CompressorState 0;
BA_ "GenSigTimeoutTime_BSM" SG_ 1952 CompressorState 0;
BA_ "GenSigTimeoutTime_CADM" SG_ 1952 CompressorState 0;
BA_ "GenSigTimeoutTime_DMSM" SG_ 1952 CompressorState 0;
BA_ "GenSigTimeoutTime_DTCM" SG_ 1952 CompressorState 0;
BA_ "GenSigTimeoutTime_ECM" SG_ 1952 CompressorState 0;
BA_ "GenSigTimeoutTime_EVCU2" SG_ 1952 CompressorState 0;
BA_ "GenSigTimeoutTime_GNMM" SG_ 1952 CompressorState 0;
BA_ "GenSigTimeoutTime_HCP" SG_ 1952 CompressorState 0;
BA_ "GenSigTimeoutTime_IPC" SG_ 1952 CompressorState 0;
BA_ "GenSigTimeoutTime_RFHM" SG_ 1952 CompressorState 0;
BA_ "GenSigTimeoutTime_TCM" SG_ 1952 CompressorState 0;
BA_ "GenSigSendType" SG_ 1952 ElecClntHtrInletTemp 3;
BA_ "GenSigTimeoutTime_AGSM" SG_ 1952 ElecClntHtrInletTemp 0;
BA_ "GenSigTimeoutTime_BCM" SG_ 1952 ElecClntHtrInletTemp 0;
BA_ "GenSigTimeoutTime_BSM" SG_ 1952 ElecClntHtrInletTemp 0;
BA_ "GenSigTimeoutTime_CADM" SG_ 1952 ElecClntHtrInletTemp 0;
BA_ "GenSigTimeoutTime_DMSM" SG_ 1952 ElecClntHtrInletTemp 0;
BA_ "GenSigTimeoutTime_DTCM" SG_ 1952 ElecClntHtrInletTemp 0;
BA_ "GenSigTimeoutTime_EVCU2" SG_ 1952 ElecClntHtrInletTemp 0;
BA_ "GenSigTimeoutTime_GNMM" SG_ 1952 ElecClntHtrInletTemp 0;
BA_ "GenSigTimeoutTime_HCP" SG_ 1952 ElecClntHtrInletTemp 0;
BA_ "GenSigTimeoutTime_IPC" SG_ 1952 ElecClntHtrInletTemp 0;
BA_ "GenSigTimeoutTime_RFHM" SG_ 1952 ElecClntHtrInletTemp 0;
BA_ "GenSigTimeoutTime_TCM" SG_ 1952 ElecClntHtrInletTemp 0;
BA_ "GenSigSendType" SG_ 1952 ElecCoolantHtrPwr 3;
BA_ "GenSigTimeoutTime_AGSM" SG_ 1952 ElecCoolantHtrPwr 0;
BA_ "GenSigTimeoutTime_BSM" SG_ 1952 ElecCoolantHtrPwr 0;
BA_ "GenSigTimeoutTime_CADM" SG_ 1952 ElecCoolantHtrPwr 0;
BA_ "GenSigTimeoutTime_DMSM" SG_ 1952 ElecCoolantHtrPwr 0;
BA_ "GenSigTimeoutTime_DTCM" SG_ 1952 ElecCoolantHtrPwr 0;
BA_ "GenSigTimeoutTime_EVCU2" SG_ 1952 ElecCoolantHtrPwr 0;
BA_ "GenSigTimeoutTime_GNMM" SG_ 1952 ElecCoolantHtrPwr 0;
BA_ "GenSigTimeoutTime_HCP" SG_ 1952 ElecCoolantHtrPwr 0;
BA_ "GenSigTimeoutTime_IPC" SG_ 1952 ElecCoolantHtrPwr 0;
BA_ "GenSigTimeoutTime_RFHM" SG_ 1952 ElecCoolantHtrPwr 0;
BA_ "GenSigTimeoutTime_TCM" SG_ 1952 ElecCoolantHtrPwr 0;
BA_ "GenSigSendType" SG_ 1952 FRfShVlvSts 3;
BA_ "GenSigTimeoutTime_AGSM" SG_ 1952 FRfShVlvSts 0;
BA_ "GenSigTimeoutTime_BSM" SG_ 1952 FRfShVlvSts 0;
BA_ "GenSigTimeoutTime_CADM" SG_ 1952 FRfShVlvSts 0;
BA_ "GenSigTimeoutTime_DMSM" SG_ 1952 FRfShVlvSts 0;
BA_ "GenSigTimeoutTime_DTCM" SG_ 1952 FRfShVlvSts 0;
BA_ "GenSigTimeoutTime_ECM" SG_ 1952 FRfShVlvSts 0;
BA_ "GenSigTimeoutTime_EVCU2" SG_ 1952 FRfShVlvSts 0;
BA_ "GenSigTimeoutTime_GNMM" SG_ 1952 FRfShVlvSts 0;
BA_ "GenSigTimeoutTime_HCP" SG_ 1952 FRfShVlvSts 0;
BA_ "GenSigTimeoutTime_IPC" SG_ 1952 FRfShVlvSts 0;
BA_ "GenSigTimeoutTime_RFHM" SG_ 1952 FRfShVlvSts 0;
BA_ "GenSigTimeoutTime_TCM" SG_ 1952 FRfShVlvSts 0;
BA_ "GenSigSendType" SG_ 1952 HeaterCoreInletTemp 3;
BA_ "GenSigTimeoutTime_AGSM" SG_ 1952 HeaterCoreInletTemp 0;
BA_ "GenSigTimeoutTime_BSM" SG_ 1952 HeaterCoreInletTemp 0;
BA_ "GenSigTimeoutTime_CADM" SG_ 1952 HeaterCoreInletTemp 0;
BA_ "GenSigTimeoutTime_DMSM" SG_ 1952 HeaterCoreInletTemp 0;
BA_ "GenSigTimeoutTime_DTCM" SG_ 1952 HeaterCoreInletTemp 0;
BA_ "GenSigTimeoutTime_EVCU2" SG_ 1952 HeaterCoreInletTemp 0;
BA_ "GenSigTimeoutTime_GNMM" SG_ 1952 HeaterCoreInletTemp 0;
BA_ "GenSigTimeoutTime_HCP" SG_ 1952 HeaterCoreInletTemp 0;
BA_ "GenSigTimeoutTime_IPC" SG_ 1952 HeaterCoreInletTemp 0;
BA_ "GenSigTimeoutTime_RFHM" SG_ 1952 HeaterCoreInletTemp 0;
BA_ "GenSigTimeoutTime_SGW" SG_ 1952 HeaterCoreInletTemp 0;
BA_ "GenSigTimeoutTime_TCM" SG_ 1952 HeaterCoreInletTemp 0;
BA_ "GenSigStartValue" SG_ 1952 HTAuxPmpMontrngRPM 3;
BA_ "GenSigSendType" SG_ 1952 HTAuxPmpMontrngRPM 3;
BA_ "GenSigTimeoutTime_AGSM" SG_ 1952 HTAuxPmpMontrngRPM 0;
BA_ "GenSigTimeoutTime_BCM" SG_ 1952 HTAuxPmpMontrngRPM 0;
BA_ "GenSigTimeoutTime_BSM" SG_ 1952 HTAuxPmpMontrngRPM 0;
BA_ "GenSigTimeoutTime_CADM" SG_ 1952 HTAuxPmpMontrngRPM 0;
BA_ "GenSigTimeoutTime_DMSM" SG_ 1952 HTAuxPmpMontrngRPM 0;
BA_ "GenSigTimeoutTime_DTCM" SG_ 1952 HTAuxPmpMontrngRPM 0;
BA_ "GenSigTimeoutTime_EVCU2" SG_ 1952 HTAuxPmpMontrngRPM 0;
BA_ "GenSigTimeoutTime_GNMM" SG_ 1952 HTAuxPmpMontrngRPM 0;
BA_ "GenSigTimeoutTime_HCP" SG_ 1952 HTAuxPmpMontrngRPM 0;
BA_ "GenSigTimeoutTime_IPC" SG_ 1952 HTAuxPmpMontrngRPM 0;
BA_ "GenSigTimeoutTime_RFHM" SG_ 1952 HTAuxPmpMontrngRPM 0;
BA_ "GenSigTimeoutTime_TCM" SG_ 1952 HTAuxPmpMontrngRPM 0;
BA_ "GenSigSendType" SG_ 1952 HTAuxPmpRPMAct 3;
BA_ "GenSigTimeoutTime_AGSM" SG_ 1952 HTAuxPmpRPMAct 0;
BA_ "GenSigTimeoutTime_BSM" SG_ 1952 HTAuxPmpRPMAct 0;
BA_ "GenSigTimeoutTime_CADM" SG_ 1952 HTAuxPmpRPMAct 0;
BA_ "GenSigTimeoutTime_DMSM" SG_ 1952 HTAuxPmpRPMAct 0;
BA_ "GenSigTimeoutTime_DTCM" SG_ 1952 HTAuxPmpRPMAct 0;
BA_ "GenSigTimeoutTime_EVCU2" SG_ 1952 HTAuxPmpRPMAct 0;
BA_ "GenSigTimeoutTime_GNMM" SG_ 1952 HTAuxPmpRPMAct 0;
BA_ "GenSigTimeoutTime_HCP" SG_ 1952 HTAuxPmpRPMAct 0;
BA_ "GenSigTimeoutTime_IPC" SG_ 1952 HTAuxPmpRPMAct 0;
BA_ "GenSigTimeoutTime_RFHM" SG_ 1952 HTAuxPmpRPMAct 0;
BA_ "GenSigTimeoutTime_TCM" SG_ 1952 HTAuxPmpRPMAct 0;
BA_ "GenSigSendType" SG_ 1952 HTShtOffVlvReq 3;
BA_ "GenSigTimeoutTime_AGSM" SG_ 1952 HTShtOffVlvReq 0;
BA_ "GenSigTimeoutTime_BSM" SG_ 1952 HTShtOffVlvReq 0;
BA_ "GenSigTimeoutTime_CADM" SG_ 1952 HTShtOffVlvReq 0;
BA_ "GenSigTimeoutTime_DMSM" SG_ 1952 HTShtOffVlvReq 0;
BA_ "GenSigTimeoutTime_DTCM" SG_ 1952 HTShtOffVlvReq 0;
BA_ "GenSigTimeoutTime_EVCU2" SG_ 1952 HTShtOffVlvReq 0;
BA_ "GenSigTimeoutTime_GNMM" SG_ 1952 HTShtOffVlvReq 0;
BA_ "GenSigTimeoutTime_HCP" SG_ 1952 HTShtOffVlvReq 0;
BA_ "GenSigTimeoutTime_IPC" SG_ 1952 HTShtOffVlvReq 0;
BA_ "GenSigTimeoutTime_RFHM" SG_ 1952 HTShtOffVlvReq 0;
BA_ "GenSigTimeoutTime_TCM" SG_ 1952 HTShtOffVlvReq 0;
BA_ "GenSigSendType" SG_ 1952 HVBatCoolantLevelLow_DPT 3;
BA_ "GenSigTimeoutTime_AGSM" SG_ 1952 HVBatCoolantLevelLow_DPT 0;
BA_ "GenSigTimeoutTime_BCM" SG_ 1952 HVBatCoolantLevelLow_DPT 0;
BA_ "GenSigTimeoutTime_BSM" SG_ 1952 HVBatCoolantLevelLow_DPT 0;
BA_ "GenSigTimeoutTime_CADM" SG_ 1952 HVBatCoolantLevelLow_DPT 0;
BA_ "GenSigTimeoutTime_DMSM" SG_ 1952 HVBatCoolantLevelLow_DPT 0;
BA_ "GenSigTimeoutTime_DTCM" SG_ 1952 HVBatCoolantLevelLow_DPT 0;
BA_ "GenSigTimeoutTime_ECM" SG_ 1952 HVBatCoolantLevelLow_DPT 0;
BA_ "GenSigTimeoutTime_EVCU2" SG_ 1952 HVBatCoolantLevelLow_DPT 0;
BA_ "GenSigTimeoutTime_GNMM" SG_ 1952 HVBatCoolantLevelLow_DPT 0;
BA_ "GenSigTimeoutTime_HCP" SG_ 1952 HVBatCoolantLevelLow_DPT 0;
BA_ "GenSigTimeoutTime_RFHM" SG_ 1952 HVBatCoolantLevelLow_DPT 0;
BA_ "GenSigTimeoutTime_TCM" SG_ 1952 HVBatCoolantLevelLow_DPT 0;
BA_ "GenSigSendType" SG_ 1952 HVBatCritCondT 3;
BA_ "GenSigTimeoutTime_AGSM" SG_ 1952 HVBatCritCondT 0;
BA_ "GenSigTimeoutTime_BSM" SG_ 1952 HVBatCritCondT 0;
BA_ "GenSigTimeoutTime_CADM" SG_ 1952 HVBatCritCondT 0;
BA_ "GenSigTimeoutTime_DMSM" SG_ 1952 HVBatCritCondT 0;
BA_ "GenSigTimeoutTime_DTCM" SG_ 1952 HVBatCritCondT 0;
BA_ "GenSigTimeoutTime_ECM" SG_ 1952 HVBatCritCondT 0;
BA_ "GenSigTimeoutTime_EVCU2" SG_ 1952 HVBatCritCondT 0;
BA_ "GenSigTimeoutTime_GNMM" SG_ 1952 HVBatCritCondT 0;
BA_ "GenSigTimeoutTime_HCP" SG_ 1952 HVBatCritCondT 0;
BA_ "GenSigTimeoutTime_IPC" SG_ 1952 HVBatCritCondT 0;
BA_ "GenSigTimeoutTime_RFHM" SG_ 1952 HVBatCritCondT 0;
BA_ "GenSigTimeoutTime_TCM" SG_ 1952 HVBatCritCondT 0;
BA_ "GenSigTimeoutTime_AGSM" SG_ 1952 Sch_PreCondition_Sts 0;
BA_ "GenSigTimeoutTime_BSM" SG_ 1952 Sch_PreCondition_Sts 0;
BA_ "GenSigTimeoutTime_CADM" SG_ 1952 Sch_PreCondition_Sts 0;
BA_ "GenSigTimeoutTime_DMSM" SG_ 1952 Sch_PreCondition_Sts 0;
BA_ "GenSigTimeoutTime_DTCM" SG_ 1952 Sch_PreCondition_Sts 0;
BA_ "GenSigTimeoutTime_ECM" SG_ 1952 Sch_PreCondition_Sts 0;
BA_ "GenSigTimeoutTime_EVCU2" SG_ 1952 Sch_PreCondition_Sts 0;
BA_ "GenSigTimeoutTime_GNMM" SG_ 1952 Sch_PreCondition_Sts 0;
BA_ "GenSigTimeoutTime_HCP" SG_ 1952 Sch_PreCondition_Sts 0;
BA_ "GenSigTimeoutTime_IPC" SG_ 1952 Sch_PreCondition_Sts 0;
BA_ "GenSigTimeoutTime_RFHM" SG_ 1952 Sch_PreCondition_Sts 0;
BA_ "GenSigTimeoutTime_SGW" SG_ 1952 Sch_PreCondition_Sts 0;
BA_ "GenSigTimeoutTime_TCM" SG_ 1952 Sch_PreCondition_Sts 0;
BA_ "GenSigTimeoutTime_AGSM" SG_ 1952 SchCond_Time_Till_Dep 0;
BA_ "GenSigTimeoutTime_BSM" SG_ 1952 SchCond_Time_Till_Dep 0;
BA_ "GenSigTimeoutTime_CADM" SG_ 1952 SchCond_Time_Till_Dep 0;
BA_ "GenSigTimeoutTime_DMSM" SG_ 1952 SchCond_Time_Till_Dep 0;
BA_ "GenSigTimeoutTime_DTCM" SG_ 1952 SchCond_Time_Till_Dep 0;
BA_ "GenSigTimeoutTime_ECM" SG_ 1952 SchCond_Time_Till_Dep 0;
BA_ "GenSigTimeoutTime_EVCU2" SG_ 1952 SchCond_Time_Till_Dep 0;
BA_ "GenSigTimeoutTime_GNMM" SG_ 1952 SchCond_Time_Till_Dep 0;
BA_ "GenSigTimeoutTime_HCP" SG_ 1952 SchCond_Time_Till_Dep 0;
BA_ "GenSigTimeoutTime_IPC" SG_ 1952 SchCond_Time_Till_Dep 0;
BA_ "GenSigTimeoutTime_RFHM" SG_ 1952 SchCond_Time_Till_Dep 0;
BA_ "GenSigTimeoutTime_SGW" SG_ 1952 SchCond_Time_Till_Dep 0;
BA_ "GenSigTimeoutTime_TCM" SG_ 1952 SchCond_Time_Till_Dep 0;
BA_ "GenSigTimeoutTime_AGSM" SG_ 276 Belt_Slip_Detected 0;
BA_ "GenSigTimeoutTime_BCM" SG_ 276 Belt_Slip_Detected 0;
BA_ "GenSigTimeoutTime_BSM" SG_ 276 Belt_Slip_Detected 0;
BA_ "GenSigTimeoutTime_CADM" SG_ 276 Belt_Slip_Detected 0;
BA_ "GenSigTimeoutTime_DMSM" SG_ 276 Belt_Slip_Detected 0;
BA_ "GenSigTimeoutTime_DTCM" SG_ 276 Belt_Slip_Detected 0;
BA_ "GenSigTimeoutTime_EVCU2" SG_ 276 Belt_Slip_Detected 0;
BA_ "GenSigTimeoutTime_GNMM" SG_ 276 Belt_Slip_Detected 0;
BA_ "GenSigTimeoutTime_HCP" SG_ 276 Belt_Slip_Detected 0;
BA_ "GenSigTimeoutTime_IPC" SG_ 276 Belt_Slip_Detected 0;
BA_ "GenSigTimeoutTime_RFHM" SG_ 276 Belt_Slip_Detected 0;
BA_ "GenSigTimeoutTime_SGW" SG_ 276 Belt_Slip_Detected 0;
BA_ "GenSigTimeoutTime_TCM" SG_ 276 Belt_Slip_Detected 0;
BA_ "GenSigStartValue" SG_ 276 BSGMaxTrqDyn 511;
BA_ "GenSigTimeoutTime_AGSM" SG_ 276 BSGMaxTrqDyn 0;
BA_ "GenSigTimeoutTime_BCM" SG_ 276 BSGMaxTrqDyn 0;
BA_ "GenSigTimeoutTime_BSM" SG_ 276 BSGMaxTrqDyn 0;
BA_ "GenSigTimeoutTime_CADM" SG_ 276 BSGMaxTrqDyn 0;
BA_ "GenSigTimeoutTime_DMSM" SG_ 276 BSGMaxTrqDyn 0;
BA_ "GenSigTimeoutTime_DTCM" SG_ 276 BSGMaxTrqDyn 0;
BA_ "GenSigTimeoutTime_EVCU2" SG_ 276 BSGMaxTrqDyn 0;
BA_ "GenSigTimeoutTime_GNMM" SG_ 276 BSGMaxTrqDyn 0;
BA_ "GenSigTimeoutTime_HCP" SG_ 276 BSGMaxTrqDyn 0;
BA_ "GenSigTimeoutTime_IPC" SG_ 276 BSGMaxTrqDyn 0;
BA_ "GenSigTimeoutTime_RFHM" SG_ 276 BSGMaxTrqDyn 0;
BA_ "GenSigTimeoutTime_SGW" SG_ 276 BSGMaxTrqDyn 0;
BA_ "GenSigTimeoutTime_TCM" SG_ 276 BSGMaxTrqDyn 0;
BA_ "GenSigStartValue" SG_ 276 BSGMinTrqDyn 511;
BA_ "GenSigTimeoutTime_AGSM" SG_ 276 BSGMinTrqDyn 0;
BA_ "GenSigTimeoutTime_BCM" SG_ 276 BSGMinTrqDyn 0;
BA_ "GenSigTimeoutTime_BSM" SG_ 276 BSGMinTrqDyn 0;
BA_ "GenSigTimeoutTime_CADM" SG_ 276 BSGMinTrqDyn 0;
BA_ "GenSigTimeoutTime_DMSM" SG_ 276 BSGMinTrqDyn 0;
BA_ "GenSigTimeoutTime_DTCM" SG_ 276 BSGMinTrqDyn 0;
BA_ "GenSigTimeoutTime_EVCU2" SG_ 276 BSGMinTrqDyn 0;
BA_ "GenSigTimeoutTime_GNMM" SG_ 276 BSGMinTrqDyn 0;
BA_ "GenSigTimeoutTime_HCP" SG_ 276 BSGMinTrqDyn 0;
BA_ "GenSigTimeoutTime_IPC" SG_ 276 BSGMinTrqDyn 0;
BA_ "GenSigTimeoutTime_RFHM" SG_ 276 BSGMinTrqDyn 0;
BA_ "GenSigTimeoutTime_SGW" SG_ 276 BSGMinTrqDyn 0;
BA_ "GenSigTimeoutTime_TCM" SG_ 276 BSGMinTrqDyn 0;
BA_ "GenSigTimeoutTime_AGSM" SG_ 276 CODE_CLEAR_BPCM_GW 0;
BA_ "GenSigTimeoutTime_BCM" SG_ 276 CODE_CLEAR_BPCM_GW 0;
BA_ "GenSigTimeoutTime_BSM" SG_ 276 CODE_CLEAR_BPCM_GW 0;
BA_ "GenSigTimeoutTime_CADM" SG_ 276 CODE_CLEAR_BPCM_GW 0;
BA_ "GenSigTimeoutTime_DMSM" SG_ 276 CODE_CLEAR_BPCM_GW 0;
BA_ "GenSigTimeoutTime_DTCM" SG_ 276 CODE_CLEAR_BPCM_GW 0;
BA_ "GenSigTimeoutTime_EVCU2" SG_ 276 CODE_CLEAR_BPCM_GW 0;
BA_ "GenSigTimeoutTime_GNMM" SG_ 276 CODE_CLEAR_BPCM_GW 0;
BA_ "GenSigTimeoutTime_HCP" SG_ 276 CODE_CLEAR_BPCM_GW 0;
BA_ "GenSigTimeoutTime_IPC" SG_ 276 CODE_CLEAR_BPCM_GW 0;
BA_ "GenSigTimeoutTime_RFHM" SG_ 276 CODE_CLEAR_BPCM_GW 0;
BA_ "GenSigTimeoutTime_SGW" SG_ 276 CODE_CLEAR_BPCM_GW 0;
BA_ "GenSigTimeoutTime_TCM" SG_ 276 CODE_CLEAR_BPCM_GW 0;
BA_ "GenSigTimeoutTime_AGSM" SG_ 276 CODE_CLEAR_EVCU2 0;
BA_ "GenSigTimeoutTime_BCM" SG_ 276 CODE_CLEAR_EVCU2 0;
BA_ "GenSigTimeoutTime_BSM" SG_ 276 CODE_CLEAR_EVCU2 0;
BA_ "GenSigTimeoutTime_CADM" SG_ 276 CODE_CLEAR_EVCU2 0;
BA_ "GenSigTimeoutTime_DMSM" SG_ 276 CODE_CLEAR_EVCU2 0;
BA_ "GenSigTimeoutTime_DTCM" SG_ 276 CODE_CLEAR_EVCU2 0;
BA_ "GenSigTimeoutTime_EVCU2" SG_ 276 CODE_CLEAR_EVCU2 0;
BA_ "GenSigTimeoutTime_GNMM" SG_ 276 CODE_CLEAR_EVCU2 0;
BA_ "GenSigTimeoutTime_HCP" SG_ 276 CODE_CLEAR_EVCU2 0;
BA_ "GenSigTimeoutTime_IPC" SG_ 276 CODE_CLEAR_EVCU2 0;
BA_ "GenSigTimeoutTime_RFHM" SG_ 276 CODE_CLEAR_EVCU2 0;
BA_ "GenSigTimeoutTime_SGW" SG_ 276 CODE_CLEAR_EVCU2 0;
BA_ "GenSigTimeoutTime_TCM" SG_ 276 CODE_CLEAR_EVCU2 0;
BA_ "GenSigTimeoutTime_AGSM" SG_ 276 CRC_HYBRID_POWERTRAIN1 0;
BA_ "GenSigTimeoutTime_BCM" SG_ 276 CRC_HYBRID_POWERTRAIN1 0;
BA_ "GenSigTimeoutTime_DMSM" SG_ 276 CRC_HYBRID_POWERTRAIN1 0;
BA_ "GenSigTimeoutTime_DTCM" SG_ 276 CRC_HYBRID_POWERTRAIN1 0;
BA_ "GenSigTimeoutTime_EVCU2" SG_ 276 CRC_HYBRID_POWERTRAIN1 0;
BA_ "GenSigTimeoutTime_GNMM" SG_ 276 CRC_HYBRID_POWERTRAIN1 0;
BA_ "GenSigTimeoutTime_HCP" SG_ 276 CRC_HYBRID_POWERTRAIN1 0;
BA_ "GenSigTimeoutTime_RFHM" SG_ 276 CRC_HYBRID_POWERTRAIN1 0;
BA_ "GenSigTimeoutTime_SGW" SG_ 276 CRC_HYBRID_POWERTRAIN1 0;
BA_ "GenSigTimeoutTime_AGSM" SG_ 276 DriveMode_PopUpRequest 0;
BA_ "GenSigTimeoutTime_BCM" SG_ 276 DriveMode_PopUpRequest 0;
BA_ "GenSigTimeoutTime_BSM" SG_ 276 DriveMode_PopUpRequest 0;
BA_ "GenSigTimeoutTime_CADM" SG_ 276 DriveMode_PopUpRequest 0;
BA_ "GenSigTimeoutTime_DMSM" SG_ 276 DriveMode_PopUpRequest 0;
BA_ "GenSigTimeoutTime_DTCM" SG_ 276 DriveMode_PopUpRequest 0;
BA_ "GenSigTimeoutTime_ECM" SG_ 276 DriveMode_PopUpRequest 0;
BA_ "GenSigTimeoutTime_EVCU2" SG_ 276 DriveMode_PopUpRequest 0;
BA_ "GenSigTimeoutTime_GNMM" SG_ 276 DriveMode_PopUpRequest 0;
BA_ "GenSigTimeoutTime_HCP" SG_ 276 DriveMode_PopUpRequest 0;
BA_ "GenSigTimeoutTime_RFHM" SG_ 276 DriveMode_PopUpRequest 0;
BA_ "GenSigTimeoutTime_SGW" SG_ 276 DriveMode_PopUpRequest 0;
BA_ "GenSigTimeoutTime_TCM" SG_ 276 DriveMode_PopUpRequest 0;
BA_ "GenSigTimeoutTime_AGSM" SG_ 276 DriveModeSts_EPT 0;
BA_ "GenSigTimeoutTime_BCM" SG_ 276 DriveModeSts_EPT 0;
BA_ "GenSigTimeoutTime_BSM" SG_ 276 DriveModeSts_EPT 0;
BA_ "GenSigTimeoutTime_CADM" SG_ 276 DriveModeSts_EPT 0;
BA_ "GenSigTimeoutTime_DMSM" SG_ 276 DriveModeSts_EPT 0;
BA_ "GenSigTimeoutTime_DTCM" SG_ 276 DriveModeSts_EPT 0;
BA_ "GenSigTimeoutTime_ECM" SG_ 276 DriveModeSts_EPT 0;
BA_ "GenSigTimeoutTime_EVCU2" SG_ 276 DriveModeSts_EPT 0;
BA_ "GenSigTimeoutTime_GNMM" SG_ 276 DriveModeSts_EPT 0;
BA_ "GenSigTimeoutTime_HCP" SG_ 276 DriveModeSts_EPT 0;
BA_ "GenSigTimeoutTime_IPC" SG_ 276 DriveModeSts_EPT 0;
BA_ "GenSigTimeoutTime_RFHM" SG_ 276 DriveModeSts_EPT 0;
BA_ "GenSigTimeoutTime_TCM" SG_ 276 DriveModeSts_EPT 0;
BA_ "GenSigTimeoutTime_AGSM" SG_ 276 DriveReady 0;
BA_ "GenSigTimeoutTime_BSM" SG_ 276 DriveReady 0;
BA_ "GenSigTimeoutTime_CADM" SG_ 276 DriveReady 0;
BA_ "GenSigTimeoutTime_DMSM" SG_ 276 DriveReady 0;
BA_ "GenSigTimeoutTime_DTCM" SG_ 276 DriveReady 0;
BA_ "GenSigTimeoutTime_ECM" SG_ 276 DriveReady 0;
BA_ "GenSigTimeoutTime_EVCU2" SG_ 276 DriveReady 0;
BA_ "GenSigTimeoutTime_GNMM" SG_ 276 DriveReady 0;
BA_ "GenSigTimeoutTime_HCP" SG_ 276 DriveReady 0;
BA_ "GenSigTimeoutTime_RFHM" SG_ 276 DriveReady 0;
BA_ "GenSigTimeoutTime_TCM" SG_ 276 DriveReady 0;
BA_ "GenSigTimeoutTime_AGSM" SG_ 276 ECMPrepIdleRes 0;
BA_ "GenSigTimeoutTime_BCM" SG_ 276 ECMPrepIdleRes 0;
BA_ "GenSigTimeoutTime_BSM" SG_ 276 ECMPrepIdleRes 0;
BA_ "GenSigTimeoutTime_CADM" SG_ 276 ECMPrepIdleRes 0;
BA_ "GenSigTimeoutTime_DMSM" SG_ 276 ECMPrepIdleRes 0;
BA_ "GenSigTimeoutTime_DTCM" SG_ 276 ECMPrepIdleRes 0;
BA_ "GenSigTimeoutTime_EVCU2" SG_ 276 ECMPrepIdleRes 0;
BA_ "GenSigTimeoutTime_GNMM" SG_ 276 ECMPrepIdleRes 0;
BA_ "GenSigTimeoutTime_HCP" SG_ 276 ECMPrepIdleRes 0;
BA_ "GenSigTimeoutTime_IPC" SG_ 276 ECMPrepIdleRes 0;
BA_ "GenSigTimeoutTime_RFHM" SG_ 276 ECMPrepIdleRes 0;
BA_ "GenSigTimeoutTime_SGW" SG_ 276 ECMPrepIdleRes 0;
BA_ "GenSigTimeoutTime_TCM" SG_ 276 ECMPrepIdleRes 0;
BA_ "GenSigTimeoutTime_AGSM" SG_ 276 Eng_Off_Allowed 0;
BA_ "GenSigTimeoutTime_BCM" SG_ 276 Eng_Off_Allowed 0;
BA_ "GenSigTimeoutTime_BSM" SG_ 276 Eng_Off_Allowed 0;
BA_ "GenSigTimeoutTime_CADM" SG_ 276 Eng_Off_Allowed 0;
BA_ "GenSigTimeoutTime_DMSM" SG_ 276 Eng_Off_Allowed 0;
BA_ "GenSigTimeoutTime_DTCM" SG_ 276 Eng_Off_Allowed 0;
BA_ "GenSigTimeoutTime_EVCU2" SG_ 276 Eng_Off_Allowed 0;
BA_ "GenSigTimeoutTime_GNMM" SG_ 276 Eng_Off_Allowed 0;
BA_ "GenSigTimeoutTime_HCP" SG_ 276 Eng_Off_Allowed 0;
BA_ "GenSigTimeoutTime_IPC" SG_ 276 Eng_Off_Allowed 0;
BA_ "GenSigTimeoutTime_RFHM" SG_ 276 Eng_Off_Allowed 0;
BA_ "GenSigTimeoutTime_SGW" SG_ 276 Eng_Off_Allowed 0;
BA_ "GenSigTimeoutTime_TCM" SG_ 276 Eng_Off_Allowed 0;
BA_ "GenSigTimeoutTime_AGSM" SG_ 276 EngActDmpgDsblReq 0;
BA_ "GenSigTimeoutTime_BCM" SG_ 276 EngActDmpgDsblReq 0;
BA_ "GenSigTimeoutTime_BSM" SG_ 276 EngActDmpgDsblReq 0;
BA_ "GenSigTimeoutTime_CADM" SG_ 276 EngActDmpgDsblReq 0;
BA_ "GenSigTimeoutTime_DMSM" SG_ 276 EngActDmpgDsblReq 0;
BA_ "GenSigTimeoutTime_DTCM" SG_ 276 EngActDmpgDsblReq 0;
BA_ "GenSigTimeoutTime_EVCU2" SG_ 276 EngActDmpgDsblReq 0;
BA_ "GenSigTimeoutTime_GNMM" SG_ 276 EngActDmpgDsblReq 0;
BA_ "GenSigTimeoutTime_HCP" SG_ 276 EngActDmpgDsblReq 0;
BA_ "GenSigTimeoutTime_IPC" SG_ 276 EngActDmpgDsblReq 0;
BA_ "GenSigTimeoutTime_RFHM" SG_ 276 EngActDmpgDsblReq 0;
BA_ "GenSigTimeoutTime_SGW" SG_ 276 EngActDmpgDsblReq 0;
BA_ "GenSigTimeoutTime_TCM" SG_ 276 EngActDmpgDsblReq 0;
BA_ "GenSigTimeoutTime_AGSM" SG_ 276 EngCntrlMode 0;
BA_ "GenSigTimeoutTime_BCM" SG_ 276 EngCntrlMode 0;
BA_ "GenSigTimeoutTime_BSM" SG_ 276 EngCntrlMode 0;
BA_ "GenSigTimeoutTime_CADM" SG_ 276 EngCntrlMode 0;
BA_ "GenSigTimeoutTime_DMSM" SG_ 276 EngCntrlMode 0;
BA_ "GenSigTimeoutTime_DTCM" SG_ 276 EngCntrlMode 0;
BA_ "GenSigTimeoutTime_EVCU2" SG_ 276 EngCntrlMode 0;
BA_ "GenSigTimeoutTime_GNMM" SG_ 276 EngCntrlMode 0;
BA_ "GenSigTimeoutTime_HCP" SG_ 276 EngCntrlMode 0;
BA_ "GenSigTimeoutTime_IPC" SG_ 276 EngCntrlMode 0;
BA_ "GenSigTimeoutTime_RFHM" SG_ 276 EngCntrlMode 0;
BA_ "GenSigTimeoutTime_SGW" SG_ 276 EngCntrlMode 0;
BA_ "GenSigTimeoutTime_TCM" SG_ 276 EngCntrlMode 0;
BA_ "GenSigTimeoutTime_AGSM" SG_ 276 EngTrqReserveCmd 0;
BA_ "GenSigTimeoutTime_BCM" SG_ 276 EngTrqReserveCmd 0;
BA_ "GenSigTimeoutTime_BSM" SG_ 276 EngTrqReserveCmd 0;
BA_ "GenSigTimeoutTime_CADM" SG_ 276 EngTrqReserveCmd 0;
BA_ "GenSigTimeoutTime_DMSM" SG_ 276 EngTrqReserveCmd 0;
BA_ "GenSigTimeoutTime_DTCM" SG_ 276 EngTrqReserveCmd 0;
BA_ "GenSigTimeoutTime_EVCU2" SG_ 276 EngTrqReserveCmd 0;
BA_ "GenSigTimeoutTime_GNMM" SG_ 276 EngTrqReserveCmd 0;
BA_ "GenSigTimeoutTime_HCP" SG_ 276 EngTrqReserveCmd 0;
BA_ "GenSigTimeoutTime_IPC" SG_ 276 EngTrqReserveCmd 0;
BA_ "GenSigTimeoutTime_RFHM" SG_ 276 EngTrqReserveCmd 0;
BA_ "GenSigTimeoutTime_SGW" SG_ 276 EngTrqReserveCmd 0;
BA_ "GenSigTimeoutTime_TCM" SG_ 276 EngTrqReserveCmd 0;
BA_ "GenSigTimeoutTime_AGSM" SG_ 276 GeneratorSetpointOverride 0;
BA_ "GenSigTimeoutTime_BCM" SG_ 276 GeneratorSetpointOverride 0;
BA_ "GenSigTimeoutTime_BSM" SG_ 276 GeneratorSetpointOverride 0;
BA_ "GenSigTimeoutTime_CADM" SG_ 276 GeneratorSetpointOverride 0;
BA_ "GenSigTimeoutTime_DMSM" SG_ 276 GeneratorSetpointOverride 0;
BA_ "GenSigTimeoutTime_DTCM" SG_ 276 GeneratorSetpointOverride 0;
BA_ "GenSigTimeoutTime_EVCU2" SG_ 276 GeneratorSetpointOverride 0;
BA_ "GenSigTimeoutTime_GNMM" SG_ 276 GeneratorSetpointOverride 0;
BA_ "GenSigTimeoutTime_HCP" SG_ 276 GeneratorSetpointOverride 0;
BA_ "GenSigTimeoutTime_IPC" SG_ 276 GeneratorSetpointOverride 0;
BA_ "GenSigTimeoutTime_RFHM" SG_ 276 GeneratorSetpointOverride 0;
BA_ "GenSigTimeoutTime_SGW" SG_ 276 GeneratorSetpointOverride 0;
BA_ "GenSigTimeoutTime_TCM" SG_ 276 GeneratorSetpointOverride 0;
BA_ "GenSigTimeoutTime_AGSM" SG_ 276 HCP_VTD_Freeze 0;
BA_ "GenSigTimeoutTime_BCM" SG_ 276 HCP_VTD_Freeze 0;
BA_ "GenSigTimeoutTime_BSM" SG_ 276 HCP_VTD_Freeze 0;
BA_ "GenSigTimeoutTime_CADM" SG_ 276 HCP_VTD_Freeze 0;
BA_ "GenSigTimeoutTime_DMSM" SG_ 276 HCP_VTD_Freeze 0;
BA_ "GenSigTimeoutTime_DTCM" SG_ 276 HCP_VTD_Freeze 0;
BA_ "GenSigTimeoutTime_EVCU2" SG_ 276 HCP_VTD_Freeze 0;
BA_ "GenSigTimeoutTime_GNMM" SG_ 276 HCP_VTD_Freeze 0;
BA_ "GenSigTimeoutTime_HCP" SG_ 276 HCP_VTD_Freeze 0;
BA_ "GenSigTimeoutTime_IPC" SG_ 276 HCP_VTD_Freeze 0;
BA_ "GenSigTimeoutTime_RFHM" SG_ 276 HCP_VTD_Freeze 0;
BA_ "GenSigTimeoutTime_SGW" SG_ 276 HCP_VTD_Freeze 0;
BA_ "GenSigTimeoutTime_TCM" SG_ 276 HCP_VTD_Freeze 0;
BA_ "GenSigTimeoutTime_AGSM" SG_ 276 HEV_ESS_Mode 0;
BA_ "GenSigTimeoutTime_BCM" SG_ 276 HEV_ESS_Mode 0;
BA_ "GenSigTimeoutTime_BSM" SG_ 276 HEV_ESS_Mode 0;
BA_ "GenSigTimeoutTime_CADM" SG_ 276 HEV_ESS_Mode 0;
BA_ "GenSigTimeoutTime_DMSM" SG_ 276 HEV_ESS_Mode 0;
BA_ "GenSigTimeoutTime_DTCM" SG_ 276 HEV_ESS_Mode 0;
BA_ "GenSigTimeoutTime_EVCU2" SG_ 276 HEV_ESS_Mode 0;
BA_ "GenSigTimeoutTime_GNMM" SG_ 276 HEV_ESS_Mode 0;
BA_ "GenSigTimeoutTime_HCP" SG_ 276 HEV_ESS_Mode 0;
BA_ "GenSigTimeoutTime_IPC" SG_ 276 HEV_ESS_Mode 0;
BA_ "GenSigTimeoutTime_RFHM" SG_ 276 HEV_ESS_Mode 0;
BA_ "GenSigTimeoutTime_SGW" SG_ 276 HEV_ESS_Mode 0;
BA_ "GenSigTimeoutTime_TCM" SG_ 276 HEV_ESS_Mode 0;
BA_ "GenSigStartValue" SG_ 276 HVBatteryShutOff 1;
BA_ "GenSigTimeoutTime_AGSM" SG_ 276 HVBatteryShutOff 0;
BA_ "GenSigTimeoutTime_BCM" SG_ 276 HVBatteryShutOff 0;
BA_ "GenSigTimeoutTime_BSM" SG_ 276 HVBatteryShutOff 0;
BA_ "GenSigTimeoutTime_CADM" SG_ 276 HVBatteryShutOff 0;
BA_ "GenSigTimeoutTime_DMSM" SG_ 276 HVBatteryShutOff 0;
BA_ "GenSigTimeoutTime_DTCM" SG_ 276 HVBatteryShutOff 0;
BA_ "GenSigTimeoutTime_ECM" SG_ 276 HVBatteryShutOff 0;
BA_ "GenSigTimeoutTime_EVCU2" SG_ 276 HVBatteryShutOff 0;
BA_ "GenSigTimeoutTime_GNMM" SG_ 276 HVBatteryShutOff 0;
BA_ "GenSigTimeoutTime_HCP" SG_ 276 HVBatteryShutOff 0;
BA_ "GenSigTimeoutTime_RFHM" SG_ 276 HVBatteryShutOff 0;
BA_ "GenSigTimeoutTime_SGW" SG_ 276 HVBatteryShutOff 0;
BA_ "GenSigTimeoutTime_TCM" SG_ 276 HVBatteryShutOff 0;
BA_ "GenSigStartValue" SG_ 276 HybCmndEngTorqImmed 938;
BA_ "GenSigTimeoutTime_AGSM" SG_ 276 HybCmndEngTorqImmed 0;
BA_ "GenSigTimeoutTime_BCM" SG_ 276 HybCmndEngTorqImmed 0;
BA_ "GenSigTimeoutTime_BSM" SG_ 276 HybCmndEngTorqImmed 0;
BA_ "GenSigTimeoutTime_CADM" SG_ 276 HybCmndEngTorqImmed 0;
BA_ "GenSigTimeoutTime_DMSM" SG_ 276 HybCmndEngTorqImmed 0;
BA_ "GenSigTimeoutTime_DTCM" SG_ 276 HybCmndEngTorqImmed 0;
BA_ "GenSigTimeoutTime_EVCU2" SG_ 276 HybCmndEngTorqImmed 0;
BA_ "GenSigTimeoutTime_GNMM" SG_ 276 HybCmndEngTorqImmed 0;
BA_ "GenSigTimeoutTime_HCP" SG_ 276 HybCmndEngTorqImmed 0;
BA_ "GenSigTimeoutTime_IPC" SG_ 276 HybCmndEngTorqImmed 0;
BA_ "GenSigTimeoutTime_RFHM" SG_ 276 HybCmndEngTorqImmed 0;
BA_ "GenSigTimeoutTime_SGW" SG_ 276 HybCmndEngTorqImmed 0;
BA_ "GenSigTimeoutTime_TCM" SG_ 276 HybCmndEngTorqImmed 0;
BA_ "GenSigStartValue" SG_ 276 HybCmndEngTorqPrdtd 938;
BA_ "GenSigTimeoutTime_AGSM" SG_ 276 HybCmndEngTorqPrdtd 0;
BA_ "GenSigTimeoutTime_BCM" SG_ 276 HybCmndEngTorqPrdtd 0;
BA_ "GenSigTimeoutTime_BSM" SG_ 276 HybCmndEngTorqPrdtd 0;
BA_ "GenSigTimeoutTime_CADM" SG_ 276 HybCmndEngTorqPrdtd 0;
BA_ "GenSigTimeoutTime_DMSM" SG_ 276 HybCmndEngTorqPrdtd 0;
BA_ "GenSigTimeoutTime_DTCM" SG_ 276 HybCmndEngTorqPrdtd 0;
BA_ "GenSigTimeoutTime_EVCU2" SG_ 276 HybCmndEngTorqPrdtd 0;
BA_ "GenSigTimeoutTime_GNMM" SG_ 276 HybCmndEngTorqPrdtd 0;
BA_ "GenSigTimeoutTime_HCP" SG_ 276 HybCmndEngTorqPrdtd 0;
BA_ "GenSigTimeoutTime_IPC" SG_ 276 HybCmndEngTorqPrdtd 0;
BA_ "GenSigTimeoutTime_RFHM" SG_ 276 HybCmndEngTorqPrdtd 0;
BA_ "GenSigTimeoutTime_SGW" SG_ 276 HybCmndEngTorqPrdtd 0;
BA_ "GenSigTimeoutTime_TCM" SG_ 276 HybCmndEngTorqPrdtd 0;
BA_ "GenSigTimeoutTime_AGSM" SG_ 276 HybCmndEngTorqRespTyp 0;
BA_ "GenSigTimeoutTime_BCM" SG_ 276 HybCmndEngTorqRespTyp 0;
BA_ "GenSigTimeoutTime_BSM" SG_ 276 HybCmndEngTorqRespTyp 0;
BA_ "GenSigTimeoutTime_CADM" SG_ 276 HybCmndEngTorqRespTyp 0;
BA_ "GenSigTimeoutTime_DMSM" SG_ 276 HybCmndEngTorqRespTyp 0;
BA_ "GenSigTimeoutTime_DTCM" SG_ 276 HybCmndEngTorqRespTyp 0;
BA_ "GenSigTimeoutTime_EVCU2" SG_ 276 HybCmndEngTorqRespTyp 0;
BA_ "GenSigTimeoutTime_GNMM" SG_ 276 HybCmndEngTorqRespTyp 0;
BA_ "GenSigTimeoutTime_HCP" SG_ 276 HybCmndEngTorqRespTyp 0;
BA_ "GenSigTimeoutTime_IPC" SG_ 276 HybCmndEngTorqRespTyp 0;
BA_ "GenSigTimeoutTime_RFHM" SG_ 276 HybCmndEngTorqRespTyp 0;
BA_ "GenSigTimeoutTime_SGW" SG_ 276 HybCmndEngTorqRespTyp 0;
BA_ "GenSigTimeoutTime_TCM" SG_ 276 HybCmndEngTorqRespTyp 0;
BA_ "GenSigTimeoutTime_AGSM" SG_ 276 HybCrnkAbrted 0;
BA_ "GenSigTimeoutTime_BCM" SG_ 276 HybCrnkAbrted 0;
BA_ "GenSigTimeoutTime_BSM" SG_ 276 HybCrnkAbrted 0;
BA_ "GenSigTimeoutTime_CADM" SG_ 276 HybCrnkAbrted 0;
BA_ "GenSigTimeoutTime_DMSM" SG_ 276 HybCrnkAbrted 0;
BA_ "GenSigTimeoutTime_DTCM" SG_ 276 HybCrnkAbrted 0;
BA_ "GenSigTimeoutTime_EVCU2" SG_ 276 HybCrnkAbrted 0;
BA_ "GenSigTimeoutTime_GNMM" SG_ 276 HybCrnkAbrted 0;
BA_ "GenSigTimeoutTime_HCP" SG_ 276 HybCrnkAbrted 0;
BA_ "GenSigTimeoutTime_IPC" SG_ 276 HybCrnkAbrted 0;
BA_ "GenSigTimeoutTime_RFHM" SG_ 276 HybCrnkAbrted 0;
BA_ "GenSigTimeoutTime_SGW" SG_ 276 HybCrnkAbrted 0;
BA_ "GenSigTimeoutTime_TCM" SG_ 276 HybCrnkAbrted 0;
BA_ "GenSigTimeoutTime_AGSM" SG_ 276 HybDFCO_Req 0;
BA_ "GenSigTimeoutTime_BCM" SG_ 276 HybDFCO_Req 0;
BA_ "GenSigTimeoutTime_BSM" SG_ 276 HybDFCO_Req 0;
BA_ "GenSigTimeoutTime_CADM" SG_ 276 HybDFCO_Req 0;
BA_ "GenSigTimeoutTime_DMSM" SG_ 276 HybDFCO_Req 0;
BA_ "GenSigTimeoutTime_DTCM" SG_ 276 HybDFCO_Req 0;
BA_ "GenSigTimeoutTime_EVCU2" SG_ 276 HybDFCO_Req 0;
BA_ "GenSigTimeoutTime_GNMM" SG_ 276 HybDFCO_Req 0;
BA_ "GenSigTimeoutTime_HCP" SG_ 276 HybDFCO_Req 0;
BA_ "GenSigTimeoutTime_IPC" SG_ 276 HybDFCO_Req 0;
BA_ "GenSigTimeoutTime_RFHM" SG_ 276 HybDFCO_Req 0;
BA_ "GenSigTimeoutTime_SGW" SG_ 276 HybDFCO_Req 0;
BA_ "GenSigTimeoutTime_TCM" SG_ 276 HybDFCO_Req 0;
BA_ "GenSigTimeoutTime_AGSM" SG_ 276 HybEngCylDeactReq 0;
BA_ "GenSigTimeoutTime_BCM" SG_ 276 HybEngCylDeactReq 0;
BA_ "GenSigTimeoutTime_BSM" SG_ 276 HybEngCylDeactReq 0;
BA_ "GenSigTimeoutTime_CADM" SG_ 276 HybEngCylDeactReq 0;
BA_ "GenSigTimeoutTime_DMSM" SG_ 276 HybEngCylDeactReq 0;
BA_ "GenSigTimeoutTime_DTCM" SG_ 276 HybEngCylDeactReq 0;
BA_ "GenSigTimeoutTime_EVCU2" SG_ 276 HybEngCylDeactReq 0;
BA_ "GenSigTimeoutTime_GNMM" SG_ 276 HybEngCylDeactReq 0;
BA_ "GenSigTimeoutTime_HCP" SG_ 276 HybEngCylDeactReq 0;
BA_ "GenSigTimeoutTime_IPC" SG_ 276 HybEngCylDeactReq 0;
BA_ "GenSigTimeoutTime_RFHM" SG_ 276 HybEngCylDeactReq 0;
BA_ "GenSigTimeoutTime_SGW" SG_ 276 HybEngCylDeactReq 0;
BA_ "GenSigTimeoutTime_TCM" SG_ 276 HybEngCylDeactReq 0;
BA_ "GenSigTimeoutTime_AGSM" SG_ 276 HybFeedback_Engine 0;
BA_ "GenSigTimeoutTime_BCM" SG_ 276 HybFeedback_Engine 0;
BA_ "GenSigTimeoutTime_BSM" SG_ 276 HybFeedback_Engine 0;
BA_ "GenSigTimeoutTime_CADM" SG_ 276 HybFeedback_Engine 0;
BA_ "GenSigTimeoutTime_DMSM" SG_ 276 HybFeedback_Engine 0;
BA_ "GenSigTimeoutTime_DTCM" SG_ 276 HybFeedback_Engine 0;
BA_ "GenSigTimeoutTime_EVCU2" SG_ 276 HybFeedback_Engine 0;
BA_ "GenSigTimeoutTime_GNMM" SG_ 276 HybFeedback_Engine 0;
BA_ "GenSigTimeoutTime_HCP" SG_ 276 HybFeedback_Engine 0;
BA_ "GenSigTimeoutTime_IPC" SG_ 276 HybFeedback_Engine 0;
BA_ "GenSigTimeoutTime_RFHM" SG_ 276 HybFeedback_Engine 0;
BA_ "GenSigTimeoutTime_SGW" SG_ 276 HybFeedback_Engine 0;
BA_ "GenSigTimeoutTime_TCM" SG_ 276 HybFeedback_Engine 0;
BA_ "GenSigTimeoutTime_AGSM" SG_ 276 HybFstTrqRq_Trans 0;
BA_ "GenSigTimeoutTime_BCM" SG_ 276 HybFstTrqRq_Trans 0;
BA_ "GenSigTimeoutTime_BSM" SG_ 276 HybFstTrqRq_Trans 0;
BA_ "GenSigTimeoutTime_CADM" SG_ 276 HybFstTrqRq_Trans 0;
BA_ "GenSigTimeoutTime_DMSM" SG_ 276 HybFstTrqRq_Trans 0;
BA_ "GenSigTimeoutTime_DTCM" SG_ 276 HybFstTrqRq_Trans 0;
BA_ "GenSigTimeoutTime_EVCU2" SG_ 276 HybFstTrqRq_Trans 0;
BA_ "GenSigTimeoutTime_GNMM" SG_ 276 HybFstTrqRq_Trans 0;
BA_ "GenSigTimeoutTime_HCP" SG_ 276 HybFstTrqRq_Trans 0;
BA_ "GenSigTimeoutTime_IPC" SG_ 276 HybFstTrqRq_Trans 0;
BA_ "GenSigTimeoutTime_RFHM" SG_ 276 HybFstTrqRq_Trans 0;
BA_ "GenSigTimeoutTime_SGW" SG_ 276 HybFstTrqRq_Trans 0;
BA_ "GenSigTimeoutTime_TCM" SG_ 276 HybFstTrqRq_Trans 0;
BA_ "GenSigTimeoutTime_AGSM" SG_ 276 Hybrid_Remedial_Stop 0;
BA_ "GenSigTimeoutTime_BCM" SG_ 276 Hybrid_Remedial_Stop 0;
BA_ "GenSigTimeoutTime_BSM" SG_ 276 Hybrid_Remedial_Stop 0;
BA_ "GenSigTimeoutTime_CADM" SG_ 276 Hybrid_Remedial_Stop 0;
BA_ "GenSigTimeoutTime_DMSM" SG_ 276 Hybrid_Remedial_Stop 0;
BA_ "GenSigTimeoutTime_DTCM" SG_ 276 Hybrid_Remedial_Stop 0;
BA_ "GenSigTimeoutTime_EVCU2" SG_ 276 Hybrid_Remedial_Stop 0;
BA_ "GenSigTimeoutTime_GNMM" SG_ 276 Hybrid_Remedial_Stop 0;
BA_ "GenSigTimeoutTime_HCP" SG_ 276 Hybrid_Remedial_Stop 0;
BA_ "GenSigTimeoutTime_IPC" SG_ 276 Hybrid_Remedial_Stop 0;
BA_ "GenSigTimeoutTime_RFHM" SG_ 276 Hybrid_Remedial_Stop 0;
BA_ "GenSigTimeoutTime_SGW" SG_ 276 Hybrid_Remedial_Stop 0;
BA_ "GenSigTimeoutTime_TCM" SG_ 276 Hybrid_Remedial_Stop 0;
BA_ "GenSigTimeoutTime_AGSM" SG_ 276 HybTransSt 0;
BA_ "GenSigTimeoutTime_BCM" SG_ 276 HybTransSt 0;
BA_ "GenSigTimeoutTime_BSM" SG_ 276 HybTransSt 0;
BA_ "GenSigTimeoutTime_CADM" SG_ 276 HybTransSt 0;
BA_ "GenSigTimeoutTime_DMSM" SG_ 276 HybTransSt 0;
BA_ "GenSigTimeoutTime_DTCM" SG_ 276 HybTransSt 0;
BA_ "GenSigTimeoutTime_EVCU2" SG_ 276 HybTransSt 0;
BA_ "GenSigTimeoutTime_GNMM" SG_ 276 HybTransSt 0;
BA_ "GenSigTimeoutTime_HCP" SG_ 276 HybTransSt 0;
BA_ "GenSigTimeoutTime_IPC" SG_ 276 HybTransSt 0;
BA_ "GenSigTimeoutTime_RFHM" SG_ 276 HybTransSt 0;
BA_ "GenSigTimeoutTime_SGW" SG_ 276 HybTransSt 0;
BA_ "GenSigTimeoutTime_TCM" SG_ 276 HybTransSt 0;
BA_ "GenSigTimeoutTime_AGSM" SG_ 276 InputSpdRaw 0;
BA_ "GenSigTimeoutTime_BCM" SG_ 276 InputSpdRaw 0;
BA_ "GenSigTimeoutTime_BSM" SG_ 276 InputSpdRaw 0;
BA_ "GenSigTimeoutTime_CADM" SG_ 276 InputSpdRaw 0;
BA_ "GenSigTimeoutTime_DMSM" SG_ 276 InputSpdRaw 0;
BA_ "GenSigTimeoutTime_DTCM" SG_ 276 InputSpdRaw 0;
BA_ "GenSigTimeoutTime_EVCU2" SG_ 276 InputSpdRaw 0;
BA_ "GenSigTimeoutTime_GNMM" SG_ 276 InputSpdRaw 0;
BA_ "GenSigTimeoutTime_HCP" SG_ 276 InputSpdRaw 0;
BA_ "GenSigTimeoutTime_IPC" SG_ 276 InputSpdRaw 0;
BA_ "GenSigTimeoutTime_RFHM" SG_ 276 InputSpdRaw 0;
BA_ "GenSigTimeoutTime_SGW" SG_ 276 InputSpdRaw 0;
BA_ "GenSigTimeoutTime_TCM" SG_ 276 InputSpdRaw 0;
BA_ "GenSigTimeoutTime_AGSM" SG_ 276 LV_SystemFailure 0;
BA_ "GenSigTimeoutTime_BCM" SG_ 276 LV_SystemFailure 0;
BA_ "GenSigTimeoutTime_BSM" SG_ 276 LV_SystemFailure 0;
BA_ "GenSigTimeoutTime_CADM" SG_ 276 LV_SystemFailure 0;
BA_ "GenSigTimeoutTime_DMSM" SG_ 276 LV_SystemFailure 0;
BA_ "GenSigTimeoutTime_DTCM" SG_ 276 LV_SystemFailure 0;
BA_ "GenSigTimeoutTime_EVCU2" SG_ 276 LV_SystemFailure 0;
BA_ "GenSigTimeoutTime_GNMM" SG_ 276 LV_SystemFailure 0;
BA_ "GenSigTimeoutTime_HCP" SG_ 276 LV_SystemFailure 0;
BA_ "GenSigTimeoutTime_IPC" SG_ 276 LV_SystemFailure 0;
BA_ "GenSigTimeoutTime_RFHM" SG_ 276 LV_SystemFailure 0;
BA_ "GenSigTimeoutTime_SGW" SG_ 276 LV_SystemFailure 0;
BA_ "GenSigTimeoutTime_TCM" SG_ 276 LV_SystemFailure 0;
BA_ "SystemSignalLongSymbol" SG_ 276 MessageCounter_HYBRID_POWERTRAI "MessageCounter_HYBRID_POWERTRAIN1";
BA_ "GenSigTimeoutTime_AGSM" SG_ 276 MessageCounter_HYBRID_POWERTRAI 0;
BA_ "GenSigTimeoutTime_BCM" SG_ 276 MessageCounter_HYBRID_POWERTRAI 0;
BA_ "GenSigTimeoutTime_DMSM" SG_ 276 MessageCounter_HYBRID_POWERTRAI 0;
BA_ "GenSigTimeoutTime_DTCM" SG_ 276 MessageCounter_HYBRID_POWERTRAI 0;
BA_ "GenSigTimeoutTime_EVCU2" SG_ 276 MessageCounter_HYBRID_POWERTRAI 0;
BA_ "GenSigTimeoutTime_GNMM" SG_ 276 MessageCounter_HYBRID_POWERTRAI 0;
BA_ "GenSigTimeoutTime_HCP" SG_ 276 MessageCounter_HYBRID_POWERTRAI 0;
BA_ "GenSigTimeoutTime_RFHM" SG_ 276 MessageCounter_HYBRID_POWERTRAI 0;
BA_ "GenSigTimeoutTime_SGW" SG_ 276 MessageCounter_HYBRID_POWERTRAI 0;
BA_ "GenSigTimeoutTime_AGSM" SG_ 276 NiTi_Disable 0;
BA_ "GenSigTimeoutTime_BCM" SG_ 276 NiTi_Disable 0;
BA_ "GenSigTimeoutTime_BSM" SG_ 276 NiTi_Disable 0;
BA_ "GenSigTimeoutTime_CADM" SG_ 276 NiTi_Disable 0;
BA_ "GenSigTimeoutTime_DMSM" SG_ 276 NiTi_Disable 0;
BA_ "GenSigTimeoutTime_DTCM" SG_ 276 NiTi_Disable 0;
BA_ "GenSigTimeoutTime_EVCU2" SG_ 276 NiTi_Disable 0;
BA_ "GenSigTimeoutTime_GNMM" SG_ 276 NiTi_Disable 0;
BA_ "GenSigTimeoutTime_HCP" SG_ 276 NiTi_Disable 0;
BA_ "GenSigTimeoutTime_IPC" SG_ 276 NiTi_Disable 0;
BA_ "GenSigTimeoutTime_RFHM" SG_ 276 NiTi_Disable 0;
BA_ "GenSigTimeoutTime_SGW" SG_ 276 NiTi_Disable 0;
BA_ "GenSigTimeoutTime_TCM" SG_ 276 NiTi_Disable 0;
BA_ "GenSigTimeoutTime_AGSM" SG_ 276 PropulsionSystemActive 0;
BA_ "GenSigTimeoutTime_BSM" SG_ 276 PropulsionSystemActive 0;
BA_ "GenSigTimeoutTime_CADM" SG_ 276 PropulsionSystemActive 0;
BA_ "GenSigTimeoutTime_DMSM" SG_ 276 PropulsionSystemActive 0;
BA_ "GenSigTimeoutTime_DTCM" SG_ 276 PropulsionSystemActive 0;
BA_ "GenSigTimeoutTime_EVCU2" SG_ 276 PropulsionSystemActive 0;
BA_ "GenSigTimeoutTime_GNMM" SG_ 276 PropulsionSystemActive 0;
BA_ "GenSigTimeoutTime_HCP" SG_ 276 PropulsionSystemActive 0;
BA_ "GenSigTimeoutTime_RFHM" SG_ 276 PropulsionSystemActive 0;
BA_ "GenSigTimeoutTime_TCM" SG_ 276 PropulsionSystemActive 0;
BA_ "GenSigStartValue" SG_ 276 RegenTarget 938;
BA_ "GenSigTimeoutTime_AGSM" SG_ 276 RegenTarget 0;
BA_ "GenSigTimeoutTime_BCM" SG_ 276 RegenTarget 0;
BA_ "GenSigTimeoutTime_BSM" SG_ 276 RegenTarget 0;
BA_ "GenSigTimeoutTime_CADM" SG_ 276 RegenTarget 0;
BA_ "GenSigTimeoutTime_DMSM" SG_ 276 RegenTarget 0;
BA_ "GenSigTimeoutTime_DTCM" SG_ 276 RegenTarget 0;
BA_ "GenSigTimeoutTime_EVCU2" SG_ 276 RegenTarget 0;
BA_ "GenSigTimeoutTime_GNMM" SG_ 276 RegenTarget 0;
BA_ "GenSigTimeoutTime_HCP" SG_ 276 RegenTarget 0;
BA_ "GenSigTimeoutTime_IPC" SG_ 276 RegenTarget 0;
BA_ "GenSigTimeoutTime_RFHM" SG_ 276 RegenTarget 0;
BA_ "GenSigTimeoutTime_SGW" SG_ 276 RegenTarget 0;
BA_ "GenSigTimeoutTime_TCM" SG_ 276 RegenTarget 0;
BA_ "GenSigTimeoutTime_AGSM" SG_ 276 REPRGD_PFC_CLEAR_BPCM_GW 0;
BA_ "GenSigTimeoutTime_BCM" SG_ 276 REPRGD_PFC_CLEAR_BPCM_GW 0;
BA_ "GenSigTimeoutTime_BSM" SG_ 276 REPRGD_PFC_CLEAR_BPCM_GW 0;
BA_ "GenSigTimeoutTime_CADM" SG_ 276 REPRGD_PFC_CLEAR_BPCM_GW 0;
BA_ "GenSigTimeoutTime_DMSM" SG_ 276 REPRGD_PFC_CLEAR_BPCM_GW 0;
BA_ "GenSigTimeoutTime_DTCM" SG_ 276 REPRGD_PFC_CLEAR_BPCM_GW 0;
BA_ "GenSigTimeoutTime_EVCU2" SG_ 276 REPRGD_PFC_CLEAR_BPCM_GW 0;
BA_ "GenSigTimeoutTime_GNMM" SG_ 276 REPRGD_PFC_CLEAR_BPCM_GW 0;
BA_ "GenSigTimeoutTime_HCP" SG_ 276 REPRGD_PFC_CLEAR_BPCM_GW 0;
BA_ "GenSigTimeoutTime_IPC" SG_ 276 REPRGD_PFC_CLEAR_BPCM_GW 0;
BA_ "GenSigTimeoutTime_RFHM" SG_ 276 REPRGD_PFC_CLEAR_BPCM_GW 0;
BA_ "GenSigTimeoutTime_SGW" SG_ 276 REPRGD_PFC_CLEAR_BPCM_GW 0;
BA_ "GenSigTimeoutTime_TCM" SG_ 276 REPRGD_PFC_CLEAR_BPCM_GW 0;
BA_ "GenSigTimeoutTime_AGSM" SG_ 276 REPRGD_PFC_CLEAR_EVCU2 0;
BA_ "GenSigTimeoutTime_BCM" SG_ 276 REPRGD_PFC_CLEAR_EVCU2 0;
BA_ "GenSigTimeoutTime_BSM" SG_ 276 REPRGD_PFC_CLEAR_EVCU2 0;
BA_ "GenSigTimeoutTime_CADM" SG_ 276 REPRGD_PFC_CLEAR_EVCU2 0;
BA_ "GenSigTimeoutTime_DMSM" SG_ 276 REPRGD_PFC_CLEAR_EVCU2 0;
BA_ "GenSigTimeoutTime_DTCM" SG_ 276 REPRGD_PFC_CLEAR_EVCU2 0;
BA_ "GenSigTimeoutTime_EVCU2" SG_ 276 REPRGD_PFC_CLEAR_EVCU2 0;
BA_ "GenSigTimeoutTime_GNMM" SG_ 276 REPRGD_PFC_CLEAR_EVCU2 0;
BA_ "GenSigTimeoutTime_HCP" SG_ 276 REPRGD_PFC_CLEAR_EVCU2 0;
BA_ "GenSigTimeoutTime_IPC" SG_ 276 REPRGD_PFC_CLEAR_EVCU2 0;
BA_ "GenSigTimeoutTime_RFHM" SG_ 276 REPRGD_PFC_CLEAR_EVCU2 0;
BA_ "GenSigTimeoutTime_SGW" SG_ 276 REPRGD_PFC_CLEAR_EVCU2 0;
BA_ "GenSigTimeoutTime_TCM" SG_ 276 REPRGD_PFC_CLEAR_EVCU2 0;
BA_ "GenSigTimeoutTime_AGSM" SG_ 276 RollingIdleSpeedTarget 0;
BA_ "GenSigTimeoutTime_BCM" SG_ 276 RollingIdleSpeedTarget 0;
BA_ "GenSigTimeoutTime_BSM" SG_ 276 RollingIdleSpeedTarget 0;
BA_ "GenSigTimeoutTime_CADM" SG_ 276 RollingIdleSpeedTarget 0;
BA_ "GenSigTimeoutTime_DMSM" SG_ 276 RollingIdleSpeedTarget 0;
BA_ "GenSigTimeoutTime_DTCM" SG_ 276 RollingIdleSpeedTarget 0;
BA_ "GenSigTimeoutTime_EVCU2" SG_ 276 RollingIdleSpeedTarget 0;
BA_ "GenSigTimeoutTime_GNMM" SG_ 276 RollingIdleSpeedTarget 0;
BA_ "GenSigTimeoutTime_HCP" SG_ 276 RollingIdleSpeedTarget 0;
BA_ "GenSigTimeoutTime_IPC" SG_ 276 RollingIdleSpeedTarget 0;
BA_ "GenSigTimeoutTime_RFHM" SG_ 276 RollingIdleSpeedTarget 0;
BA_ "GenSigTimeoutTime_SGW" SG_ 276 RollingIdleSpeedTarget 0;
BA_ "GenSigTimeoutTime_TCM" SG_ 276 RollingIdleSpeedTarget 0;
BA_ "GenSigTimeoutTime_AGSM" SG_ 276 TransInpSpdPrfl 0;
BA_ "GenSigTimeoutTime_BCM" SG_ 276 TransInpSpdPrfl 0;
BA_ "GenSigTimeoutTime_BSM" SG_ 276 TransInpSpdPrfl 0;
BA_ "GenSigTimeoutTime_CADM" SG_ 276 TransInpSpdPrfl 0;
BA_ "GenSigTimeoutTime_DMSM" SG_ 276 TransInpSpdPrfl 0;
BA_ "GenSigTimeoutTime_DTCM" SG_ 276 TransInpSpdPrfl 0;
BA_ "GenSigTimeoutTime_EVCU2" SG_ 276 TransInpSpdPrfl 0;
BA_ "GenSigTimeoutTime_GNMM" SG_ 276 TransInpSpdPrfl 0;
BA_ "GenSigTimeoutTime_HCP" SG_ 276 TransInpSpdPrfl 0;
BA_ "GenSigTimeoutTime_IPC" SG_ 276 TransInpSpdPrfl 0;
BA_ "GenSigTimeoutTime_RFHM" SG_ 276 TransInpSpdPrfl 0;
BA_ "GenSigTimeoutTime_SGW" SG_ 276 TransInpSpdPrfl 0;
BA_ "GenSigTimeoutTime_TCM" SG_ 276 TransInpSpdPrfl 0;
BA_ "GenSigTimeoutTime_AGSM" SG_ 269 BSGActualTorque 0;
BA_ "GenSigTimeoutTime_BSM" SG_ 269 BSGActualTorque 0;
BA_ "GenSigTimeoutTime_CADM" SG_ 269 BSGActualTorque 0;
BA_ "GenSigTimeoutTime_DMSM" SG_ 269 BSGActualTorque 0;
BA_ "GenSigTimeoutTime_DTCM" SG_ 269 BSGActualTorque 0;
BA_ "GenSigTimeoutTime_EVCU2" SG_ 269 BSGActualTorque 0;
BA_ "GenSigTimeoutTime_GNMM" SG_ 269 BSGActualTorque 0;
BA_ "GenSigTimeoutTime_HCP" SG_ 269 BSGActualTorque 0;
BA_ "GenSigTimeoutTime_IPC" SG_ 269 BSGActualTorque 0;
BA_ "GenSigTimeoutTime_RFHM" SG_ 269 BSGActualTorque 0;
BA_ "GenSigTimeoutTime_SGW" SG_ 269 BSGActualTorque 0;
BA_ "GenSigTimeoutTime_TCM" SG_ 269 BSGActualTorque 0;
BA_ "GenSigTimeoutTime_AGSM" SG_ 269 BSGChrgIdleSpeedTarget 0;
BA_ "GenSigTimeoutTime_BCM" SG_ 269 BSGChrgIdleSpeedTarget 0;
BA_ "GenSigTimeoutTime_BSM" SG_ 269 BSGChrgIdleSpeedTarget 0;
BA_ "GenSigTimeoutTime_CADM" SG_ 269 BSGChrgIdleSpeedTarget 0;
BA_ "GenSigTimeoutTime_DMSM" SG_ 269 BSGChrgIdleSpeedTarget 0;
BA_ "GenSigTimeoutTime_DTCM" SG_ 269 BSGChrgIdleSpeedTarget 0;
BA_ "GenSigTimeoutTime_EVCU2" SG_ 269 BSGChrgIdleSpeedTarget 0;
BA_ "GenSigTimeoutTime_GNMM" SG_ 269 BSGChrgIdleSpeedTarget 0;
BA_ "GenSigTimeoutTime_HCP" SG_ 269 BSGChrgIdleSpeedTarget 0;
BA_ "GenSigTimeoutTime_IPC" SG_ 269 BSGChrgIdleSpeedTarget 0;
BA_ "GenSigTimeoutTime_RFHM" SG_ 269 BSGChrgIdleSpeedTarget 0;
BA_ "GenSigTimeoutTime_SGW" SG_ 269 BSGChrgIdleSpeedTarget 0;
BA_ "GenSigTimeoutTime_TCM" SG_ 269 BSGChrgIdleSpeedTarget 0;
BA_ "GenSigTimeoutTime_AGSM" SG_ 269 CODE_CLR_HCP 0;
BA_ "GenSigTimeoutTime_BCM" SG_ 269 CODE_CLR_HCP 0;
BA_ "GenSigTimeoutTime_BSM" SG_ 269 CODE_CLR_HCP 0;
BA_ "GenSigTimeoutTime_CADM" SG_ 269 CODE_CLR_HCP 0;
BA_ "GenSigTimeoutTime_DMSM" SG_ 269 CODE_CLR_HCP 0;
BA_ "GenSigTimeoutTime_DTCM" SG_ 269 CODE_CLR_HCP 0;
BA_ "GenSigTimeoutTime_EVCU2" SG_ 269 CODE_CLR_HCP 0;
BA_ "GenSigTimeoutTime_GNMM" SG_ 269 CODE_CLR_HCP 0;
BA_ "GenSigTimeoutTime_HCP" SG_ 269 CODE_CLR_HCP 0;
BA_ "GenSigTimeoutTime_IPC" SG_ 269 CODE_CLR_HCP 0;
BA_ "GenSigTimeoutTime_RFHM" SG_ 269 CODE_CLR_HCP 0;
BA_ "GenSigTimeoutTime_SGW" SG_ 269 CODE_CLR_HCP 0;
BA_ "GenSigTimeoutTime_TCM" SG_ 269 CODE_CLR_HCP 0;
BA_ "GenSigTimeoutTime_AGSM" SG_ 269 CRC_HYBRID_POWERTRAIN2 0;
BA_ "GenSigTimeoutTime_BCM" SG_ 269 CRC_HYBRID_POWERTRAIN2 0;
BA_ "GenSigTimeoutTime_CADM" SG_ 269 CRC_HYBRID_POWERTRAIN2 0;
BA_ "GenSigTimeoutTime_DMSM" SG_ 269 CRC_HYBRID_POWERTRAIN2 0;
BA_ "GenSigTimeoutTime_DTCM" SG_ 269 CRC_HYBRID_POWERTRAIN2 0;
BA_ "GenSigTimeoutTime_EVCU2" SG_ 269 CRC_HYBRID_POWERTRAIN2 0;
BA_ "GenSigTimeoutTime_GNMM" SG_ 269 CRC_HYBRID_POWERTRAIN2 0;
BA_ "GenSigTimeoutTime_HCP" SG_ 269 CRC_HYBRID_POWERTRAIN2 0;
BA_ "GenSigTimeoutTime_IPC" SG_ 269 CRC_HYBRID_POWERTRAIN2 0;
BA_ "GenSigTimeoutTime_RFHM" SG_ 269 CRC_HYBRID_POWERTRAIN2 0;
BA_ "GenSigTimeoutTime_SGW" SG_ 269 CRC_HYBRID_POWERTRAIN2 0;
BA_ "GenSigStartValue" SG_ 269 HybridEngineMaxTorqAllowed 938;
BA_ "GenSigTimeoutTime_AGSM" SG_ 269 HybridEngineMaxTorqAllowed 0;
BA_ "GenSigTimeoutTime_BCM" SG_ 269 HybridEngineMaxTorqAllowed 0;
BA_ "GenSigTimeoutTime_BSM" SG_ 269 HybridEngineMaxTorqAllowed 0;
BA_ "GenSigTimeoutTime_CADM" SG_ 269 HybridEngineMaxTorqAllowed 0;
BA_ "GenSigTimeoutTime_DMSM" SG_ 269 HybridEngineMaxTorqAllowed 0;
BA_ "GenSigTimeoutTime_DTCM" SG_ 269 HybridEngineMaxTorqAllowed 0;
BA_ "GenSigTimeoutTime_EVCU2" SG_ 269 HybridEngineMaxTorqAllowed 0;
BA_ "GenSigTimeoutTime_GNMM" SG_ 269 HybridEngineMaxTorqAllowed 0;
BA_ "GenSigTimeoutTime_HCP" SG_ 269 HybridEngineMaxTorqAllowed 0;
BA_ "GenSigTimeoutTime_IPC" SG_ 269 HybridEngineMaxTorqAllowed 0;
BA_ "GenSigTimeoutTime_RFHM" SG_ 269 HybridEngineMaxTorqAllowed 0;
BA_ "GenSigTimeoutTime_SGW" SG_ 269 HybridEngineMaxTorqAllowed 0;
BA_ "GenSigTimeoutTime_TCM" SG_ 269 HybridEngineMaxTorqAllowed 0;
BA_ "GenSigTimeoutTime_AGSM" SG_ 269 IdleSpeedActiveSts 0;
BA_ "GenSigTimeoutTime_BCM" SG_ 269 IdleSpeedActiveSts 0;
BA_ "GenSigTimeoutTime_BSM" SG_ 269 IdleSpeedActiveSts 0;
BA_ "GenSigTimeoutTime_CADM" SG_ 269 IdleSpeedActiveSts 0;
BA_ "GenSigTimeoutTime_DMSM" SG_ 269 IdleSpeedActiveSts 0;
BA_ "GenSigTimeoutTime_DTCM" SG_ 269 IdleSpeedActiveSts 0;
BA_ "GenSigTimeoutTime_EVCU2" SG_ 269 IdleSpeedActiveSts 0;
BA_ "GenSigTimeoutTime_GNMM" SG_ 269 IdleSpeedActiveSts 0;
BA_ "GenSigTimeoutTime_HCP" SG_ 269 IdleSpeedActiveSts 0;
BA_ "GenSigTimeoutTime_IPC" SG_ 269 IdleSpeedActiveSts 0;
BA_ "GenSigTimeoutTime_RFHM" SG_ 269 IdleSpeedActiveSts 0;
BA_ "GenSigTimeoutTime_SGW" SG_ 269 IdleSpeedActiveSts 0;
BA_ "GenSigTimeoutTime_TCM" SG_ 269 IdleSpeedActiveSts 0;
BA_ "SystemSignalLongSymbol" SG_ 269 MessageCounter_HYBRID_POWERTRAI "MessageCounter_HYBRID_POWERTRAIN2";
BA_ "GenSigTimeoutTime_AGSM" SG_ 269 MessageCounter_HYBRID_POWERTRAI 0;
BA_ "GenSigTimeoutTime_BCM" SG_ 269 MessageCounter_HYBRID_POWERTRAI 0;
BA_ "GenSigTimeoutTime_CADM" SG_ 269 MessageCounter_HYBRID_POWERTRAI 0;
BA_ "GenSigTimeoutTime_DMSM" SG_ 269 MessageCounter_HYBRID_POWERTRAI 0;
BA_ "GenSigTimeoutTime_DTCM" SG_ 269 MessageCounter_HYBRID_POWERTRAI 0;
BA_ "GenSigTimeoutTime_EVCU2" SG_ 269 MessageCounter_HYBRID_POWERTRAI 0;
BA_ "GenSigTimeoutTime_GNMM" SG_ 269 MessageCounter_HYBRID_POWERTRAI 0;
BA_ "GenSigTimeoutTime_HCP" SG_ 269 MessageCounter_HYBRID_POWERTRAI 0;
BA_ "GenSigTimeoutTime_IPC" SG_ 269 MessageCounter_HYBRID_POWERTRAI 0;
BA_ "GenSigTimeoutTime_RFHM" SG_ 269 MessageCounter_HYBRID_POWERTRAI 0;
BA_ "GenSigTimeoutTime_SGW" SG_ 269 MessageCounter_HYBRID_POWERTRAI 0;
BA_ "GenSigTimeoutTime_AGSM" SG_ 269 REPRGD_PFC_CLR_HCP 0;
BA_ "GenSigTimeoutTime_BCM" SG_ 269 REPRGD_PFC_CLR_HCP 0;
BA_ "GenSigTimeoutTime_BSM" SG_ 269 REPRGD_PFC_CLR_HCP 0;
BA_ "GenSigTimeoutTime_CADM" SG_ 269 REPRGD_PFC_CLR_HCP 0;
BA_ "GenSigTimeoutTime_DMSM" SG_ 269 REPRGD_PFC_CLR_HCP 0;
BA_ "GenSigTimeoutTime_DTCM" SG_ 269 REPRGD_PFC_CLR_HCP 0;
BA_ "GenSigTimeoutTime_EVCU2" SG_ 269 REPRGD_PFC_CLR_HCP 0;
BA_ "GenSigTimeoutTime_GNMM" SG_ 269 REPRGD_PFC_CLR_HCP 0;
BA_ "GenSigTimeoutTime_HCP" SG_ 269 REPRGD_PFC_CLR_HCP 0;
BA_ "GenSigTimeoutTime_IPC" SG_ 269 REPRGD_PFC_CLR_HCP 0;
BA_ "GenSigTimeoutTime_RFHM" SG_ 269 REPRGD_PFC_CLR_HCP 0;
BA_ "GenSigTimeoutTime_SGW" SG_ 269 REPRGD_PFC_CLR_HCP 0;
BA_ "GenSigTimeoutTime_TCM" SG_ 269 REPRGD_PFC_CLR_HCP 0;
BA_ "GenSigTimeoutTime_AGSM" SG_ 269 ReqTorqueOverLayActive 0;
BA_ "GenSigTimeoutTime_BSM" SG_ 269 ReqTorqueOverLayActive 0;
BA_ "GenSigTimeoutTime_CADM" SG_ 269 ReqTorqueOverLayActive 0;
BA_ "GenSigTimeoutTime_DMSM" SG_ 269 ReqTorqueOverLayActive 0;
BA_ "GenSigTimeoutTime_DTCM" SG_ 269 ReqTorqueOverLayActive 0;
BA_ "GenSigTimeoutTime_ECM" SG_ 269 ReqTorqueOverLayActive 0;
BA_ "GenSigTimeoutTime_EVCU2" SG_ 269 ReqTorqueOverLayActive 0;
BA_ "GenSigTimeoutTime_GNMM" SG_ 269 ReqTorqueOverLayActive 0;
BA_ "GenSigTimeoutTime_HCP" SG_ 269 ReqTorqueOverLayActive 0;
BA_ "GenSigTimeoutTime_IPC" SG_ 269 ReqTorqueOverLayActive 0;
BA_ "GenSigTimeoutTime_RFHM" SG_ 269 ReqTorqueOverLayActive 0;
BA_ "GenSigTimeoutTime_SGW" SG_ 269 ReqTorqueOverLayActive 0;
BA_ "GenSigTimeoutTime_AGSM" SG_ 269 TCC_Slip_Rgn 0;
BA_ "GenSigTimeoutTime_BCM" SG_ 269 TCC_Slip_Rgn 0;
BA_ "GenSigTimeoutTime_BSM" SG_ 269 TCC_Slip_Rgn 0;
BA_ "GenSigTimeoutTime_CADM" SG_ 269 TCC_Slip_Rgn 0;
BA_ "GenSigTimeoutTime_DMSM" SG_ 269 TCC_Slip_Rgn 0;
BA_ "GenSigTimeoutTime_DTCM" SG_ 269 TCC_Slip_Rgn 0;
BA_ "GenSigTimeoutTime_ECM" SG_ 269 TCC_Slip_Rgn 0;
BA_ "GenSigTimeoutTime_EVCU2" SG_ 269 TCC_Slip_Rgn 0;
BA_ "GenSigTimeoutTime_GNMM" SG_ 269 TCC_Slip_Rgn 0;
BA_ "GenSigTimeoutTime_HCP" SG_ 269 TCC_Slip_Rgn 0;
BA_ "GenSigTimeoutTime_IPC" SG_ 269 TCC_Slip_Rgn 0;
BA_ "GenSigTimeoutTime_RFHM" SG_ 269 TCC_Slip_Rgn 0;
BA_ "GenSigTimeoutTime_SGW" SG_ 269 TCC_Slip_Rgn 0;
BA_ "GenSigTimeoutTime_AGSM" SG_ 1033 BattPowerUse_Display 0;
BA_ "GenSigTimeoutTime_BCM" SG_ 1033 BattPowerUse_Display 0;
BA_ "GenSigTimeoutTime_BSM" SG_ 1033 BattPowerUse_Display 0;
BA_ "GenSigTimeoutTime_CADM" SG_ 1033 BattPowerUse_Display 0;
BA_ "GenSigTimeoutTime_DMSM" SG_ 1033 BattPowerUse_Display 0;
BA_ "GenSigTimeoutTime_DTCM" SG_ 1033 BattPowerUse_Display 0;
BA_ "GenSigTimeoutTime_ECM" SG_ 1033 BattPowerUse_Display 0;
BA_ "GenSigTimeoutTime_EVCU2" SG_ 1033 BattPowerUse_Display 0;
BA_ "GenSigTimeoutTime_GNMM" SG_ 1033 BattPowerUse_Display 0;
BA_ "GenSigTimeoutTime_HCP" SG_ 1033 BattPowerUse_Display 0;
BA_ "GenSigTimeoutTime_RFHM" SG_ 1033 BattPowerUse_Display 0;
BA_ "GenSigTimeoutTime_TCM" SG_ 1033 BattPowerUse_Display 0;
BA_ "GenSigTimeoutTime_AGSM" SG_ 1033 BattPowerUse_DisplayV 0;
BA_ "GenSigTimeoutTime_BCM" SG_ 1033 BattPowerUse_DisplayV 0;
BA_ "GenSigTimeoutTime_BSM" SG_ 1033 BattPowerUse_DisplayV 0;
BA_ "GenSigTimeoutTime_CADM" SG_ 1033 BattPowerUse_DisplayV 0;
BA_ "GenSigTimeoutTime_DMSM" SG_ 1033 BattPowerUse_DisplayV 0;
BA_ "GenSigTimeoutTime_DTCM" SG_ 1033 BattPowerUse_DisplayV 0;
BA_ "GenSigTimeoutTime_ECM" SG_ 1033 BattPowerUse_DisplayV 0;
BA_ "GenSigTimeoutTime_EVCU2" SG_ 1033 BattPowerUse_DisplayV 0;
BA_ "GenSigTimeoutTime_GNMM" SG_ 1033 BattPowerUse_DisplayV 0;
BA_ "GenSigTimeoutTime_HCP" SG_ 1033 BattPowerUse_DisplayV 0;
BA_ "GenSigTimeoutTime_RFHM" SG_ 1033 BattPowerUse_DisplayV 0;
BA_ "GenSigTimeoutTime_TCM" SG_ 1033 BattPowerUse_DisplayV 0;
BA_ "GenSigTimeoutTime_AGSM" SG_ 1033 CRC_HYBRID_POWERTRAIN5 0;
BA_ "GenSigTimeoutTime_BCM" SG_ 1033 CRC_HYBRID_POWERTRAIN5 0;
BA_ "GenSigTimeoutTime_BSM" SG_ 1033 CRC_HYBRID_POWERTRAIN5 0;
BA_ "GenSigTimeoutTime_CADM" SG_ 1033 CRC_HYBRID_POWERTRAIN5 0;
BA_ "GenSigTimeoutTime_DMSM" SG_ 1033 CRC_HYBRID_POWERTRAIN5 0;
BA_ "GenSigTimeoutTime_DTCM" SG_ 1033 CRC_HYBRID_POWERTRAIN5 0;
BA_ "GenSigTimeoutTime_EVCU2" SG_ 1033 CRC_HYBRID_POWERTRAIN5 0;
BA_ "GenSigTimeoutTime_GNMM" SG_ 1033 CRC_HYBRID_POWERTRAIN5 0;
BA_ "GenSigTimeoutTime_HCP" SG_ 1033 CRC_HYBRID_POWERTRAIN5 0;
BA_ "GenSigTimeoutTime_IPC" SG_ 1033 CRC_HYBRID_POWERTRAIN5 0;
BA_ "GenSigTimeoutTime_RFHM" SG_ 1033 CRC_HYBRID_POWERTRAIN5 0;
BA_ "GenSigTimeoutTime_SGW" SG_ 1033 CRC_HYBRID_POWERTRAIN5 0;
BA_ "GenSigTimeoutTime_AGSM" SG_ 1033 ElectricTrqMult4Pedal 0;
BA_ "GenSigTimeoutTime_BCM" SG_ 1033 ElectricTrqMult4Pedal 0;
BA_ "GenSigTimeoutTime_BSM" SG_ 1033 ElectricTrqMult4Pedal 0;
BA_ "GenSigTimeoutTime_CADM" SG_ 1033 ElectricTrqMult4Pedal 0;
BA_ "GenSigTimeoutTime_DMSM" SG_ 1033 ElectricTrqMult4Pedal 0;
BA_ "GenSigTimeoutTime_DTCM" SG_ 1033 ElectricTrqMult4Pedal 0;
BA_ "GenSigTimeoutTime_EVCU2" SG_ 1033 ElectricTrqMult4Pedal 0;
BA_ "GenSigTimeoutTime_GNMM" SG_ 1033 ElectricTrqMult4Pedal 0;
BA_ "GenSigTimeoutTime_HCP" SG_ 1033 ElectricTrqMult4Pedal 0;
BA_ "GenSigTimeoutTime_IPC" SG_ 1033 ElectricTrqMult4Pedal 0;
BA_ "GenSigTimeoutTime_RFHM" SG_ 1033 ElectricTrqMult4Pedal 0;
BA_ "GenSigTimeoutTime_SGW" SG_ 1033 ElectricTrqMult4Pedal 0;
BA_ "GenSigTimeoutTime_TCM" SG_ 1033 ElectricTrqMult4Pedal 0;
BA_ "GenSigTimeoutTime_AGSM" SG_ 1033 HCP_Stop_Start_Fault 0;
BA_ "GenSigTimeoutTime_BCM" SG_ 1033 HCP_Stop_Start_Fault 0;
BA_ "GenSigTimeoutTime_BSM" SG_ 1033 HCP_Stop_Start_Fault 0;
BA_ "GenSigTimeoutTime_CADM" SG_ 1033 HCP_Stop_Start_Fault 0;
BA_ "GenSigTimeoutTime_DMSM" SG_ 1033 HCP_Stop_Start_Fault 0;
BA_ "GenSigTimeoutTime_DTCM" SG_ 1033 HCP_Stop_Start_Fault 0;
BA_ "GenSigTimeoutTime_EVCU2" SG_ 1033 HCP_Stop_Start_Fault 0;
BA_ "GenSigTimeoutTime_GNMM" SG_ 1033 HCP_Stop_Start_Fault 0;
BA_ "GenSigTimeoutTime_HCP" SG_ 1033 HCP_Stop_Start_Fault 0;
BA_ "GenSigTimeoutTime_IPC" SG_ 1033 HCP_Stop_Start_Fault 0;
BA_ "GenSigTimeoutTime_RFHM" SG_ 1033 HCP_Stop_Start_Fault 0;
BA_ "GenSigTimeoutTime_SGW" SG_ 1033 HCP_Stop_Start_Fault 0;
BA_ "GenSigTimeoutTime_TCM" SG_ 1033 HCP_Stop_Start_Fault 0;
BA_ "GenSigStartValue" SG_ 1033 HCPMaxEngRPM 255;
BA_ "GenSigTimeoutTime_AGSM" SG_ 1033 HCPMaxEngRPM 0;
BA_ "GenSigTimeoutTime_BCM" SG_ 1033 HCPMaxEngRPM 0;
BA_ "GenSigTimeoutTime_BSM" SG_ 1033 HCPMaxEngRPM 0;
BA_ "GenSigTimeoutTime_CADM" SG_ 1033 HCPMaxEngRPM 0;
BA_ "GenSigTimeoutTime_DMSM" SG_ 1033 HCPMaxEngRPM 0;
BA_ "GenSigTimeoutTime_DTCM" SG_ 1033 HCPMaxEngRPM 0;
BA_ "GenSigTimeoutTime_EVCU2" SG_ 1033 HCPMaxEngRPM 0;
BA_ "GenSigTimeoutTime_GNMM" SG_ 1033 HCPMaxEngRPM 0;
BA_ "GenSigTimeoutTime_HCP" SG_ 1033 HCPMaxEngRPM 0;
BA_ "GenSigTimeoutTime_IPC" SG_ 1033 HCPMaxEngRPM 0;
BA_ "GenSigTimeoutTime_RFHM" SG_ 1033 HCPMaxEngRPM 0;
BA_ "GenSigTimeoutTime_SGW" SG_ 1033 HCPMaxEngRPM 0;
BA_ "GenSigTimeoutTime_TCM" SG_ 1033 HCPMaxEngRPM 0;
BA_ "GenSigTimeoutTime_AGSM" SG_ 1033 HEV_HybPwrtrnRdcdPerfCmnd 0;
BA_ "GenSigTimeoutTime_BCM" SG_ 1033 HEV_HybPwrtrnRdcdPerfCmnd 0;
BA_ "GenSigTimeoutTime_BSM" SG_ 1033 HEV_HybPwrtrnRdcdPerfCmnd 0;
BA_ "GenSigTimeoutTime_CADM" SG_ 1033 HEV_HybPwrtrnRdcdPerfCmnd 0;
BA_ "GenSigTimeoutTime_DMSM" SG_ 1033 HEV_HybPwrtrnRdcdPerfCmnd 0;
BA_ "GenSigTimeoutTime_DTCM" SG_ 1033 HEV_HybPwrtrnRdcdPerfCmnd 0;
BA_ "GenSigTimeoutTime_EVCU2" SG_ 1033 HEV_HybPwrtrnRdcdPerfCmnd 0;
BA_ "GenSigTimeoutTime_GNMM" SG_ 1033 HEV_HybPwrtrnRdcdPerfCmnd 0;
BA_ "GenSigTimeoutTime_HCP" SG_ 1033 HEV_HybPwrtrnRdcdPerfCmnd 0;
BA_ "GenSigTimeoutTime_IPC" SG_ 1033 HEV_HybPwrtrnRdcdPerfCmnd 0;
BA_ "GenSigTimeoutTime_RFHM" SG_ 1033 HEV_HybPwrtrnRdcdPerfCmnd 0;
BA_ "GenSigTimeoutTime_SGW" SG_ 1033 HEV_HybPwrtrnRdcdPerfCmnd 0;
BA_ "GenSigTimeoutTime_TCM" SG_ 1033 HEV_HybPwrtrnRdcdPerfCmnd 0;
BA_ "GenSigTimeoutTime_AGSM" SG_ 1033 Hybrid_AGS2Position 0;
BA_ "GenSigTimeoutTime_BCM" SG_ 1033 Hybrid_AGS2Position 0;
BA_ "GenSigTimeoutTime_BSM" SG_ 1033 Hybrid_AGS2Position 0;
BA_ "GenSigTimeoutTime_CADM" SG_ 1033 Hybrid_AGS2Position 0;
BA_ "GenSigTimeoutTime_DMSM" SG_ 1033 Hybrid_AGS2Position 0;
BA_ "GenSigTimeoutTime_DTCM" SG_ 1033 Hybrid_AGS2Position 0;
BA_ "GenSigTimeoutTime_EVCU2" SG_ 1033 Hybrid_AGS2Position 0;
BA_ "GenSigTimeoutTime_GNMM" SG_ 1033 Hybrid_AGS2Position 0;
BA_ "GenSigTimeoutTime_HCP" SG_ 1033 Hybrid_AGS2Position 0;
BA_ "GenSigTimeoutTime_IPC" SG_ 1033 Hybrid_AGS2Position 0;
BA_ "GenSigTimeoutTime_RFHM" SG_ 1033 Hybrid_AGS2Position 0;
BA_ "GenSigTimeoutTime_SGW" SG_ 1033 Hybrid_AGS2Position 0;
BA_ "GenSigTimeoutTime_TCM" SG_ 1033 Hybrid_AGS2Position 0;
BA_ "GenSigTimeoutTime_AGSM" SG_ 1033 Hybrid_AGSPosition 0;
BA_ "GenSigTimeoutTime_BCM" SG_ 1033 Hybrid_AGSPosition 0;
BA_ "GenSigTimeoutTime_BSM" SG_ 1033 Hybrid_AGSPosition 0;
BA_ "GenSigTimeoutTime_CADM" SG_ 1033 Hybrid_AGSPosition 0;
BA_ "GenSigTimeoutTime_DMSM" SG_ 1033 Hybrid_AGSPosition 0;
BA_ "GenSigTimeoutTime_DTCM" SG_ 1033 Hybrid_AGSPosition 0;
BA_ "GenSigTimeoutTime_EVCU2" SG_ 1033 Hybrid_AGSPosition 0;
BA_ "GenSigTimeoutTime_GNMM" SG_ 1033 Hybrid_AGSPosition 0;
BA_ "GenSigTimeoutTime_HCP" SG_ 1033 Hybrid_AGSPosition 0;
BA_ "GenSigTimeoutTime_IPC" SG_ 1033 Hybrid_AGSPosition 0;
BA_ "GenSigTimeoutTime_RFHM" SG_ 1033 Hybrid_AGSPosition 0;
BA_ "GenSigTimeoutTime_SGW" SG_ 1033 Hybrid_AGSPosition 0;
BA_ "GenSigTimeoutTime_TCM" SG_ 1033 Hybrid_AGSPosition 0;
BA_ "GenSigTimeoutTime_AGSM" SG_ 1033 Hybrid_EVT_ModeSts 0;
BA_ "GenSigTimeoutTime_BSM" SG_ 1033 Hybrid_EVT_ModeSts 0;
BA_ "GenSigTimeoutTime_CADM" SG_ 1033 Hybrid_EVT_ModeSts 0;
BA_ "GenSigTimeoutTime_DMSM" SG_ 1033 Hybrid_EVT_ModeSts 0;
BA_ "GenSigTimeoutTime_DTCM" SG_ 1033 Hybrid_EVT_ModeSts 0;
BA_ "GenSigTimeoutTime_ECM" SG_ 1033 Hybrid_EVT_ModeSts 0;
BA_ "GenSigTimeoutTime_EVCU2" SG_ 1033 Hybrid_EVT_ModeSts 0;
BA_ "GenSigTimeoutTime_GNMM" SG_ 1033 Hybrid_EVT_ModeSts 0;
BA_ "GenSigTimeoutTime_HCP" SG_ 1033 Hybrid_EVT_ModeSts 0;
BA_ "GenSigTimeoutTime_IPC" SG_ 1033 Hybrid_EVT_ModeSts 0;
BA_ "GenSigTimeoutTime_RFHM" SG_ 1033 Hybrid_EVT_ModeSts 0;
BA_ "GenSigTimeoutTime_TCM" SG_ 1033 Hybrid_EVT_ModeSts 0;
BA_ "GenSigTimeoutTime_AGSM" SG_ 1033 HybridEmissionsMalfunction 0;
BA_ "GenSigTimeoutTime_BCM" SG_ 1033 HybridEmissionsMalfunction 0;
BA_ "GenSigTimeoutTime_BSM" SG_ 1033 HybridEmissionsMalfunction 0;
BA_ "GenSigTimeoutTime_CADM" SG_ 1033 HybridEmissionsMalfunction 0;
BA_ "GenSigTimeoutTime_DMSM" SG_ 1033 HybridEmissionsMalfunction 0;
BA_ "GenSigTimeoutTime_DTCM" SG_ 1033 HybridEmissionsMalfunction 0;
BA_ "GenSigTimeoutTime_ECM" SG_ 1033 HybridEmissionsMalfunction 0;
BA_ "GenSigTimeoutTime_EVCU2" SG_ 1033 HybridEmissionsMalfunction 0;
BA_ "GenSigTimeoutTime_GNMM" SG_ 1033 HybridEmissionsMalfunction 0;
BA_ "GenSigTimeoutTime_HCP" SG_ 1033 HybridEmissionsMalfunction 0;
BA_ "GenSigTimeoutTime_IPC" SG_ 1033 HybridEmissionsMalfunction 0;
BA_ "GenSigTimeoutTime_RFHM" SG_ 1033 HybridEmissionsMalfunction 0;
BA_ "GenSigTimeoutTime_SGW" SG_ 1033 HybridEmissionsMalfunction 0;
BA_ "GenSigTimeoutTime_TCM" SG_ 1033 HybridEmissionsMalfunction 0;
BA_ "GenSigStartValue" SG_ 1033 IdleCLoopTrq 511;
BA_ "GenSigTimeoutTime_AGSM" SG_ 1033 IdleCLoopTrq 0;
BA_ "GenSigTimeoutTime_BCM" SG_ 1033 IdleCLoopTrq 0;
BA_ "GenSigTimeoutTime_BSM" SG_ 1033 IdleCLoopTrq 0;
BA_ "GenSigTimeoutTime_CADM" SG_ 1033 IdleCLoopTrq 0;
BA_ "GenSigTimeoutTime_DMSM" SG_ 1033 IdleCLoopTrq 0;
BA_ "GenSigTimeoutTime_DTCM" SG_ 1033 IdleCLoopTrq 0;
BA_ "GenSigTimeoutTime_EVCU2" SG_ 1033 IdleCLoopTrq 0;
BA_ "GenSigTimeoutTime_GNMM" SG_ 1033 IdleCLoopTrq 0;
BA_ "GenSigTimeoutTime_HCP" SG_ 1033 IdleCLoopTrq 0;
BA_ "GenSigTimeoutTime_IPC" SG_ 1033 IdleCLoopTrq 0;
BA_ "GenSigTimeoutTime_RFHM" SG_ 1033 IdleCLoopTrq 0;
BA_ "GenSigTimeoutTime_SGW" SG_ 1033 IdleCLoopTrq 0;
BA_ "GenSigTimeoutTime_TCM" SG_ 1033 IdleCLoopTrq 0;
BA_ "SystemSignalLongSymbol" SG_ 1033 MessageCounter_HYBRID_POWERTRAI "MessageCounter_HYBRID_POWERTRAIN5";
BA_ "GenSigTimeoutTime_AGSM" SG_ 1033 MessageCounter_HYBRID_POWERTRAI 0;
BA_ "GenSigTimeoutTime_BCM" SG_ 1033 MessageCounter_HYBRID_POWERTRAI 0;
BA_ "GenSigTimeoutTime_BSM" SG_ 1033 MessageCounter_HYBRID_POWERTRAI 0;
BA_ "GenSigTimeoutTime_CADM" SG_ 1033 MessageCounter_HYBRID_POWERTRAI 0;
BA_ "GenSigTimeoutTime_DMSM" SG_ 1033 MessageCounter_HYBRID_POWERTRAI 0;
BA_ "GenSigTimeoutTime_DTCM" SG_ 1033 MessageCounter_HYBRID_POWERTRAI 0;
BA_ "GenSigTimeoutTime_EVCU2" SG_ 1033 MessageCounter_HYBRID_POWERTRAI 0;
BA_ "GenSigTimeoutTime_GNMM" SG_ 1033 MessageCounter_HYBRID_POWERTRAI 0;
BA_ "GenSigTimeoutTime_HCP" SG_ 1033 MessageCounter_HYBRID_POWERTRAI 0;
BA_ "GenSigTimeoutTime_IPC" SG_ 1033 MessageCounter_HYBRID_POWERTRAI 0;
BA_ "GenSigTimeoutTime_RFHM" SG_ 1033 MessageCounter_HYBRID_POWERTRAI 0;
BA_ "GenSigTimeoutTime_SGW" SG_ 1033 MessageCounter_HYBRID_POWERTRAI 0;
BA_ "GenSigTimeoutTime_AGSM" SG_ 1033 Motor1PowerUse_Display 0;
BA_ "GenSigTimeoutTime_BCM" SG_ 1033 Motor1PowerUse_Display 0;
BA_ "GenSigTimeoutTime_BSM" SG_ 1033 Motor1PowerUse_Display 0;
BA_ "GenSigTimeoutTime_CADM" SG_ 1033 Motor1PowerUse_Display 0;
BA_ "GenSigTimeoutTime_DMSM" SG_ 1033 Motor1PowerUse_Display 0;
BA_ "GenSigTimeoutTime_DTCM" SG_ 1033 Motor1PowerUse_Display 0;
BA_ "GenSigTimeoutTime_ECM" SG_ 1033 Motor1PowerUse_Display 0;
BA_ "GenSigTimeoutTime_EVCU2" SG_ 1033 Motor1PowerUse_Display 0;
BA_ "GenSigTimeoutTime_GNMM" SG_ 1033 Motor1PowerUse_Display 0;
BA_ "GenSigTimeoutTime_HCP" SG_ 1033 Motor1PowerUse_Display 0;
BA_ "GenSigTimeoutTime_IPC" SG_ 1033 Motor1PowerUse_Display 0;
BA_ "GenSigTimeoutTime_RFHM" SG_ 1033 Motor1PowerUse_Display 0;
BA_ "GenSigTimeoutTime_TCM" SG_ 1033 Motor1PowerUse_Display 0;
BA_ "GenSigTimeoutTime_AGSM" SG_ 1033 Motor1PowerUse_DisplayV 0;
BA_ "GenSigTimeoutTime_BCM" SG_ 1033 Motor1PowerUse_DisplayV 0;
BA_ "GenSigTimeoutTime_BSM" SG_ 1033 Motor1PowerUse_DisplayV 0;
BA_ "GenSigTimeoutTime_CADM" SG_ 1033 Motor1PowerUse_DisplayV 0;
BA_ "GenSigTimeoutTime_DMSM" SG_ 1033 Motor1PowerUse_DisplayV 0;
BA_ "GenSigTimeoutTime_DTCM" SG_ 1033 Motor1PowerUse_DisplayV 0;
BA_ "GenSigTimeoutTime_ECM" SG_ 1033 Motor1PowerUse_DisplayV 0;
BA_ "GenSigTimeoutTime_EVCU2" SG_ 1033 Motor1PowerUse_DisplayV 0;
BA_ "GenSigTimeoutTime_GNMM" SG_ 1033 Motor1PowerUse_DisplayV 0;
BA_ "GenSigTimeoutTime_HCP" SG_ 1033 Motor1PowerUse_DisplayV 0;
BA_ "GenSigTimeoutTime_IPC" SG_ 1033 Motor1PowerUse_DisplayV 0;
BA_ "GenSigTimeoutTime_RFHM" SG_ 1033 Motor1PowerUse_DisplayV 0;
BA_ "GenSigTimeoutTime_TCM" SG_ 1033 Motor1PowerUse_DisplayV 0;
BA_ "GenSigTimeoutTime_AGSM" SG_ 1033 Motor2PowerUse_Display 0;
BA_ "GenSigTimeoutTime_BCM" SG_ 1033 Motor2PowerUse_Display 0;
BA_ "GenSigTimeoutTime_BSM" SG_ 1033 Motor2PowerUse_Display 0;
BA_ "GenSigTimeoutTime_CADM" SG_ 1033 Motor2PowerUse_Display 0;
BA_ "GenSigTimeoutTime_DMSM" SG_ 1033 Motor2PowerUse_Display 0;
BA_ "GenSigTimeoutTime_DTCM" SG_ 1033 Motor2PowerUse_Display 0;
BA_ "GenSigTimeoutTime_ECM" SG_ 1033 Motor2PowerUse_Display 0;
BA_ "GenSigTimeoutTime_EVCU2" SG_ 1033 Motor2PowerUse_Display 0;
BA_ "GenSigTimeoutTime_GNMM" SG_ 1033 Motor2PowerUse_Display 0;
BA_ "GenSigTimeoutTime_HCP" SG_ 1033 Motor2PowerUse_Display 0;
BA_ "GenSigTimeoutTime_IPC" SG_ 1033 Motor2PowerUse_Display 0;
BA_ "GenSigTimeoutTime_RFHM" SG_ 1033 Motor2PowerUse_Display 0;
BA_ "GenSigTimeoutTime_TCM" SG_ 1033 Motor2PowerUse_Display 0;
BA_ "GenSigTimeoutTime_AGSM" SG_ 1033 Motor2PowerUse_DisplayV 0;
BA_ "GenSigTimeoutTime_BCM" SG_ 1033 Motor2PowerUse_DisplayV 0;
BA_ "GenSigTimeoutTime_BSM" SG_ 1033 Motor2PowerUse_DisplayV 0;
BA_ "GenSigTimeoutTime_CADM" SG_ 1033 Motor2PowerUse_DisplayV 0;
BA_ "GenSigTimeoutTime_DMSM" SG_ 1033 Motor2PowerUse_DisplayV 0;
BA_ "GenSigTimeoutTime_DTCM" SG_ 1033 Motor2PowerUse_DisplayV 0;
BA_ "GenSigTimeoutTime_ECM" SG_ 1033 Motor2PowerUse_DisplayV 0;
BA_ "GenSigTimeoutTime_EVCU2" SG_ 1033 Motor2PowerUse_DisplayV 0;
BA_ "GenSigTimeoutTime_GNMM" SG_ 1033 Motor2PowerUse_DisplayV 0;
BA_ "GenSigTimeoutTime_HCP" SG_ 1033 Motor2PowerUse_DisplayV 0;
BA_ "GenSigTimeoutTime_IPC" SG_ 1033 Motor2PowerUse_DisplayV 0;
BA_ "GenSigTimeoutTime_RFHM" SG_ 1033 Motor2PowerUse_DisplayV 0;
BA_ "GenSigTimeoutTime_TCM" SG_ 1033 Motor2PowerUse_DisplayV 0;
BA_ "GenSigTimeoutTime_AGSM" SG_ 1033 MotorsPowerUse_Display 0;
BA_ "GenSigTimeoutTime_BCM" SG_ 1033 MotorsPowerUse_Display 0;
BA_ "GenSigTimeoutTime_BSM" SG_ 1033 MotorsPowerUse_Display 0;
BA_ "GenSigTimeoutTime_CADM" SG_ 1033 MotorsPowerUse_Display 0;
BA_ "GenSigTimeoutTime_DMSM" SG_ 1033 MotorsPowerUse_Display 0;
BA_ "GenSigTimeoutTime_DTCM" SG_ 1033 MotorsPowerUse_Display 0;
BA_ "GenSigTimeoutTime_ECM" SG_ 1033 MotorsPowerUse_Display 0;
BA_ "GenSigTimeoutTime_EVCU2" SG_ 1033 MotorsPowerUse_Display 0;
BA_ "GenSigTimeoutTime_GNMM" SG_ 1033 MotorsPowerUse_Display 0;
BA_ "GenSigTimeoutTime_HCP" SG_ 1033 MotorsPowerUse_Display 0;
BA_ "GenSigTimeoutTime_IPC" SG_ 1033 MotorsPowerUse_Display 0;
BA_ "GenSigTimeoutTime_RFHM" SG_ 1033 MotorsPowerUse_Display 0;
BA_ "GenSigTimeoutTime_TCM" SG_ 1033 MotorsPowerUse_Display 0;
BA_ "GenSigTimeoutTime_AGSM" SG_ 1033 MotorsPowerUse_DisplayV 0;
BA_ "GenSigTimeoutTime_BCM" SG_ 1033 MotorsPowerUse_DisplayV 0;
BA_ "GenSigTimeoutTime_BSM" SG_ 1033 MotorsPowerUse_DisplayV 0;
BA_ "GenSigTimeoutTime_CADM" SG_ 1033 MotorsPowerUse_DisplayV 0;
BA_ "GenSigTimeoutTime_DMSM" SG_ 1033 MotorsPowerUse_DisplayV 0;
BA_ "GenSigTimeoutTime_DTCM" SG_ 1033 MotorsPowerUse_DisplayV 0;
BA_ "GenSigTimeoutTime_ECM" SG_ 1033 MotorsPowerUse_DisplayV 0;
BA_ "GenSigTimeoutTime_EVCU2" SG_ 1033 MotorsPowerUse_DisplayV 0;
BA_ "GenSigTimeoutTime_GNMM" SG_ 1033 MotorsPowerUse_DisplayV 0;
BA_ "GenSigTimeoutTime_HCP" SG_ 1033 MotorsPowerUse_DisplayV 0;
BA_ "GenSigTimeoutTime_IPC" SG_ 1033 MotorsPowerUse_DisplayV 0;
BA_ "GenSigTimeoutTime_RFHM" SG_ 1033 MotorsPowerUse_DisplayV 0;
BA_ "GenSigTimeoutTime_TCM" SG_ 1033 MotorsPowerUse_DisplayV 0;
BA_ "GenSigTimeoutTime_AGSM" SG_ 1033 PT_WorkSite_Invtr_Capacity_HCP 0;
BA_ "GenSigTimeoutTime_BSM" SG_ 1033 PT_WorkSite_Invtr_Capacity_HCP 0;
BA_ "GenSigTimeoutTime_CADM" SG_ 1033 PT_WorkSite_Invtr_Capacity_HCP 0;
BA_ "GenSigTimeoutTime_DMSM" SG_ 1033 PT_WorkSite_Invtr_Capacity_HCP 0;
BA_ "GenSigTimeoutTime_DTCM" SG_ 1033 PT_WorkSite_Invtr_Capacity_HCP 0;
BA_ "GenSigTimeoutTime_ECM" SG_ 1033 PT_WorkSite_Invtr_Capacity_HCP 0;
BA_ "GenSigTimeoutTime_EVCU2" SG_ 1033 PT_WorkSite_Invtr_Capacity_HCP 0;
BA_ "GenSigTimeoutTime_GNMM" SG_ 1033 PT_WorkSite_Invtr_Capacity_HCP 0;
BA_ "GenSigTimeoutTime_HCP" SG_ 1033 PT_WorkSite_Invtr_Capacity_HCP 0;
BA_ "GenSigTimeoutTime_IPC" SG_ 1033 PT_WorkSite_Invtr_Capacity_HCP 0;
BA_ "GenSigTimeoutTime_RFHM" SG_ 1033 PT_WorkSite_Invtr_Capacity_HCP 0;
BA_ "GenSigTimeoutTime_SGW" SG_ 1033 PT_WorkSite_Invtr_Capacity_HCP 0;
BA_ "GenSigTimeoutTime_TCM" SG_ 1033 PT_WorkSite_Invtr_Capacity_HCP 0;
BA_ "GenSigTimeoutTime_AGSM" SG_ 1033 PT_WorkSite_Invtr_Sts_HCP 0;
BA_ "GenSigTimeoutTime_BSM" SG_ 1033 PT_WorkSite_Invtr_Sts_HCP 0;
BA_ "GenSigTimeoutTime_CADM" SG_ 1033 PT_WorkSite_Invtr_Sts_HCP 0;
BA_ "GenSigTimeoutTime_DMSM" SG_ 1033 PT_WorkSite_Invtr_Sts_HCP 0;
BA_ "GenSigTimeoutTime_DTCM" SG_ 1033 PT_WorkSite_Invtr_Sts_HCP 0;
BA_ "GenSigTimeoutTime_ECM" SG_ 1033 PT_WorkSite_Invtr_Sts_HCP 0;
BA_ "GenSigTimeoutTime_EVCU2" SG_ 1033 PT_WorkSite_Invtr_Sts_HCP 0;
BA_ "GenSigTimeoutTime_GNMM" SG_ 1033 PT_WorkSite_Invtr_Sts_HCP 0;
BA_ "GenSigTimeoutTime_HCP" SG_ 1033 PT_WorkSite_Invtr_Sts_HCP 0;
BA_ "GenSigTimeoutTime_IPC" SG_ 1033 PT_WorkSite_Invtr_Sts_HCP 0;
BA_ "GenSigTimeoutTime_RFHM" SG_ 1033 PT_WorkSite_Invtr_Sts_HCP 0;
BA_ "GenSigTimeoutTime_SGW" SG_ 1033 PT_WorkSite_Invtr_Sts_HCP 0;
BA_ "GenSigTimeoutTime_TCM" SG_ 1033 PT_WorkSite_Invtr_Sts_HCP 0;
BA_ "GenSigTimeoutTime_AGSM" SG_ 1033 Smartload_Actv 0;
BA_ "GenSigTimeoutTime_BCM" SG_ 1033 Smartload_Actv 0;
BA_ "GenSigTimeoutTime_BSM" SG_ 1033 Smartload_Actv 0;
BA_ "GenSigTimeoutTime_CADM" SG_ 1033 Smartload_Actv 0;
BA_ "GenSigTimeoutTime_DMSM" SG_ 1033 Smartload_Actv 0;
BA_ "GenSigTimeoutTime_DTCM" SG_ 1033 Smartload_Actv 0;
BA_ "GenSigTimeoutTime_EVCU2" SG_ 1033 Smartload_Actv 0;
BA_ "GenSigTimeoutTime_GNMM" SG_ 1033 Smartload_Actv 0;
BA_ "GenSigTimeoutTime_HCP" SG_ 1033 Smartload_Actv 0;
BA_ "GenSigTimeoutTime_IPC" SG_ 1033 Smartload_Actv 0;
BA_ "GenSigTimeoutTime_RFHM" SG_ 1033 Smartload_Actv 0;
BA_ "GenSigTimeoutTime_SGW" SG_ 1033 Smartload_Actv 0;
BA_ "GenSigTimeoutTime_TCM" SG_ 1033 Smartload_Actv 0;
BA_ "GenSigTimeoutTime_AGSM" SG_ 1580 V2H_Discharge_Capacity 0;
BA_ "GenSigTimeoutTime_BCM" SG_ 1580 V2H_Discharge_Capacity 0;
BA_ "GenSigTimeoutTime_BSM" SG_ 1580 V2H_Discharge_Capacity 0;
BA_ "GenSigTimeoutTime_CADM" SG_ 1580 V2H_Discharge_Capacity 0;
BA_ "GenSigTimeoutTime_DMSM" SG_ 1580 V2H_Discharge_Capacity 0;
BA_ "GenSigTimeoutTime_DTCM" SG_ 1580 V2H_Discharge_Capacity 0;
BA_ "GenSigTimeoutTime_ECM" SG_ 1580 V2H_Discharge_Capacity 0;
BA_ "GenSigTimeoutTime_EVCU2" SG_ 1580 V2H_Discharge_Capacity 0;
BA_ "GenSigTimeoutTime_GNMM" SG_ 1580 V2H_Discharge_Capacity 0;
BA_ "GenSigTimeoutTime_HCP" SG_ 1580 V2H_Discharge_Capacity 0;
BA_ "GenSigTimeoutTime_IPC" SG_ 1580 V2H_Discharge_Capacity 0;
BA_ "GenSigTimeoutTime_RFHM" SG_ 1580 V2H_Discharge_Capacity 0;
BA_ "GenSigTimeoutTime_TCM" SG_ 1580 V2H_Discharge_Capacity 0;
VAL_ 1846 Big_ECU_Ready_CADM 0 "Not Ready" 1 "Ready for Transfer" 2 "ECU ID not Downloaded" 3 "Ready for Install";
VAL_ 1846 Download_Status_CADM 0 "Not Downloading" 1 "Download in Progress" 2 "Download Completed" 3 "Fault Download Failed";
VAL_ 1846 Update_Status_CADM 0 "Not Updating" 1 "Update in Progress" 2 "Update Completed" 3 "Fault Update Failed";
VAL_ 1825 Ready_Status_EVCU2 0 "Eval_in_progress_default_value" 1 "Proceed_with_FOTA" 2 "Abort_FOTA";
VAL_ 525 Altitude_RMSE 254 "OutOfRange" 255 "SNA";
VAL_ 525 GNMM_Health 0 "Not_Avail" 1 "Avail_full_capacity" 2 "Primary_IMU_NA" 3 "GPS_GNSS_NA" 4 "Correction_Data_NA" 7 "SNA";
VAL_ 525 Heading_Angle 65535 "SNA";
VAL_ 525 Lat_GNMM 4294967295 "SNA";
VAL_ 525 LatAcceleration_GNMM 4095 "SNA";
VAL_ 525 LateralVelocity_GNMM 16383 "SNA";
VAL_ 525 Latitude_RMSE 254 "OutOfRange" 255 "SNA";
VAL_ 525 Long_GNMM 4294967295 "SNA";
VAL_ 525 LongAcceleration_GNMM 4095 "SNA";
VAL_ 525 Longitude_RMSE 254 "OutOfRange" 255 "SNA";
VAL_ 525 LongitudinalVelocity_GNMM 16383 "SNA";
VAL_ 525 Pitch_RMSE 254 "OutOfRange" 255 "SNA";
VAL_ 525 PitchRate_GNMM 4095 "SNA";
VAL_ 525 Roll_RMSE 254 "OutOfRange" 255 "SNA";
VAL_ 525 RollRate_GNMM 4095 "SNA";
VAL_ 525 VerticalAcceleration_GNMM 4095 "SNA";
VAL_ 525 VerticalVelocity_GNMM 16383 "SNA";
VAL_ 525 YawRate_GNMM 32767 "SNA";
VAL_ 525 YawRate_RMSE 254 "OutOfRange" 255 "SNA";
VAL_ 1487 Chargeport_Lock_Status 0 "Default" 1 "Locked" 2 "Unlocked" 3 "reserved";
VAL_ 1487 Cooperative_Status 0 "Default" 1 "Regular_Charging" 2 "External_Charging" 3 "ChargeNow_Override" 4 "Other_reason";
VAL_ 1487 Energy_to_Battery 511 "SNA";
VAL_ 1487 Est_Range_FullCharge 2047 "SNA";
VAL_ 1487 EV_Charge_Current 2047 "SNA";
VAL_ 1487 EVSE_Power 511 "SNA";
VAL_ 1487 Lv1_EstChargeTime_80 8191 "SNA";
VAL_ 1487 Lv2_EstChargeTime_80 8191 "SNA";
VAL_ 1487 Total_Battery_Capacity 4095 "SNA";
VAL_ 266 HVBatCellVoltage_Max 8191 "SNA";
VAL_ 266 HVBatCellVoltage_Min 8191 "SNA";
VAL_ 266 HVBatContactorSts 0 "Open" 1 "Precharging" 2 "Closed" 3 "Precharge_Failed" 4 "Precharge_Inhibited" 7 "SNA";
VAL_ 266 HVBatteryCurrent 16383 "SNA";
VAL_ 266 HVBatteryVoltage 4095 "SNA";
VAL_ 266 IsolationSts_HVBattery 0 "N_S" 1 "PASS" 2 "FAIL" 3 "INV";
VAL_ 266 IsolationSts_HVPowertrain 0 "N_S" 1 "PASS" 2 "FAIL" 3 "INV";
VAL_ 1027 HVBatteryMILRequest 0 "FALSE" 1 "TRUE";
VAL_ 1834 HVBattery_RealTimeClock 4294967295 "SNA";
VAL_ 1834 HVBattery_RealTimeClockV 0 "Valid" 1 "Not_Valid";
VAL_ 1579 ChargeSystemSts 0 "NotCharging" 1 "Charging" 2 "ChargeInterrupted" 3 "ChargeComplete" 4 "ChargeError" 7 "SNA";
VAL_ 1049 BatteryPowerUsageV 0 "Valid" 1 "Not_Valid";
VAL_ 1049 BatteryPowerUse_DisplayV 0 "Valid" 1 "Not_Valid";
VAL_ 1049 ChargeSystemFault_DPT 0 "Not_Faulted" 1 "Faulted";
VAL_ 1049 ChargeSystemSts_DPT 0 "NotCharging" 1 "Charging" 2 "ChargeInterrupted" 3 "ChargeComplete" 7 "SNA";
VAL_ 1049 ChargingLevelForDisplay 0 "Default_NoLevel" 1 "Level_1_AC" 2 "Level_2_AC" 3 "Level_3_AC" 4 "Level_1_DC" 5 "Level_2_DC" 6 "PlugInNotDet" 7 "PPI_1_No_Drive" 8 "PPI_2_OK_Drive" 15 "SNA";
VAL_ 1049 EnginePowerUse_DisplayV 0 "Valid" 1 "Not_Valid";
VAL_ 1049 EstimatedRange 255 "SNA";
VAL_ 1049 FOTA_Schedule_Conflict 0 "False" 1 "True";
VAL_ 1049 HCP_EVServiceLampOn 0 "OFF" 1 "ON" 2 "BLINK" 3 "SNA";
VAL_ 1049 HVACPowerUse_DisplayV 0 "Valid" 1 "Not_Valid";
VAL_ 1049 HVBatterySOC_DisplayV 0 "Valid" 1 "Not_Valid";
VAL_ 1049 HybridEfficiencyCoachV 0 "Valid" 1 "Invalid";
VAL_ 1049 HybridMILRequest 0 "Not_Active" 1 "Active";
VAL_ 1049 HybridOutputPowerV 0 "Valid" 1 "Invalid";
VAL_ 1049 Lv1_EstChargeTime 8191 "SNA";
VAL_ 1049 Lv2_EstChargeTime 2047 "SNA";
VAL_ 1049 OnePedal_Drive_Sts 0 "Off" 1 "On" 2 "Unavailable";
VAL_ 1049 PlugAndChargeSts 0 "Inactive" 1 "Active";
VAL_ 1049 PopUpMessage1 0 "False" 1 "True";
VAL_ 1049 PopUpMessage10 0 "False" 1 "True";
VAL_ 1049 PopUpMessage11 0 "False" 1 "True";
VAL_ 1049 PopUpMessage15 0 "Not_Active" 1 "Active";
VAL_ 1049 PopUpMessage2 0 "False" 1 "True";
VAL_ 1049 PopUpMessage3 0 "False" 1 "True";
VAL_ 1049 PopUpMessage4 0 "False" 1 "True";
VAL_ 1049 PopUpMessage5 0 "False" 1 "True";
VAL_ 1049 PopUpMessage6 0 "False" 1 "True";
VAL_ 1049 PopUpMessage7 0 "False" 1 "True";
VAL_ 1049 PopUpMessage9 0 "False" 1 "True";
VAL_ 1049 RefrigerantPressure 511 "SNA";
VAL_ 1049 Regen_Status 0 "unavailable " 1 "Level1" 2 "Level2" 3 "Level3" 4 "Level4" 5 "Level5";
VAL_ 1044 AWD_Failure_Status 0 "Not_Active" 1 "Active";
VAL_ 1044 BPCM_HV_Temp_Avg 2047 "SNA";
VAL_ 1044 DischargingSysStatus 0 "Inactive" 1 "Active" 2 "Faulted" 3 "SNA";
VAL_ 1044 PnC_Failure 0 "No_Failure" 1 "Failure";
VAL_ 1044 PnC_Reattepmt_Failure 0 "No_Failure" 1 "Failure";
VAL_ 1044 RI_AC_FAN_Range 1023 "SNA";
VAL_ 1044 RI_AUDIO_Range 1023 "SNA";
VAL_ 1044 RI_DEFROST_Range 511 "SNA";
VAL_ 1044 RI_LIGHTS_Range 511 "SNA";
VAL_ 1044 RI_SEATSWHL_Range 511 "SNA";
VAL_ 1044 RI_TOTAL_Range_Add 2047 "SNA";
VAL_ 1952 CabinConditioningSts 0 "Default" 1 "Preconditioning will be rejected-not plugged in" 2 "Preconditioning stopped due to SOC" 3 "Preconditioning" 4 "Cabin set point reached" 5 "Preconditioning off " 6 "Preconditioning failed due to other conditions than HV Battery temperature " 7 "Preconditioning fails due to HV battery temperature" 8 "Battery conditioning complete and the HV battery is ok" 9 "Battery Conditioning stopped before complete and the HV battery is not ok  " 15 "SNA";
VAL_ 1952 CabinPreconditionReqSts 0 "DEFAULT" 1 "PRE" 2 "SPR" 3 "PRE_OFF" 4 "PRF" 5 "NOT_OK" 6 "BCC" 7 "BCS" 8 "STOPPED_DUE_TO_SOC" 9 "EJECTED_NOT_PLUGGED_IN" 15 "SNA";
VAL_ 1952 CompressorState 0 "NormalOperation" 1 "DegradedOperation" 2 "Inoperative" 3 "Reserved1" 4 "Reserved2" 5 "Reserved3" 6 "Reserved4" 15 "SNA";
VAL_ 1952 ElecClntHtrInletTemp 255 "SNA";
VAL_ 1952 ElecCoolantHtrPwr 255 "SNA";
VAL_ 1952 FRfShVlvSts 0 "Open" 1 "Closed";
VAL_ 1952 HeaterCoreInletTemp 255 "SNA";
VAL_ 1952 HTAuxPmpMontrngRPM 0 "TRUE" 1 "FALSE" 3 "SNA";
VAL_ 1952 HTAuxPmpRPMAct 255 "SNA";
VAL_ 1952 HTShtOffVlvReq 0 "Open" 1 "Closed";
VAL_ 1952 HVBatCoolantLevelLow_DPT 0 "False" 1 "True" 3 "SNA";
VAL_ 1952 HVBatCritCondT 0 "False" 1 "True";
VAL_ 1952 Sch_PreCondition_Sts 0 "False" 1 "True" 3 "SNA";
VAL_ 1952 SchCond_Time_Till_Dep 127 "SNA";
VAL_ 276 Belt_Slip_Detected 0 "False" 1 "True";
VAL_ 276 BSGMaxTrqDyn 1023 "SNA";
VAL_ 276 BSGMinTrqDyn 1023 "SNA";
VAL_ 276 DriveMode_PopUpRequest 0 "TM0" 1 "TM1" 2 "TM2" 3 "TM3" 4 "TM4" 5 "TM5" 6 "TM6" 7 "TM7" 8 "TM8" 9 "TM9" 10 "TM10" 11 "TM11" 12 "TM12" 13 "TM13" 14 "TM14" 15 "SNA";
VAL_ 276 DriveModeSts_EPT 0 "Drive_Mode_Unavailable" 1 "Eco_Drive" 2 "Sport_Hybrid" 3 "Extend" 4 "ESave" 8 "Electric" 9 "Blended" 15 "SNA";
VAL_ 276 DriveReady 0 "Default" 1 "Vehicle is allowed to shift out of park or neutral";
VAL_ 276 EngTrqReserveCmd 255 "SNA";
VAL_ 276 HCP_VTD_Freeze 0 "No_reset" 1 "Lifetime_and_Recent_Clear" 2 "Recent_Clear" 3 "Freeze";
VAL_ 276 HEV_ESS_Mode 0 "EngOff" 1 "IS" 2 "STPA" 3 "EFA" 4 "ETS" 5 "PT" 6 "DFA" 7 "SPPA" 8 "SF" 9 "CT" 15 "SNA";
VAL_ 276 HVBatteryShutOff 0 "Not_Active" 1 "Active";
VAL_ 276 HybCmndEngTorqImmed 4095 "SNA";
VAL_ 276 HybCmndEngTorqPrdtd 4095 "SNA";
VAL_ 276 HybCmndEngTorqRespTyp 0 "Inactive" 1 "PL" 2 "MR" 3 "SNA";
VAL_ 276 HybTransSt 0 "INIT" 1 "Neutral_Stable_State" 2 "EVT_Mode1_Stable_State" 3 "EVT_Mode2_Stable_State" 4 "Gear1_Stable_State" 5 "Gear2_Stable_State" 6 "Gear3_Stable_State" 7 "Gear4_Stable_State" 8 "G1_G2_SP" 9 "G1_G2_TP" 10 "G2_G1_SP" 11 "G2_G1_TP" 12 "G2_G3_SP" 13 "G2_G3_TP" 14 "G3_G2_SP" 15 "G3_G2_TP" 16 "G3_G4_SP" 17 "G3_G4_TP" 18 "G4_G3_SP" 19 "G4_G3_TP" 20 "EVT_M1_Gear1_SP" 21 "EVT_M1_Gear2_SP" 22 "EVT_M2_Gear2_SP" 23 "EVT_M2_Gear3_SP" 24 "EVT_M2_Gear4_SP" 25 "Neutral_EVT_M1_Shift" 26 "Neutral_EVT_M2_Shift" 27 "Shift_Neutral" 28 "EVT_M1_EVT_M2_QS" 29 "EVT_M2_EVT_M1_QS" 30 "EVT_M1_SP" 31 "EVT_M2_SP" 32 "G1_Abort_G1G2_TP" 33 "G2_Abort_G2G3_TP" 34 "G3_Abort_G3G4_TP" 35 "G2_Abort_G2G1_TP" 36 "G3_Abort_G3G2_TP" 37 "G4_Abort_G4G3_TP" 38 "Init_Neut" 39 "M3" 40 "NeutToM3" 41 "M1ToM2_PwrOnC2CSpdPhs" 42 "M1ToM2_PwrOnC2CTorqPhs" 43 "M2ToM1_PwrOffC2CSpdPhs" 44 "M2ToM1_PwrOffC2CTorqPhs" 45 "M1ToM3_PwrOnC2CSpdPhs" 46 "M1ToM3_PwrOnC2CTorqPhs" 47 "M3ToM1_PwrOffC2CSpdPhs" 48 "M3ToM1_PwrOffC2CTorqPhs" 49 "M3ToG4" 50 "G2ToG4_PwrOnC2CSpdPhs" 51 "G2ToG4_PwrOnC2CTorqPhs" 52 "G4ToG2_PwrOffC2CSpdPhs" 53 "G4ToG2_PwrOffC2CTorqPhs" 54 "M1Abort_FromM1ToM2_C2CSpdPhs" 55 "M1Abort_FromM1ToM2_C2CTorqPhs" 56 "M1Abort_FromM1ToM3_C2CSpdPhs" 57 "M1Abort_FromM1ToM3_C2CTorqPhs" 58 "M2Abort_FromM2ToM1_C2CSpdPhs" 59 "M2Abort_FromM2ToM1_C2CTorqPhs" 60 "M3Abort" 61 "M3Abort_FromM3ToM1_C2CSpdPhs" 62 "M3Abort_FromM3ToM1_C2CTorqPhs" 63 "INV" 64 "G2Abort_FromG2ToG4_C2CSpdPhs" 65 "G2Abort_FromG2ToG4_C2CTorqPhs" 66 "G4Abort_FromG4ToG2_C2CSpdPhs" 67 "G4Abort_FromG4ToG2_C2CTorqPhs";
VAL_ 276 InputSpdRaw 4095 "SNA";
VAL_ 276 NiTi_Disable 0 "False" 1 "True";
VAL_ 276 PropulsionSystemActive 0 "Not_Active" 1 "Active";
VAL_ 276 RegenTarget 4095 "SNA";
VAL_ 269 BSGActualTorque 1023 "SNA";
VAL_ 269 BSGChrgIdleSpeedTarget 8191 "SNA";
VAL_ 269 CODE_CLR_HCP 0 "Not Clear" 1 "Clear";
VAL_ 269 HybridEngineMaxTorqAllowed 4095 "SNA";
VAL_ 269 REPRGD_PFC_CLR_HCP 0 "Do Nothing" 1 "Set Incomplete";
VAL_ 1033 BattPowerUse_DisplayV 0 "Valid" 1 "Not_Valid";
VAL_ 1033 ElectricTrqMult4Pedal 255 "SNA";
VAL_ 1033 HCPMaxEngRPM 255 "SNA";
VAL_ 1033 Hybrid_AGS2Position 127 "SNA";
VAL_ 1033 Hybrid_AGSPosition 127 "SNA";
VAL_ 1033 Hybrid_EVT_ModeSts 0 "Hybrid Mode" 1 "EVT Mode";
VAL_ 1033 HybridEmissionsMalfunction 0 "Not_Active" 1 "Active";
VAL_ 1033 IdleCLoopTrq 1023 "SNA";
VAL_ 1033 Motor1PowerUse_DisplayV 0 "Valid" 1 "Not_Valid";
VAL_ 1033 Motor2PowerUse_DisplayV 0 "Valid" 1 "Not_Valid";
VAL_ 1033 MotorsPowerUse_DisplayV 0 "Valid" 1 "Not_Valid";
VAL_ 1033 PT_WorkSite_Invtr_Sts_HCP 0 "Not_Active" 1 "Active" 3 "SNA";
VAL_ 1033 Smartload_Actv 0 "Inactive" 1 "Active" 3 "SNA";
